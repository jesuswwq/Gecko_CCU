ASAP2_VERSION 1 31
/begin PROJECT ProjectName "Project Comment Goes Here"
/begin HEADER "Header Comments go here" /end HEADER
/begin MODULE ModuleName "Module Comment Goes Here"
/begin MOD_COMMON "Mod Common Comment Here" BYTE_ORDER MSB_LAST /end MOD_COMMON
/begin RECORD_LAYOUT Scalar_BOOLEAN FNC_VALUES 1 UBYTE COLUMN_DIR DIRECT /end RECORD_LAYOUT
/begin RECORD_LAYOUT Scalar_UBYTE FNC_VALUES 1 UBYTE COLUMN_DIR DIRECT /end RECORD_LAYOUT
/begin RECORD_LAYOUT Scalar_UWORD FNC_VALUES 1 UWORD COLUMN_DIR DIRECT /end RECORD_LAYOUT
/begin RECORD_LAYOUT Scalar_FLOAT32_IEEE FNC_VALUES 1 FLOAT32_IEEE COLUMN_DIR DIRECT /end RECORD_LAYOUT
/begin RECORD_LAYOUT Lookup1D_X_BYTE AXIS_PTS_X 1 SBYTE INDEX_INCR DIRECT /end RECORD_LAYOUT
/begin RECORD_LAYOUT Lookup1D_UBYTE FNC_VALUES 1 UBYTE COLUMN_DIR DIRECT /end RECORD_LAYOUT
/begin RECORD_LAYOUT Lookup1D_X_UWORD AXIS_PTS_X 1 UWORD INDEX_INCR DIRECT /end RECORD_LAYOUT
/begin RECORD_LAYOUT Lookup1D_X_WORD AXIS_PTS_X 1 SWORD INDEX_INCR DIRECT /end RECORD_LAYOUT
/begin RECORD_LAYOUT Lookup1D_ULONG FNC_VALUES 1 ULONG COLUMN_DIR DIRECT /end RECORD_LAYOUT
/begin RECORD_LAYOUT Lookup1D_X_ULONG AXIS_PTS_X 1 ULONG INDEX_INCR DIRECT /end RECORD_LAYOUT
/begin RECORD_LAYOUT Lookup1D_SLONG FNC_VALUES 1 SLONG COLUMN_DIR DIRECT /end RECORD_LAYOUT
/begin RECORD_LAYOUT Lookup1D_X_LONG AXIS_PTS_X 1 SLONG INDEX_INCR DIRECT /end RECORD_LAYOUT
/begin RECORD_LAYOUT Lookup1D_FLOAT32_IEEE FNC_VALUES 1 FLOAT32_IEEE COLUMN_DIR DIRECT /end RECORD_LAYOUT
/begin RECORD_LAYOUT Lookup1D_X_FLOAT32_IEEE AXIS_PTS_X 1 FLOAT32_IEEE INDEX_INCR DIRECT /end RECORD_LAYOUT
/begin RECORD_LAYOUT Lookup1D_FLOAT64_IEEE FNC_VALUES 1 FLOAT64_IEEE COLUMN_DIR DIRECT /end RECORD_LAYOUT
/begin RECORD_LAYOUT Lookup1D_X_FLOAT64_IEEE AXIS_PTS_X 1 FLOAT64_IEEE INDEX_INCR DIRECT /end RECORD_LAYOUT
/begin RECORD_LAYOUT Lookup2D_BOOLEAN FNC_VALUES 1 UBYTE COLUMN_DIR DIRECT /end RECORD_LAYOUT
/begin RECORD_LAYOUT Lookup2D_X_BOOLEAN AXIS_PTS_X 1 UBYTE INDEX_INCR DIRECT /end RECORD_LAYOUT
/begin RECORD_LAYOUT Lookup2D_X_UBYTE AXIS_PTS_X 1 UBYTE INDEX_INCR DIRECT /end RECORD_LAYOUT
/begin RECORD_LAYOUT Lookup2D_FLOAT32_IEEE FNC_VALUES 1 FLOAT32_IEEE COLUMN_DIR DIRECT /end RECORD_LAYOUT
/begin RECORD_LAYOUT Lookup2D_X_FLOAT32_IEEE AXIS_PTS_X 1 FLOAT32_IEEE INDEX_INCR DIRECT /end RECORD_LAYOUT
/begin AXIS_PTS ASYS_HVBatPackTyp_X_Ah "" 0x0000 /* @ECU_Address@ASYS_HVBatPackTyp_X_Ah@ */ NO_INPUT_QUANTITY Lookup2D_X_UBYTE 0 AppSwcVcu_CM_uint8_Ah 10 0.0 255.0 /end AXIS_PTS
/begin AXIS_PTS ARME_BMSBatRptSOC_Y_pct "标准续航查表RPTSOC值" 0x0000 /* @ECU_Address@ARME_BMSBatRptSOC_Y_pct@ */ NO_INPUT_QUANTITY Lookup2D_X_FLOAT32_IEEE 0 AppSwcVcu_CM_single_pct 12 0.0 1000.0 /end AXIS_PTS
/begin CHARACTERISTIC MEMS_CellOverVoltThr_mV "过压闭环控制目标电压" CURVE 0x0000 /* @ECU_Address@MEMS_CellOverVoltThr_mV@ */ Lookup1D_FLOAT32_IEEE 0 AppSwcVcu_CM_single_mV 0.0 10000.0
 /begin AXIS_DESCR COM_AXIS NO_INPUT_QUANTITY AppSwcVcu_CM_uint8_Ah 10 0.0 255.0 AXIS_PTS_REF ASYS_HVBatPackTyp_X_Ah /end AXIS_DESCR
/end CHARACTERISTIC
/begin CHARACTERISTIC MEMS_CellUndrVoltThr1_mV "低温电压闭环控制目标电压" CURVE 0x0000 /* @ECU_Address@MEMS_CellUndrVoltThr1_mV@ */ Lookup1D_FLOAT32_IEEE 0 AppSwcVcu_CM_single_mV 0.0 10000.0
 /begin AXIS_DESCR COM_AXIS NO_INPUT_QUANTITY AppSwcVcu_CM_uint8_Ah 10 0.0 255.0 AXIS_PTS_REF ASYS_HVBatPackTyp_X_Ah /end AXIS_DESCR
/end CHARACTERISTIC
/begin CHARACTERISTIC MEMS_CellUndrVoltThr2_mV "常温电压闭环控制目标电压" CURVE 0x0000 /* @ECU_Address@MEMS_CellUndrVoltThr2_mV@ */ Lookup1D_FLOAT32_IEEE 0 AppSwcVcu_CM_single_mV 0.0 10000.0
 /begin AXIS_DESCR COM_AXIS NO_INPUT_QUANTITY AppSwcVcu_CM_uint8_Ah 10 0.0 255.0 AXIS_PTS_REF ASYS_HVBatPackTyp_X_Ah /end AXIS_DESCR
/end CHARACTERISTIC
/begin CHARACTERISTIC MDAG_BMSSOCLoRecThr1_pct "BMSSOC低故障恢复门槛_低温" CURVE 0x0000 /* @ECU_Address@MDAG_BMSSOCLoRecThr1_pct@ */ Lookup1D_FLOAT32_IEEE 0 AppSwcVcu_CM_single_pct 0.0 100.0
 /begin AXIS_DESCR COM_AXIS NO_INPUT_QUANTITY AppSwcVcu_CM_uint8_Ah 10 0.0 255.0 AXIS_PTS_REF ASYS_HVBatPackTyp_X_Ah /end AXIS_DESCR
/end CHARACTERISTIC
/begin CHARACTERISTIC MDAG_BMSSOCLoRecThr2_pct "BMSSOC低故障恢复门槛_高温" CURVE 0x0000 /* @ECU_Address@MDAG_BMSSOCLoRecThr2_pct@ */ Lookup1D_FLOAT32_IEEE 0 AppSwcVcu_CM_single_pct 0.0 100.0
 /begin AXIS_DESCR COM_AXIS NO_INPUT_QUANTITY AppSwcVcu_CM_uint8_Ah 10 0.0 255.0 AXIS_PTS_REF ASYS_HVBatPackTyp_X_Ah /end AXIS_DESCR
/end CHARACTERISTIC
/begin CHARACTERISTIC MDAG_BMSSOCLoThr1_pct "BMSSOC低故障触发门槛_低温" CURVE 0x0000 /* @ECU_Address@MDAG_BMSSOCLoThr1_pct@ */ Lookup1D_FLOAT32_IEEE 0 AppSwcVcu_CM_single_pct 0.0 100.0
 /begin AXIS_DESCR COM_AXIS NO_INPUT_QUANTITY AppSwcVcu_CM_uint8_Ah 10 0.0 255.0 AXIS_PTS_REF ASYS_HVBatPackTyp_X_Ah /end AXIS_DESCR
/end CHARACTERISTIC
/begin CHARACTERISTIC MDAG_BMSSOCLoThr2_pct "BMSSOC低故障触发门槛_高温" CURVE 0x0000 /* @ECU_Address@MDAG_BMSSOCLoThr2_pct@ */ Lookup1D_FLOAT32_IEEE 0 AppSwcVcu_CM_single_pct 0.0 100.0
 /begin AXIS_DESCR COM_AXIS NO_INPUT_QUANTITY AppSwcVcu_CM_uint8_Ah 10 0.0 255.0 AXIS_PTS_REF ASYS_HVBatPackTyp_X_Ah /end AXIS_DESCR
/end CHARACTERISTIC
/begin CHARACTERISTIC MRME_WLTPStdPwrCnsm_kWh100km "标准工况100km电耗（按照100km折算）" CURVE 0x0000 /* @ECU_Address@MRME_WLTPStdPwrCnsm_kWh100km@ */ Lookup1D_FLOAT32_IEEE 0 AppSwcVcu_CM_single_kWh100km -1000.0 1000.0
 /begin AXIS_DESCR COM_AXIS NO_INPUT_QUANTITY AppSwcVcu_CM_uint8_Ah 10 0.0 255.0 AXIS_PTS_REF ASYS_HVBatPackTyp_X_Ah /end AXIS_DESCR
/end CHARACTERISTIC
/begin CHARACTERISTIC MRME_WLTPStdDwLimFac_c "基于标准续航WLTP最小下限系数(使用电芯温度修正)" CURVE 0x0000 /* @ECU_Address@MRME_WLTPStdDwLimFac_c@ */ Lookup1D_FLOAT32_IEEE 0 AppSwcVcu_CM_single 0.0 100.0
 /begin AXIS_DESCR COM_AXIS NO_INPUT_QUANTITY AppSwcVcu_CM_single_C 6 -100.0 100.0 AXIS_PTS_REF ARME_BMSBatCellTempMin_X_C /end AXIS_DESCR
/end CHARACTERISTIC
/begin AXIS_PTS ARME_BMSBatCellTempMin_X_C "BMS电芯最小温度" 0x0000 /* @ECU_Address@ARME_BMSBatCellTempMin_X_C@ */ NO_INPUT_QUANTITY Lookup1D_X_FLOAT32_IEEE 0 AppSwcVcu_CM_single_C 6 -100.0 100.0 /end AXIS_PTS
/begin CHARACTERISTIC MRME_WLTPStdRmnMil_km "标准续航WLTP查表值" MAP 0x0000 /* @ECU_Address@MRME_WLTPStdRmnMil_km@ */ Lookup2D_FLOAT32_IEEE 0 AppSwcVcu_CM_single_km 0.0 1000.0
 /begin AXIS_DESCR COM_AXIS NO_INPUT_QUANTITY AppSwcVcu_CM_single_pct 12 0.0 1000.0 AXIS_PTS_REF ARME_BMSBatRptSOC_Y_pct /end AXIS_DESCR
 /begin AXIS_DESCR COM_AXIS NO_INPUT_QUANTITY AppSwcVcu_CM_uint8_Ah 10 0.0 255.0 AXIS_PTS_REF ASYS_HVBatPackTyp_X_Ah /end AXIS_DESCR
/end CHARACTERISTIC
/begin CHARACTERISTIC MRME_WLTPStdSOCCnsm_pct100km "标准工况SOC消耗（按100km折算）" CURVE 0x0000 /* @ECU_Address@MRME_WLTPStdSOCCnsm_pct100km@ */ Lookup1D_FLOAT32_IEEE 0 AppSwcVcu_CM_single_pct100km -1000.0 1000.0
 /begin AXIS_DESCR COM_AXIS NO_INPUT_QUANTITY AppSwcVcu_CM_uint8_Ah 10 0.0 255.0 AXIS_PTS_REF ASYS_HVBatPackTyp_X_Ah /end AXIS_DESCR
/end CHARACTERISTIC
/begin CHARACTERISTIC MRME_DynRmnMilEstChgStp_c "动态续航变化速率修正系数（默认以1km为基准）" MAP 0x0000 /* @ECU_Address@MRME_DynRmnMilEstChgStp_c@ */ Lookup2D_FLOAT32_IEEE 0 AppSwcVcu_CM_single_C -100.0 100.0
 /begin AXIS_DESCR COM_AXIS NO_INPUT_QUANTITY AppSwcVcu_CM_single_km 10 -1000.0 1000.0 AXIS_PTS_REF ARME_EstTgtSubDynEstErr_Y_km /end AXIS_DESCR
 /begin AXIS_DESCR COM_AXIS NO_INPUT_QUANTITY AppSwcVcu_CM_single_C 6 -100.0 100.0 AXIS_PTS_REF ARME_BMSBatCellTempMin_X_C /end AXIS_DESCR
/end CHARACTERISTIC
/begin AXIS_PTS ARME_EstTgtSubDynEstErr_Y_km "目标续航与实际续航值差值" 0x0000 /* @ECU_Address@ARME_EstTgtSubDynEstErr_Y_km@ */ NO_INPUT_QUANTITY Lookup2D_X_FLOAT32_IEEE 0 AppSwcVcu_CM_single_km 10 -1000.0 1000.0 /end AXIS_PTS
/begin CHARACTERISTIC MDAC_INVMaxDrgTqWhl_Nm "" CURVE 0x0000 /* @ECU_Address@MDAC_INVMaxDrgTqWhl_Nm@ */ Lookup1D_FLOAT32_IEEE 0 AppSwcVcu_CM_single_Nm -10000.0 10000.0
 /begin AXIS_DESCR COM_AXIS VVTM_VehSpd_kph AppSwcVcu_CM_single_kph 12 -300.0 300.0 AXIS_PTS_REF ADAC_INVMaxDrgTqWhl_X_kph /end AXIS_DESCR
/end CHARACTERISTIC
/begin AXIS_PTS ADAC_INVMaxDrgTqWhl_X_kph "" 0x0000 /* @ECU_Address@ADAC_INVMaxDrgTqWhl_X_kph@ */ VVTM_VehSpd_kph Lookup1D_X_FLOAT32_IEEE 0 AppSwcVcu_CM_single_kph 12 -300.0 300.0 /end AXIS_PTS
/begin CHARACTERISTIC MTQC_RegenMaxTqIncRate_Nmps "" CURVE 0x0000 /* @ECU_Address@MTQC_RegenMaxTqIncRate_Nmps@ */ Lookup1D_FLOAT32_IEEE 0 AppSwcVcu_CM_single_Nmps 0.0 100000.0
 /begin AXIS_DESCR COM_AXIS NO_INPUT_QUANTITY AppSwcVcu_CM_single_Nm 8 -10000.0 10000.0 AXIS_PTS_REF ATQC_RegenMaxTqIncRate_X_Nm /end AXIS_DESCR
/end CHARACTERISTIC
/begin AXIS_PTS ATQC_RegenMaxTqIncRate_X_Nm "" 0x0000 /* @ECU_Address@ATQC_RegenMaxTqIncRate_X_Nm@ */ NO_INPUT_QUANTITY Lookup1D_X_FLOAT32_IEEE 0 AppSwcVcu_CM_single_Nm 8 -10000.0 10000.0 /end AXIS_PTS
/begin CHARACTERISTIC MTQC_RegenMaxTqDecRate_Nmps "" MAP 0x0000 /* @ECU_Address@MTQC_RegenMaxTqDecRate_Nmps@ */ Lookup2D_FLOAT32_IEEE 0 AppSwcVcu_CM_single_Nmps -100000.0 0.0
 /begin AXIS_DESCR COM_AXIS NO_INPUT_QUANTITY AppSwcVcu_CM_single_pct 5 -100.0 200.0 AXIS_PTS_REF ATQC_RegenMaxTqDecRate_Y_pct /end AXIS_DESCR
 /begin AXIS_DESCR COM_AXIS VVTM_VehSpd_kph AppSwcVcu_CM_single_kph 4 -300.0 300.0 AXIS_PTS_REF ATQC_RegenMaxTqDecRate_X_kph /end AXIS_DESCR
/end CHARACTERISTIC
/begin AXIS_PTS ATQC_RegenMaxTqDecRate_X_kph "" 0x0000 /* @ECU_Address@ATQC_RegenMaxTqDecRate_X_kph@ */ VVTM_VehSpd_kph Lookup2D_X_FLOAT32_IEEE 0 AppSwcVcu_CM_single_kph 4 -300.0 300.0 /end AXIS_PTS
/begin AXIS_PTS ATQC_RegenMaxTqDecRate_Y_pct "" 0x0000 /* @ECU_Address@ATQC_RegenMaxTqDecRate_Y_pct@ */ NO_INPUT_QUANTITY Lookup2D_X_FLOAT32_IEEE 0 AppSwcVcu_CM_single_pct 5 -100.0 200.0 /end AXIS_PTS
/begin CHARACTERISTIC MTQD_WhlSpdDiffMaxTqFac_c "" CURVE 0x0000 /* @ECU_Address@MTQD_WhlSpdDiffMaxTqFac_c@ */ Lookup1D_FLOAT32_IEEE 0 AppSwcVcu_CM_single_c 0.0 1.0
 /begin AXIS_DESCR COM_AXIS NO_INPUT_QUANTITY AppSwcVcu_CM_single_kph 10 -300.0 300.0 AXIS_PTS_REF ATQD_WhlSpdDiffMaxTq_X_kph /end AXIS_DESCR
/end CHARACTERISTIC
/begin AXIS_PTS ATQD_WhlSpdDiffMaxTq_X_kph "" 0x0000 /* @ECU_Address@ATQD_WhlSpdDiffMaxTq_X_kph@ */ NO_INPUT_QUANTITY Lookup1D_X_FLOAT32_IEEE 0 AppSwcVcu_CM_single_kph 10 -300.0 300.0 /end AXIS_PTS
/begin CHARACTERISTIC MTQD_WhlSpdDiffMaxTq_Nm "" CURVE 0x0000 /* @ECU_Address@MTQD_WhlSpdDiffMaxTq_Nm@ */ Lookup1D_FLOAT32_IEEE 0 AppSwcVcu_CM_single_Nm -10000.0 10000.0
 /begin AXIS_DESCR COM_AXIS NO_INPUT_QUANTITY AppSwcVcu_CM_single_kph 10 -300.0 300.0 AXIS_PTS_REF ATQD_WhlSpdDiffMaxTq_X_kph /end AXIS_DESCR
/end CHARACTERISTIC
/begin CHARACTERISTIC MTQD_LimpHomeMaxTq_Nm "" CURVE 0x0000 /* @ECU_Address@MTQD_LimpHomeMaxTq_Nm@ */ Lookup1D_FLOAT32_IEEE 0 AppSwcVcu_CM_single_Nm -10000.0 10000.0
 /begin AXIS_DESCR COM_AXIS VVTM_VehSpd_kph AppSwcVcu_CM_single_kph 8 -300.0 300.0 AXIS_PTS_REF ATQD_LimpHomeMaxTq_X_kph /end AXIS_DESCR
/end CHARACTERISTIC
/begin AXIS_PTS ATQD_LimpHomeMaxTq_X_kph "" 0x0000 /* @ECU_Address@ATQD_LimpHomeMaxTq_X_kph@ */ VVTM_VehSpd_kph Lookup1D_X_FLOAT32_IEEE 0 AppSwcVcu_CM_single_kph 8 -300.0 300.0 /end AXIS_PTS
/begin CHARACTERISTIC MTQF_TqRateLimEndErrE_Nm "torque ending error in E" MAP 0x0000 /* @ECU_Address@MTQF_TqRateLimEndErrE_Nm@ */ Lookup2D_FLOAT32_IEEE 0 AppSwcVcu_CM_single_Nm -10000.0 10000.0
 /begin AXIS_DESCR COM_AXIS VVTM_VehSpd_kph AppSwcVcu_CM_single_kph 11 -300.0 300.0 AXIS_PTS_REF ATQF_TqRateLimEndErr_Y_kph /end AXIS_DESCR
 /begin AXIS_DESCR COM_AXIS VDAC_VirtPedPstn_pct AppSwcVcu_CM_single_pct 14 -100.0 200.0 AXIS_PTS_REF ATQF_TqRateLimEndErr_X_pct /end AXIS_DESCR
/end CHARACTERISTIC
/begin AXIS_PTS ATQF_TqRateLimEndErr_X_pct "pedal position including acc and brk" 0x0000 /* @ECU_Address@ATQF_TqRateLimEndErr_X_pct@ */ VDAC_VirtPedPstn_pct Lookup2D_X_FLOAT32_IEEE 0 AppSwcVcu_CM_single_pct 14 -100.0 200.0 /end AXIS_PTS
/begin AXIS_PTS ATQF_TqRateLimEndErr_Y_kph "vehicle speed" 0x0000 /* @ECU_Address@ATQF_TqRateLimEndErr_Y_kph@ */ VVTM_VehSpd_kph Lookup2D_X_FLOAT32_IEEE 0 AppSwcVcu_CM_single_kph 11 -300.0 300.0 /end AXIS_PTS
/begin CHARACTERISTIC MTQF_TqRateLimEndErrS_Nm "torque ending error in S" MAP 0x0000 /* @ECU_Address@MTQF_TqRateLimEndErrS_Nm@ */ Lookup2D_FLOAT32_IEEE 0 AppSwcVcu_CM_single_Nm -10000.0 10000.0
 /begin AXIS_DESCR COM_AXIS VVTM_VehSpd_kph AppSwcVcu_CM_single_kph 11 -300.0 300.0 AXIS_PTS_REF ATQF_TqRateLimEndErr_Y_kph /end AXIS_DESCR
 /begin AXIS_DESCR COM_AXIS VDAC_VirtPedPstn_pct AppSwcVcu_CM_single_pct 14 -100.0 200.0 AXIS_PTS_REF ATQF_TqRateLimEndErr_X_pct /end AXIS_DESCR
/end CHARACTERISTIC
/begin CHARACTERISTIC MTQF_TqRateLimEndErrN_Nm "torque ending error in N" MAP 0x0000 /* @ECU_Address@MTQF_TqRateLimEndErrN_Nm@ */ Lookup2D_FLOAT32_IEEE 0 AppSwcVcu_CM_single_Nm -10000.0 10000.0
 /begin AXIS_DESCR COM_AXIS VVTM_VehSpd_kph AppSwcVcu_CM_single_kph 11 -300.0 300.0 AXIS_PTS_REF ATQF_TqRateLimEndErr_Y_kph /end AXIS_DESCR
 /begin AXIS_DESCR COM_AXIS VDAC_VirtPedPstn_pct AppSwcVcu_CM_single_pct 14 -100.0 200.0 AXIS_PTS_REF ATQF_TqRateLimEndErr_X_pct /end AXIS_DESCR
/end CHARACTERISTIC
/begin CHARACTERISTIC MTZX_RampDecRate_Nmps "" CURVE 0x0000 /* @ECU_Address@MTZX_RampDecRate_Nmps@ */ Lookup1D_FLOAT32_IEEE 0 AppSwcVcu_CM_single_Nmps -100000.0 100000.0
 /begin AXIS_DESCR COM_AXIS NO_INPUT_QUANTITY AppSwcVcu_CM_single_Nm 10 0.0 100000.0 AXIS_PTS_REF ATZX_RampDecRate_X_Nm /end AXIS_DESCR
/end CHARACTERISTIC
/begin AXIS_PTS ATZX_RampDecRate_X_Nm "" 0x0000 /* @ECU_Address@ATZX_RampDecRate_X_Nm@ */ NO_INPUT_QUANTITY Lookup1D_X_FLOAT32_IEEE 0 AppSwcVcu_CM_single_Nm 10 0.0 100000.0 /end AXIS_PTS
/begin CHARACTERISTIC MTZX_RampIncRate_Nmps "" CURVE 0x0000 /* @ECU_Address@MTZX_RampIncRate_Nmps@ */ Lookup1D_FLOAT32_IEEE 0 AppSwcVcu_CM_single_Nmps -100000.0 100000.0
 /begin AXIS_DESCR COM_AXIS NO_INPUT_QUANTITY AppSwcVcu_CM_single_Nm 10 0.0 100000.0 AXIS_PTS_REF ATZX_RampIncRate_X_Nm /end AXIS_DESCR
/end CHARACTERISTIC
/begin AXIS_PTS ATZX_RampIncRate_X_Nm "" 0x0000 /* @ECU_Address@ATZX_RampIncRate_X_Nm@ */ NO_INPUT_QUANTITY Lookup1D_X_FLOAT32_IEEE 0 AppSwcVcu_CM_single_Nm 10 0.0 100000.0 /end AXIS_PTS
/begin CHARACTERISTIC MTZX_BZIncRate_Nmps "" CURVE 0x0000 /* @ECU_Address@MTZX_BZIncRate_Nmps@ */ Lookup1D_FLOAT32_IEEE 0 AppSwcVcu_CM_single_Nmps -100000.0 100000.0
 /begin AXIS_DESCR COM_AXIS NO_INPUT_QUANTITY AppSwcVcu_CM_single_Nm 11 -1000.0 1000.0 AXIS_PTS_REF ATZX_BZIncRate_X_Nm /end AXIS_DESCR
/end CHARACTERISTIC
/begin AXIS_PTS ATZX_BZIncRate_X_Nm "" 0x0000 /* @ECU_Address@ATZX_BZIncRate_X_Nm@ */ NO_INPUT_QUANTITY Lookup1D_X_FLOAT32_IEEE 0 AppSwcVcu_CM_single_Nm 11 -1000.0 1000.0 /end AXIS_PTS
/begin CHARACTERISTIC MTZX_BZDecRate_Nmps "" CURVE 0x0000 /* @ECU_Address@MTZX_BZDecRate_Nmps@ */ Lookup1D_FLOAT32_IEEE 0 AppSwcVcu_CM_single_Nmps -100000.0 100000.0
 /begin AXIS_DESCR COM_AXIS NO_INPUT_QUANTITY AppSwcVcu_CM_single_Nm 11 -1000.0 1000.0 AXIS_PTS_REF ATZX_BZDecRate_X_Nm /end AXIS_DESCR
/end CHARACTERISTIC
/begin AXIS_PTS ATZX_BZDecRate_X_Nm "" 0x0000 /* @ECU_Address@ATZX_BZDecRate_X_Nm@ */ NO_INPUT_QUANTITY Lookup1D_X_FLOAT32_IEEE 0 AppSwcVcu_CM_single_Nm 11 -1000.0 1000.0 /end AXIS_PTS
/begin CHARACTERISTIC MTZX_AZIncRate_Nmps "" CURVE 0x0000 /* @ECU_Address@MTZX_AZIncRate_Nmps@ */ Lookup1D_FLOAT32_IEEE 0 AppSwcVcu_CM_single_Nmps -100000.0 100000.0
 /begin AXIS_DESCR COM_AXIS NO_INPUT_QUANTITY AppSwcVcu_CM_single_Nm 11 -1000.0 1000.0 AXIS_PTS_REF ATZX_AZIncRate_X_Nm /end AXIS_DESCR
/end CHARACTERISTIC
/begin AXIS_PTS ATZX_AZIncRate_X_Nm "" 0x0000 /* @ECU_Address@ATZX_AZIncRate_X_Nm@ */ NO_INPUT_QUANTITY Lookup1D_X_FLOAT32_IEEE 0 AppSwcVcu_CM_single_Nm 11 -1000.0 1000.0 /end AXIS_PTS
/begin CHARACTERISTIC MTZX_AZDecRate_Nmps "" CURVE 0x0000 /* @ECU_Address@MTZX_AZDecRate_Nmps@ */ Lookup1D_FLOAT32_IEEE 0 AppSwcVcu_CM_single_Nmps -100000.0 100000.0
 /begin AXIS_DESCR COM_AXIS NO_INPUT_QUANTITY AppSwcVcu_CM_single_Nm 11 -1000.0 1000.0 AXIS_PTS_REF ATZX_AZDecRate_X_Nm /end AXIS_DESCR
/end CHARACTERISTIC
/begin AXIS_PTS ATZX_AZDecRate_X_Nm "" 0x0000 /* @ECU_Address@ATZX_AZDecRate_X_Nm@ */ NO_INPUT_QUANTITY Lookup1D_X_FLOAT32_IEEE 0 AppSwcVcu_CM_single_Nm 11 -1000.0 1000.0 /end AXIS_PTS
/begin CHARACTERISTIC MTZX_ZeroTqOfstInc_Nm "" MAP 0x0000 /* @ECU_Address@MTZX_ZeroTqOfstInc_Nm@ */ Lookup2D_FLOAT32_IEEE 0 AppSwcVcu_CM_single_Nm -1000.0 1000.0
 /begin AXIS_DESCR COM_AXIS VVTM_VehSpd_kph AppSwcVcu_CM_single_kph 16 -300.0 300.0 AXIS_PTS_REF ATZX_ZeroTqOfstInc_Y_kph /end AXIS_DESCR
 /begin AXIS_DESCR COM_AXIS NO_INPUT_QUANTITY AppSwcVcu_CM_single_Nm 5 -10000.0 10000.0 AXIS_PTS_REF ATZX_OPDSlopTq_X_Nm /end AXIS_DESCR
/end CHARACTERISTIC
/begin AXIS_PTS ATZX_OPDSlopTq_X_Nm "" 0x0000 /* @ECU_Address@ATZX_OPDSlopTq_X_Nm@ */ NO_INPUT_QUANTITY Lookup2D_X_FLOAT32_IEEE 0 AppSwcVcu_CM_single_Nm 5 -10000.0 10000.0 /end AXIS_PTS
/begin AXIS_PTS ATZX_ZeroTqOfstInc_Y_kph "" 0x0000 /* @ECU_Address@ATZX_ZeroTqOfstInc_Y_kph@ */ VVTM_VehSpd_kph Lookup2D_X_FLOAT32_IEEE 0 AppSwcVcu_CM_single_kph 16 -300.0 300.0 /end AXIS_PTS
/begin CHARACTERISTIC MTZX_ZeroTqOfstDec_Nm "" MAP 0x0000 /* @ECU_Address@MTZX_ZeroTqOfstDec_Nm@ */ Lookup2D_FLOAT32_IEEE 0 AppSwcVcu_CM_single_Nm -1000.0 1000.0
 /begin AXIS_DESCR COM_AXIS VVTM_VehSpd_kph AppSwcVcu_CM_single_kph 16 -300.0 300.0 AXIS_PTS_REF ATZX_ZeroTqOfstDec_Y_kph /end AXIS_DESCR
 /begin AXIS_DESCR COM_AXIS NO_INPUT_QUANTITY AppSwcVcu_CM_single_Nm 5 -10000.0 10000.0 AXIS_PTS_REF ATZX_OPDSlopTq_X_Nm /end AXIS_DESCR
/end CHARACTERISTIC
/begin AXIS_PTS ATZX_ZeroTqOfstDec_Y_kph "" 0x0000 /* @ECU_Address@ATZX_ZeroTqOfstDec_Y_kph@ */ VVTM_VehSpd_kph Lookup2D_X_FLOAT32_IEEE 0 AppSwcVcu_CM_single_kph 16 -300.0 300.0 /end AXIS_PTS
/begin CHARACTERISTIC MTZX_ZeroXTmDec_s "" MAP 0x0000 /* @ECU_Address@MTZX_ZeroXTmDec_s@ */ Lookup2D_FLOAT32_IEEE 0 AppSwcVcu_CM_single_s 0.0 60.0
 /begin AXIS_DESCR COM_AXIS VVTM_VehSpd_kph AppSwcVcu_CM_single_kph 16 -300.0 300.0 AXIS_PTS_REF ATZX_ZeroXTmDec_Y_kph /end AXIS_DESCR
 /begin AXIS_DESCR COM_AXIS NO_INPUT_QUANTITY AppSwcVcu_CM_single_Nm 5 -10000.0 10000.0 AXIS_PTS_REF ATZX_OPDSlopTq_X_Nm /end AXIS_DESCR
/end CHARACTERISTIC
/begin AXIS_PTS ATZX_ZeroXTmDec_Y_kph "" 0x0000 /* @ECU_Address@ATZX_ZeroXTmDec_Y_kph@ */ VVTM_VehSpd_kph Lookup2D_X_FLOAT32_IEEE 0 AppSwcVcu_CM_single_kph 16 -300.0 300.0 /end AXIS_PTS
/begin CHARACTERISTIC MTZX_ZeroXTmInc_s "" MAP 0x0000 /* @ECU_Address@MTZX_ZeroXTmInc_s@ */ Lookup2D_FLOAT32_IEEE 0 AppSwcVcu_CM_single_s 0.0 60.0
 /begin AXIS_DESCR COM_AXIS VVTM_VehSpd_kph AppSwcVcu_CM_single_kph 16 -300.0 300.0 AXIS_PTS_REF ATZX_ZeroXTmInc_Y_kph /end AXIS_DESCR
 /begin AXIS_DESCR COM_AXIS NO_INPUT_QUANTITY AppSwcVcu_CM_single_Nm 5 -10000.0 10000.0 AXIS_PTS_REF ATZX_OPDSlopTq_X_Nm /end AXIS_DESCR
/end CHARACTERISTIC
/begin AXIS_PTS ATZX_ZeroXTmInc_Y_kph "" 0x0000 /* @ECU_Address@ATZX_ZeroXTmInc_Y_kph@ */ VVTM_VehSpd_kph Lookup2D_X_FLOAT32_IEEE 0 AppSwcVcu_CM_single_kph 16 -300.0 300.0 /end AXIS_PTS
/begin CHARACTERISTIC KDAC_BrkPedPrsdOff_pct "" VALUE 0x0000 /* @ECU_Address@KDAC_BrkPedPrsdOff_pct@ */ Scalar_FLOAT32_IEEE 0 AppSwcVcu_CM_single_pct -1000.0 1000.0 /end CHARACTERISTIC
/begin CHARACTERISTIC KDAC_BrkPedPrsdOn_pct "" VALUE 0x0000 /* @ECU_Address@KDAC_BrkPedPrsdOn_pct@ */ Scalar_FLOAT32_IEEE 0 AppSwcVcu_CM_single_pct -1000.0 1000.0 /end CHARACTERISTIC
/begin CHARACTERISTIC KDAC_BrkTq2PresrCvrtCoeff_c "" VALUE 0x0000 /* @ECU_Address@KDAC_BrkTq2PresrCvrtCoeff_c@ */ Scalar_FLOAT32_IEEE 0 AppSwcVcu_CM_single_c 0.0 100000.0 /end CHARACTERISTIC
/begin CHARACTERISTIC KDAC_DrvAsstTqSplitEHBMin_Nm "" VALUE 0x0000 /* @ECU_Address@KDAC_DrvAsstTqSplitEHBMin_Nm@ */ Scalar_FLOAT32_IEEE 0 AppSwcVcu_CM_single_Nm -10000.0 0.0 /end CHARACTERISTIC
/begin CHARACTERISTIC KDAC_HDCTqReqWhlAchvd_Nm "" VALUE 0x0000 /* @ECU_Address@KDAC_HDCTqReqWhlAchvd_Nm@ */ Scalar_FLOAT32_IEEE 0 AppSwcVcu_CM_single_Nm 0.0 100000.0 /end CHARACTERISTIC
/begin CHARACTERISTIC KDAC_HDCTqReqWhlDec_Nmps "" VALUE 0x0000 /* @ECU_Address@KDAC_HDCTqReqWhlDec_Nmps@ */ Scalar_FLOAT32_IEEE 0 AppSwcVcu_CM_single_Nm -100000.0 0.0 /end CHARACTERISTIC
/begin CHARACTERISTIC KDAC_HDCTqReqWhlInc_Nmps "" VALUE 0x0000 /* @ECU_Address@KDAC_HDCTqReqWhlInc_Nmps@ */ Scalar_FLOAT32_IEEE 0 AppSwcVcu_CM_single_Nm 0.0 100000.0 /end CHARACTERISTIC
/begin CHARACTERISTIC KDAC_VirtAccelPedPstnOff_pct "" VALUE 0x0000 /* @ECU_Address@KDAC_VirtAccelPedPstnOff_pct@ */ Scalar_FLOAT32_IEEE 0 AppSwcVcu_CM_single_pct -1000.0 1000.0 /end CHARACTERISTIC
/begin CHARACTERISTIC KDAC_VirtAccelPedPstnOn_pct "" VALUE 0x0000 /* @ECU_Address@KDAC_VirtAccelPedPstnOn_pct@ */ Scalar_FLOAT32_IEEE 0 AppSwcVcu_CM_single_pct -1000.0 1000.0 /end CHARACTERISTIC
/begin CHARACTERISTIC KDAG_AccPedCrsChkThr_pct "加速踏板双路校验偏差门槛" VALUE 0x0000 /* @ECU_Address@KDAG_AccPedCrsChkThr_pct@ */ Scalar_FLOAT32_IEEE 0 AppSwcVcu_CM_single_pct 0.0 100.0 /end CHARACTERISTIC
/begin CHARACTERISTIC KDAG_BMSCmdTmOutFailTm1_s "BMS继电器指令响应超时确认时间_非直流充电闭合等待时间" VALUE 0x0000 /* @ECU_Address@KDAG_BMSCmdTmOutFailTm1_s@ */ Scalar_FLOAT32_IEEE 0 AppSwcVcu_CM_single_s 0.0 3600.0 /end CHARACTERISTIC
/begin CHARACTERISTIC KDAG_BMSCmdTmOutFailTm2_s "BMS继电器指令响应超时确认时间_直流充电闭合等待时间" VALUE 0x0000 /* @ECU_Address@KDAG_BMSCmdTmOutFailTm2_s@ */ Scalar_FLOAT32_IEEE 0 AppSwcVcu_CM_single_s 0.0 3600.0 /end CHARACTERISTIC
/begin CHARACTERISTIC KDAG_BMSCmdTmOutFailTm3_s "BMS继电器指令响应超时确认时间_BMS自己断开继电器等待时间" VALUE 0x0000 /* @ECU_Address@KDAG_BMSCmdTmOutFailTm3_s@ */ Scalar_FLOAT32_IEEE 0 AppSwcVcu_CM_single_s 0.0 3600.0 /end CHARACTERISTIC
/begin CHARACTERISTIC KDAG_BrkSwCrsChkIntvlTm_s "两次制动开关校验至少需要间隔的时间" VALUE 0x0000 /* @ECU_Address@KDAG_BrkSwCrsChkIntvlTm_s@ */ Scalar_FLOAT32_IEEE 0 AppSwcVcu_CM_single_s 0.0 3600.0 /end CHARACTERISTIC
/begin CHARACTERISTIC KDAG_BrkSwDisagreeTmHi_s "制动开关不一致时间High_高于此值表示此次校验不通过" VALUE 0x0000 /* @ECU_Address@KDAG_BrkSwDisagreeTmHi_s@ */ Scalar_FLOAT32_IEEE 0 AppSwcVcu_CM_single_s 0.0 3600.0 /end CHARACTERISTIC
/begin CHARACTERISTIC KDAG_BrkSwDisagreeTmLo_s "制动开关不一致时间Low_低于此值表示此次校验通过" VALUE 0x0000 /* @ECU_Address@KDAG_BrkSwDisagreeTmLo_s@ */ Scalar_FLOAT32_IEEE 0 AppSwcVcu_CM_single_s 0.0 3600.0 /end CHARACTERISTIC
/begin CHARACTERISTIC KDAG_BrkSwDisagreeTmLong_s "制动开关不一致时间Long_高于此值直接报校验故障" VALUE 0x0000 /* @ECU_Address@KDAG_BrkSwDisagreeTmLong_s@ */ Scalar_FLOAT32_IEEE 0 AppSwcVcu_CM_single_s 0.0 3600.0 /end CHARACTERISTIC
/begin CHARACTERISTIC KDAG_HVILVoltMax_mV "高压互锁电压过高门槛" VALUE 0x0000 /* @ECU_Address@KDAG_HVILVoltMax_mV@ */ Scalar_FLOAT32_IEEE 0 AppSwcVcu_CM_single_mV 0.0 20000.0 /end CHARACTERISTIC
/begin CHARACTERISTIC KDAG_HVILVoltMin_mV "高压互锁电压过低门槛" VALUE 0x0000 /* @ECU_Address@KDAG_HVILVoltMin_mV@ */ Scalar_FLOAT32_IEEE 0 AppSwcVcu_CM_single_mV 0.0 20000.0 /end CHARACTERISTIC
/begin CHARACTERISTIC KDAG_LVBattTempHi_C "蓄电池过温温度门槛" VALUE 0x0000 /* @ECU_Address@KDAG_LVBattTempHi_C@ */ Scalar_FLOAT32_IEEE 0 AppSwcVcu_CM_single_C -40.0 200.0 /end CHARACTERISTIC
/begin CHARACTERISTIC KDAG_OBCConnectTmOutFailTm1_s "OBC连接超时故障等待时间_连接前" VALUE 0x0000 /* @ECU_Address@KDAG_OBCConnectTmOutFailTm1_s@ */ Scalar_FLOAT32_IEEE 0 AppSwcVcu_CM_single_s 0.0 3600.0 /end CHARACTERISTIC
/begin CHARACTERISTIC KDAG_OBCConnectTmOutFailTm2_s "OBC连接超时故障等待时间_连接后断开" VALUE 0x0000 /* @ECU_Address@KDAG_OBCConnectTmOutFailTm2_s@ */ Scalar_FLOAT32_IEEE 0 AppSwcVcu_CM_single_s 0.0 3600.0 /end CHARACTERISTIC
/begin CHARACTERISTIC KEMS_ChrgCurFbKiMax_A "充电KI上限限制" VALUE 0x0000 /* @ECU_Address@KEMS_ChrgCurFbKiMax_A@ */ Scalar_FLOAT32_IEEE 0 AppSwcVcu_CM_single_A 0.0 10000.0 /end CHARACTERISTIC
/begin CHARACTERISTIC KEMS_ChrgCurFbKiMin_A "充电KI下限限制" VALUE 0x0000 /* @ECU_Address@KEMS_ChrgCurFbKiMin_A@ */ Scalar_FLOAT32_IEEE 0 AppSwcVcu_CM_single_A 0.0 10000.0 /end CHARACTERISTIC
/begin CHARACTERISTIC KEMS_ChrgCurFbMax_A "充电KP+KI上限限制" VALUE 0x0000 /* @ECU_Address@KEMS_ChrgCurFbMax_A@ */ Scalar_FLOAT32_IEEE 0 AppSwcVcu_CM_single_A 0.0 10000.0 /end CHARACTERISTIC
/begin CHARACTERISTIC KEMS_ChrgCurFbMin_A "充电KP+KI下限限制" VALUE 0x0000 /* @ECU_Address@KEMS_ChrgCurFbMin_A@ */ Scalar_FLOAT32_IEEE 0 AppSwcVcu_CM_single_A 0.0 10000.0 /end CHARACTERISTIC
/begin CHARACTERISTIC KEMS_ChrgPwrFbKiMax_kW "充电功率闭环KI上限限制" VALUE 0x0000 /* @ECU_Address@KEMS_ChrgPwrFbKiMax_kW@ */ Scalar_FLOAT32_IEEE 0 AppSwcVcu_CM_single_kW -10000.0 10000.0 /end CHARACTERISTIC
/begin CHARACTERISTIC KEMS_ChrgPwrFbKiMin_kW "充电功率闭环KI下限限制" VALUE 0x0000 /* @ECU_Address@KEMS_ChrgPwrFbKiMin_kW@ */ Scalar_FLOAT32_IEEE 0 AppSwcVcu_CM_single_kW -10000.0 10000.0 /end CHARACTERISTIC
/begin CHARACTERISTIC KEMS_ChrgPwrFbMax_kW "充电功率闭环KI+KP上限限制" VALUE 0x0000 /* @ECU_Address@KEMS_ChrgPwrFbMax_kW@ */ Scalar_FLOAT32_IEEE 0 AppSwcVcu_CM_single_kW -10000.0 10000.0 /end CHARACTERISTIC
/begin CHARACTERISTIC KEMS_ChrgPwrFbMin_kW "充电功率闭环KI+KP下限限制" VALUE 0x0000 /* @ECU_Address@KEMS_ChrgPwrFbMin_kW@ */ Scalar_FLOAT32_IEEE 0 AppSwcVcu_CM_single_kW -10000.0 10000.0 /end CHARACTERISTIC
/begin CHARACTERISTIC KEMS_DchaCurFbKiMax_A "放电Ki上限限制" VALUE 0x0000 /* @ECU_Address@KEMS_DchaCurFbKiMax_A@ */ Scalar_FLOAT32_IEEE 0 AppSwcVcu_CM_single_A -10000.0 0.0 /end CHARACTERISTIC
/begin CHARACTERISTIC KEMS_DchaCurFbKiMin_A "放电Ki下限限制" VALUE 0x0000 /* @ECU_Address@KEMS_DchaCurFbKiMin_A@ */ Scalar_FLOAT32_IEEE 0 AppSwcVcu_CM_single_A -10000.0 0.0 /end CHARACTERISTIC
/begin CHARACTERISTIC KEMS_DchaCurFbMax_A "放电KP+Ki上限限制" VALUE 0x0000 /* @ECU_Address@KEMS_DchaCurFbMax_A@ */ Scalar_FLOAT32_IEEE 0 AppSwcVcu_CM_single_A -10000.0 0.0 /end CHARACTERISTIC
/begin CHARACTERISTIC KEMS_DchaCurFbMin_A "放电KP+Ki下限限制" VALUE 0x0000 /* @ECU_Address@KEMS_DchaCurFbMin_A@ */ Scalar_FLOAT32_IEEE 0 AppSwcVcu_CM_single_A -10000.0 0.0 /end CHARACTERISTIC
/begin CHARACTERISTIC KEMS_DchaPwrFbKiMax_kW "放电功率闭环KI上限限制" VALUE 0x0000 /* @ECU_Address@KEMS_DchaPwrFbKiMax_kW@ */ Scalar_FLOAT32_IEEE 0 AppSwcVcu_CM_single_kW -10000.0 10000.0 /end CHARACTERISTIC
/begin CHARACTERISTIC KEMS_DchaPwrFbKiMin_kW "放电功率闭环KI下限限制" VALUE 0x0000 /* @ECU_Address@KEMS_DchaPwrFbKiMin_kW@ */ Scalar_FLOAT32_IEEE 0 AppSwcVcu_CM_single_kW -10000.0 10000.0 /end CHARACTERISTIC
/begin CHARACTERISTIC KEMS_DchaPwrFbMax_kW "放电功率闭环KI+KP上限限制" VALUE 0x0000 /* @ECU_Address@KEMS_DchaPwrFbMax_kW@ */ Scalar_FLOAT32_IEEE 0 AppSwcVcu_CM_single_kW -10000.0 10000.0 /end CHARACTERISTIC
/begin CHARACTERISTIC KEMS_DchaPwrFbMin_kW "放电功率闭环KI+KP下限限制" VALUE 0x0000 /* @ECU_Address@KEMS_DchaPwrFbMin_kW@ */ Scalar_FLOAT32_IEEE 0 AppSwcVcu_CM_single_kW -10000.0 10000.0 /end CHARACTERISTIC
/begin CHARACTERISTIC KGSM_EPBReqMaxTm_s "规范：EPB拉起操作时间阈值" VALUE 0x0000 /* @ECU_Address@KGSM_EPBReqMaxTm_s@ */ Scalar_FLOAT32_IEEE 0 AppSwcVcu_CM_single_s 0.0 1000.0 /end CHARACTERISTIC
/begin CHARACTERISTIC KGSM_GrShftMaxVehSpd_kph "规范：换挡车速阈值" VALUE 0x0000 /* @ECU_Address@KGSM_GrShftMaxVehSpd_kph@ */ Scalar_FLOAT32_IEEE 0 AppSwcVcu_CM_single_kph 0.0 1000.0 /end CHARACTERISTIC
/begin CHARACTERISTIC KGSM_INVTrnOffDly_s "规范：车辆实际档位由非P档进入到P档计时满2S" VALUE 0x0000 /* @ECU_Address@KGSM_INVTrnOffDly_s@ */ Scalar_FLOAT32_IEEE 0 AppSwcVcu_CM_single_s 0.0 1000.0 /end CHARACTERISTIC
/begin CHARACTERISTIC KGSM_PErrDispMaxTm_s "规范：Perror置位时间阈值" VALUE 0x0000 /* @ECU_Address@KGSM_PErrDispMaxTm_s@ */ Scalar_FLOAT32_IEEE 0 AppSwcVcu_CM_single_s 0.0 1000.0 /end CHARACTERISTIC
/begin CHARACTERISTIC KHMI_BackwSldgBgnEnd_kph "" VALUE 0x0000 /* @ECU_Address@KHMI_BackwSldgBgnEnd_kph@ */ Scalar_FLOAT32_IEEE 0 AppSwcVcu_CM_single_kph -200.0 200.0 /end CHARACTERISTIC
/begin CHARACTERISTIC KHMI_BackwSldgBgnSpd_kph "" VALUE 0x0000 /* @ECU_Address@KHMI_BackwSldgBgnSpd_kph@ */ Scalar_FLOAT32_IEEE 0 AppSwcVcu_CM_single_kph -200.0 200.0 /end CHARACTERISTIC
/begin CHARACTERISTIC KHMI_BackwSldgDst_m "" VALUE 0x0000 /* @ECU_Address@KHMI_BackwSldgDst_m@ */ Scalar_FLOAT32_IEEE 0 AppSwcVcu_CM_single_m -200.0 200.0 /end CHARACTERISTIC
/begin CHARACTERISTIC KHMI_BatCellMaxTemWarning_C "电芯（最高温度）限功率温度" VALUE 0x0000 /* @ECU_Address@KHMI_BatCellMaxTemWarning_C@ */ Scalar_FLOAT32_IEEE 0 AppSwcVcu_CM_single_C -127.0 127.0 /end CHARACTERISTIC
/begin CHARACTERISTIC KHMI_BothAccBrkTime_s "回馈能力受限判断时长" VALUE 0x0000 /* @ECU_Address@KHMI_BothAccBrkTime_s@ */ Scalar_FLOAT32_IEEE 0 AppSwcVcu_CM_single_s 0.0 200.0 /end CHARACTERISTIC
/begin CHARACTERISTIC KHMI_CellOverTempTime_s "电芯过温判断时长" VALUE 0x0000 /* @ECU_Address@KHMI_CellOverTempTime_s@ */ Scalar_FLOAT32_IEEE 0 AppSwcVcu_CM_single_s 0.0 200.0 /end CHARACTERISTIC
/begin CHARACTERISTIC KHMI_DriPwrLmtTime_s "驱动能力受限判断时长" VALUE 0x0000 /* @ECU_Address@KHMI_DriPwrLmtTime_s@ */ Scalar_FLOAT32_IEEE 0 AppSwcVcu_CM_single_s 0.0 1000.0 /end CHARACTERISTIC
/begin CHARACTERISTIC KHMI_DriPwrLmtVa_kw "驱动能力受限阈值" VALUE 0x0000 /* @ECU_Address@KHMI_DriPwrLmtVa_kw@ */ Scalar_FLOAT32_IEEE 0 AppSwcVcu_CM_single_kw 0.0 300.0 /end CHARACTERISTIC
/begin CHARACTERISTIC KHMI_FwdSldgBgnEnd_kph "" VALUE 0x0000 /* @ECU_Address@KHMI_FwdSldgBgnEnd_kph@ */ Scalar_FLOAT32_IEEE 0 AppSwcVcu_CM_single_kph -200.0 200.0 /end CHARACTERISTIC
/begin CHARACTERISTIC KHMI_FwdSldgBgnSpd_kph "" VALUE 0x0000 /* @ECU_Address@KHMI_FwdSldgBgnSpd_kph@ */ Scalar_FLOAT32_IEEE 0 AppSwcVcu_CM_single_kph -200.0 200.0 /end CHARACTERISTIC
/begin CHARACTERISTIC KHMI_FwdSldgDst_m "" VALUE 0x0000 /* @ECU_Address@KHMI_FwdSldgDst_m@ */ Scalar_FLOAT32_IEEE 0 AppSwcVcu_CM_single_m -200.0 200.0 /end CHARACTERISTIC
/begin CHARACTERISTIC KHMI_RecPwrLmtTime_s "回馈能力受限判断时长" VALUE 0x0000 /* @ECU_Address@KHMI_RecPwrLmtTime_s@ */ Scalar_FLOAT32_IEEE 0 AppSwcVcu_CM_single_s 0.0 1000.0 /end CHARACTERISTIC
/begin CHARACTERISTIC KHMI_RecPwrLmtVa_kw "回馈能力受限阈值" VALUE 0x0000 /* @ECU_Address@KHMI_RecPwrLmtVa_kw@ */ Scalar_FLOAT32_IEEE 0 AppSwcVcu_CM_single_kw -200.0 0.0 /end CHARACTERISTIC
/begin CHARACTERISTIC KHMI_SnowModWarnSpd_kph "雪地模式超速报警车速阈值" VALUE 0x0000 /* @ECU_Address@KHMI_SnowModWarnSpd_kph@ */ Scalar_FLOAT32_IEEE 0 AppSwcVcu_CM_single_kph 0.0 200.0 /end CHARACTERISTIC
/begin CHARACTERISTIC KHMI_SpdWheelFRdiff_kph "左右车轮差值阈值" VALUE 0x0000 /* @ECU_Address@KHMI_SpdWheelFRdiff_kph@ */ Scalar_FLOAT32_IEEE 0 AppSwcVcu_CM_single_kph 0.0 200.0 /end CHARACTERISTIC
/begin CHARACTERISTIC KHVM_ChrgTransCfmTm_s "充放电状态转移到结束的确认时间" VALUE 0x0000 /* @ECU_Address@KHVM_ChrgTransCfmTm_s@ */ Scalar_FLOAT32_IEEE 0 AppSwcVcu_CM_single_s 0.0 6000.0 /end CHARACTERISTIC
/begin CHARACTERISTIC KHVM_KL15OffPwrDwnCfmTm_s "KL15断开确认时间" VALUE 0x0000 /* @ECU_Address@KHVM_KL15OffPwrDwnCfmTm_s@ */ Scalar_FLOAT32_IEEE 0 AppSwcVcu_CM_single_s 0.0 6000.0 /end CHARACTERISTIC
/begin CHARACTERISTIC KHVM_PTRdyBrkSwEffctvTm_s "刹车上升沿保持时间" VALUE 0x0000 /* @ECU_Address@KHVM_PTRdyBrkSwEffctvTm_s@ */ Scalar_FLOAT32_IEEE 0 AppSwcVcu_CM_single_s 0.0 6000.0 /end CHARACTERISTIC
/begin CHARACTERISTIC KHVM_PwrUpACChrgEffctvTm_s "OBC唤醒源上升沿保持时间" VALUE 0x0000 /* @ECU_Address@KHVM_PwrUpACChrgEffctvTm_s@ */ Scalar_FLOAT32_IEEE 0 AppSwcVcu_CM_single_s 0.0 6000.0 /end CHARACTERISTIC
/begin CHARACTERISTIC KHVM_PwrUpDCChrgEffctvTm_s "BMS唤醒源上升沿保持时间" VALUE 0x0000 /* @ECU_Address@KHVM_PwrUpDCChrgEffctvTm_s@ */ Scalar_FLOAT32_IEEE 0 AppSwcVcu_CM_single_s 0.0 6000.0 /end CHARACTERISTIC
/begin CHARACTERISTIC KHVM_PwrUpIBSDlyTm_s "IBS唤醒源延迟时间" VALUE 0x0000 /* @ECU_Address@KHVM_PwrUpIBSDlyTm_s@ */ Scalar_FLOAT32_IEEE 0 AppSwcVcu_CM_single_s 0.0 6000.0 /end CHARACTERISTIC
/begin CHARACTERISTIC KHVM_PwrUpIBSEffctvTm_s "IBS上升沿保持时间" VALUE 0x0000 /* @ECU_Address@KHVM_PwrUpIBSEffctvTm_s@ */ Scalar_FLOAT32_IEEE 0 AppSwcVcu_CM_single_s 0.0 6000.0 /end CHARACTERISTIC
/begin CHARACTERISTIC KHVM_PwrUpKL15EffctvTm_s "KL15上升沿保持时间" VALUE 0x0000 /* @ECU_Address@KHVM_PwrUpKL15EffctvTm_s@ */ Scalar_FLOAT32_IEEE 0 AppSwcVcu_CM_single_s 0.0 6000.0 /end CHARACTERISTIC
/begin CHARACTERISTIC KHVM_SOCLoPwrDwnDlyTm_s "SOC极低确认时间" VALUE 0x0000 /* @ECU_Address@KHVM_SOCLoPwrDwnDlyTm_s@ */ Scalar_FLOAT32_IEEE 0 AppSwcVcu_CM_single_s 0.0 6000.0 /end CHARACTERISTIC
/begin CHARACTERISTIC KIPC_AccPed1FullPstn_pct "" VALUE 0x0000 /* @ECU_Address@KIPC_AccPed1FullPstn_pct@ */ Scalar_FLOAT32_IEEE 0 AppSwcVcu_CM_single_pct 0.0 100.0 /end CHARACTERISTIC
/begin CHARACTERISTIC KIPC_AccPed2FullPstn_pct "" VALUE 0x0000 /* @ECU_Address@KIPC_AccPed2FullPstn_pct@ */ Scalar_FLOAT32_IEEE 0 AppSwcVcu_CM_single_pct 0.0 100.0 /end CHARACTERISTIC
/begin CHARACTERISTIC KIPC_AccPedDbnd_pct "" VALUE 0x0000 /* @ECU_Address@KIPC_AccPedDbnd_pct@ */ Scalar_FLOAT32_IEEE 0 AppSwcVcu_CM_single_pct 0.0 100.0 /end CHARACTERISTIC
/begin CHARACTERISTIC KIPC_AccPedInitTm_s "" VALUE 0x0000 /* @ECU_Address@KIPC_AccPedInitTm_s@ */ Scalar_FLOAT32_IEEE 0 AppSwcVcu_CM_single_s 0.0 100.0 /end CHARACTERISTIC
/begin CHARACTERISTIC KIPC_AccPedLrnDwnFiltCoeff_rat "" VALUE 0x0000 /* @ECU_Address@KIPC_AccPedLrnDwnFiltCoeff_rat@ */ Scalar_FLOAT32_IEEE 0 AppSwcVcu_CM_single_rat 0.0 1.0 /end CHARACTERISTIC
/begin CHARACTERISTIC KIPC_AccPedLrnDwnStabThr_pct "" VALUE 0x0000 /* @ECU_Address@KIPC_AccPedLrnDwnStabThr_pct@ */ Scalar_FLOAT32_IEEE 0 AppSwcVcu_CM_single_pct 0.0 100.0 /end CHARACTERISTIC
/begin CHARACTERISTIC KIPC_AccPedLrnDwnStabTm_s "" VALUE 0x0000 /* @ECU_Address@KIPC_AccPedLrnDwnStabTm_s@ */ Scalar_FLOAT32_IEEE 0 AppSwcVcu_CM_single_s 0.0 600.0 /end CHARACTERISTIC
/begin CHARACTERISTIC KIPC_AccPedMinPstnHi_pct "" VALUE 0x0000 /* @ECU_Address@KIPC_AccPedMinPstnHi_pct@ */ Scalar_FLOAT32_IEEE 0 AppSwcVcu_CM_single_pct 0.0 100.0 /end CHARACTERISTIC
/begin CHARACTERISTIC KIPC_AccPedMinPstnLo_pct "" VALUE 0x0000 /* @ECU_Address@KIPC_AccPedMinPstnLo_pct@ */ Scalar_FLOAT32_IEEE 0 AppSwcVcu_CM_single_pct 0.0 100.0 /end CHARACTERISTIC
/begin CHARACTERISTIC KIPC_AccPedMinPstnLrnUpHi_pct "" VALUE 0x0000 /* @ECU_Address@KIPC_AccPedMinPstnLrnUpHi_pct@ */ Scalar_FLOAT32_IEEE 0 AppSwcVcu_CM_single_pct 0.0 100.0 /end CHARACTERISTIC
/begin CHARACTERISTIC KIPC_AccPedMinPstnLrnUpLo_pct "" VALUE 0x0000 /* @ECU_Address@KIPC_AccPedMinPstnLrnUpLo_pct@ */ Scalar_FLOAT32_IEEE 0 AppSwcVcu_CM_single_pct 0.0 100.0 /end CHARACTERISTIC
/begin CHARACTERISTIC KIPC_AccPedMinPstnUpOfst_pct "" VALUE 0x0000 /* @ECU_Address@KIPC_AccPedMinPstnUpOfst_pct@ */ Scalar_FLOAT32_IEEE 0 AppSwcVcu_CM_single_pct 0.0 100.0 /end CHARACTERISTIC
/begin CHARACTERISTIC KIPC_AccPedNormzPstnFiltTm_s "" VALUE 0x0000 /* @ECU_Address@KIPC_AccPedNormzPstnFiltTm_s@ */ Scalar_FLOAT32_IEEE 0 AppSwcVcu_CM_single_s 0.0 600.0 /end CHARACTERISTIC
/begin CHARACTERISTIC KIPC_AccPedPrsdThr4Stk_pct "" VALUE 0x0000 /* @ECU_Address@KIPC_AccPedPrsdThr4Stk_pct@ */ Scalar_FLOAT32_IEEE 0 AppSwcVcu_CM_single_pct 0.0 100.0 /end CHARACTERISTIC
/begin CHARACTERISTIC KIPC_AccPedPstnLmt_pct "" VALUE 0x0000 /* @ECU_Address@KIPC_AccPedPstnLmt_pct@ */ Scalar_FLOAT32_IEEE 0 AppSwcVcu_CM_single_pct 0.0 200.0 /end CHARACTERISTIC
/begin CHARACTERISTIC KIPC_AccPedPstnOvrdVal_pct "" VALUE 0x0000 /* @ECU_Address@KIPC_AccPedPstnOvrdVal_pct@ */ Scalar_FLOAT32_IEEE 0 AppSwcVcu_CM_single_pct 0.0 100.0 /end CHARACTERISTIC
/begin CHARACTERISTIC KIPC_AccPedSclRng_pct "" VALUE 0x0000 /* @ECU_Address@KIPC_AccPedSclRng_pct@ */ Scalar_FLOAT32_IEEE 0 AppSwcVcu_CM_single_pct 0.0 120.0 /end CHARACTERISTIC
/begin CHARACTERISTIC KIPC_AccPedStkFiltCoeff_rat "" VALUE 0x0000 /* @ECU_Address@KIPC_AccPedStkFiltCoeff_rat@ */ Scalar_FLOAT32_IEEE 0 AppSwcVcu_CM_single_rat 0.0 1.0 /end CHARACTERISTIC
/begin CHARACTERISTIC KIPC_AccPedStkStabThr_pct "" VALUE 0x0000 /* @ECU_Address@KIPC_AccPedStkStabThr_pct@ */ Scalar_FLOAT32_IEEE 0 AppSwcVcu_CM_single_pct 0.0 10.0 /end CHARACTERISTIC
/begin CHARACTERISTIC KIPC_AccPedStkStabTm_s "" VALUE 0x0000 /* @ECU_Address@KIPC_AccPedStkStabTm_s@ */ Scalar_FLOAT32_IEEE 0 AppSwcVcu_CM_single_s 0.0 600.0 /end CHARACTERISTIC
/begin CHARACTERISTIC KIPC_AccPedSwThr_pct "油门开关开启阈值" VALUE 0x0000 /* @ECU_Address@KIPC_AccPedSwThr_pct@ */ Scalar_FLOAT32_IEEE 0 AppSwcVcu_CM_single_pct 0.0 100.0 /end CHARACTERISTIC
/begin CHARACTERISTIC KIPC_AccPedZeroPstnDecRate_pctps "" VALUE 0x0000 /* @ECU_Address@KIPC_AccPedZeroPstnDecRate_pctps@ */ Scalar_FLOAT32_IEEE 0 AppSwcVcu_CM_single_pctps -100000.0 0.0 /end CHARACTERISTIC
/begin CHARACTERISTIC KIPC_AccPedZeroPstnIncRate_pctps "" VALUE 0x0000 /* @ECU_Address@KIPC_AccPedZeroPstnIncRate_pctps@ */ Scalar_FLOAT32_IEEE 0 AppSwcVcu_CM_single_pctps 0.0 100000.0 /end CHARACTERISTIC
/begin CHARACTERISTIC KIPC_BrkPedPrsdThr4Stk_pct "" VALUE 0x0000 /* @ECU_Address@KIPC_BrkPedPrsdThr4Stk_pct@ */ Scalar_FLOAT32_IEEE 0 AppSwcVcu_CM_single_pct 0.0 100.0 /end CHARACTERISTIC
/begin CHARACTERISTIC KIPC_BrkPedReldThr4Stk_pct "" VALUE 0x0000 /* @ECU_Address@KIPC_BrkPedReldThr4Stk_pct@ */ Scalar_FLOAT32_IEEE 0 AppSwcVcu_CM_single_pct 0.0 100.0 /end CHARACTERISTIC
/begin CHARACTERISTIC KIPC_ExitAutoCrpDrvDist_m "" VALUE 0x0000 /* @ECU_Address@KIPC_ExitAutoCrpDrvDist_m@ */ Scalar_FLOAT32_IEEE 0 AppSwcVcu_CM_single_m -100.0 10000.0 /end CHARACTERISTIC
/begin CHARACTERISTIC KIPC_ExitAutoCrpPNDurTm_s "" VALUE 0x0000 /* @ECU_Address@KIPC_ExitAutoCrpPNDurTm_s@ */ Scalar_FLOAT32_IEEE 0 AppSwcVcu_CM_single_s 0.0 600.0 /end CHARACTERISTIC
/begin CHARACTERISTIC KIPC_ExitAutoCrpVehSpd_kph "" VALUE 0x0000 /* @ECU_Address@KIPC_ExitAutoCrpVehSpd_kph@ */ Scalar_FLOAT32_IEEE 0 AppSwcVcu_CM_single_kph -100.0 300.0 /end CHARACTERISTIC
/begin CHARACTERISTIC KRME_AvgSOCCnsm100NumWghtFac_c "前100个数组能耗加权系数" VALUE 0x0000 /* @ECU_Address@KRME_AvgSOCCnsm100NumWghtFac_c@ */ Scalar_FLOAT32_IEEE 0 AppSwcVcu_CM_single_c 0.0 100.0 /end CHARACTERISTIC
/begin CHARACTERISTIC KRME_AvgSOCCnsm10NumWghtFac_c "前10个数组能耗加权系数" VALUE 0x0000 /* @ECU_Address@KRME_AvgSOCCnsm10NumWghtFac_c@ */ Scalar_FLOAT32_IEEE 0 AppSwcVcu_CM_single_c 0.0 100.0 /end CHARACTERISTIC
/begin CHARACTERISTIC KRME_AvgSOCCnsm15NumWghtFac_c "前15个数组能耗加权系数" VALUE 0x0000 /* @ECU_Address@KRME_AvgSOCCnsm15NumWghtFac_c@ */ Scalar_FLOAT32_IEEE 0 AppSwcVcu_CM_single_c 0.0 100.0 /end CHARACTERISTIC
/begin CHARACTERISTIC KRME_AvgSOCCnsm1NumWghtFac_c "初始数组加权系数" VALUE 0x0000 /* @ECU_Address@KRME_AvgSOCCnsm1NumWghtFac_c@ */ Scalar_FLOAT32_IEEE 0 AppSwcVcu_CM_single_c 0.0 100.0 /end CHARACTERISTIC
/begin CHARACTERISTIC KRME_AvgSOCCnsm25NumWghtFac_c "前25个数组能耗加权系数" VALUE 0x0000 /* @ECU_Address@KRME_AvgSOCCnsm25NumWghtFac_c@ */ Scalar_FLOAT32_IEEE 0 AppSwcVcu_CM_single_c 0.0 100.0 /end CHARACTERISTIC
/begin CHARACTERISTIC KRME_AvgSOCCnsm50NumWghtFac_c "前50个数组能耗加权系数" VALUE 0x0000 /* @ECU_Address@KRME_AvgSOCCnsm50NumWghtFac_c@ */ Scalar_FLOAT32_IEEE 0 AppSwcVcu_CM_single_c 0.0 100.0 /end CHARACTERISTIC
/begin CHARACTERISTIC KRME_AvgSOCCnsm5NumWghtFac_c "前5个数组能耗加权系数" VALUE 0x0000 /* @ECU_Address@KRME_AvgSOCCnsm5NumWghtFac_c@ */ Scalar_FLOAT32_IEEE 0 AppSwcVcu_CM_single_c 0.0 100.0 /end CHARACTERISTIC
/begin CHARACTERISTIC KRME_AvgSOCCnsmWghtVal_pctpkm "加权SOC消耗强控值" VALUE 0x0000 /* @ECU_Address@KRME_AvgSOCCnsmWghtVal_pctpkm@ */ Scalar_FLOAT32_IEEE 0 AppSwcVcu_CM_single_pctpkm -1000.0 1000.0 /end CHARACTERISTIC
/begin CHARACTERISTIC KRME_CalPwrCnsmVehThr_kph "PwrCnse计算累计里程的车速值" VALUE 0x0000 /* @ECU_Address@KRME_CalPwrCnsmVehThr_kph@ */ Scalar_FLOAT32_IEEE 0 AppSwcVcu_CM_single_kph 0.0 1000.0 /end CHARACTERISTIC
/begin CHARACTERISTIC KRME_CalSOCCnsmTgtDist_m "SOC消耗单位里程" VALUE 0x0000 /* @ECU_Address@KRME_CalSOCCnsmTgtDist_m@ */ Scalar_FLOAT32_IEEE 0 AppSwcVcu_CM_single_m 0.0 100000.0 /end CHARACTERISTIC
/begin CHARACTERISTIC KRME_CalSOCCnsmVehThr_kph "计算SOC消耗使能车速值" VALUE 0x0000 /* @ECU_Address@KRME_CalSOCCnsmVehThr_kph@ */ Scalar_FLOAT32_IEEE 0 AppSwcVcu_CM_single_kph 0.0 1000.0 /end CHARACTERISTIC
/begin CHARACTERISTIC KRME_VehStpDlyTm_s "车辆停止确认时间" VALUE 0x0000 /* @ECU_Address@KRME_VehStpDlyTm_s@ */ Scalar_FLOAT32_IEEE 0 AppSwcVcu_CM_single_s 0.0 1000.0 /end CHARACTERISTIC
/begin CHARACTERISTIC KRME_WLTPRmnMilEstVldOff_km "动态续航WLTP有效性Off" VALUE 0x0000 /* @ECU_Address@KRME_WLTPRmnMilEstVldOff_km@ */ Scalar_FLOAT32_IEEE 0 AppSwcVcu_CM_single_km 0.0 1000.0 /end CHARACTERISTIC
/begin CHARACTERISTIC KRME_WLTPRmnMilEstVldOn_km "动态续航WLTP有效性On" VALUE 0x0000 /* @ECU_Address@KRME_WLTPRmnMilEstVldOn_km@ */ Scalar_FLOAT32_IEEE 0 AppSwcVcu_CM_single_km 0.0 1000.0 /end CHARACTERISTIC
/begin CHARACTERISTIC KRME_WLTPStdUpLimFac_c "基于标准续航WLTP最大上限系数" VALUE 0x0000 /* @ECU_Address@KRME_WLTPStdUpLimFac_c@ */ Scalar_FLOAT32_IEEE 0 AppSwcVcu_CM_single 0.0 100.0 /end CHARACTERISTIC
/begin CHARACTERISTIC KTQC_ABSorESPActvTm1_s "" VALUE 0x0000 /* @ECU_Address@KTQC_ABSorESPActvTm1_s@ */ Scalar_FLOAT32_IEEE 0 AppSwcVcu_CM_single_s 0.0 3600.0 /end CHARACTERISTIC
/begin CHARACTERISTIC KTQC_ABSorESPActvTm2_s "" VALUE 0x0000 /* @ECU_Address@KTQC_ABSorESPActvTm2_s@ */ Scalar_FLOAT32_IEEE 0 AppSwcVcu_CM_single_s 0.0 3600.0 /end CHARACTERISTIC
/begin CHARACTERISTIC KTQC_BrkRegenTgtTqDecRate_Nmps "" VALUE 0x0000 /* @ECU_Address@KTQC_BrkRegenTgtTqDecRate_Nmps@ */ Scalar_FLOAT32_IEEE 0 AppSwcVcu_CM_single_Nmps -100000.0 0.0 /end CHARACTERISTIC
/begin CHARACTERISTIC KTQC_BrkRegenTgtTqIncRate_Nmps "" VALUE 0x0000 /* @ECU_Address@KTQC_BrkRegenTgtTqIncRate_Nmps@ */ Scalar_FLOAT32_IEEE 0 AppSwcVcu_CM_single_Nmps 0.0 100000.0 /end CHARACTERISTIC
/begin CHARACTERISTIC KTQC_CstRegenLmtTqDecRecry_Nmps "" VALUE 0x0000 /* @ECU_Address@KTQC_CstRegenLmtTqDecRecry_Nmps@ */ Scalar_FLOAT32_IEEE 0 AppSwcVcu_CM_single_Nmps 0.0 100000.0 /end CHARACTERISTIC
/begin CHARACTERISTIC KTQC_CstRegenLmtTqDecSlow_Nmps "" VALUE 0x0000 /* @ECU_Address@KTQC_CstRegenLmtTqDecSlow_Nmps@ */ Scalar_FLOAT32_IEEE 0 AppSwcVcu_CM_single_Nmps 0.0 100000.0 /end CHARACTERISTIC
/begin CHARACTERISTIC KTQC_CstRegenLmtTqIncPhs1_Nmps "" VALUE 0x0000 /* @ECU_Address@KTQC_CstRegenLmtTqIncPhs1_Nmps@ */ Scalar_FLOAT32_IEEE 0 AppSwcVcu_CM_single_Nmps 0.0 100000.0 /end CHARACTERISTIC
/begin CHARACTERISTIC KTQC_CstRegenLmtTqIncPhs2_Nmps "" VALUE 0x0000 /* @ECU_Address@KTQC_CstRegenLmtTqIncPhs2_Nmps@ */ Scalar_FLOAT32_IEEE 0 AppSwcVcu_CM_single_Nmps 0.0 100000.0 /end CHARACTERISTIC
/begin CHARACTERISTIC KTQC_DrvTqHiDsblRBSDlyTm_s "" VALUE 0x0000 /* @ECU_Address@KTQC_DrvTqHiDsblRBSDlyTm_s@ */ Scalar_FLOAT32_IEEE 0 AppSwcVcu_CM_single_s 0.0 60.0 /end CHARACTERISTIC
/begin CHARACTERISTIC KTQC_DrvTqHiDsblRBSThr_Nm "" VALUE 0x0000 /* @ECU_Address@KTQC_DrvTqHiDsblRBSThr_Nm@ */ Scalar_FLOAT32_IEEE 0 AppSwcVcu_CM_single_Nm -10000.0 10000.0 /end CHARACTERISTIC
/begin CHARACTERISTIC KTQC_DrvTqLoEnblRBSDlyTm_s "" VALUE 0x0000 /* @ECU_Address@KTQC_DrvTqLoEnblRBSDlyTm_s@ */ Scalar_FLOAT32_IEEE 0 AppSwcVcu_CM_single_s 0.0 60.0 /end CHARACTERISTIC
/begin CHARACTERISTIC KTQC_DrvTqLoEnblRBSThr_Nm "" VALUE 0x0000 /* @ECU_Address@KTQC_DrvTqLoEnblRBSThr_Nm@ */ Scalar_FLOAT32_IEEE 0 AppSwcVcu_CM_single_Nm -10000.0 10000.0 /end CHARACTERISTIC
/begin CHARACTERISTIC KTQC_RsmCstRegenAccPed_pct "" VALUE 0x0000 /* @ECU_Address@KTQC_RsmCstRegenAccPed_pct@ */ Scalar_FLOAT32_IEEE 0 AppSwcVcu_CM_single_pct -100.0 200.0 /end CHARACTERISTIC
/begin CHARACTERISTIC KTQC_RsmCstRegenTqReq_Nm "" VALUE 0x0000 /* @ECU_Address@KTQC_RsmCstRegenTqReq_Nm@ */ Scalar_FLOAT32_IEEE 0 AppSwcVcu_CM_single_Nm -10000.0 10000.0 /end CHARACTERISTIC
/begin CHARACTERISTIC KTQD_WhlSpdDiffFiltCoeff_c "" VALUE 0x0000 /* @ECU_Address@KTQD_WhlSpdDiffFiltCoeff_c@ */ Scalar_FLOAT32_IEEE 0 AppSwcVcu_CM_single_c 0.0 1.0 /end CHARACTERISTIC
/begin CHARACTERISTIC KTQF_TqDecDlyTm_s "torque increase judgement turn on delay" VALUE 0x0000 /* @ECU_Address@KTQF_TqDecDlyTm_s@ */ Scalar_FLOAT32_IEEE 0 AppSwcVcu_CM_single_s -100000.0 100000.0 /end CHARACTERISTIC
/begin CHARACTERISTIC KTQF_TqDecThr_Nm "torque decrease judgement tq threshold" VALUE 0x0000 /* @ECU_Address@KTQF_TqDecThr_Nm@ */ Scalar_FLOAT32_IEEE 0 AppSwcVcu_CM_single_Nm -100000.0 100000.0 /end CHARACTERISTIC
/begin CHARACTERISTIC KTQF_TqIncDlyTm_s "torque Decrease judgement turn on delay" VALUE 0x0000 /* @ECU_Address@KTQF_TqIncDlyTm_s@ */ Scalar_FLOAT32_IEEE 0 AppSwcVcu_CM_single_s -100000.0 100000.0 /end CHARACTERISTIC
/begin CHARACTERISTIC KTQF_TqIncThr_Nm "torque increase judgement tq threshold" VALUE 0x0000 /* @ECU_Address@KTQF_TqIncThr_Nm@ */ Scalar_FLOAT32_IEEE 0 AppSwcVcu_CM_single_Nm -100000.0 100000.0 /end CHARACTERISTIC
/begin CHARACTERISTIC KTQF_TqOutChgRateFilt_rat "torque output change rate filter" VALUE 0x0000 /* @ECU_Address@KTQF_TqOutChgRateFilt_rat@ */ Scalar_FLOAT32_IEEE 0 AppSwcVcu_CM_single_rat 0.0 1.0 /end CHARACTERISTIC
/begin CHARACTERISTIC KTQF_TqRateDecMin_Nmps "Rate limit, max decreasing. " VALUE 0x0000 /* @ECU_Address@KTQF_TqRateDecMin_Nmps@ */ Scalar_FLOAT32_IEEE 0 AppSwcVcu_CM_single_Nmps -100000.0 100000.0 /end CHARACTERISTIC
/begin CHARACTERISTIC KTQF_TqRateIncMin_Nmps "Rate limit, min decreasing. " VALUE 0x0000 /* @ECU_Address@KTQF_TqRateIncMin_Nmps@ */ Scalar_FLOAT32_IEEE 0 AppSwcVcu_CM_single_Nmps -100000.0 100000.0 /end CHARACTERISTIC
/begin CHARACTERISTIC KTQF_TqRateLimEndErrFac_c "" VALUE 0x0000 /* @ECU_Address@KTQF_TqRateLimEndErrFac_c@ */ Scalar_FLOAT32_IEEE 0 AppSwcVcu_CM_single_c 0.0 1000.0 /end CHARACTERISTIC
/begin CHARACTERISTIC KTQF_TqRateLimEndTm_s "Rate limit, target torque prediction time towards ending. " VALUE 0x0000 /* @ECU_Address@KTQF_TqRateLimEndTm_s@ */ Scalar_FLOAT32_IEEE 0 AppSwcVcu_CM_single_s 0.0 100.0 /end CHARACTERISTIC
/begin CHARACTERISTIC KTQF_TqRawChgRateFilt_rat "raw torque change rate filter" VALUE 0x0000 /* @ECU_Address@KTQF_TqRawChgRateFilt_rat@ */ Scalar_FLOAT32_IEEE 0 AppSwcVcu_CM_single_rat 0.0 1.0 /end CHARACTERISTIC
/begin CHARACTERISTIC KTQR_ABSActvDlyTm4Dampng_s "" VALUE 0x0000 /* @ECU_Address@KTQR_ABSActvDlyTm4Dampng_s@ */ Scalar_FLOAT32_IEEE 0 AppSwcVcu_CM_single_s 0.0 1000.0 /end CHARACTERISTIC
/begin CHARACTERISTIC KTQR_MotDampngBrkout_pct "" VALUE 0x0000 /* @ECU_Address@KTQR_MotDampngBrkout_pct@ */ Scalar_FLOAT32_IEEE 0 AppSwcVcu_CM_single_pct -10.0 150.0 /end CHARACTERISTIC
/begin CHARACTERISTIC KTQR_MotDampngLmtFac_c "" VALUE 0x0000 /* @ECU_Address@KTQR_MotDampngLmtFac_c@ */ Scalar_FLOAT32_IEEE 0 AppSwcVcu_CM_single_c 0.0 100.0 /end CHARACTERISTIC
/begin CHARACTERISTIC KTQR_MotDampngLmtMaxRate_Nmps "" VALUE 0x0000 /* @ECU_Address@KTQR_MotDampngLmtMaxRate_Nmps@ */ Scalar_FLOAT32_IEEE 0 AppSwcVcu_CM_single_Nmps 0.0 10000.0 /end CHARACTERISTIC
/begin CHARACTERISTIC KTQR_MotDampngLmtMin_Nm "" VALUE 0x0000 /* @ECU_Address@KTQR_MotDampngLmtMin_Nm@ */ Scalar_FLOAT32_IEEE 0 AppSwcVcu_CM_single_Nm 0.0 100.0 /end CHARACTERISTIC
/begin CHARACTERISTIC KTQR_MotDampngSpdOff_rpm "" VALUE 0x0000 /* @ECU_Address@KTQR_MotDampngSpdOff_rpm@ */ Scalar_FLOAT32_IEEE 0 AppSwcVcu_CM_single_rpm -10.0 100000.0 /end CHARACTERISTIC
/begin CHARACTERISTIC KTQR_MotDampngSpdOn_rpm "" VALUE 0x0000 /* @ECU_Address@KTQR_MotDampngSpdOn_rpm@ */ Scalar_FLOAT32_IEEE 0 AppSwcVcu_CM_single_rpm -10.0 100000.0 /end CHARACTERISTIC
/begin CHARACTERISTIC KTQR_MotorStdbyDlyTm_s "" VALUE 0x0000 /* @ECU_Address@KTQR_MotorStdbyDlyTm_s@ */ Scalar_FLOAT32_IEEE 0 AppSwcVcu_CM_single_s 0.0 1000.0 /end CHARACTERISTIC
/begin CHARACTERISTIC KTQR_MotorStdbyVehHaltHi_kph "" VALUE 0x0000 /* @ECU_Address@KTQR_MotorStdbyVehHaltHi_kph@ */ Scalar_FLOAT32_IEEE 0 AppSwcVcu_CM_single_kph -1000.0 1000.0 /end CHARACTERISTIC
/begin CHARACTERISTIC KTQR_MotorStdbyVehHaltLo_kph "" VALUE 0x0000 /* @ECU_Address@KTQR_MotorStdbyVehHaltLo_kph@ */ Scalar_FLOAT32_IEEE 0 AppSwcVcu_CM_single_kph -1000.0 1000.0 /end CHARACTERISTIC
/begin CHARACTERISTIC KTQR_MotorTqZeroDlyTm_s "" VALUE 0x0000 /* @ECU_Address@KTQR_MotorTqZeroDlyTm_s@ */ Scalar_FLOAT32_IEEE 0 AppSwcVcu_CM_single_s 0.0 1000.0 /end CHARACTERISTIC
/begin CHARACTERISTIC KTQR_MotorTqZero_Nm "" VALUE 0x0000 /* @ECU_Address@KTQR_MotorTqZero_Nm@ */ Scalar_FLOAT32_IEEE 0 AppSwcVcu_CM_single_Nm -1000.0 1000.0 /end CHARACTERISTIC
/begin CHARACTERISTIC KVSO_DistErrHldSlip_kph "" VALUE 0x0000 /* @ECU_Address@KVSO_DistErrHldSlip_kph@ */ Scalar_FLOAT32_IEEE 0 AppSwcVcu_CM_single_kph -10.0 1000.0 /end CHARACTERISTIC
/begin CHARACTERISTIC KVSO_DistErrHldSpd_kph "" VALUE 0x0000 /* @ECU_Address@KVSO_DistErrHldSpd_kph@ */ Scalar_FLOAT32_IEEE 0 AppSwcVcu_CM_single_kph -10.0 1000.0 /end CHARACTERISTIC
/begin CHARACTERISTIC KVSO_DistErrHldStrg_kph "" VALUE 0x0000 /* @ECU_Address@KVSO_DistErrHldStrg_kph@ */ Scalar_FLOAT32_IEEE 0 AppSwcVcu_CM_single_kph -10.0 1000.0 /end CHARACTERISTIC
/begin CHARACTERISTIC KVSO_WhlDistErrRecThr_m "" VALUE 0x0000 /* @ECU_Address@KVSO_WhlDistErrRecThr_m@ */ Scalar_FLOAT32_IEEE 0 AppSwcVcu_CM_single_m 0.0 100000.0 /end CHARACTERISTIC
/begin CHARACTERISTIC KVSO_WhlDistErrRefRecThr_m "" VALUE 0x0000 /* @ECU_Address@KVSO_WhlDistErrRefRecThr_m@ */ Scalar_FLOAT32_IEEE 0 AppSwcVcu_CM_single_m 0.0 100000.0 /end CHARACTERISTIC
/begin CHARACTERISTIC KDAG_BMSUndrVoltActnMsk1_enum "BMSPack欠压故障动作_升级前" VALUE 0x0000 /* @ECU_Address@KDAG_BMSUndrVoltActnMsk1_enum@ */ Scalar_UWORD 0 AppSwcVcu_CM_uint16_enum 0.0 65535.0 /end CHARACTERISTIC
/begin CHARACTERISTIC KDAG_BMSUndrVoltActnMsk2_enum "BMSPack欠压故障动作_升级后" VALUE 0x0000 /* @ECU_Address@KDAG_BMSUndrVoltActnMsk2_enum@ */ Scalar_UWORD 0 AppSwcVcu_CM_uint16_enum 0.0 65535.0 /end CHARACTERISTIC
/begin CHARACTERISTIC KDAG_DCCCmdTmOutActnMsk1_enum "DCDC模式指令响应超时故障动作_升级前" VALUE 0x0000 /* @ECU_Address@KDAG_DCCCmdTmOutActnMsk1_enum@ */ Scalar_UWORD 0 AppSwcVcu_CM_uint16_enum 0.0 65535.0 /end CHARACTERISTIC
/begin CHARACTERISTIC KDAG_DCCCmdTmOutActnMsk2_enum "DCDC模式指令响应超时故障动作_升级后" VALUE 0x0000 /* @ECU_Address@KDAG_DCCCmdTmOutActnMsk2_enum@ */ Scalar_UWORD 0 AppSwcVcu_CM_uint16_enum 0.0 65535.0 /end CHARACTERISTIC
/begin CHARACTERISTIC KDAG_DCCModeFltActnMsk1_enum "DCDCModeFault故障动作_升级前" VALUE 0x0000 /* @ECU_Address@KDAG_DCCModeFltActnMsk1_enum@ */ Scalar_UWORD 0 AppSwcVcu_CM_uint16_enum 0.0 65535.0 /end CHARACTERISTIC
/begin CHARACTERISTIC KDAG_DCCModeFltActnMsk2_enum "DCDCModeFault故障动作_升级后" VALUE 0x0000 /* @ECU_Address@KDAG_DCCModeFltActnMsk2_enum@ */ Scalar_UWORD 0 AppSwcVcu_CM_uint16_enum 0.0 65535.0 /end CHARACTERISTIC
/begin CHARACTERISTIC KDAG_DCCSysFailLvl3ActnMsk1_enum "DCDCFaillevel3故障动作_升级前" VALUE 0x0000 /* @ECU_Address@KDAG_DCCSysFailLvl3ActnMsk1_enum@ */ Scalar_UWORD 0 AppSwcVcu_CM_uint16_enum 0.0 65535.0 /end CHARACTERISTIC
/begin CHARACTERISTIC KDAG_DCCSysFailLvl3ActnMsk2_enum "DCDCFaillevel3故障动作_升级后" VALUE 0x0000 /* @ECU_Address@KDAG_DCCSysFailLvl3ActnMsk2_enum@ */ Scalar_UWORD 0 AppSwcVcu_CM_uint16_enum 0.0 65535.0 /end CHARACTERISTIC
/begin CHARACTERISTIC KDAG_HVILVoltChkActnMsk1_enum "高压互锁故障动作_升级前" VALUE 0x0000 /* @ECU_Address@KDAG_HVILVoltChkActnMsk1_enum@ */ Scalar_UWORD 0 AppSwcVcu_CM_uint16_enum 0.0 65535.0 /end CHARACTERISTIC
/begin CHARACTERISTIC KDAG_HVILVoltChkActnMsk2_enum "高压互锁故障动作_升级后" VALUE 0x0000 /* @ECU_Address@KDAG_HVILVoltChkActnMsk2_enum@ */ Scalar_UWORD 0 AppSwcVcu_CM_uint16_enum 0.0 65535.0 /end CHARACTERISTIC
/begin CHARACTERISTIC KDAG_LVBattTempHiActnMsk1_enum "蓄电池过温故障动作_升级前" VALUE 0x0000 /* @ECU_Address@KDAG_LVBattTempHiActnMsk1_enum@ */ Scalar_UWORD 0 AppSwcVcu_CM_uint16_enum 0.0 65535.0 /end CHARACTERISTIC
/begin CHARACTERISTIC KDAG_LVBattTempHiActnMsk2_enum "蓄电池过温故障动作_升级后" VALUE 0x0000 /* @ECU_Address@KDAG_LVBattTempHiActnMsk2_enum@ */ Scalar_UWORD 0 AppSwcVcu_CM_uint16_enum 0.0 65535.0 /end CHARACTERISTIC
/begin CHARACTERISTIC KIPM_HwKL30Hi_mV "" VALUE 0x0000 /* @ECU_Address@KIPM_HwKL30Hi_mV@ */ Scalar_UWORD 0 AppSwcVcu_CM_uint16_mV 0.0 20000.0 /end CHARACTERISTIC
/begin CHARACTERISTIC KIPM_HwKL30Lo_mV "" VALUE 0x0000 /* @ECU_Address@KIPM_HwKL30Lo_mV@ */ Scalar_UWORD 0 AppSwcVcu_CM_uint16_mV 0.0 20000.0 /end CHARACTERISTIC
/begin CHARACTERISTIC KIPM_HwKL30_mV_ovrdval "" VALUE 0x0000 /* @ECU_Address@KIPM_HwKL30_mV_ovrdval@ */ Scalar_UWORD 0 AppSwcVcu_CM_uint16_mV 0.0 20000.0 /end CHARACTERISTIC
/begin CHARACTERISTIC KIPM_HwShftPstnSwPrsdHi_Ohm "" VALUE 0x0000 /* @ECU_Address@KIPM_HwShftPstnSwPrsdHi_Ohm@ */ Scalar_UWORD 0 AppSwcVcu_CM_uint16_Ohm 0.0 65535.0 /end CHARACTERISTIC
/begin CHARACTERISTIC KIPM_HwShftPstnSwPrsdLo_Ohm "" VALUE 0x0000 /* @ECU_Address@KIPM_HwShftPstnSwPrsdLo_Ohm@ */ Scalar_UWORD 0 AppSwcVcu_CM_uint16_Ohm 0.0 65535.0 /end CHARACTERISTIC
/begin CHARACTERISTIC KIPM_HwShftPstnSwReldHi_Ohm "" VALUE 0x0000 /* @ECU_Address@KIPM_HwShftPstnSwReldHi_Ohm@ */ Scalar_UWORD 0 AppSwcVcu_CM_uint16_Ohm 0.0 65535.0 /end CHARACTERISTIC
/begin CHARACTERISTIC KIPM_HwShftPstnSwReldLo_Ohm "" VALUE 0x0000 /* @ECU_Address@KIPM_HwShftPstnSwReldLo_Ohm@ */ Scalar_UWORD 0 AppSwcVcu_CM_uint16_Ohm 0.0 65535.0 /end CHARACTERISTIC
/begin CHARACTERISTIC KIPM_HwShftPstnSwShtBatt_Ohm "" VALUE 0x0000 /* @ECU_Address@KIPM_HwShftPstnSwShtBatt_Ohm@ */ Scalar_UWORD 0 AppSwcVcu_CM_uint16_Ohm 0.0 65535.0 /end CHARACTERISTIC
/begin CHARACTERISTIC KIPM_HwShftPstnSwShtGnd_Ohm "" VALUE 0x0000 /* @ECU_Address@KIPM_HwShftPstnSwShtGnd_Ohm@ */ Scalar_UWORD 0 AppSwcVcu_CM_uint16_Ohm 0.0 65535.0 /end CHARACTERISTIC
/begin CHARACTERISTIC KGSM_ReqEPBVal_enum "请求EPB状态-观测量：VGSM_ReqEPB_enum" VALUE 0x0000 /* @ECU_Address@KGSM_ReqEPBVal_enum@ */ Scalar_UBYTE 0 AppSwcVcu_CM_EnumEPBReq 0 2 /end CHARACTERISTIC
/begin CHARACTERISTIC KGSM_VehActGearPstnVal_enum "实际输出档位控制 0-P 1-N 2-D 3-R-观测量：VGSM_VehActGearPstn_enum" VALUE 0x0000 /* @ECU_Address@KGSM_VehActGearPstnVal_enum@ */ Scalar_UBYTE 0 AppSwcVcu_CM_EnumGearPstn 0 3 /end CHARACTERISTIC
/begin CHARACTERISTIC KIPM_HwShftPstnSwSts_enum_ovrdval "" VALUE 0x0000 /* @ECU_Address@KIPM_HwShftPstnSwSts_enum_ovrdval@ */ Scalar_UBYTE 0 AppSwcVcu_CM_EnumPGearSwSts 0 4 /end CHARACTERISTIC
/begin CHARACTERISTIC KDAC_OPDTqRespFst_flg "" VALUE 0x0000 /* @ECU_Address@KDAC_OPDTqRespFst_flg@ */ Scalar_BOOLEAN 0 AppSwcVcu_CM_boolean_flg 0.0 1.0 /end CHARACTERISTIC
/begin CHARACTERISTIC KDAC_OPDTqRespSprt_flg "" VALUE 0x0000 /* @ECU_Address@KDAC_OPDTqRespSprt_flg@ */ Scalar_BOOLEAN 0 AppSwcVcu_CM_boolean_flg 0.0 1.0 /end CHARACTERISTIC
/begin CHARACTERISTIC KGSM_DRFlt2NSw_flg "驱动档故障进N档强控" VALUE 0x0000 /* @ECU_Address@KGSM_DRFlt2NSw_flg@ */ Scalar_BOOLEAN 0 AppSwcVcu_CM_boolean_flg 0.0 1.0 /end CHARACTERISTIC
/begin CHARACTERISTIC KGSM_DRFlt2NVal_flg "驱动档故障进N档-观测量：VGSM_DRFlt2N_flg" VALUE 0x0000 /* @ECU_Address@KGSM_DRFlt2NVal_flg@ */ Scalar_BOOLEAN 0 AppSwcVcu_CM_boolean_flg 0.0 1.0 /end CHARACTERISTIC
/begin CHARACTERISTIC KGSM_GrNReq2PSw_flg "N档非换挡请求进P档请求强控" VALUE 0x0000 /* @ECU_Address@KGSM_GrNReq2PSw_flg@ */ Scalar_BOOLEAN 0 AppSwcVcu_CM_boolean_flg 0.0 1.0 /end CHARACTERISTIC
/begin CHARACTERISTIC KGSM_GrNReq2PVal_flg "N档非换挡请求进P档请求-观测量：VGSM_GrNReq2P_flg" VALUE 0x0000 /* @ECU_Address@KGSM_GrNReq2PVal_flg@ */ Scalar_BOOLEAN 0 AppSwcVcu_CM_boolean_flg 0.0 1.0 /end CHARACTERISTIC
/begin CHARACTERISTIC KGSM_HldGearPSw_flg "保持P档请求强控" VALUE 0x0000 /* @ECU_Address@KGSM_HldGearPSw_flg@ */ Scalar_BOOLEAN 0 AppSwcVcu_CM_boolean_flg 0.0 1.0 /end CHARACTERISTIC
/begin CHARACTERISTIC KGSM_HldGearPVal_flg "保持P档请求-观测量：VGSM_HldGearP_flg" VALUE 0x0000 /* @ECU_Address@KGSM_HldGearPVal_flg@ */ Scalar_BOOLEAN 0 AppSwcVcu_CM_boolean_flg 0.0 1.0 /end CHARACTERISTIC
/begin CHARACTERISTIC KGSM_ReqEPBSw_flg "请求EPB状态强控" VALUE 0x0000 /* @ECU_Address@KGSM_ReqEPBSw_flg@ */ Scalar_BOOLEAN 0 AppSwcVcu_CM_boolean_flg 0.0 1.0 /end CHARACTERISTIC
/begin CHARACTERISTIC KGSM_VehActGearPstnSw_flg "实际输出档位控制强控" VALUE 0x0000 /* @ECU_Address@KGSM_VehActGearPstnSw_flg@ */ Scalar_BOOLEAN 0 AppSwcVcu_CM_boolean_flg 0.0 1.0 /end CHARACTERISTIC
/begin CHARACTERISTIC KHVM_INVPreprogm_ovrdflg "INV与编程标定控制开关" VALUE 0x0000 /* @ECU_Address@KHVM_INVPreprogm_ovrdflg@ */ Scalar_BOOLEAN 0 AppSwcVcu_CM_boolean 0.0 1.0 /end CHARACTERISTIC
/begin CHARACTERISTIC KHVM_INVPreprogm_ovrdval "INV与编程标定控制值" VALUE 0x0000 /* @ECU_Address@KHVM_INVPreprogm_ovrdval@ */ Scalar_BOOLEAN 0 AppSwcVcu_CM_boolean 0.0 1.0 /end CHARACTERISTIC
/begin CHARACTERISTIC KHVM_PTRdy2PTStdby_ovrdflg "Rdy退回Stdby开关" VALUE 0x0000 /* @ECU_Address@KHVM_PTRdy2PTStdby_ovrdflg@ */ Scalar_BOOLEAN 0 AppSwcVcu_CM_boolean 0.0 1.0 /end CHARACTERISTIC
/begin CHARACTERISTIC KHVM_PTRdy2PTStdby_ovrdval "Rdy退回Stdby控制值" VALUE 0x0000 /* @ECU_Address@KHVM_PTRdy2PTStdby_ovrdval@ */ Scalar_BOOLEAN 0 AppSwcVcu_CM_boolean 0.0 1.0 /end CHARACTERISTIC
/begin CHARACTERISTIC KHVM_PTStdby2PTRdy_ovrdflg "Stdby进入Rdy开关" VALUE 0x0000 /* @ECU_Address@KHVM_PTStdby2PTRdy_ovrdflg@ */ Scalar_BOOLEAN 0 AppSwcVcu_CM_boolean 0.0 1.0 /end CHARACTERISTIC
/begin CHARACTERISTIC KHVM_PTStdby2PTRdy_ovrdval "Stdby进入Rdy控制值" VALUE 0x0000 /* @ECU_Address@KHVM_PTStdby2PTRdy_ovrdval@ */ Scalar_BOOLEAN 0 AppSwcVcu_CM_boolean 0.0 1.0 /end CHARACTERISTIC
/begin CHARACTERISTIC KHVM_PowUpSelfChek_ovrdflg "高压自检条件控制开关" VALUE 0x0000 /* @ECU_Address@KHVM_PowUpSelfChek_ovrdflg@ */ Scalar_BOOLEAN 0 AppSwcVcu_CM_boolean 0.0 1.0 /end CHARACTERISTIC
/begin CHARACTERISTIC KHVM_PowUpSelfChek_ovrdval "高压自检条件控制值" VALUE 0x0000 /* @ECU_Address@KHVM_PowUpSelfChek_ovrdval@ */ Scalar_BOOLEAN 0 AppSwcVcu_CM_boolean 0.0 1.0 /end CHARACTERISTIC
/begin CHARACTERISTIC KHVM_PwrOn2PwrDwn_ovrdflg "高压下电条件满足开关" VALUE 0x0000 /* @ECU_Address@KHVM_PwrOn2PwrDwn_ovrdflg@ */ Scalar_BOOLEAN 0 AppSwcVcu_CM_boolean 0.0 1.0 /end CHARACTERISTIC
/begin CHARACTERISTIC KHVM_PwrOn2PwrDwn_ovrdval "高压下电条件满足控制值" VALUE 0x0000 /* @ECU_Address@KHVM_PwrOn2PwrDwn_ovrdval@ */ Scalar_BOOLEAN 0 AppSwcVcu_CM_boolean 0.0 1.0 /end CHARACTERISTIC
/begin CHARACTERISTIC KHVM_WakeUp2PwrUp_ovrdflg "唤醒到上高压条件开关" VALUE 0x0000 /* @ECU_Address@KHVM_WakeUp2PwrUp_ovrdflg@ */ Scalar_BOOLEAN 0 AppSwcVcu_CM_boolean 0.0 1.0 /end CHARACTERISTIC
/begin CHARACTERISTIC KHVM_WakeUp2PwrUp_ovrdval "唤醒到上高压条件控制值" VALUE 0x0000 /* @ECU_Address@KHVM_WakeUp2PwrUp_ovrdval@ */ Scalar_BOOLEAN 0 AppSwcVcu_CM_boolean 0.0 1.0 /end CHARACTERISTIC
/begin CHARACTERISTIC KHVM_WakeUpVCU_ovrdflg "休眠到唤醒条件控制开关" VALUE 0x0000 /* @ECU_Address@KHVM_WakeUpVCU_ovrdflg@ */ Scalar_BOOLEAN 0 AppSwcVcu_CM_boolean 0.0 1.0 /end CHARACTERISTIC
/begin CHARACTERISTIC KHVM_WakeUpVCU_ovrdval "休眠到唤醒条件控制值" VALUE 0x0000 /* @ECU_Address@KHVM_WakeUpVCU_ovrdval@ */ Scalar_BOOLEAN 0 AppSwcVcu_CM_boolean 0.0 1.0 /end CHARACTERISTIC
/begin CHARACTERISTIC KIPC_AccPedPstnOvrdSw_flg "" VALUE 0x0000 /* @ECU_Address@KIPC_AccPedPstnOvrdSw_flg@ */ Scalar_BOOLEAN 0 AppSwcVcu_CM_boolean_flg 0.0 1.0 /end CHARACTERISTIC
/begin CHARACTERISTIC KIPC_AccPedStkDiagEnbl_flg "" VALUE 0x0000 /* @ECU_Address@KIPC_AccPedStkDiagEnbl_flg@ */ Scalar_BOOLEAN 0 AppSwcVcu_CM_boolean_flg 0.0 1.0 /end CHARACTERISTIC
/begin CHARACTERISTIC KIPC_ESCVehSpdPrio_flg "" VALUE 0x0000 /* @ECU_Address@KIPC_ESCVehSpdPrio_flg@ */ Scalar_BOOLEAN 0 AppSwcVcu_CM_boolean_flg 0.0 1.0 /end CHARACTERISTIC
/begin CHARACTERISTIC KIPC_ESCWhlSpdPrio_flg "" VALUE 0x0000 /* @ECU_Address@KIPC_ESCWhlSpdPrio_flg@ */ Scalar_BOOLEAN 0 AppSwcVcu_CM_boolean_flg 0.0 1.0 /end CHARACTERISTIC
/begin CHARACTERISTIC KIPC_EnblFltRstAccPedZP_flg "" VALUE 0x0000 /* @ECU_Address@KIPC_EnblFltRstAccPedZP_flg@ */ Scalar_BOOLEAN 0 AppSwcVcu_CM_boolean_flg 0.0 1.0 /end CHARACTERISTIC
/begin CHARACTERISTIC KIPC_EnblVpedAutoCrp_flg "" VALUE 0x0000 /* @ECU_Address@KIPC_EnblVpedAutoCrp_flg@ */ Scalar_BOOLEAN 0 AppSwcVcu_CM_boolean_flg 0.0 1.0 /end CHARACTERISTIC
/begin CHARACTERISTIC KIPM_HwBMSWakeup_flg_ovrdflg "" VALUE 0x0000 /* @ECU_Address@KIPM_HwBMSWakeup_flg_ovrdflg@ */ Scalar_BOOLEAN 0 AppSwcVcu_CM_boolean_flg 0.0 1.0 /end CHARACTERISTIC
/begin CHARACTERISTIC KIPM_HwBMSWakeup_flg_ovrdval "" VALUE 0x0000 /* @ECU_Address@KIPM_HwBMSWakeup_flg_ovrdval@ */ Scalar_BOOLEAN 0 AppSwcVcu_CM_boolean_flg 0.0 1.0 /end CHARACTERISTIC
/begin CHARACTERISTIC KIPM_HwBrkSwHi_flg_ovrdflg "" VALUE 0x0000 /* @ECU_Address@KIPM_HwBrkSwHi_flg_ovrdflg@ */ Scalar_BOOLEAN 0 AppSwcVcu_CM_boolean_flg 0.0 1.0 /end CHARACTERISTIC
/begin CHARACTERISTIC KIPM_HwBrkSwHi_flg_ovrdval "" VALUE 0x0000 /* @ECU_Address@KIPM_HwBrkSwHi_flg_ovrdval@ */ Scalar_BOOLEAN 0 AppSwcVcu_CM_boolean_flg 0.0 1.0 /end CHARACTERISTIC
/begin CHARACTERISTIC KIPM_HwBrkSwLo_flg_ovrdflg "" VALUE 0x0000 /* @ECU_Address@KIPM_HwBrkSwLo_flg_ovrdflg@ */ Scalar_BOOLEAN 0 AppSwcVcu_CM_boolean_flg 0.0 1.0 /end CHARACTERISTIC
/begin CHARACTERISTIC KIPM_HwBrkSwLo_flg_ovrdval "" VALUE 0x0000 /* @ECU_Address@KIPM_HwBrkSwLo_flg_ovrdval@ */ Scalar_BOOLEAN 0 AppSwcVcu_CM_boolean_flg 0.0 1.0 /end CHARACTERISTIC
/begin CHARACTERISTIC KIPM_HwCrpModeSw_flg_ovrdflg "" VALUE 0x0000 /* @ECU_Address@KIPM_HwCrpModeSw_flg_ovrdflg@ */ Scalar_BOOLEAN 0 AppSwcVcu_CM_boolean_flg 0.0 1.0 /end CHARACTERISTIC
/begin CHARACTERISTIC KIPM_HwCrpModeSw_flg_ovrdval "" VALUE 0x0000 /* @ECU_Address@KIPM_HwCrpModeSw_flg_ovrdval@ */ Scalar_BOOLEAN 0 AppSwcVcu_CM_boolean_flg 0.0 1.0 /end CHARACTERISTIC
/begin CHARACTERISTIC KIPM_HwDrvModeSw_flg_ovrdflg "" VALUE 0x0000 /* @ECU_Address@KIPM_HwDrvModeSw_flg_ovrdflg@ */ Scalar_BOOLEAN 0 AppSwcVcu_CM_boolean_flg 0.0 1.0 /end CHARACTERISTIC
/begin CHARACTERISTIC KIPM_HwDrvModeSw_flg_ovrdval "" VALUE 0x0000 /* @ECU_Address@KIPM_HwDrvModeSw_flg_ovrdval@ */ Scalar_BOOLEAN 0 AppSwcVcu_CM_boolean_flg 0.0 1.0 /end CHARACTERISTIC
/begin CHARACTERISTIC KIPM_HwEmgcyShutOff_flg_ovrdflg "" VALUE 0x0000 /* @ECU_Address@KIPM_HwEmgcyShutOff_flg_ovrdflg@ */ Scalar_BOOLEAN 0 AppSwcVcu_CM_boolean_flg 0.0 1.0 /end CHARACTERISTIC
/begin CHARACTERISTIC KIPM_HwEmgcyShutOff_flg_ovrdval "" VALUE 0x0000 /* @ECU_Address@KIPM_HwEmgcyShutOff_flg_ovrdval@ */ Scalar_BOOLEAN 0 AppSwcVcu_CM_boolean_flg 0.0 1.0 /end CHARACTERISTIC
/begin CHARACTERISTIC KIPM_HwKL15A_flg_ovrdflg "" VALUE 0x0000 /* @ECU_Address@KIPM_HwKL15A_flg_ovrdflg@ */ Scalar_BOOLEAN 0 AppSwcVcu_CM_boolean_flg 0.0 1.0 /end CHARACTERISTIC
/begin CHARACTERISTIC KIPM_HwKL15A_flg_ovrdval "" VALUE 0x0000 /* @ECU_Address@KIPM_HwKL15A_flg_ovrdval@ */ Scalar_BOOLEAN 0 AppSwcVcu_CM_boolean_flg 0.0 1.0 /end CHARACTERISTIC
/begin CHARACTERISTIC KIPM_HwKL15B_flg_ovrdflg "" VALUE 0x0000 /* @ECU_Address@KIPM_HwKL15B_flg_ovrdflg@ */ Scalar_BOOLEAN 0 AppSwcVcu_CM_boolean_flg 0.0 1.0 /end CHARACTERISTIC
/begin CHARACTERISTIC KIPM_HwKL15B_flg_ovrdval "" VALUE 0x0000 /* @ECU_Address@KIPM_HwKL15B_flg_ovrdval@ */ Scalar_BOOLEAN 0 AppSwcVcu_CM_boolean_flg 0.0 1.0 /end CHARACTERISTIC
/begin CHARACTERISTIC KIPM_HwKL30_mV_ovrdflg "" VALUE 0x0000 /* @ECU_Address@KIPM_HwKL30_mV_ovrdflg@ */ Scalar_BOOLEAN 0 AppSwcVcu_CM_boolean_flg 0.0 1.0 /end CHARACTERISTIC
/begin CHARACTERISTIC KIPM_HwOBCWakeup_flg_ovrdflg "" VALUE 0x0000 /* @ECU_Address@KIPM_HwOBCWakeup_flg_ovrdflg@ */ Scalar_BOOLEAN 0 AppSwcVcu_CM_boolean_flg 0.0 1.0 /end CHARACTERISTIC
/begin CHARACTERISTIC KIPM_HwOBCWakeup_flg_ovrdval "" VALUE 0x0000 /* @ECU_Address@KIPM_HwOBCWakeup_flg_ovrdval@ */ Scalar_BOOLEAN 0 AppSwcVcu_CM_boolean_flg 0.0 1.0 /end CHARACTERISTIC
/begin CHARACTERISTIC KIPM_HwRearFogLampSwt_flg_ovrdflg "" VALUE 0x0000 /* @ECU_Address@KIPM_HwRearFogLampSwt_flg_ovrdflg@ */ Scalar_BOOLEAN 0 AppSwcVcu_CM_boolean_flg 0.0 1.0 /end CHARACTERISTIC
/begin CHARACTERISTIC KIPM_HwRearFogLampSwt_flg_ovrdval "" VALUE 0x0000 /* @ECU_Address@KIPM_HwRearFogLampSwt_flg_ovrdval@ */ Scalar_BOOLEAN 0 AppSwcVcu_CM_boolean_flg 0.0 1.0 /end CHARACTERISTIC
/begin CHARACTERISTIC KIPM_HwShftPstnSwSts_enum_ovrdflg "" VALUE 0x0000 /* @ECU_Address@KIPM_HwShftPstnSwSts_enum_ovrdflg@ */ Scalar_BOOLEAN 0 AppSwcVcu_CM_boolean_flg 0.0 1.0 /end CHARACTERISTIC
/begin CHARACTERISTIC KIPM_HwVehCrash_flg_ovrdflg "" VALUE 0x0000 /* @ECU_Address@KIPM_HwVehCrash_flg_ovrdflg@ */ Scalar_BOOLEAN 0 AppSwcVcu_CM_boolean_flg 0.0 1.0 /end CHARACTERISTIC
/begin CHARACTERISTIC KIPM_HwVehCrash_flg_ovrdval "" VALUE 0x0000 /* @ECU_Address@KIPM_HwVehCrash_flg_ovrdval@ */ Scalar_BOOLEAN 0 AppSwcVcu_CM_boolean_flg 0.0 1.0 /end CHARACTERISTIC
/begin CHARACTERISTIC KOPM_HwWakeupBMS_flg_ovrdflg "" VALUE 0x0000 /* @ECU_Address@KOPM_HwWakeupBMS_flg_ovrdflg@ */ Scalar_BOOLEAN 0 AppSwcVcu_CM_boolean_flg 0.0 1.0 /end CHARACTERISTIC
/begin CHARACTERISTIC KOPM_HwWakeupBMS_flg_ovrdval "" VALUE 0x0000 /* @ECU_Address@KOPM_HwWakeupBMS_flg_ovrdval@ */ Scalar_BOOLEAN 0 AppSwcVcu_CM_boolean_flg 0.0 1.0 /end CHARACTERISTIC
/begin CHARACTERISTIC KRME_AvgSOCCnsmWghtSw_flg "加权SOC消耗强控开关" VALUE 0x0000 /* @ECU_Address@KRME_AvgSOCCnsmWghtSw_flg@ */ Scalar_BOOLEAN 0 AppSwcVcu_CM_boolean_flg 0.0 1.0 /end CHARACTERISTIC
/begin CHARACTERISTIC KRME_WLTPCtrlModeSel_flg "WLTP控制方式选择:0-动态续航 1-查表WLTP续航" VALUE 0x0000 /* @ECU_Address@KRME_WLTPCtrlModeSel_flg@ */ Scalar_BOOLEAN 0 AppSwcVcu_CM_boolean_flg 0.0 1.0 /end CHARACTERISTIC
/begin CHARACTERISTIC KTQC_ABSInhbBrkRegen_flg "" VALUE 0x0000 /* @ECU_Address@KTQC_ABSInhbBrkRegen_flg@ */ Scalar_BOOLEAN 0 AppSwcVcu_CM_boolean_flg 0.0 1.0 /end CHARACTERISTIC
/begin CHARACTERISTIC KTQC_EnblBrkRsmCstRegen_flg "" VALUE 0x0000 /* @ECU_Address@KTQC_EnblBrkRsmCstRegen_flg@ */ Scalar_BOOLEAN 0 AppSwcVcu_CM_boolean_flg 0.0 1.0 /end CHARACTERISTIC
/begin CHARACTERISTIC KTQC_EnblESPIntvBrkTgtZero_flg "" VALUE 0x0000 /* @ECU_Address@KTQC_EnblESPIntvBrkTgtZero_flg@ */ Scalar_BOOLEAN 0 AppSwcVcu_CM_boolean_flg 0.0 1.0 /end CHARACTERISTIC
/begin CHARACTERISTIC KTQC_EnblRBSIntv_flg "" VALUE 0x0000 /* @ECU_Address@KTQC_EnblRBSIntv_flg@ */ Scalar_BOOLEAN 0 AppSwcVcu_CM_boolean_flg 0.0 1.0 /end CHARACTERISTIC
/begin CHARACTERISTIC KTQF_DsblEndFlgRateCond_flg "set to false, change rate is considered when judging ending flag" VALUE 0x0000 /* @ECU_Address@KTQF_DsblEndFlgRateCond_flg@ */ Scalar_BOOLEAN 0 AppSwcVcu_CM_boolean_flg 0.0 1.0 /end CHARACTERISTIC
/begin CHARACTERISTIC KTQR_ASDEnbl_flg "" VALUE 0x0000 /* @ECU_Address@KTQR_ASDEnbl_flg@ */ Scalar_BOOLEAN 0 AppSwcVcu_CM_boolean_flg 0.0 1.0 /end CHARACTERISTIC
/begin CHARACTERISTIC KTQR_AllZeroCrsDsblDamp_flg "" VALUE 0x0000 /* @ECU_Address@KTQR_AllZeroCrsDsblDamp_flg@ */ Scalar_BOOLEAN 0 AppSwcVcu_CM_boolean_flg 0.0 1.0 /end CHARACTERISTIC
/begin CHARACTERISTIC KTQR_MotorDampngDsblAZ_flg "" VALUE 0x0000 /* @ECU_Address@KTQR_MotorDampngDsblAZ_flg@ */ Scalar_BOOLEAN 0 AppSwcVcu_CM_boolean_flg 0.0 1.0 /end CHARACTERISTIC
/begin CHARACTERISTIC KTQR_MotorDampngDsblBZ_flg "" VALUE 0x0000 /* @ECU_Address@KTQR_MotorDampngDsblBZ_flg@ */ Scalar_BOOLEAN 0 AppSwcVcu_CM_boolean_flg 0.0 1.0 /end CHARACTERISTIC
/begin CHARACTERISTIC KTQR_MotorDampngDsblZX_flg "" VALUE 0x0000 /* @ECU_Address@KTQR_MotorDampngDsblZX_flg@ */ Scalar_BOOLEAN 0 AppSwcVcu_CM_boolean_flg 0.0 1.0 /end CHARACTERISTIC
/begin CHARACTERISTIC KTQR_MotorDampngEnbl_flg "" VALUE 0x0000 /* @ECU_Address@KTQR_MotorDampngEnbl_flg@ */ Scalar_BOOLEAN 0 AppSwcVcu_CM_boolean_flg 0.0 1.0 /end CHARACTERISTIC
/begin CHARACTERISTIC KTQR_MotorStdbyEnbl_flg "" VALUE 0x0000 /* @ECU_Address@KTQR_MotorStdbyEnbl_flg@ */ Scalar_BOOLEAN 0 AppSwcVcu_CM_boolean_flg 0.0 1.0 /end CHARACTERISTIC
/begin CHARACTERISTIC KDAG_BrkSwCrsChkCntDec_cnt "制动开关双路校验计数减少步长" VALUE 0x0000 /* @ECU_Address@KDAG_BrkSwCrsChkCntDec_cnt@ */ Scalar_UBYTE 0 AppSwcVcu_CM_uint8_cnt 0.0 255.0 /end CHARACTERISTIC
/begin CHARACTERISTIC KDAG_BrkSwCrsChkCntHi_cnt "制动开关双路校验计数High_高于此值判定有故障" VALUE 0x0000 /* @ECU_Address@KDAG_BrkSwCrsChkCntHi_cnt@ */ Scalar_UBYTE 0 AppSwcVcu_CM_uint8_cnt 0.0 255.0 /end CHARACTERISTIC
/begin CHARACTERISTIC KDAG_BrkSwCrsChkCntInc_cnt "制动开关双路校验计数增加步长" VALUE 0x0000 /* @ECU_Address@KDAG_BrkSwCrsChkCntInc_cnt@ */ Scalar_UBYTE 0 AppSwcVcu_CM_uint8_cnt 0.0 255.0 /end CHARACTERISTIC
/begin CHARACTERISTIC KDAG_BrkSwCrsChkCntLo_cnt "制动开关双路校验计数Low_低于此值判定无故障" VALUE 0x0000 /* @ECU_Address@KDAG_BrkSwCrsChkCntLo_cnt@ */ Scalar_UBYTE 0 AppSwcVcu_CM_uint8_cnt 0.0 255.0 /end CHARACTERISTIC
/begin CHARACTERISTIC KDAG_BrkSwCrsChkCntMax_cnt "制动开关双路校验计数Max" VALUE 0x0000 /* @ECU_Address@KDAG_BrkSwCrsChkCntMax_cnt@ */ Scalar_UBYTE 0 AppSwcVcu_CM_uint8_cnt 0.0 255.0 /end CHARACTERISTIC
/begin CHARACTERISTIC KIBS_KL30VoltDebNumThr_cnt "KL30电压低于补电电压总次数_versteckt" VALUE 0x0000 /* @ECU_Address@KIBS_KL30VoltDebNumThr_cnt@ */ Scalar_UBYTE 0 AppSwcVcu_CM_uint8_cnt 0.0 255.0 /end CHARACTERISTIC
/begin CHARACTERISTIC KRME_PwrCnsmStorRst_enum "重置PwrCnse数组存储值(标定使用)" VALUE 0x0000 /* @ECU_Address@KRME_PwrCnsmStorRst_enum@ */ Scalar_UBYTE 0 AppSwcVcu_CM_uint8 0.0 255.0 /end CHARACTERISTIC
/begin CHARACTERISTIC KRME_SOCCnsmStorRst_enum "重置SOCCnse数组存储值(标定使用)" VALUE 0x0000 /* @ECU_Address@KRME_SOCCnsmStorRst_enum@ */ Scalar_UBYTE 0 AppSwcVcu_CM_uint8 0.0 255.0 /end CHARACTERISTIC
/begin MEASUREMENT VVTM_MotorActPwr_kW "" FLOAT32_IEEE AppSwcVcu_CM_single_kW 0 0 -100000.0 100000.0 ECU_ADDRESS 0x0000 /* @ECU_Address@VVTM_MotorActPwr_kW@ */ /end MEASUREMENT
/begin MEASUREMENT VTZX_ClkZXTm_s "" FLOAT32_IEEE AppSwcVcu_CM_single_s 0 0 -100000.0 100000.0 ECU_ADDRESS 0x0000 /* @ECU_Address@VTZX_ClkZXTm_s@ */ /end MEASUREMENT
/begin MEASUREMENT VTZX_MotorTqReq_Nm "" FLOAT32_IEEE AppSwcVcu_CM_single_Nm 0 0 -100000.0 100000.0 ECU_ADDRESS 0x0000 /* @ECU_Address@VTZX_MotorTqReq_Nm@ */ /end MEASUREMENT
/begin MEASUREMENT VTZX_MotorTqReqZX_Nm "" FLOAT32_IEEE AppSwcVcu_CM_single_Nm 0 0 -100000.0 100000.0 ECU_ADDRESS 0x0000 /* @ECU_Address@VTZX_MotorTqReqZX_Nm@ */ /end MEASUREMENT
/begin MEASUREMENT VTZX_ZeroTqHldInc_Nm "" FLOAT32_IEEE AppSwcVcu_CM_single_Nm 0 0 -100000.0 100000.0 ECU_ADDRESS 0x0000 /* @ECU_Address@VTZX_ZeroTqHldInc_Nm@ */ /end MEASUREMENT
/begin MEASUREMENT VTZX_ZeroTqHldDec_Nm "" FLOAT32_IEEE AppSwcVcu_CM_single_Nm 0 0 -100000.0 100000.0 ECU_ADDRESS 0x0000 /* @ECU_Address@VTZX_ZeroTqHldDec_Nm@ */ /end MEASUREMENT
/begin MEASUREMENT VTZX_BZIncRate_Nmps "" FLOAT32_IEEE AppSwcVcu_CM_single_Nmps 0 0 -100000.0 100000.0 ECU_ADDRESS 0x0000 /* @ECU_Address@VTZX_BZIncRate_Nmps@ */ /end MEASUREMENT
/begin MEASUREMENT VTZX_BZDecRate_Nmps "" FLOAT32_IEEE AppSwcVcu_CM_single_Nmps 0 0 -100000.0 100000.0 ECU_ADDRESS 0x0000 /* @ECU_Address@VTZX_BZDecRate_Nmps@ */ /end MEASUREMENT
/begin MEASUREMENT VTZX_AZIncRate_Nmps "" FLOAT32_IEEE AppSwcVcu_CM_single_Nmps 0 0 -100000.0 100000.0 ECU_ADDRESS 0x0000 /* @ECU_Address@VTZX_AZIncRate_Nmps@ */ /end MEASUREMENT
/begin MEASUREMENT VTZX_AZDecRate_Nmps "" FLOAT32_IEEE AppSwcVcu_CM_single_Nmps 0 0 -100000.0 100000.0 ECU_ADDRESS 0x0000 /* @ECU_Address@VTZX_AZDecRate_Nmps@ */ /end MEASUREMENT
/begin MEASUREMENT VTZX_ZeroTqOfstInc_Nm "" FLOAT32_IEEE AppSwcVcu_CM_single_Nm 0 0 -100000.0 100000.0 ECU_ADDRESS 0x0000 /* @ECU_Address@VTZX_ZeroTqOfstInc_Nm@ */ /end MEASUREMENT
/begin MEASUREMENT VTZX_ZeroTqOfstDec_Nm "" FLOAT32_IEEE AppSwcVcu_CM_single_Nm 0 0 -100000.0 100000.0 ECU_ADDRESS 0x0000 /* @ECU_Address@VTZX_ZeroTqOfstDec_Nm@ */ /end MEASUREMENT
/begin MEASUREMENT VTZX_ZeroTqOfst_Nm "" FLOAT32_IEEE AppSwcVcu_CM_single_Nm 0 0 -100000.0 100000.0 ECU_ADDRESS 0x0000 /* @ECU_Address@VTZX_ZeroTqOfst_Nm@ */ /end MEASUREMENT
/begin MEASUREMENT VTZX_ZeroXTm_s "" FLOAT32_IEEE AppSwcVcu_CM_single_s 0 0 -100000.0 100000.0 ECU_ADDRESS 0x0000 /* @ECU_Address@VTZX_ZeroXTm_s@ */ /end MEASUREMENT
/begin MEASUREMENT VTQC_DrvTqReqWhlABS_Nm "" FLOAT32_IEEE AppSwcVcu_CM_single_Nm 0 0 -100000.0 100000.0 ECU_ADDRESS 0x0000 /* @ECU_Address@VTQC_DrvTqReqWhlABS_Nm@ */ /end MEASUREMENT
/begin MEASUREMENT VTQC_BrkRegenMaxTqWhl_Nm "" FLOAT32_IEEE AppSwcVcu_CM_single_Nm 0 0 -100000.0 100000.0 ECU_ADDRESS 0x0000 /* @ECU_Address@VTQC_BrkRegenMaxTqWhl_Nm@ */ /end MEASUREMENT
/begin MEASUREMENT VTQC_BrkRegenTgtTqWhl_Nm "" FLOAT32_IEEE AppSwcVcu_CM_single_Nm 0 0 -100000.0 100000.0 ECU_ADDRESS 0x0000 /* @ECU_Address@VTQC_BrkRegenTgtTqWhl_Nm@ */ /end MEASUREMENT
/begin MEASUREMENT VTQC_DrvTqReqWhl_Nm "" FLOAT32_IEEE AppSwcVcu_CM_single_Nm 0 0 -100000.0 100000.0 ECU_ADDRESS 0x0000 /* @ECU_Address@VTQC_DrvTqReqWhl_Nm@ */ /end MEASUREMENT
/begin MEASUREMENT VTQC_MotorTqReq_Nm "" FLOAT32_IEEE AppSwcVcu_CM_single_Nm 0 0 -100000.0 100000.0 ECU_ADDRESS 0x0000 /* @ECU_Address@VTQC_MotorTqReq_Nm@ */ /end MEASUREMENT
/begin MEASUREMENT VTQC_CstRegenLmtTq_Nm "" FLOAT32_IEEE AppSwcVcu_CM_single_Nm 0 0 -100000.0 100000.0 ECU_ADDRESS 0x0000 /* @ECU_Address@VTQC_CstRegenLmtTq_Nm@ */ /end MEASUREMENT
/begin MEASUREMENT VTQF_DrvTqReqWhl_Nm "" FLOAT32_IEEE AppSwcVcu_CM_single_Nm 0 0 -100000.0 100000.0 ECU_ADDRESS 0x0000 /* @ECU_Address@VTQF_DrvTqReqWhl_Nm@ */ /end MEASUREMENT
/begin MEASUREMENT VTQD_PedalTqReqWhlRaw_Nm "" FLOAT32_IEEE AppSwcVcu_CM_single_Nm 0 0 -100000.0 100000.0 ECU_ADDRESS 0x0000 /* @ECU_Address@VTQD_PedalTqReqWhlRaw_Nm@ */ /end MEASUREMENT
/begin MEASUREMENT VTQD_DrvTqReqWhl_Nm "" FLOAT32_IEEE AppSwcVcu_CM_single_Nm 0 0 -100000.0 100000.0 ECU_ADDRESS 0x0000 /* @ECU_Address@VTQD_DrvTqReqWhl_Nm@ */ /end MEASUREMENT
/begin MEASUREMENT VDAC_DrvAsstTqSplitINV_Nm "" FLOAT32_IEEE AppSwcVcu_CM_single_Nm 0 0 -100000.0 100000.0 ECU_ADDRESS 0x0000 /* @ECU_Address@VDAC_DrvAsstTqSplitINV_Nm@ */ /end MEASUREMENT
/begin MEASUREMENT VDAC_DrvAsstTqSplitEHB_Nm "" FLOAT32_IEEE AppSwcVcu_CM_single_Nm 0 0 -100000.0 100000.0 ECU_ADDRESS 0x0000 /* @ECU_Address@VDAC_DrvAsstTqSplitEHB_Nm@ */ /end MEASUREMENT
/begin MEASUREMENT VDAC_DrvAsstTqTgt_Nm "" FLOAT32_IEEE AppSwcVcu_CM_single_Nm 0 0 -100000.0 100000.0 ECU_ADDRESS 0x0000 /* @ECU_Address@VDAC_DrvAsstTqTgt_Nm@ */ /end MEASUREMENT
/begin MEASUREMENT VDAC_VirtAccelPedPstnRaw_pct "" FLOAT32_IEEE AppSwcVcu_CM_single_pct 0 0 -100000.0 100000.0 ECU_ADDRESS 0x0000 /* @ECU_Address@VDAC_VirtAccelPedPstnRaw_pct@ */ /end MEASUREMENT
/begin MEASUREMENT VDAC_MstrCylPresrReq_bar "" FLOAT32_IEEE AppSwcVcu_CM_single_bar 0 0 -100000.0 100000.0 ECU_ADDRESS 0x0000 /* @ECU_Address@VDAC_MstrCylPresrReq_bar@ */ /end MEASUREMENT
/begin MEASUREMENT VDAC_VirtAccPedPstn_pct "" FLOAT32_IEEE AppSwcVcu_CM_single_pct 0 0 -100000.0 100000.0 ECU_ADDRESS 0x0000 /* @ECU_Address@VDAC_VirtAccPedPstn_pct@ */ /end MEASUREMENT
/begin MEASUREMENT VDAC_VirtPedPstn_pct "" FLOAT32_IEEE AppSwcVcu_CM_single_pct 0 0 -100000.0 100000.0 ECU_ADDRESS 0x0000 /* @ECU_Address@VDAC_VirtPedPstn_pct@ */ /end MEASUREMENT
/begin MEASUREMENT VDAC_HDCTgtSpd_kph "" FLOAT32_IEEE AppSwcVcu_CM_single_kph 0 0 -100000.0 100000.0 ECU_ADDRESS 0x0000 /* @ECU_Address@VDAC_HDCTgtSpd_kph@ */ /end MEASUREMENT
/begin MEASUREMENT VCPT_MotorSpd_rpm "" FLOAT32_IEEE AppSwcVcu_CM_single_rpm 0 0 -100000.0 100000.0 ECU_ADDRESS 0x0000 /* @ECU_Address@VCPT_MotorSpd_rpm@ */ /end MEASUREMENT
/begin MEASUREMENT VCPT_MotorGenMaxTq_Nm "" FLOAT32_IEEE AppSwcVcu_CM_single_Nm 0 0 -100000.0 100000.0 ECU_ADDRESS 0x0000 /* @ECU_Address@VCPT_MotorGenMaxTq_Nm@ */ /end MEASUREMENT
/begin MEASUREMENT VCPT_MotorMotMaxTq_Nm "" FLOAT32_IEEE AppSwcVcu_CM_single_Nm 0 0 -100000.0 100000.0 ECU_ADDRESS 0x0000 /* @ECU_Address@VCPT_MotorMotMaxTq_Nm@ */ /end MEASUREMENT
/begin MEASUREMENT VVTM_VehSpd_kph "" FLOAT32_IEEE AppSwcVcu_CM_single_kph 0 0 -100000.0 100000.0 ECU_ADDRESS 0x0000 /* @ECU_Address@VVTM_VehSpd_kph@ */ /end MEASUREMENT
/begin MEASUREMENT VVTM_VehAcceltn_mps2 "" FLOAT32_IEEE AppSwcVcu_CM_single_mps2 0 0 -100000.0 100000.0 ECU_ADDRESS 0x0000 /* @ECU_Address@VVTM_VehAcceltn_mps2@ */ /end MEASUREMENT
/begin MEASUREMENT VVTM_MotorSpd_rpm "" FLOAT32_IEEE AppSwcVcu_CM_single_rpm 0 0 -100000.0 100000.0 ECU_ADDRESS 0x0000 /* @ECU_Address@VVTM_MotorSpd_rpm@ */ /end MEASUREMENT
/begin MEASUREMENT VVSO_RoadSlopTqEst_Nm "" FLOAT32_IEEE AppSwcVcu_CM_single_Nm 0 0 -100000.0 100000.0 ECU_ADDRESS 0x0000 /* @ECU_Address@VVSO_RoadSlopTqEst_Nm@ */ /end MEASUREMENT
/begin MEASUREMENT VVSO_VehMassEst_kg "" FLOAT32_IEEE AppSwcVcu_CM_single_kg 0 0 -100000.0 100000.0 ECU_ADDRESS 0x0000 /* @ECU_Address@VVSO_VehMassEst_kg@ */ /end MEASUREMENT
/begin MEASUREMENT VVSO_SlopEst_rat "" FLOAT32_IEEE AppSwcVcu_CM_single_rat 0 0 -100000.0 100000.0 ECU_ADDRESS 0x0000 /* @ECU_Address@VVSO_SlopEst_rat@ */ /end MEASUREMENT
/begin MEASUREMENT VVSO_VehSpd_kph "" FLOAT32_IEEE AppSwcVcu_CM_single_kph 0 0 -100000.0 100000.0 ECU_ADDRESS 0x0000 /* @ECU_Address@VVSO_VehSpd_kph@ */ /end MEASUREMENT
/begin MEASUREMENT VVSO_XWhlDistErr_m "" FLOAT32_IEEE AppSwcVcu_CM_single_m 0 0 -100000.0 100000.0 ECU_ADDRESS 0x0000 /* @ECU_Address@VVSO_XWhlDistErr_m@ */ /end MEASUREMENT
/begin MEASUREMENT VVSO_DrvDist_m "" FLOAT32_IEEE AppSwcVcu_CM_single_m 0 0 -100000.0 100000.0 ECU_ADDRESS 0x0000 /* @ECU_Address@VVSO_DrvDist_m@ */ /end MEASUREMENT
/begin MEASUREMENT VRME_WLTPRmnMilEst_km "WLTP标准续航查表值" FLOAT32_IEEE AppSwcVcu_CM_single_km 0 0 0.0 1000.0 ECU_ADDRESS 0x0000 /* @ECU_Address@VRME_WLTPRmnMilEst_km@ */ /end MEASUREMENT
/begin MEASUREMENT VRME_WLTPRmnMilEstUpLim_km "动态续航上限值" FLOAT32_IEEE AppSwcVcu_CM_single_km 0 0 0.0 1000.0 ECU_ADDRESS 0x0000 /* @ECU_Address@VRME_WLTPRmnMilEstUpLim_km@ */ /end MEASUREMENT
/begin MEASUREMENT VRME_CalSOCCnsmTgtDist_m "单位目标行驶里程" FLOAT32_IEEE AppSwcVcu_CM_single_m 0 0 0.0 100000.0 ECU_ADDRESS 0x0000 /* @ECU_Address@VRME_CalSOCCnsmTgtDist_m@ */ /end MEASUREMENT
/begin MEASUREMENT VRME_WLTPStdSOCCnsm_pctpkm "标准工况下SOC消耗/km" FLOAT32_IEEE AppSwcVcu_CM_single_pctpkm 0 0 -1000.0 1000.0 ECU_ADDRESS 0x0000 /* @ECU_Address@VRME_WLTPStdSOCCnsm_pctpkm@ */ /end MEASUREMENT
/begin MEASUREMENT VRME_CalSOCCnsmPerTrig_pctptrig "SOC消耗/目标里程" FLOAT32_IEEE AppSwcVcu_CM_single_pctptrig 0 0 -1000.0 1000.0 ECU_ADDRESS 0x0000 /* @ECU_Address@VRME_CalSOCCnsmPerTrig_pctptrig@ */ /end MEASUREMENT
/begin MEASUREMENT VRME_CalSOCCnsmPerkm_pctpkm "目标里程消耗折算为单位里程" FLOAT32_IEEE AppSwcVcu_CM_single_pctpkm 0 0 -1000.0 1000.0 ECU_ADDRESS 0x0000 /* @ECU_Address@VRME_CalSOCCnsmPerkm_pctpkm@ */ /end MEASUREMENT
/begin MEASUREMENT VRME_AvgSOCCnsm5Num_pctpkm "前5个数组平均SOC能耗" FLOAT32_IEEE AppSwcVcu_CM_single_pctpkm 0 0 -1000.0 1000.0 ECU_ADDRESS 0x0000 /* @ECU_Address@VRME_AvgSOCCnsm5Num_pctpkm@ */ /end MEASUREMENT
/begin MEASUREMENT VRME_AvgSOCCnsm10Num_pctpkm "前10个数组平均SOC能耗" FLOAT32_IEEE AppSwcVcu_CM_single_pctpkm 0 0 -1000.0 1000.0 ECU_ADDRESS 0x0000 /* @ECU_Address@VRME_AvgSOCCnsm10Num_pctpkm@ */ /end MEASUREMENT
/begin MEASUREMENT VRME_AvgSOCCnsm15Num_pctpkm "前15个数组平均SOC能耗" FLOAT32_IEEE AppSwcVcu_CM_single_pctpkm 0 0 -1000.0 1000.0 ECU_ADDRESS 0x0000 /* @ECU_Address@VRME_AvgSOCCnsm15Num_pctpkm@ */ /end MEASUREMENT
/begin MEASUREMENT VRME_AvgSOCCnsm25Num_pctpkm "前25个数组平均SOC能耗" FLOAT32_IEEE AppSwcVcu_CM_single_pctpkm 0 0 -1000.0 1000.0 ECU_ADDRESS 0x0000 /* @ECU_Address@VRME_AvgSOCCnsm25Num_pctpkm@ */ /end MEASUREMENT
/begin MEASUREMENT VRME_AvgSOCCnsm50Num_pctpkm "前50个数组平均SOC能耗" FLOAT32_IEEE AppSwcVcu_CM_single_pctpkm 0 0 -1000.0 1000.0 ECU_ADDRESS 0x0000 /* @ECU_Address@VRME_AvgSOCCnsm50Num_pctpkm@ */ /end MEASUREMENT
/begin MEASUREMENT VRME_AvgSOCCnsm100Num_pctpkm "前100个数组平均SOC能耗" FLOAT32_IEEE AppSwcVcu_CM_single_pctpkm 0 0 -1000.0 1000.0 ECU_ADDRESS 0x0000 /* @ECU_Address@VRME_AvgSOCCnsm100Num_pctpkm@ */ /end MEASUREMENT
/begin MEASUREMENT VRME_AvgSOCCnsmWght_pctpkm "加权平均SOC能耗/km" FLOAT32_IEEE AppSwcVcu_CM_single_pctpkm 0 0 -1000.0 1000.0 ECU_ADDRESS 0x0000 /* @ECU_Address@VRME_AvgSOCCnsmWght_pctpkm@ */ /end MEASUREMENT
/begin MEASUREMENT VRME_WLTPRmnMilEstDwLim_km "动态续航下限值" FLOAT32_IEEE AppSwcVcu_CM_single_km 0 0 0.0 1000.0 ECU_ADDRESS 0x0000 /* @ECU_Address@VRME_WLTPRmnMilEstDwLim_km@ */ /end MEASUREMENT
/begin MEASUREMENT VRME_DynRmnMilEstTgt_km "动态续航目标值" FLOAT32_IEEE AppSwcVcu_CM_single_km 0 0 0.0 1000.0 ECU_ADDRESS 0x0000 /* @ECU_Address@VRME_DynRmnMilEstTgt_km@ */ /end MEASUREMENT
/begin MEASUREMENT VRME_DynRmnMilEstChgFac_c "动态续航变化系数" FLOAT32_IEEE AppSwcVcu_CM_single_c 0 0 0.0 100.0 ECU_ADDRESS 0x0000 /* @ECU_Address@VRME_DynRmnMilEstChgFac_c@ */ /end MEASUREMENT
/begin MEASUREMENT VRME_DynRmnMilEst_km "动态续航限幅值" FLOAT32_IEEE AppSwcVcu_CM_single_km 0 0 0.0 1000.0 ECU_ADDRESS 0x0000 /* @ECU_Address@VRME_DynRmnMilEst_km@ */ /end MEASUREMENT
/begin MEASUREMENT VRME_WLTPStdPwrCnsm_kWhpkm "标准工况下电耗" FLOAT32_IEEE AppSwcVcu_CM_single_kWhpkm 0 0 0.0 1000.0 ECU_ADDRESS 0x0000 /* @ECU_Address@VRME_WLTPStdPwrCnsm_kWhpkm@ */ /end MEASUREMENT
/begin MEASUREMENT VRME_CalPwrCnsmPerTrig_kWhpkm "Pwr消耗/单位里程（1km）" FLOAT32_IEEE AppSwcVcu_CM_single_kWhpkm 0 0 -1000.0 1000.0 ECU_ADDRESS 0x0000 /* @ECU_Address@VRME_CalPwrCnsmPerTrig_kWhpkm@ */ /end MEASUREMENT
/begin MEASUREMENT VRME_AvgPwrCnsm100km_kWhpkm "100km平均Pwr能耗" FLOAT32_IEEE AppSwcVcu_CM_single_kWhpkm 0 0 -1000.0 1000.0 ECU_ADDRESS 0x0000 /* @ECU_Address@VRME_AvgPwrCnsm100km_kWhpkm@ */ /end MEASUREMENT
/begin MEASUREMENT VRME_VehTotPwrCurrCyc_kWh "当前驾驶循环车辆使用功率" FLOAT32_IEEE AppSwcVcu_CM_single_kWh 0 0 -1000.0 1000.0 ECU_ADDRESS 0x0000 /* @ECU_Address@VRME_VehTotPwrCurrCyc_kWh@ */ /end MEASUREMENT
/begin MEASUREMENT VRME_AvgPwrCnsm5km_kWhpkm "5km平均Pwr能耗" FLOAT32_IEEE AppSwcVcu_CM_single_kWhpkm 0 0 -1000.0 1000.0 ECU_ADDRESS 0x0000 /* @ECU_Address@VRME_AvgPwrCnsm5km_kWhpkm@ */ /end MEASUREMENT
/begin MEASUREMENT VRME_AvgPwrCnsm10km_kWhpkm "10km平均Pwr能耗" FLOAT32_IEEE AppSwcVcu_CM_single_kWhpkm 0 0 -1000.0 1000.0 ECU_ADDRESS 0x0000 /* @ECU_Address@VRME_AvgPwrCnsm10km_kWhpkm@ */ /end MEASUREMENT
/begin MEASUREMENT VRMEAvgPwrCnsm15km_kWhpkm "15km平均Pwr能耗" FLOAT32_IEEE AppSwcVcu_CM_single_kWhpkm 0 0 -1000.0 1000.0 ECU_ADDRESS 0x0000 /* @ECU_Address@VRMEAvgPwrCnsm15km_kWhpkm@ */ /end MEASUREMENT
/begin MEASUREMENT VRME_AvgPwrCnsm25km_kWhpkm "25km平均Pwr能耗" FLOAT32_IEEE AppSwcVcu_CM_single_kWhpkm 0 0 -1000.0 1000.0 ECU_ADDRESS 0x0000 /* @ECU_Address@VRME_AvgPwrCnsm25km_kWhpkm@ */ /end MEASUREMENT
/begin MEASUREMENT VRME_AvgPwrCnsm50km_kWhpkm "50km平均Pwr能耗" FLOAT32_IEEE AppSwcVcu_CM_single_kWhpkm 0 0 -1000.0 1000.0 ECU_ADDRESS 0x0000 /* @ECU_Address@VRME_AvgPwrCnsm50km_kWhpkm@ */ /end MEASUREMENT
/begin MEASUREMENT VRME_VehTotDistCurrCyc_km "当前驾驶循环累计总里程" FLOAT32_IEEE AppSwcVcu_CM_single_km 0 0 0.0 1000.0 ECU_ADDRESS 0x0000 /* @ECU_Address@VRME_VehTotDistCurrCyc_km@ */ /end MEASUREMENT
/begin MEASUREMENT VIPC_AccPed1NormzPstn_pct "" FLOAT32_IEEE AppSwcVcu_CM_single_pct 0 0 0.0 100.0 ECU_ADDRESS 0x0000 /* @ECU_Address@VIPC_AccPed1NormzPstn_pct@ */ /end MEASUREMENT
/begin MEASUREMENT VIPC_AccPed1MinPstnLrnd_pct "" FLOAT32_IEEE AppSwcVcu_CM_single_pct 0 0 0.0 100.0 ECU_ADDRESS 0x0000 /* @ECU_Address@VIPC_AccPed1MinPstnLrnd_pct@ */ /end MEASUREMENT
/begin MEASUREMENT VIPC_AccPed1SclPstn_pct "" FLOAT32_IEEE AppSwcVcu_CM_single_pct 0 0 0.0 150.0 ECU_ADDRESS 0x0000 /* @ECU_Address@VIPC_AccPed1SclPstn_pct@ */ /end MEASUREMENT
/begin MEASUREMENT VIPC_AccPed2NormzPstn_pct "" FLOAT32_IEEE AppSwcVcu_CM_single_pct 0 0 0.0 100.0 ECU_ADDRESS 0x0000 /* @ECU_Address@VIPC_AccPed2NormzPstn_pct@ */ /end MEASUREMENT
/begin MEASUREMENT VIPC_AccPed2MinPstnLrnd_pct "" FLOAT32_IEEE AppSwcVcu_CM_single_pct 0 0 0.0 100.0 ECU_ADDRESS 0x0000 /* @ECU_Address@VIPC_AccPed2MinPstnLrnd_pct@ */ /end MEASUREMENT
/begin MEASUREMENT VIPC_AccPed2SclPstn_pct "" FLOAT32_IEEE AppSwcVcu_CM_single_pct 0 0 0.0 150.0 ECU_ADDRESS 0x0000 /* @ECU_Address@VIPC_AccPed2SclPstn_pct@ */ /end MEASUREMENT
/begin MEASUREMENT VIPC_AccPedWghtPstn_pct "" FLOAT32_IEEE AppSwcVcu_CM_single_pct 0 0 0.0 150.0 ECU_ADDRESS 0x0000 /* @ECU_Address@VIPC_AccPedWghtPstn_pct@ */ /end MEASUREMENT
/begin MEASUREMENT VIPC_AccPedWghtAvg_pct "" FLOAT32_IEEE AppSwcVcu_CM_single_pct 0 0 0.0 150.0 ECU_ADDRESS 0x0000 /* @ECU_Address@VIPC_AccPedWghtAvg_pct@ */ /end MEASUREMENT
/begin MEASUREMENT VIPC_AccPedZeroPstn_pct "" FLOAT32_IEEE AppSwcVcu_CM_single_pct 0 0 0.0 100000.0 ECU_ADDRESS 0x0000 /* @ECU_Address@VIPC_AccPedZeroPstn_pct@ */ /end MEASUREMENT
/begin MEASUREMENT VIPC_AccPedStkPstn_pct "" FLOAT32_IEEE AppSwcVcu_CM_single_pct 0 0 0.0 100000.0 ECU_ADDRESS 0x0000 /* @ECU_Address@VIPC_AccPedStkPstn_pct@ */ /end MEASUREMENT
/begin MEASUREMENT VIPC_AccPedPstn_pct "" FLOAT32_IEEE AppSwcVcu_CM_single_pct 0 0 0.0 100000.0 ECU_ADDRESS 0x0000 /* @ECU_Address@VIPC_AccPedPstn_pct@ */ /end MEASUREMENT
/begin MEASUREMENT VIPC_VehSpdDrvn_kph "" FLOAT32_IEEE AppSwcVcu_CM_single_kph 0 0 -100000.0 100000.0 ECU_ADDRESS 0x0000 /* @ECU_Address@VIPC_VehSpdDrvn_kph@ */ /end MEASUREMENT
/begin MEASUREMENT VIPC_VehSpd_kph "" FLOAT32_IEEE AppSwcVcu_CM_single_kph 0 0 -100000.0 100000.0 ECU_ADDRESS 0x0000 /* @ECU_Address@VIPC_VehSpd_kph@ */ /end MEASUREMENT
/begin MEASUREMENT VIPC_VehSpdNonDrvn_kph "" FLOAT32_IEEE AppSwcVcu_CM_single_kph 0 0 -100000.0 100000.0 ECU_ADDRESS 0x0000 /* @ECU_Address@VIPC_VehSpdNonDrvn_kph@ */ /end MEASUREMENT
/begin MEASUREMENT VIBS_HwKL30_V "滤波后的KL30电压_versteckt" FLOAT32_IEEE AppSwcVcu_CM_single_V 0 0 -40.0 215.0 ECU_ADDRESS 0x0000 /* @ECU_Address@VIBS_HwKL30_V@ */ /end MEASUREMENT
/begin MEASUREMENT VIBS_EnvirTemp_C "IBS环境温度_versteckt" FLOAT32_IEEE AppSwcVcu_CM_single_C 0 0 -50.0 200.0 ECU_ADDRESS 0x0000 /* @ECU_Address@VIBS_EnvirTemp_C@ */ /end MEASUREMENT
/begin MEASUREMENT VHMI_GrDSldDist_m "D档后溜距离" FLOAT32_IEEE AppSwcVcu_CM_single_m 0 0 -1000.0 0.0 ECU_ADDRESS 0x0000 /* @ECU_Address@VHMI_GrDSldDist_m@ */ /end MEASUREMENT
/begin MEASUREMENT VHMI_GrRSldDist_m "R档前溜距离" FLOAT32_IEEE AppSwcVcu_CM_single_m 0 0 0.0 1000.0 ECU_ADDRESS 0x0000 /* @ECU_Address@VHMI_GrRSldDist_m@ */ /end MEASUREMENT
/begin MEASUREMENT VEMS_CellTempSyn_C "" FLOAT32_IEEE AppSwcVcu_CM_single_C 0 0 -100000.0 100000.0 ECU_ADDRESS 0x0000 /* @ECU_Address@VEMS_CellTempSyn_C@ */ /end MEASUREMENT
/begin MEASUREMENT VEMS_ChrgCurFbKp_A "" FLOAT32_IEEE AppSwcVcu_CM_single_A 0 0 -100000.0 100000.0 ECU_ADDRESS 0x0000 /* @ECU_Address@VEMS_ChrgCurFbKp_A@ */ /end MEASUREMENT
/begin MEASUREMENT VEMS_ChrgCurFbKi_A "" FLOAT32_IEEE AppSwcVcu_CM_single_A 0 0 -100000.0 100000.0 ECU_ADDRESS 0x0000 /* @ECU_Address@VEMS_ChrgCurFbKi_A@ */ /end MEASUREMENT
/begin MEASUREMENT VEMS_ChrgCurFb_A "" FLOAT32_IEEE AppSwcVcu_CM_single_A 0 0 -100000.0 100000.0 ECU_ADDRESS 0x0000 /* @ECU_Address@VEMS_ChrgCurFb_A@ */ /end MEASUREMENT
/begin MEASUREMENT VEMS_DchaCurFbKp_A "" FLOAT32_IEEE AppSwcVcu_CM_single_A 0 0 -100000.0 100000.0 ECU_ADDRESS 0x0000 /* @ECU_Address@VEMS_DchaCurFbKp_A@ */ /end MEASUREMENT
/begin MEASUREMENT VEMS_DchaCurFbKi_A "" FLOAT32_IEEE AppSwcVcu_CM_single_A 0 0 -100000.0 100000.0 ECU_ADDRESS 0x0000 /* @ECU_Address@VEMS_DchaCurFbKi_A@ */ /end MEASUREMENT
/begin MEASUREMENT VEMS_DchaCurFb_A "" FLOAT32_IEEE AppSwcVcu_CM_single_A 0 0 -100000.0 100000.0 ECU_ADDRESS 0x0000 /* @ECU_Address@VEMS_DchaCurFb_A@ */ /end MEASUREMENT
/begin MEASUREMENT VEMS_DchaPwrFbKp_kW "" FLOAT32_IEEE AppSwcVcu_CM_single_kW 0 0 -100000.0 100000.0 ECU_ADDRESS 0x0000 /* @ECU_Address@VEMS_DchaPwrFbKp_kW@ */ /end MEASUREMENT
/begin MEASUREMENT VEMS_DchaPwrFbKi_kW "" FLOAT32_IEEE AppSwcVcu_CM_single_kW 0 0 -100000.0 100000.0 ECU_ADDRESS 0x0000 /* @ECU_Address@VEMS_DchaPwrFbKi_kW@ */ /end MEASUREMENT
/begin MEASUREMENT VEMS_ChrgPwrFbKp_kW "" FLOAT32_IEEE AppSwcVcu_CM_single_kW 0 0 -100000.0 100000.0 ECU_ADDRESS 0x0000 /* @ECU_Address@VEMS_ChrgPwrFbKp_kW@ */ /end MEASUREMENT
/begin MEASUREMENT VEMS_ChrgPwrFbKi_kW "" FLOAT32_IEEE AppSwcVcu_CM_single_kW 0 0 -100000.0 100000.0 ECU_ADDRESS 0x0000 /* @ECU_Address@VEMS_ChrgPwrFbKi_kW@ */ /end MEASUREMENT
/begin MEASUREMENT VIPM_HwKL30_mV "" UWORD AppSwcVcu_CM_uint16_mV 0 0 0.0 65535.0 ECU_ADDRESS 0x0000 /* @ECU_Address@VIPM_HwKL30_mV@ */ /end MEASUREMENT
/begin MEASUREMENT VDAC_DrvAsstTqSts_enum "" UBYTE AppSwcVcu_CM_uint8_enum 0 0 0.0 255.0 ECU_ADDRESS 0x0000 /* @ECU_Address@VDAC_DrvAsstTqSts_enum@ */ /end MEASUREMENT
/begin MEASUREMENT VDAC_VirtAccPedPstnSta_enum "" UBYTE AppSwcVcu_CM_uint8_enum 0 0 0.0 255.0 ECU_ADDRESS 0x0000 /* @ECU_Address@VDAC_VirtAccPedPstnSta_enum@ */ /end MEASUREMENT
/begin MEASUREMENT VIPC_AccPedSnsrSta_enum "" UBYTE AppSwcVcu_CM_uint8_enum 0 0 0.0 255.0 ECU_ADDRESS 0x0000 /* @ECU_Address@VIPC_AccPedSnsrSta_enum@ */ /end MEASUREMENT
/begin MEASUREMENT VGSM_PGrSwSts_enum "规范：P按键触发标志位-VCU_PGearSwcst" UBYTE AppSwcVcu_CM_uint8_enum 0 0 0.0 255.0 ECU_ADDRESS 0x0000 /* @ECU_Address@VGSM_PGrSwSts_enum@ */ /end MEASUREMENT
/begin MEASUREMENT VDAG_ESCFltLvl1FltSt_enum "ESC1级故障状态" UBYTE AppSwcVcu_CM_uint8_enum 0 0 0.0 255.0 ECU_ADDRESS 0x0000 /* @ECU_Address@VDAG_ESCFltLvl1FltSt_enum@ */ /end MEASUREMENT
/begin MEASUREMENT VDAG_ESCFltLvl4FltSt_enum "ESC4级故障状态" UBYTE AppSwcVcu_CM_uint8_enum 0 0 0.0 255.0 ECU_ADDRESS 0x0000 /* @ECU_Address@VDAG_ESCFltLvl4FltSt_enum@ */ /end MEASUREMENT
/begin MEASUREMENT VDAG_EHBFltLvl5FltSt_enum "EHB5级故障状态" UBYTE AppSwcVcu_CM_uint8_enum 0 0 0.0 255.0 ECU_ADDRESS 0x0000 /* @ECU_Address@VDAG_EHBFltLvl5FltSt_enum@ */ /end MEASUREMENT
/begin MEASUREMENT VDAG_EHBFltLvl3FltSt_enum "EHB3级故障状态" UBYTE AppSwcVcu_CM_uint8_enum 0 0 0.0 255.0 ECU_ADDRESS 0x0000 /* @ECU_Address@VDAG_EHBFltLvl3FltSt_enum@ */ /end MEASUREMENT
/begin MEASUREMENT VDAG_EHBFltLvl2FltSt_enum "EHB2级故障状态" UBYTE AppSwcVcu_CM_uint8_enum 0 0 0.0 255.0 ECU_ADDRESS 0x0000 /* @ECU_Address@VDAG_EHBFltLvl2FltSt_enum@ */ /end MEASUREMENT
/begin MEASUREMENT VDAG_EHBFltLvl1FltSt_enum "EHB1级故障状态" UBYTE AppSwcVcu_CM_uint8_enum 0 0 0.0 255.0 ECU_ADDRESS 0x0000 /* @ECU_Address@VDAG_EHBFltLvl1FltSt_enum@ */ /end MEASUREMENT
/begin MEASUREMENT VDAG_ESCVehSpdInvldFltSt_enum "车速失效故障状态" UBYTE AppSwcVcu_CM_uint8_enum 0 0 0.0 255.0 ECU_ADDRESS 0x0000 /* @ECU_Address@VDAG_ESCVehSpdInvldFltSt_enum@ */ /end MEASUREMENT
/begin MEASUREMENT VDAG_GearShftInvldFltSt_enum "换挡输入失效故障状态" UBYTE AppSwcVcu_CM_uint8_enum 0 0 0.0 255.0 ECU_ADDRESS 0x0000 /* @ECU_Address@VDAG_GearShftInvldFltSt_enum@ */ /end MEASUREMENT
/begin MEASUREMENT VDAG_ESCFltLvl5FltSt_enum "ESC5级故障状态" UBYTE AppSwcVcu_CM_uint8_enum 0 0 0.0 255.0 ECU_ADDRESS 0x0000 /* @ECU_Address@VDAG_ESCFltLvl5FltSt_enum@ */ /end MEASUREMENT
/begin MEASUREMENT VDAG_ESCFltLvl3FltSt_enum "ESC3级故障状态" UBYTE AppSwcVcu_CM_uint8_enum 0 0 0.0 255.0 ECU_ADDRESS 0x0000 /* @ECU_Address@VDAG_ESCFltLvl3FltSt_enum@ */ /end MEASUREMENT
/begin MEASUREMENT VDAG_ESCFltLvl2FltSt_enum "ESC2级故障状态" UBYTE AppSwcVcu_CM_uint8_enum 0 0 0.0 255.0 ECU_ADDRESS 0x0000 /* @ECU_Address@VDAG_ESCFltLvl2FltSt_enum@ */ /end MEASUREMENT
/begin MEASUREMENT VDAG_EHBFltLvl4FltSt_enum "EHB4级故障状态" UBYTE AppSwcVcu_CM_uint8_enum 0 0 0.0 255.0 ECU_ADDRESS 0x0000 /* @ECU_Address@VDAG_EHBFltLvl4FltSt_enum@ */ /end MEASUREMENT
/begin MEASUREMENT VDAG_TMSFailLvl3FltSt_enum "TMSRFailLevel3故障状态" UBYTE AppSwcVcu_CM_uint8_enum 0 0 0.0 255.0 ECU_ADDRESS 0x0000 /* @ECU_Address@VDAG_TMSFailLvl3FltSt_enum@ */ /end MEASUREMENT
/begin MEASUREMENT VDAG_SysPwrModeInvldFltSt_enum "PowerMode失效故障状态" UBYTE AppSwcVcu_CM_uint8_enum 0 0 0.0 255.0 ECU_ADDRESS 0x0000 /* @ECU_Address@VDAG_SysPwrModeInvldFltSt_enum@ */ /end MEASUREMENT
/begin MEASUREMENT VDAG_LVBattSOCLoFltSt_enum "蓄电池SOC低的故障状态" UBYTE AppSwcVcu_CM_uint8_enum 0 0 0.0 255.0 ECU_ADDRESS 0x0000 /* @ECU_Address@VDAG_LVBattSOCLoFltSt_enum@ */ /end MEASUREMENT
/begin MEASUREMENT VDAG_LVBattVoltHiFltSt_enum "蓄电池电压高故障状态" UBYTE AppSwcVcu_CM_uint8_enum 0 0 0.0 255.0 ECU_ADDRESS 0x0000 /* @ECU_Address@VDAG_LVBattVoltHiFltSt_enum@ */ /end MEASUREMENT
/begin MEASUREMENT VDAG_LVBattVoltLoFltSt_enum "蓄电池电压低故障状态" UBYTE AppSwcVcu_CM_uint8_enum 0 0 0.0 255.0 ECU_ADDRESS 0x0000 /* @ECU_Address@VDAG_LVBattVoltLoFltSt_enum@ */ /end MEASUREMENT
/begin MEASUREMENT VDAG_LVBattTempHiFltSt_enum "蓄电池过温故障状态" UBYTE AppSwcVcu_CM_uint8_enum 0 0 0.0 255.0 ECU_ADDRESS 0x0000 /* @ECU_Address@VDAG_LVBattTempHiFltSt_enum@ */ /end MEASUREMENT
/begin MEASUREMENT VDAG_LVBattSOHLoFltSt_enum "蓄电池SOH低的故障状态" UBYTE AppSwcVcu_CM_uint8_enum 0 0 0.0 255.0 ECU_ADDRESS 0x0000 /* @ECU_Address@VDAG_LVBattSOHLoFltSt_enum@ */ /end MEASUREMENT
/begin MEASUREMENT VDAG_WaterTempAbvThrFltSt_enum "冷却水温过高故障状态" UBYTE AppSwcVcu_CM_uint8_enum 0 0 0.0 255.0 ECU_ADDRESS 0x0000 /* @ECU_Address@VDAG_WaterTempAbvThrFltSt_enum@ */ /end MEASUREMENT
/begin MEASUREMENT VDAG_WaterTempBlwThrFltSt_enum "冷却水温过低故障状态" UBYTE AppSwcVcu_CM_uint8_enum 0 0 0.0 255.0 ECU_ADDRESS 0x0000 /* @ECU_Address@VDAG_WaterTempBlwThrFltSt_enum@ */ /end MEASUREMENT
/begin MEASUREMENT VDAG_OBCSysFailLvl3FltSt_enum "OBCFailLevel3故障状态" UBYTE AppSwcVcu_CM_uint8_enum 0 0 0.0 255.0 ECU_ADDRESS 0x0000 /* @ECU_Address@VDAG_OBCSysFailLvl3FltSt_enum@ */ /end MEASUREMENT
/begin MEASUREMENT VDAG_OBCSysFailLvl2FltSt_enum "OBCFailLevel2故障状态" UBYTE AppSwcVcu_CM_uint8_enum 0 0 0.0 255.0 ECU_ADDRESS 0x0000 /* @ECU_Address@VDAG_OBCSysFailLvl2FltSt_enum@ */ /end MEASUREMENT
/begin MEASUREMENT VDAG_OBCSysFailLvl1FltSt_enum "OBCFailLevel1故障状态" UBYTE AppSwcVcu_CM_uint8_enum 0 0 0.0 255.0 ECU_ADDRESS 0x0000 /* @ECU_Address@VDAG_OBCSysFailLvl1FltSt_enum@ */ /end MEASUREMENT
/begin MEASUREMENT VDAG_OBCInletConnectFltSt_enum "OBC插枪故障状态" UBYTE AppSwcVcu_CM_uint8_enum 0 0 0.0 255.0 ECU_ADDRESS 0x0000 /* @ECU_Address@VDAG_OBCInletConnectFltSt_enum@ */ /end MEASUREMENT
/begin MEASUREMENT VDAG_ACDchaBMSPwrLoFltSt_enum "AC放电BMS功率低故障状态" UBYTE AppSwcVcu_CM_uint8_enum 0 0 0.0 255.0 ECU_ADDRESS 0x0000 /* @ECU_Address@VDAG_ACDchaBMSPwrLoFltSt_enum@ */ /end MEASUREMENT
/begin MEASUREMENT VDAG_ACDchaBMSSOCLoFltSt_enum "AC放电BMSSOC低故障状态" UBYTE AppSwcVcu_CM_uint8_enum 0 0 0.0 255.0 ECU_ADDRESS 0x0000 /* @ECU_Address@VDAG_ACDchaBMSSOCLoFltSt_enum@ */ /end MEASUREMENT
/begin MEASUREMENT VDAG_OBCChrgReqFltSt_enum "OBCChargeRequest故障状态" UBYTE AppSwcVcu_CM_uint8_enum 0 0 0.0 255.0 ECU_ADDRESS 0x0000 /* @ECU_Address@VDAG_OBCChrgReqFltSt_enum@ */ /end MEASUREMENT
/begin MEASUREMENT VDAG_OBCS2StatFltSt_enum "OBCS2连接超时故障状态" UBYTE AppSwcVcu_CM_uint8_enum 0 0 0.0 255.0 ECU_ADDRESS 0x0000 /* @ECU_Address@VDAG_OBCS2StatFltSt_enum@ */ /end MEASUREMENT
/begin MEASUREMENT VDAG_OBCConnectTmOutFltSt_enum "OBC连接超时故障状态" UBYTE AppSwcVcu_CM_uint8_enum 0 0 0.0 255.0 ECU_ADDRESS 0x0000 /* @ECU_Address@VDAG_OBCConnectTmOutFltSt_enum@ */ /end MEASUREMENT
/begin MEASUREMENT VDAG_OBCModeMsmtchFltSt_enum "OBC模式不匹配故障状态" UBYTE AppSwcVcu_CM_uint8_enum 0 0 0.0 255.0 ECU_ADDRESS 0x0000 /* @ECU_Address@VDAG_OBCModeMsmtchFltSt_enum@ */ /end MEASUREMENT
/begin MEASUREMENT VDAG_ACChrgStFailFltSt_enum "ACChargeStateFail故障状态" UBYTE AppSwcVcu_CM_uint8_enum 0 0 0.0 255.0 ECU_ADDRESS 0x0000 /* @ECU_Address@VDAG_ACChrgStFailFltSt_enum@ */ /end MEASUREMENT
/begin MEASUREMENT VDAG_ACDchaOverPwrFltSt_enum "AC放电功率超限故障" UBYTE AppSwcVcu_CM_uint8_enum 0 0 0.0 255.0 ECU_ADDRESS 0x0000 /* @ECU_Address@VDAG_ACDchaOverPwrFltSt_enum@ */ /end MEASUREMENT
/begin MEASUREMENT VDAG_OBCSysFailLvl4FltSt_enum "OBCFailLevel4故障状态" UBYTE AppSwcVcu_CM_uint8_enum 0 0 0.0 255.0 ECU_ADDRESS 0x0000 /* @ECU_Address@VDAG_OBCSysFailLvl4FltSt_enum@ */ /end MEASUREMENT
/begin MEASUREMENT VDAG_INVInVoltLoFltSt_enum "INV输入电压低故障状态" UBYTE AppSwcVcu_CM_uint8_enum 0 0 0.0 255.0 ECU_ADDRESS 0x0000 /* @ECU_Address@VDAG_INVInVoltLoFltSt_enum@ */ /end MEASUREMENT
/begin MEASUREMENT VDAG_DCCInVoltLoFltSt_enum "DCDC输入电压低故障状态" UBYTE AppSwcVcu_CM_uint8_enum 0 0 0.0 255.0 ECU_ADDRESS 0x0000 /* @ECU_Address@VDAG_DCCInVoltLoFltSt_enum@ */ /end MEASUREMENT
/begin MEASUREMENT VDAG_DCCCmdTmOutFltSt_enum "DCDC模式指令响应超时故障状态" UBYTE AppSwcVcu_CM_uint8_enum 0 0 0.0 255.0 ECU_ADDRESS 0x0000 /* @ECU_Address@VDAG_DCCCmdTmOutFltSt_enum@ */ /end MEASUREMENT
/begin MEASUREMENT VDAG_DCCModeFltFltSt_enum "DCDCModeFault故障状态" UBYTE AppSwcVcu_CM_uint8_enum 0 0 0.0 255.0 ECU_ADDRESS 0x0000 /* @ECU_Address@VDAG_DCCModeFltFltSt_enum@ */ /end MEASUREMENT
/begin MEASUREMENT VDAG_DCCSysFailLvl4FltSt_enum "DCDCFailLevel4故障状态" UBYTE AppSwcVcu_CM_uint8_enum 0 0 0.0 255.0 ECU_ADDRESS 0x0000 /* @ECU_Address@VDAG_DCCSysFailLvl4FltSt_enum@ */ /end MEASUREMENT
/begin MEASUREMENT VDAG_DCCSysFailLvl3FltSt_enum "DCDCFailLevel3故障状态" UBYTE AppSwcVcu_CM_uint8_enum 0 0 0.0 255.0 ECU_ADDRESS 0x0000 /* @ECU_Address@VDAG_DCCSysFailLvl3FltSt_enum@ */ /end MEASUREMENT
/begin MEASUREMENT VDAG_DCCSysFailLvl2FltSt_enum "DCDCFailLevel2故障状态" UBYTE AppSwcVcu_CM_uint8_enum 0 0 0.0 255.0 ECU_ADDRESS 0x0000 /* @ECU_Address@VDAG_DCCSysFailLvl2FltSt_enum@ */ /end MEASUREMENT
/begin MEASUREMENT VDAG_DCCSysFailLvl1FltSt_enum "DCDCFailLevel1故障状态" UBYTE AppSwcVcu_CM_uint8_enum 0 0 0.0 255.0 ECU_ADDRESS 0x0000 /* @ECU_Address@VDAG_DCCSysFailLvl1FltSt_enum@ */ /end MEASUREMENT
/begin MEASUREMENT VDAG_INVRunCmdRespFltSt_enum "INVRun指令响应超时故障状态" UBYTE AppSwcVcu_CM_uint8_enum 0 0 0.0 255.0 ECU_ADDRESS 0x0000 /* @ECU_Address@VDAG_INVRunCmdRespFltSt_enum@ */ /end MEASUREMENT
/begin MEASUREMENT VDAG_INVFltLvl4FltSt_enum "INVFaultLevel4故障状态" UBYTE AppSwcVcu_CM_uint8_enum 0 0 0.0 255.0 ECU_ADDRESS 0x0000 /* @ECU_Address@VDAG_INVFltLvl4FltSt_enum@ */ /end MEASUREMENT
/begin MEASUREMENT VDAG_INVFltLvl3FltSt_enum "INVFaultLevel3故障状态" UBYTE AppSwcVcu_CM_uint8_enum 0 0 0.0 255.0 ECU_ADDRESS 0x0000 /* @ECU_Address@VDAG_INVFltLvl3FltSt_enum@ */ /end MEASUREMENT
/begin MEASUREMENT VDAG_INVFltLvl2FltSt_enum "INVFaultLevel2故障状态" UBYTE AppSwcVcu_CM_uint8_enum 0 0 0.0 255.0 ECU_ADDRESS 0x0000 /* @ECU_Address@VDAG_INVFltLvl2FltSt_enum@ */ /end MEASUREMENT
/begin MEASUREMENT VDAG_INVFltLvl1FltSt_enum "INVFaultLevel1故障状态" UBYTE AppSwcVcu_CM_uint8_enum 0 0 0.0 255.0 ECU_ADDRESS 0x0000 /* @ECU_Address@VDAG_INVFltLvl1FltSt_enum@ */ /end MEASUREMENT
/begin MEASUREMENT VDAG_DCSCmdTmOutFltSt_enum "DCSCmd超时故障状态" UBYTE AppSwcVcu_CM_uint8_enum 0 0 0.0 255.0 ECU_ADDRESS 0x0000 /* @ECU_Address@VDAG_DCSCmdTmOutFltSt_enum@ */ /end MEASUREMENT
/begin MEASUREMENT VDAG_CellUndrVoltFltSt_enum "BMSCell欠压故障状态" UBYTE AppSwcVcu_CM_uint8_enum 0 0 0.0 255.0 ECU_ADDRESS 0x0000 /* @ECU_Address@VDAG_CellUndrVoltFltSt_enum@ */ /end MEASUREMENT
/begin MEASUREMENT VDAG_BMSUndrVoltFltSt_enum "BMSPack欠压故障状态" UBYTE AppSwcVcu_CM_uint8_enum 0 0 0.0 255.0 ECU_ADDRESS 0x0000 /* @ECU_Address@VDAG_BMSUndrVoltFltSt_enum@ */ /end MEASUREMENT
/begin MEASUREMENT VDAG_BMSEmgcySdnFltSt_enum "BMS紧急下电故障状态" UBYTE AppSwcVcu_CM_uint8_enum 0 0 0.0 255.0 ECU_ADDRESS 0x0000 /* @ECU_Address@VDAG_BMSEmgcySdnFltSt_enum@ */ /end MEASUREMENT
/begin MEASUREMENT VDAG_BMSSOCLoFltSt_enum "BMSSOC低故障状态" UBYTE AppSwcVcu_CM_uint8_enum 0 0 0.0 255.0 ECU_ADDRESS 0x0000 /* @ECU_Address@VDAG_BMSSOCLoFltSt_enum@ */ /end MEASUREMENT
/begin MEASUREMENT VDAG_BMSSysFailLvl3FltSt_enum "BMSFailLevel3故障状态" UBYTE AppSwcVcu_CM_uint8_enum 0 0 0.0 255.0 ECU_ADDRESS 0x0000 /* @ECU_Address@VDAG_BMSSysFailLvl3FltSt_enum@ */ /end MEASUREMENT
/begin MEASUREMENT VDAG_BMSSysFailLvl2FltSt_enum "BMSFailLevel2故障状态" UBYTE AppSwcVcu_CM_uint8_enum 0 0 0.0 255.0 ECU_ADDRESS 0x0000 /* @ECU_Address@VDAG_BMSSysFailLvl2FltSt_enum@ */ /end MEASUREMENT
/begin MEASUREMENT VDAG_BMSSysFailLvl1FltSt_enum "BMSFailLevel1故障状态" UBYTE AppSwcVcu_CM_uint8_enum 0 0 0.0 255.0 ECU_ADDRESS 0x0000 /* @ECU_Address@VDAG_BMSSysFailLvl1FltSt_enum@ */ /end MEASUREMENT
/begin MEASUREMENT VDAG_ACSCmdTmOutFltSt_enum "ACSCmd超时故障状态" UBYTE AppSwcVcu_CM_uint8_enum 0 0 0.0 255.0 ECU_ADDRESS 0x0000 /* @ECU_Address@VDAG_ACSCmdTmOutFltSt_enum@ */ /end MEASUREMENT
/begin MEASUREMENT VDAG_DCSModeFailFltSt_enum "DCSModeFail故障状态" UBYTE AppSwcVcu_CM_uint8_enum 0 0 0.0 255.0 ECU_ADDRESS 0x0000 /* @ECU_Address@VDAG_DCSModeFailFltSt_enum@ */ /end MEASUREMENT
/begin MEASUREMENT VDAG_DCSChrgReqFltSt_enum "DCSChargeRequest故障状态" UBYTE AppSwcVcu_CM_uint8_enum 0 0 0.0 255.0 ECU_ADDRESS 0x0000 /* @ECU_Address@VDAG_DCSChrgReqFltSt_enum@ */ /end MEASUREMENT
/begin MEASUREMENT VDAG_DCSInletConnectFltSt_enum "DCS插枪故障状态" UBYTE AppSwcVcu_CM_uint8_enum 0 0 0.0 255.0 ECU_ADDRESS 0x0000 /* @ECU_Address@VDAG_DCSInletConnectFltSt_enum@ */ /end MEASUREMENT
/begin MEASUREMENT VDAG_DCSFailStaFltSt_enum "DCSFailState故障状态" UBYTE AppSwcVcu_CM_uint8_enum 0 0 0.0 255.0 ECU_ADDRESS 0x0000 /* @ECU_Address@VDAG_DCSFailStaFltSt_enum@ */ /end MEASUREMENT
/begin MEASUREMENT VDAG_HVIsoResistLoFltSt_enum "高压电池绝缘故障状态" UBYTE AppSwcVcu_CM_uint8_enum 0 0 0.0 255.0 ECU_ADDRESS 0x0000 /* @ECU_Address@VDAG_HVIsoResistLoFltSt_enum@ */ /end MEASUREMENT
/begin MEASUREMENT VDAG_BMSCmdTmOutFltSt_enum "BMS继电器指令响应超时故障状态" UBYTE AppSwcVcu_CM_uint8_enum 0 0 0.0 255.0 ECU_ADDRESS 0x0000 /* @ECU_Address@VDAG_BMSCmdTmOutFltSt_enum@ */ /end MEASUREMENT
/begin MEASUREMENT VDAG_BrkSwCrsChkCnt_cnt "制动开关相互校验错误计数" UBYTE AppSwcVcu_CM_uint8_enum 0 0 0.0 255.0 ECU_ADDRESS 0x0000 /* @ECU_Address@VDAG_BrkSwCrsChkCnt_cnt@ */ /end MEASUREMENT
/begin MEASUREMENT VDAG_HVILVoltHiFltSt_enum "高压互锁电压高故障状态" UBYTE AppSwcVcu_CM_uint8_enum 0 0 0.0 255.0 ECU_ADDRESS 0x0000 /* @ECU_Address@VDAG_HVILVoltHiFltSt_enum@ */ /end MEASUREMENT
/begin MEASUREMENT VDAG_HVILVoltLoFltSt_enum "高压互锁电压低故障状态" UBYTE AppSwcVcu_CM_uint8_enum 0 0 0.0 255.0 ECU_ADDRESS 0x0000 /* @ECU_Address@VDAG_HVILVoltLoFltSt_enum@ */ /end MEASUREMENT
/begin MEASUREMENT VDAG_BrkPedShtBattFltSt_enum "制动踏板短电源故障状态" UBYTE AppSwcVcu_CM_uint8_enum 0 0 0.0 255.0 ECU_ADDRESS 0x0000 /* @ECU_Address@VDAG_BrkPedShtBattFltSt_enum@ */ /end MEASUREMENT
/begin MEASUREMENT VDAG_BrkSwCrsChkFltSt_enum "制动开关相互校验故障状态" UBYTE AppSwcVcu_CM_uint8_enum 0 0 0.0 255.0 ECU_ADDRESS 0x0000 /* @ECU_Address@VDAG_BrkSwCrsChkFltSt_enum@ */ /end MEASUREMENT
/begin MEASUREMENT VDAG_BrkPedShtGndFltSt_enum "制动踏板短地故障状态" UBYTE AppSwcVcu_CM_uint8_enum 0 0 0.0 255.0 ECU_ADDRESS 0x0000 /* @ECU_Address@VDAG_BrkPedShtGndFltSt_enum@ */ /end MEASUREMENT
/begin MEASUREMENT VDAG_AccPed2ShtGndFltSt_enum "加速踏板2路短地故障状态" UBYTE AppSwcVcu_CM_uint8_enum 0 0 0.0 255.0 ECU_ADDRESS 0x0000 /* @ECU_Address@VDAG_AccPed2ShtGndFltSt_enum@ */ /end MEASUREMENT
/begin MEASUREMENT VDAG_AccPed1ShtBattFltSt_enum "加速踏板1路短电源故障状态" UBYTE AppSwcVcu_CM_uint8_enum 0 0 0.0 255.0 ECU_ADDRESS 0x0000 /* @ECU_Address@VDAG_AccPed1ShtBattFltSt_enum@ */ /end MEASUREMENT
/begin MEASUREMENT VDAG_AccPed2SuplyShtCircFltSt_enum "加速踏板2路供电短路故障状态" UBYTE AppSwcVcu_CM_uint8_enum 0 0 0.0 255.0 ECU_ADDRESS 0x0000 /* @ECU_Address@VDAG_AccPed2SuplyShtCircFltSt_enum@ */ /end MEASUREMENT
/begin MEASUREMENT VDAG_AccPed1SuplyShtCircFltSt_enum "加速踏板1路供电短路故障状态" UBYTE AppSwcVcu_CM_uint8_enum 0 0 0.0 255.0 ECU_ADDRESS 0x0000 /* @ECU_Address@VDAG_AccPed1SuplyShtCircFltSt_enum@ */ /end MEASUREMENT
/begin MEASUREMENT VDAG_AccPed1ShtGndFltSt_enum "加速踏板1路短地故障状态" UBYTE AppSwcVcu_CM_uint8_enum 0 0 0.0 255.0 ECU_ADDRESS 0x0000 /* @ECU_Address@VDAG_AccPed1ShtGndFltSt_enum@ */ /end MEASUREMENT
/begin MEASUREMENT VDAG_AccPedBothFailFltSt_enum "加速踏板双路失效故障状态" UBYTE AppSwcVcu_CM_uint8_enum 0 0 0.0 255.0 ECU_ADDRESS 0x0000 /* @ECU_Address@VDAG_AccPedBothFailFltSt_enum@ */ /end MEASUREMENT
/begin MEASUREMENT VDAG_AccPedCrsChkFltSt_enum "加速踏板相互校验故障状态" UBYTE AppSwcVcu_CM_uint8_enum 0 0 0.0 255.0 ECU_ADDRESS 0x0000 /* @ECU_Address@VDAG_AccPedCrsChkFltSt_enum@ */ /end MEASUREMENT
/begin MEASUREMENT VDAG_AccPed2ShtBattFltSt_enum "加速踏板2路短电源故障状态" UBYTE AppSwcVcu_CM_uint8_enum 0 0 0.0 255.0 ECU_ADDRESS 0x0000 /* @ECU_Address@VDAG_AccPed2ShtBattFltSt_enum@ */ /end MEASUREMENT
/begin MEASUREMENT VDAG_VehCrashFltSt_enum "碰撞故障状态" UBYTE AppSwcVcu_CM_uint8_enum 0 0 0.0 255.0 ECU_ADDRESS 0x0000 /* @ECU_Address@VDAG_VehCrashFltSt_enum@ */ /end MEASUREMENT
/begin MEASUREMENT VOPM_HwWakeupBMS_flg "" UBYTE AppSwcVcu_CM_boolean_flg 0 0 0.0 1.0 ECU_ADDRESS 0x0000 /* @ECU_Address@VOPM_HwWakeupBMS_flg@ */ /end MEASUREMENT
/begin MEASUREMENT VIPM_HwVehCrash_flg "" UBYTE AppSwcVcu_CM_boolean_flg 0 0 0.0 1.0 ECU_ADDRESS 0x0000 /* @ECU_Address@VIPM_HwVehCrash_flg@ */ /end MEASUREMENT
/begin MEASUREMENT VIPM_HwRearFogLampSwt_flg "" UBYTE AppSwcVcu_CM_boolean_flg 0 0 0.0 1.0 ECU_ADDRESS 0x0000 /* @ECU_Address@VIPM_HwRearFogLampSwt_flg@ */ /end MEASUREMENT
/begin MEASUREMENT VIPM_HwOBCWakeup_flg "" UBYTE AppSwcVcu_CM_boolean_flg 0 0 0.0 1.0 ECU_ADDRESS 0x0000 /* @ECU_Address@VIPM_HwOBCWakeup_flg@ */ /end MEASUREMENT
/begin MEASUREMENT VIPM_HwKL15B_flg "" UBYTE AppSwcVcu_CM_boolean_flg 0 0 0.0 1.0 ECU_ADDRESS 0x0000 /* @ECU_Address@VIPM_HwKL15B_flg@ */ /end MEASUREMENT
/begin MEASUREMENT VIPM_HwKL15A_flg "" UBYTE AppSwcVcu_CM_boolean_flg 0 0 0.0 1.0 ECU_ADDRESS 0x0000 /* @ECU_Address@VIPM_HwKL15A_flg@ */ /end MEASUREMENT
/begin MEASUREMENT VIPM_HwEmgcyShutOff_flg "" UBYTE AppSwcVcu_CM_boolean_flg 0 0 0.0 1.0 ECU_ADDRESS 0x0000 /* @ECU_Address@VIPM_HwEmgcyShutOff_flg@ */ /end MEASUREMENT
/begin MEASUREMENT VIPM_HwDrvModeSw_flg "" UBYTE AppSwcVcu_CM_boolean_flg 0 0 0.0 1.0 ECU_ADDRESS 0x0000 /* @ECU_Address@VIPM_HwDrvModeSw_flg@ */ /end MEASUREMENT
/begin MEASUREMENT VIPM_HwCrpModeSw_flg "" UBYTE AppSwcVcu_CM_boolean_flg 0 0 0.0 1.0 ECU_ADDRESS 0x0000 /* @ECU_Address@VIPM_HwCrpModeSw_flg@ */ /end MEASUREMENT
/begin MEASUREMENT VIPM_HwBrkSwLo_flg "" UBYTE AppSwcVcu_CM_boolean_flg 0 0 0.0 1.0 ECU_ADDRESS 0x0000 /* @ECU_Address@VIPM_HwBrkSwLo_flg@ */ /end MEASUREMENT
/begin MEASUREMENT VIPM_HwBrkSwHi_flg "" UBYTE AppSwcVcu_CM_boolean_flg 0 0 0.0 1.0 ECU_ADDRESS 0x0000 /* @ECU_Address@VIPM_HwBrkSwHi_flg@ */ /end MEASUREMENT
/begin MEASUREMENT VIPM_HwBMSWakeup_flg "" UBYTE AppSwcVcu_CM_boolean_flg 0 0 0.0 1.0 ECU_ADDRESS 0x0000 /* @ECU_Address@VIPM_HwBMSWakeup_flg@ */ /end MEASUREMENT
/begin MEASUREMENT VVTM_RegenReqBrkLampOn_flg "" UBYTE AppSwcVcu_CM_boolean_flg 0 0 0.0 1.0 ECU_ADDRESS 0x0000 /* @ECU_Address@VVTM_RegenReqBrkLampOn_flg@ */ /end MEASUREMENT
/begin MEASUREMENT VTQR_ASDEnbl_flg "" UBYTE AppSwcVcu_CM_boolean_flg 0 0 0.0 1.0 ECU_ADDRESS 0x0000 /* @ECU_Address@VTQR_ASDEnbl_flg@ */ /end MEASUREMENT
/begin MEASUREMENT VTQR_MotorStdby_flg "" UBYTE AppSwcVcu_CM_boolean_flg 0 0 0.0 1.0 ECU_ADDRESS 0x0000 /* @ECU_Address@VTQR_MotorStdby_flg@ */ /end MEASUREMENT
/begin MEASUREMENT VTQR_MotDampngEnbl_flg "" UBYTE AppSwcVcu_CM_boolean_flg 0 0 0.0 1.0 ECU_ADDRESS 0x0000 /* @ECU_Address@VTQR_MotDampngEnbl_flg@ */ /end MEASUREMENT
/begin MEASUREMENT VTQF_TqRateLimEndg_flg "" UBYTE AppSwcVcu_CM_boolean_flg 0 0 0.0 1.0 ECU_ADDRESS 0x0000 /* @ECU_Address@VTQF_TqRateLimEndg_flg@ */ /end MEASUREMENT
/begin MEASUREMENT VVSO_iTPMSAvail_flg "" UBYTE AppSwcVcu_CM_boolean_flg 0 0 0.0 1.0 ECU_ADDRESS 0x0000 /* @ECU_Address@VVSO_iTPMSAvail_flg@ */ /end MEASUREMENT
/begin MEASUREMENT VVSO_WhlDistErrHld_flg "" UBYTE AppSwcVcu_CM_boolean_flg 0 0 0.0 1.0 ECU_ADDRESS 0x0000 /* @ECU_Address@VVSO_WhlDistErrHld_flg@ */ /end MEASUREMENT
/begin MEASUREMENT VRME_CalSOCCnsmTrig_flg "累计里程大于目标里程" UBYTE AppSwcVcu_CM_boolean_flg 0 0 0.0 1.0 ECU_ADDRESS 0x0000 /* @ECU_Address@VRME_CalSOCCnsmTrig_flg@ */ /end MEASUREMENT
/begin MEASUREMENT VRME_VehStacEnbl_flg "车辆静止状态" UBYTE AppSwcVcu_CM_boolean_flg 0 0 0.0 1.0 ECU_ADDRESS 0x0000 /* @ECU_Address@VRME_VehStacEnbl_flg@ */ /end MEASUREMENT
/begin MEASUREMENT VRME_DynRmnMilEstUpdTrig_flg "更新续航值" UBYTE AppSwcVcu_CM_boolean_flg 0 0 0.0 1.0 ECU_ADDRESS 0x0000 /* @ECU_Address@VRME_DynRmnMilEstUpdTrig_flg@ */ /end MEASUREMENT
/begin MEASUREMENT VRME_DynRmnMilEstV_flg "动态续航有效性" UBYTE AppSwcVcu_CM_boolean_flg 0 0 0.0 1.0 ECU_ADDRESS 0x0000 /* @ECU_Address@VRME_DynRmnMilEstV_flg@ */ /end MEASUREMENT
/begin MEASUREMENT VRME_CalPwrCnsmTrig_flg "累计里程大于单位里程（默认1km）" UBYTE AppSwcVcu_CM_boolean_flg 0 0 0.0 1.0 ECU_ADDRESS 0x0000 /* @ECU_Address@VRME_CalPwrCnsmTrig_flg@ */ /end MEASUREMENT
/begin MEASUREMENT VIPC_AccPed1Flt_flg "" UBYTE AppSwcVcu_CM_boolean_flg 0 0 0.0 1.0 ECU_ADDRESS 0x0000 /* @ECU_Address@VIPC_AccPed1Flt_flg@ */ /end MEASUREMENT
/begin MEASUREMENT VIPC_AccPed1LrnUpActv_flg "" UBYTE AppSwcVcu_CM_boolean_flg 0 0 0.0 1.0 ECU_ADDRESS 0x0000 /* @ECU_Address@VIPC_AccPed1LrnUpActv_flg@ */ /end MEASUREMENT
/begin MEASUREMENT VIPC_AccPed2Flt_flg "" UBYTE AppSwcVcu_CM_boolean_flg 0 0 0.0 1.0 ECU_ADDRESS 0x0000 /* @ECU_Address@VIPC_AccPed2Flt_flg@ */ /end MEASUREMENT
/begin MEASUREMENT VIPC_AccPed2LrnUpActv_flg "" UBYTE AppSwcVcu_CM_boolean_flg 0 0 0.0 1.0 ECU_ADDRESS 0x0000 /* @ECU_Address@VIPC_AccPed2LrnUpActv_flg@ */ /end MEASUREMENT
/begin MEASUREMENT VIPC_ZeroPstnRst_flg "" UBYTE AppSwcVcu_CM_boolean_flg 0 0 0.0 1.0 ECU_ADDRESS 0x0000 /* @ECU_Address@VIPC_ZeroPstnRst_flg@ */ /end MEASUREMENT
/begin MEASUREMENT VIPC_AccPedStkStab_flg "" UBYTE AppSwcVcu_CM_boolean_flg 0 0 0.0 1.0 ECU_ADDRESS 0x0000 /* @ECU_Address@VIPC_AccPedStkStab_flg@ */ /end MEASUREMENT
/begin MEASUREMENT VIPC_AccPedStkBrkPrsd_flg "" UBYTE AppSwcVcu_CM_boolean_flg 0 0 0.0 1.0 ECU_ADDRESS 0x0000 /* @ECU_Address@VIPC_AccPedStkBrkPrsd_flg@ */ /end MEASUREMENT
/begin MEASUREMENT VIPC_AccPedStkActv_flg "" UBYTE AppSwcVcu_CM_boolean_flg 0 0 0.0 1.0 ECU_ADDRESS 0x0000 /* @ECU_Address@VIPC_AccPedStkActv_flg@ */ /end MEASUREMENT
/begin MEASUREMENT VIPC_AccPedPstnVld_flg "" UBYTE AppSwcVcu_CM_boolean_flg 0 0 0.0 1.0 ECU_ADDRESS 0x0000 /* @ECU_Address@VIPC_AccPedPstnVld_flg@ */ /end MEASUREMENT
/begin MEASUREMENT VIPC_DrvSw_flg "" UBYTE AppSwcVcu_CM_boolean_flg 0 0 0.0 1.0 ECU_ADDRESS 0x0000 /* @ECU_Address@VIPC_DrvSw_flg@ */ /end MEASUREMENT
/begin MEASUREMENT VIPC_VpedAutoCrp_flg "" UBYTE AppSwcVcu_CM_boolean_flg 0 0 0.0 1.0 ECU_ADDRESS 0x0000 /* @ECU_Address@VIPC_VpedAutoCrp_flg@ */ /end MEASUREMENT
/begin MEASUREMENT VIPC_VehSpdDrvnVld_flg "" UBYTE AppSwcVcu_CM_boolean_flg 0 0 0.0 1.0 ECU_ADDRESS 0x0000 /* @ECU_Address@VIPC_VehSpdDrvnVld_flg@ */ /end MEASUREMENT
/begin MEASUREMENT VIPC_VehSpdVld_flg "" UBYTE AppSwcVcu_CM_boolean_flg 0 0 0.0 1.0 ECU_ADDRESS 0x0000 /* @ECU_Address@VIPC_VehSpdVld_flg@ */ /end MEASUREMENT
/begin MEASUREMENT VIPC_VehSpdNonDrvnVld_flg "" UBYTE AppSwcVcu_CM_boolean_flg 0 0 0.0 1.0 ECU_ADDRESS 0x0000 /* @ECU_Address@VIPC_VehSpdNonDrvnVld_flg@ */ /end MEASUREMENT
/begin MEASUREMENT BSW_RTCWakeup_flg "RTC唤醒标志位_versteckt" UBYTE AppSwcVcu_CM_boolean_flg 0 0 0.0 1.0 ECU_ADDRESS 0x0000 /* @ECU_Address@BSW_RTCWakeup_flg@ */ /end MEASUREMENT
/begin MEASUREMENT VIBS_WupVoltAllow_flg "KL30电压允许标志位_versteckt" UBYTE AppSwcVcu_CM_boolean_flg 0 0 0.0 1.0 ECU_ADDRESS 0x0000 /* @ECU_Address@VIBS_WupVoltAllow_flg@ */ /end MEASUREMENT
/begin MEASUREMENT VIBS_NMReq_flg "IBS请求网络标志位_versteckt" UBYTE AppSwcVcu_CM_boolean_flg 0 0 0.0 1.0 ECU_ADDRESS 0x0000 /* @ECU_Address@VIBS_NMReq_flg@ */ /end MEASUREMENT
/begin MEASUREMENT VIBS_RTCWakeup_flg "RTC唤醒标志位（含延迟时间）_versteckt" UBYTE AppSwcVcu_CM_boolean_flg 0 0 0.0 1.0 ECU_ADDRESS 0x0000 /* @ECU_Address@VIBS_RTCWakeup_flg@ */ /end MEASUREMENT
/begin MEASUREMENT VHVM_INVPreprogmFlg_flg "INV预编程条件满足" UBYTE AppSwcVcu_CM_boolean_flg 0 0 0.0 1.0 ECU_ADDRESS 0x0000 /* @ECU_Address@VHVM_INVPreprogmFlg_flg@ */ /end MEASUREMENT
/begin MEASUREMENT VHVM_VehHalt_flg "车辆停止标志位（车速极其）" UBYTE AppSwcVcu_CM_boolean_flg 0 0 0.0 1.0 ECU_ADDRESS 0x0000 /* @ECU_Address@VHVM_VehHalt_flg@ */ /end MEASUREMENT
/begin MEASUREMENT VHVM_DCChrgEnbl_flg "直流充电基本条件满足" UBYTE AppSwcVcu_CM_boolean_flg 0 0 0.0 1.0 ECU_ADDRESS 0x0000 /* @ECU_Address@VHVM_DCChrgEnbl_flg@ */ /end MEASUREMENT
/begin MEASUREMENT VHVM_DCChrging2Over_flg "直流充电中转移到充电结束标志位" UBYTE AppSwcVcu_CM_boolean_flg 0 0 0.0 1.0 ECU_ADDRESS 0x0000 /* @ECU_Address@VHVM_DCChrging2Over_flg@ */ /end MEASUREMENT
/begin MEASUREMENT VHVM_ACDschrging2Stop_flg "交流放电中转移到放电停止标志位" UBYTE AppSwcVcu_CM_boolean_flg 0 0 0.0 1.0 ECU_ADDRESS 0x0000 /* @ECU_Address@VHVM_ACDschrging2Stop_flg@ */ /end MEASUREMENT
/begin MEASUREMENT VHVM_ACChrging2Stop_flg "交流充电中转移到充电停止标志位" UBYTE AppSwcVcu_CM_boolean_flg 0 0 0.0 1.0 ECU_ADDRESS 0x0000 /* @ECU_Address@VHVM_ACChrging2Stop_flg@ */ /end MEASUREMENT
/begin MEASUREMENT VHVM_WakeUpVCU_flg "休眠到唤醒条件满足" UBYTE AppSwcVcu_CM_boolean_flg 0 0 0.0 1.0 ECU_ADDRESS 0x0000 /* @ECU_Address@VHVM_WakeUpVCU_flg@ */ /end MEASUREMENT
/begin MEASUREMENT VHVM_PowUpSelfChek_flg "高压自检标志位" UBYTE AppSwcVcu_CM_boolean_flg 0 0 0.0 1.0 ECU_ADDRESS 0x0000 /* @ECU_Address@VHVM_PowUpSelfChek_flg@ */ /end MEASUREMENT
/begin MEASUREMENT VHVM_WakeUp2PwrUpKL15_flg "K15唤醒上电" UBYTE AppSwcVcu_CM_boolean_flg 0 0 0.0 1.0 ECU_ADDRESS 0x0000 /* @ECU_Address@VHVM_WakeUp2PwrUpKL15_flg@ */ /end MEASUREMENT
/begin MEASUREMENT VHVM_WakeUp2PwrUpDCChrg_flg "直流充电唤醒上电" UBYTE AppSwcVcu_CM_boolean_flg 0 0 0.0 1.0 ECU_ADDRESS 0x0000 /* @ECU_Address@VHVM_WakeUp2PwrUpDCChrg_flg@ */ /end MEASUREMENT
/begin MEASUREMENT VHVM_ACChrgEnbl_flg "交流充电基本条件满足" UBYTE AppSwcVcu_CM_boolean_flg 0 0 0.0 1.0 ECU_ADDRESS 0x0000 /* @ECU_Address@VHVM_ACChrgEnbl_flg@ */ /end MEASUREMENT
/begin MEASUREMENT VHVM_WakeUp2PwrUpACChrg_flg "交流充电唤醒上电" UBYTE AppSwcVcu_CM_boolean_flg 0 0 0.0 1.0 ECU_ADDRESS 0x0000 /* @ECU_Address@VHVM_WakeUp2PwrUpACChrg_flg@ */ /end MEASUREMENT
/begin MEASUREMENT VHVM_ACDchaEnbl_flg "交流放电基本条件满足" UBYTE AppSwcVcu_CM_boolean_flg 0 0 0.0 1.0 ECU_ADDRESS 0x0000 /* @ECU_Address@VHVM_ACDchaEnbl_flg@ */ /end MEASUREMENT
/begin MEASUREMENT VHVM_WakeUp2PwrUpACDcha_flg "交流放电唤醒上电" UBYTE AppSwcVcu_CM_boolean_flg 0 0 0.0 1.0 ECU_ADDRESS 0x0000 /* @ECU_Address@VHVM_WakeUp2PwrUpACDcha_flg@ */ /end MEASUREMENT
/begin MEASUREMENT VHVM_WakeUp2PwrUpIBS_flg "IBS唤醒上电" UBYTE AppSwcVcu_CM_boolean_flg 0 0 0.0 1.0 ECU_ADDRESS 0x0000 /* @ECU_Address@VHVM_WakeUp2PwrUpIBS_flg@ */ /end MEASUREMENT
/begin MEASUREMENT VHVM_WakeUp2PwrUp_flg "唤醒到上高压条件满足（唤醒源上升沿+高压自检通过）" UBYTE AppSwcVcu_CM_boolean_flg 0 0 0.0 1.0 ECU_ADDRESS 0x0000 /* @ECU_Address@VHVM_WakeUp2PwrUp_flg@ */ /end MEASUREMENT
/begin MEASUREMENT VHVM_PTStdby2PTRdy_flg "PTStdby到PTRdy标志位" UBYTE AppSwcVcu_CM_boolean_flg 0 0 0.0 1.0 ECU_ADDRESS 0x0000 /* @ECU_Address@VHVM_PTStdby2PTRdy_flg@ */ /end MEASUREMENT
/begin MEASUREMENT VHVM_PTRdy2PTStdby_flg "PTRdy到PTStdby标志位" UBYTE AppSwcVcu_CM_boolean_flg 0 0 0.0 1.0 ECU_ADDRESS 0x0000 /* @ECU_Address@VHVM_PTRdy2PTStdby_flg@ */ /end MEASUREMENT
/begin MEASUREMENT VHVM_PwrOn2PwrDwn_flg "高压下电条件满足标志位（正常/故障/紧急）" UBYTE AppSwcVcu_CM_boolean_flg 0 0 0.0 1.0 ECU_ADDRESS 0x0000 /* @ECU_Address@VHVM_PwrOn2PwrDwn_flg@ */ /end MEASUREMENT
/begin MEASUREMENT VHMI_GrDSldSw_flg "D档溜坡计速/距离标志" UBYTE AppSwcVcu_CM_boolean 0 0 0.0 1.0 ECU_ADDRESS 0x0000 /* @ECU_Address@VHMI_GrDSldSw_flg@ */ /end MEASUREMENT
/begin MEASUREMENT VHMI_GrRSldSw_flg "R档溜坡计速/距离标志" UBYTE AppSwcVcu_CM_boolean 0 0 0.0 1.0 ECU_ADDRESS 0x0000 /* @ECU_Address@VHMI_GrRSldSw_flg@ */ /end MEASUREMENT
/begin MEASUREMENT VGSM_AsstDrvFbShft_flg "规范：ACC/CC禁止档位解析" UBYTE AppSwcVcu_CM_boolean_flg 0 0 0.0 1.0 ECU_ADDRESS 0x0000 /* @ECU_Address@VGSM_AsstDrvFbShft_flg@ */ /end MEASUREMENT
/begin MEASUREMENT VGSM_HldGearP_flg "规范：保持P档标志位" UBYTE AppSwcVcu_CM_boolean_flg 0 0 0.0 1.0 ECU_ADDRESS 0x0000 /* @ECU_Address@VGSM_HldGearP_flg@ */ /end MEASUREMENT
/begin MEASUREMENT VGSM_GrNReq2P_flg "N档非换挡请求进P档请求" UBYTE AppSwcVcu_CM_boolean_flg 0 0 0.0 1.0 ECU_ADDRESS 0x0000 /* @ECU_Address@VGSM_GrNReq2P_flg@ */ /end MEASUREMENT
/begin MEASUREMENT VGSM_DRFlt2N_flg "规范：退至非驱动档标志位" UBYTE AppSwcVcu_CM_boolean_flg 0 0 0.0 1.0 ECU_ADDRESS 0x0000 /* @ECU_Address@VGSM_DRFlt2N_flg@ */ /end MEASUREMENT
/begin MEASUREMENT VGSM_ReqEPBRels_flg "规范：EPB释放请求标志位" UBYTE AppSwcVcu_CM_boolean_flg 0 0 0.0 1.0 ECU_ADDRESS 0x0000 /* @ECU_Address@VGSM_ReqEPBRels_flg@ */ /end MEASUREMENT
/begin MEASUREMENT VGSM_ReqEPBAply_flg "规范：EPB拉起请求标志位" UBYTE AppSwcVcu_CM_boolean_flg 0 0 0.0 1.0 ECU_ADDRESS 0x0000 /* @ECU_Address@VGSM_ReqEPBAply_flg@ */ /end MEASUREMENT
/begin MEASUREMENT VGSM_VehEPBStErr_flg "规范：P档故障PGear error-VCU_VhclPGearError" UBYTE AppSwcVcu_CM_boolean_flg 0 0 0.0 1.0 ECU_ADDRESS 0x0000 /* @ECU_Address@VGSM_VehEPBStErr_flg@ */ /end MEASUREMENT
/begin MEASUREMENT VGSM_INVRunEnbl_flg "规范：INV使能控制（允许扭矩控制）-VCU_1_EnaInvRun" UBYTE AppSwcVcu_CM_boolean_flg 0 0 0.0 1.0 ECU_ADDRESS 0x0000 /* @ECU_Address@VGSM_INVRunEnbl_flg@ */ /end MEASUREMENT
/begin MEASUREMENT VGSM_EPBRelsFlt_flg "故障P-EPB释放故障" UBYTE AppSwcVcu_CM_boolean_flg 0 0 0.0 1.0 ECU_ADDRESS 0x0000 /* @ECU_Address@VGSM_EPBRelsFlt_flg@ */ /end MEASUREMENT
/begin MEASUREMENT VGSM_EPBAplyFlt_flg "故障P-EPB拉起故障" UBYTE AppSwcVcu_CM_boolean_flg 0 0 0.0 1.0 ECU_ADDRESS 0x0000 /* @ECU_Address@VGSM_EPBAplyFlt_flg@ */ /end MEASUREMENT
/begin MEASUREMENT VEMS_UseConChrgCur_flg "" UBYTE AppSwcVcu_CM_boolean_flg 0 0 0.0 1.0 ECU_ADDRESS 0x0000 /* @ECU_Address@VEMS_UseConChrgCur_flg@ */ /end MEASUREMENT
/begin MEASUREMENT VEMS_UseConDchaCur_flg "" UBYTE AppSwcVcu_CM_boolean_flg 0 0 0.0 1.0 ECU_ADDRESS 0x0000 /* @ECU_Address@VEMS_UseConDchaCur_flg@ */ /end MEASUREMENT
/begin MEASUREMENT VEMS_TMSActSOCEnbl_flg "SOC是否限制TMS" UBYTE AppSwcVcu_CM_boolean_flg 0 0 0.0 1.0 ECU_ADDRESS 0x0000 /* @ECU_Address@VEMS_TMSActSOCEnbl_flg@ */ /end MEASUREMENT
/begin MEASUREMENT VGSM_ShftTgtGrReq_enum "换挡杆目标档位 0-NoCmd 1-P 2-N 3-D 4-R " UBYTE AppSwcVcu_CM_EnumTgtGearPstn 0 0 0 4 ECU_ADDRESS 0x0000 /* @ECU_Address@VGSM_ShftTgtGrReq_enum@ */ /end MEASUREMENT
/begin MEASUREMENT VGSM_VehTgtGrReq_enum "规范:目标档位" UBYTE AppSwcVcu_CM_EnumTgtGearPstn 0 0 0 4 ECU_ADDRESS 0x0000 /* @ECU_Address@VGSM_VehTgtGrReq_enum@ */ /end MEASUREMENT
/begin MEASUREMENT VTZX_TqZXSt_enum "" UBYTE AppSwcVcu_CM_EnumTZXStat 0 0 0 8 ECU_ADDRESS 0x0000 /* @ECU_Address@VTZX_TqZXSt_enum@ */ /end MEASUREMENT
/begin MEASUREMENT VIPM_HwShftPstnSwSts_enum "" UBYTE AppSwcVcu_CM_EnumPGearSwSts 0 0 0 4 ECU_ADDRESS 0x0000 /* @ECU_Address@VIPM_HwShftPstnSwSts_enum@ */ /end MEASUREMENT
/begin MEASUREMENT VTQR_MotorDirReq_enum "" UBYTE AppSwcVcu_CM_EnumMotorDirReq 0 0 0 3 ECU_ADDRESS 0x0000 /* @ECU_Address@VTQR_MotorDirReq_enum@ */ /end MEASUREMENT
/begin MEASUREMENT VDAC_HDCSt_enum "" UBYTE AppSwcVcu_CM_EnumHDCState 0 0 0 2 ECU_ADDRESS 0x0000 /* @ECU_Address@VDAC_HDCSt_enum@ */ /end MEASUREMENT
/begin MEASUREMENT VGSM_VehActGearPstn_enum "规范：实际档位-VCU_VhclActlGearPos" UBYTE AppSwcVcu_CM_EnumGearPstn 0 0 0 3 ECU_ADDRESS 0x0000 /* @ECU_Address@VGSM_VehActGearPstn_enum@ */ /end MEASUREMENT
/begin MEASUREMENT VGSM_ReqEPB_enum "规范：EPB操作信号-VCUF_ReqEPB" UBYTE AppSwcVcu_CM_EnumEPBReq 0 0 0 2 ECU_ADDRESS 0x0000 /* @ECU_Address@VGSM_ReqEPB_enum@ */ /end MEASUREMENT
/begin COMPU_METHOD AppSwcVcu_CM_single_pct "Q = V" RAT_FUNC "%8.6" "pct" COEFFS 0 1 0 0 0 1 /end COMPU_METHOD
/begin COMPU_METHOD AppSwcVcu_CM_single_c "Q = V" RAT_FUNC "%8.6" "c" COEFFS 0 1 0 0 0 1 /end COMPU_METHOD
/begin COMPU_METHOD AppSwcVcu_CM_single_kW "Q = V" RAT_FUNC "%8.6" "kW" COEFFS 0 1 0 0 0 1 /end COMPU_METHOD
/begin COMPU_METHOD AppSwcVcu_CM_single_rat "Q = V" RAT_FUNC "%8.6" "rat" COEFFS 0 1 0 0 0 1 /end COMPU_METHOD
/begin COMPU_METHOD AppSwcVcu_CM_single_C "Q = V" RAT_FUNC "%8.6" "C" COEFFS 0 1 0 0 0 1 /end COMPU_METHOD
/begin COMPU_METHOD AppSwcVcu_CM_single_A "Q = V" RAT_FUNC "%8.6" "A" COEFFS 0 1 0 0 0 1 /end COMPU_METHOD
/begin COMPU_METHOD AppSwcVcu_CM_uint8_Ah "Q = V" RAT_FUNC "%3.0" "Ah" COEFFS 0 1 0 0 0 1 /end COMPU_METHOD
/begin COMPU_METHOD AppSwcVcu_CM_single_mV "Q = V" RAT_FUNC "%8.6" "mV" COEFFS 0 1 0 0 0 1 /end COMPU_METHOD
/begin COMPU_METHOD AppSwcVcu_CM_single_kph "Q = V" RAT_FUNC "%8.6" "kph" COEFFS 0 1 0 0 0 1 /end COMPU_METHOD
/begin COMPU_METHOD AppSwcVcu_CM_single_rpm "Q = V" RAT_FUNC "%8.6" "rpm" COEFFS 0 1 0 0 0 1 /end COMPU_METHOD
/begin COMPU_METHOD AppSwcVcu_CM_single_V "Q = V" RAT_FUNC "%8.6" "V" COEFFS 0 1 0 0 0 1 /end COMPU_METHOD
/begin COMPU_METHOD AppSwcVcu_CM_single_Nm "Q = V" RAT_FUNC "%8.6" "Nm" COEFFS 0 1 0 0 0 1 /end COMPU_METHOD
/begin COMPU_METHOD AppSwcVcu_CM_single_mps2 "Q = V" RAT_FUNC "%8.6" "mps2" COEFFS 0 1 0 0 0 1 /end COMPU_METHOD
/begin COMPU_METHOD AppSwcVcu_CM_single_Nmps "Q = V" RAT_FUNC "%8.6" "Nmps" COEFFS 0 1 0 0 0 1 /end COMPU_METHOD
/begin COMPU_METHOD AppSwcVcu_CM_single_s "Q = V" RAT_FUNC "%8.6" "s" COEFFS 0 1 0 0 0 1 /end COMPU_METHOD
/begin COMPU_METHOD AppSwcVcu_CM_uint16_mV "Q = V" RAT_FUNC "%5.0" "mV" COEFFS 0 1 0 0 0 1 /end COMPU_METHOD
/begin COMPU_METHOD AppSwcVcu_CM_single_m "Q = V" RAT_FUNC "%8.6" "m" COEFFS 0 1 0 0 0 1 /end COMPU_METHOD
/begin COMPU_METHOD AppSwcVcu_CM_uint8_enum "Q = V" RAT_FUNC "%3.0" "enum" COEFFS 0 1 0 0 0 1 /end COMPU_METHOD
/begin COMPU_METHOD AppSwcVcu_CM_single_km "Q = V" RAT_FUNC "%8.6" "km" COEFFS 0 1 0 0 0 1 /end COMPU_METHOD
/begin COMPU_METHOD AppSwcVcu_CM_single_kWh100km "Q = V" RAT_FUNC "%8.6" "kWh100km" COEFFS 0 1 0 0 0 1 /end COMPU_METHOD
/begin COMPU_METHOD AppSwcVcu_CM_single "Q = V" RAT_FUNC "%8.6" "" COEFFS 0 1 0 0 0 1 /end COMPU_METHOD
/begin COMPU_METHOD AppSwcVcu_CM_single_pct100km "Q = V" RAT_FUNC "%8.6" "pct100km" COEFFS 0 1 0 0 0 1 /end COMPU_METHOD
/begin COMPU_METHOD AppSwcVcu_CM_single_pctps "Q = V" RAT_FUNC "%8.6" "pctps" COEFFS 0 1 0 0 0 1 /end COMPU_METHOD
/begin COMPU_METHOD AppSwcVcu_CM_single_kw "Q = V" RAT_FUNC "%8.6" "kw" COEFFS 0 1 0 0 0 1 /end COMPU_METHOD
/begin COMPU_METHOD AppSwcVcu_CM_single_pctpkm "Q = V" RAT_FUNC "%8.6" "pctpkm" COEFFS 0 1 0 0 0 1 /end COMPU_METHOD
/begin COMPU_METHOD AppSwcVcu_CM_single_kg "Q = V" RAT_FUNC "%8.6" "kg" COEFFS 0 1 0 0 0 1 /end COMPU_METHOD
/begin COMPU_METHOD AppSwcVcu_CM_single_bar "Q = V" RAT_FUNC "%8.6" "bar" COEFFS 0 1 0 0 0 1 /end COMPU_METHOD
/begin COMPU_METHOD AppSwcVcu_CM_uint16_enum "Q = V" RAT_FUNC "%5.0" "enum" COEFFS 0 1 0 0 0 1 /end COMPU_METHOD
/begin COMPU_METHOD AppSwcVcu_CM_uint16_Ohm "Q = V" RAT_FUNC "%5.0" "Ohm" COEFFS 0 1 0 0 0 1 /end COMPU_METHOD
/begin COMPU_METHOD AppSwcVcu_CM_EnumEPBReq "Enumerated data type: EnumEPBReq" TAB_VERB "%0.6" "" COMPU_TAB_REF VTAB_FOR_AppSwcVcu_CM_EnumEPBReq /end COMPU_METHOD
/begin COMPU_VTAB VTAB_FOR_AppSwcVcu_CM_EnumEPBReq "Enumerated data type: EnumEPBReq" TAB_VERB 3 0 "EnumEPBReq_NoCmd" 1 "EnumEPBReq_Apply" 2 "EnumEPBReq_Release" /end COMPU_VTAB
/begin COMPU_METHOD AppSwcVcu_CM_EnumGearPstn "Enumerated data type: EnumGearPstn" TAB_VERB "%0.6" "" COMPU_TAB_REF VTAB_FOR_AppSwcVcu_CM_EnumGearPstn /end COMPU_METHOD
/begin COMPU_VTAB VTAB_FOR_AppSwcVcu_CM_EnumGearPstn "Enumerated data type: EnumGearPstn" TAB_VERB 4 0 "EnumGearPstn_P" 1 "EnumGearPstn_N" 2 "EnumGearPstn_D" 3 "EnumGearPstn_R" /end COMPU_VTAB
/begin COMPU_METHOD AppSwcVcu_CM_EnumPGearSwSts "Enumerated data type: EnumPGearSwSts" TAB_VERB "%0.6" "" COMPU_TAB_REF VTAB_FOR_AppSwcVcu_CM_EnumPGearSwSts /end COMPU_METHOD
/begin COMPU_VTAB VTAB_FOR_AppSwcVcu_CM_EnumPGearSwSts "Enumerated data type: EnumPGearSwSts" TAB_VERB 5 0 "EnumPGearSwSts_Reld" 1 "EnumPGearSwSts_Prsd" 2 "EnumPGearSwSts_ShtGnd" 3 "EnumPGearSwSts_ShtBat" 4 "EnumPGearSwSts_Unknown" /end COMPU_VTAB
/begin COMPU_METHOD AppSwcVcu_CM_boolean_flg "Q = V" RAT_FUNC "%1.0" "flg" COEFFS 0 1 0 0 0 1 /end COMPU_METHOD
/begin COMPU_METHOD AppSwcVcu_CM_boolean "Q = V" RAT_FUNC "%1.0" "" COEFFS 0 1 0 0 0 1 /end COMPU_METHOD
/begin COMPU_METHOD AppSwcVcu_CM_uint8_cnt "Q = V" RAT_FUNC "%3.0" "cnt" COEFFS 0 1 0 0 0 1 /end COMPU_METHOD
/begin COMPU_METHOD AppSwcVcu_CM_uint8 "Q = V" RAT_FUNC "%3.0" "" COEFFS 0 1 0 0 0 1 /end COMPU_METHOD
/begin COMPU_METHOD AppSwcVcu_CM_single_pctptrig "Q = V" RAT_FUNC "%8.6" "pctptrig" COEFFS 0 1 0 0 0 1 /end COMPU_METHOD
/begin COMPU_METHOD AppSwcVcu_CM_single_kWhpkm "Q = V" RAT_FUNC "%8.6" "kWhpkm" COEFFS 0 1 0 0 0 1 /end COMPU_METHOD
/begin COMPU_METHOD AppSwcVcu_CM_single_kWh "Q = V" RAT_FUNC "%8.6" "kWh" COEFFS 0 1 0 0 0 1 /end COMPU_METHOD
/begin COMPU_METHOD AppSwcVcu_CM_EnumTgtGearPstn "Enumerated data type: EnumTgtGearPstn" TAB_VERB "%0.6" "" COMPU_TAB_REF VTAB_FOR_AppSwcVcu_CM_EnumTgtGearPstn /end COMPU_METHOD
/begin COMPU_VTAB VTAB_FOR_AppSwcVcu_CM_EnumTgtGearPstn "Enumerated data type: EnumTgtGearPstn" TAB_VERB 5 0 "EnumTgtGearPstn_NoReq" 1 "EnumTgtGearPstn_P" 2 "EnumTgtGearPstn_N" 3 "EnumTgtGearPstn_D" 4 "EnumTgtGearPstn_R" /end COMPU_VTAB
/begin COMPU_METHOD AppSwcVcu_CM_EnumTZXStat "Enumerated data type: EnumTZXStat" TAB_VERB "%0.6" "" COMPU_TAB_REF VTAB_FOR_AppSwcVcu_CM_EnumTZXStat /end COMPU_METHOD
/begin COMPU_VTAB VTAB_FOR_AppSwcVcu_CM_EnumTZXStat "Enumerated data type: EnumTZXStat" TAB_VERB 9 0 "EnumTZXStat_NTRL" 1 "EnumTZXStat_NZ" 2 "EnumTZXStat_AZD" 3 "EnumTZXStat_BZI" 4 "EnumTZXStat_ZXD" 5 "EnumTZXStat_ZXI" 6 "EnumTZXStat_BZD" 7 "EnumTZXStat_AZI" 8 "EnumTZXStat_PZ" /end COMPU_VTAB
/begin COMPU_METHOD AppSwcVcu_CM_EnumMotorDirReq "Enumerated data type: EnumMotorDirReq" TAB_VERB "%0.6" "" COMPU_TAB_REF VTAB_FOR_AppSwcVcu_CM_EnumMotorDirReq /end COMPU_METHOD
/begin COMPU_VTAB VTAB_FOR_AppSwcVcu_CM_EnumMotorDirReq "Enumerated data type: EnumMotorDirReq" TAB_VERB 4 0 "EnumMotorDirReq_Stdby" 1 "EnumMotorDirReq_Forward" 2 "EnumMotorDirReq_Reverse" 3 "EnumMotorDirReq_Invalid" /end COMPU_VTAB
/begin COMPU_METHOD AppSwcVcu_CM_EnumHDCState "Enumerated data type: EnumHDCState" TAB_VERB "%0.6" "" COMPU_TAB_REF VTAB_FOR_AppSwcVcu_CM_EnumHDCState /end COMPU_METHOD
/begin COMPU_VTAB VTAB_FOR_AppSwcVcu_CM_EnumHDCState "Enumerated data type: EnumHDCState" TAB_VERB 3 0 "EnumHDCState_Idle" 1 "EnumHDCState_Standby" 2 "EnumHDCState_Active" /end COMPU_VTAB
/begin GROUP S1448_Subsys_VIPM_HwBMSWakeup_flg "AppSwcVcu/VcuRx/HwInVCU/Subsys_VIPM_HwBMSWakeup_flg" /begin REF_CHARACTERISTIC KIPM_HwBMSWakeup_flg_ovrdflg KIPM_HwBMSWakeup_flg_ovrdval /end REF_CHARACTERISTIC /begin REF_MEASUREMENT VIPM_HwBMSWakeup_flg /end REF_MEASUREMENT /end GROUP
/begin GROUP S1448_Subsys_VIPM_HwBrkSwHi_flg "AppSwcVcu/VcuRx/HwInVCU/Subsys_VIPM_HwBrkSwHi_flg" /begin REF_CHARACTERISTIC KIPM_HwBrkSwHi_flg_ovrdflg KIPM_HwBrkSwHi_flg_ovrdval /end REF_CHARACTERISTIC /begin REF_MEASUREMENT VIPM_HwBrkSwHi_flg /end REF_MEASUREMENT /end GROUP
/begin GROUP S1448_Subsys_VIPM_HwBrkSwLo_flg "AppSwcVcu/VcuRx/HwInVCU/Subsys_VIPM_HwBrkSwLo_flg" /begin REF_CHARACTERISTIC KIPM_HwBrkSwLo_flg_ovrdflg KIPM_HwBrkSwLo_flg_ovrdval /end REF_CHARACTERISTIC /begin REF_MEASUREMENT VIPM_HwBrkSwLo_flg /end REF_MEASUREMENT /end GROUP
/begin GROUP S1448_Subsys_VIPM_HwCrpModeSw "AppSwcVcu/VcuRx/HwInVCU/Subsys_VIPM_HwCrpModeSw" /begin REF_CHARACTERISTIC KIPM_HwCrpModeSw_flg_ovrdflg KIPM_HwCrpModeSw_flg_ovrdval /end REF_CHARACTERISTIC /begin REF_MEASUREMENT VIPM_HwCrpModeSw_flg /end REF_MEASUREMENT /end GROUP
/begin GROUP S1448_Subsys_VIPM_HwDrvModeSw_flg "AppSwcVcu/VcuRx/HwInVCU/Subsys_VIPM_HwDrvModeSw_flg" /begin REF_CHARACTERISTIC KIPM_HwDrvModeSw_flg_ovrdflg KIPM_HwDrvModeSw_flg_ovrdval /end REF_CHARACTERISTIC /begin REF_MEASUREMENT VIPM_HwDrvModeSw_flg /end REF_MEASUREMENT /end GROUP
/begin GROUP S1448_Subsys_VIPM_HwEmgcyShutOff_flg "AppSwcVcu/VcuRx/HwInVCU/Subsys_VIPM_HwEmgcyShutOff_flg"
 /begin REF_CHARACTERISTIC KIPM_HwEmgcyShutOff_flg_ovrdflg KIPM_HwEmgcyShutOff_flg_ovrdval /end REF_CHARACTERISTIC
 /begin REF_MEASUREMENT VIPM_HwEmgcyShutOff_flg /end REF_MEASUREMENT
/end GROUP
/begin GROUP S1448_Subsys_VIPM_HwKL15A_flg "AppSwcVcu/VcuRx/HwInVCU/Subsys_VIPM_HwKL15A_flg" /begin REF_CHARACTERISTIC KIPM_HwKL15A_flg_ovrdflg KIPM_HwKL15A_flg_ovrdval /end REF_CHARACTERISTIC /begin REF_MEASUREMENT VIPM_HwKL15A_flg /end REF_MEASUREMENT /end GROUP
/begin GROUP S1448_Subsys_VIPM_HwKL15B_flg "AppSwcVcu/VcuRx/HwInVCU/Subsys_VIPM_HwKL15B_flg" /begin REF_CHARACTERISTIC KIPM_HwKL15B_flg_ovrdflg KIPM_HwKL15B_flg_ovrdval /end REF_CHARACTERISTIC /begin REF_MEASUREMENT VIPM_HwKL15B_flg /end REF_MEASUREMENT /end GROUP
/begin GROUP S1448_Subsys_VIPM_HwKL30_mV "AppSwcVcu/VcuRx/HwInVCU/Subsys_VIPM_HwKL30_mV"
 /begin REF_CHARACTERISTIC KIPM_HwKL30Hi_mV KIPM_HwKL30Lo_mV KIPM_HwKL30_mV_ovrdflg KIPM_HwKL30_mV_ovrdval /end REF_CHARACTERISTIC
 /begin REF_MEASUREMENT VIPM_HwKL30_mV /end REF_MEASUREMENT
/end GROUP
/begin GROUP S1448_Subsys_VIPM_HwOBCWakeup_flg "AppSwcVcu/VcuRx/HwInVCU/Subsys_VIPM_HwOBCWakeup_flg" /begin REF_CHARACTERISTIC KIPM_HwOBCWakeup_flg_ovrdflg KIPM_HwOBCWakeup_flg_ovrdval /end REF_CHARACTERISTIC /begin REF_MEASUREMENT VIPM_HwOBCWakeup_flg /end REF_MEASUREMENT /end GROUP
/begin GROUP S1448_Subsys_VIPM_HwRearFogLampSwt_flg "AppSwcVcu/VcuRx/HwInVCU/Subsys_VIPM_HwRearFogLampSwt_flg"
 /begin REF_CHARACTERISTIC KIPM_HwRearFogLampSwt_flg_ovrdflg KIPM_HwRearFogLampSwt_flg_ovrdval /end REF_CHARACTERISTIC
 /begin REF_MEASUREMENT VIPM_HwRearFogLampSwt_flg /end REF_MEASUREMENT
/end GROUP
/begin GROUP S1448_Subsys_VIPM_HwShftPstnSwSts_enum "AppSwcVcu/VcuRx/HwInVCU/Subsys_VIPM_HwShftPstnSwSts_enum"
 /begin REF_CHARACTERISTIC KIPM_HwShftPstnSwSts_enum_ovrdflg KIPM_HwShftPstnSwSts_enum_ovrdval /end REF_CHARACTERISTIC
 /begin REF_MEASUREMENT VIPM_HwShftPstnSwSts_enum /end REF_MEASUREMENT
/end GROUP
/begin GROUP S1448_Subsys_VIPM_HwVehCrash_flg "AppSwcVcu/VcuRx/HwInVCU/Subsys_VIPM_HwVehCrash_flg" /begin REF_CHARACTERISTIC KIPM_HwVehCrash_flg_ovrdflg KIPM_HwVehCrash_flg_ovrdval /end REF_CHARACTERISTIC /begin REF_MEASUREMENT VIPM_HwVehCrash_flg /end REF_MEASUREMENT /end GROUP
/begin GROUP S1448_Subsystem "AppSwcVcu/VcuRx/HwInVCU/Subsystem"
 /begin REF_CHARACTERISTIC KIPM_HwShftPstnSwPrsdHi_Ohm KIPM_HwShftPstnSwPrsdLo_Ohm KIPM_HwShftPstnSwReldHi_Ohm KIPM_HwShftPstnSwReldLo_Ohm KIPM_HwShftPstnSwShtBatt_Ohm KIPM_HwShftPstnSwShtGnd_Ohm /end REF_CHARACTERISTIC
/end GROUP
/begin GROUP S1475_Subsys_VOPM_HwWakeupBMS_flg "AppSwcVcu/VcuTx/HwOutVCU/Subsys_VOPM_HwWakeupBMS_flg" /begin REF_CHARACTERISTIC KOPM_HwWakeupBMS_flg_ovrdflg KOPM_HwWakeupBMS_flg_ovrdval /end REF_CHARACTERISTIC /begin REF_MEASUREMENT VOPM_HwWakeupBMS_flg /end REF_MEASUREMENT /end GROUP
/begin GROUP S1492_EPBControl "AppSwcVcu/gsm/GearShift/EPBControl"
 /begin REF_CHARACTERISTIC KGSM_EPBReqMaxTm_s KGSM_PErrDispMaxTm_s KGSM_ReqEPBSw_flg KGSM_ReqEPBVal_enum /end REF_CHARACTERISTIC
 /begin REF_MEASUREMENT VGSM_EPBAplyFlt_flg VGSM_EPBRelsFlt_flg VGSM_ReqEPB_enum VGSM_VehEPBStErr_flg /end REF_MEASUREMENT
/end GROUP
/begin GROUP S1492_GearLogical "AppSwcVcu/gsm/GearShift/GearLogical"
 /begin SUB_GROUP S1494_GearPrecondition S1494_GearReq S1494_GearTransion S1494_Turn_Off_Delay1 /end SUB_GROUP
 /begin REF_CHARACTERISTIC KGSM_INVTrnOffDly_s KGSM_VehActGearPstnSw_flg KGSM_VehActGearPstnVal_enum /end REF_CHARACTERISTIC
 /begin REF_MEASUREMENT VGSM_VehActGearPstn_enum /end REF_MEASUREMENT
/end GROUP
/begin GROUP S26_RS_Latch "AppSwcVcu/EMS/EnergyManagementSystem/ChrgPwrCalc/RS_Latch" /begin REF_MEASUREMENT VEMS_UseConChrgCur_flg /end REF_MEASUREMENT /end GROUP
/begin GROUP S27_PIPwrClsLoop "AppSwcVcu/EMS/EnergyManagementSystem/ChrgPwrPICtrl/PIPwrClsLoop"
 /begin REF_CHARACTERISTIC KEMS_ChrgPwrFbKiMax_kW KEMS_ChrgPwrFbKiMin_kW KEMS_ChrgPwrFbMax_kW KEMS_ChrgPwrFbMin_kW /end REF_CHARACTERISTIC
 /begin REF_MEASUREMENT VEMS_ChrgPwrFbKi_kW VEMS_ChrgPwrFbKp_kW /end REF_MEASUREMENT
/end GROUP
/begin GROUP S28_RS_Latch "AppSwcVcu/EMS/EnergyManagementSystem/DchaPwrCalc/RS_Latch" /begin REF_MEASUREMENT VEMS_UseConDchaCur_flg /end REF_MEASUREMENT /end GROUP
/begin GROUP S29_PIPwrClsLoop "AppSwcVcu/EMS/EnergyManagementSystem/DchaPwrPICtrl/PIPwrClsLoop"
 /begin REF_CHARACTERISTIC KEMS_DchaPwrFbKiMax_kW KEMS_DchaPwrFbKiMin_kW KEMS_DchaPwrFbMax_kW KEMS_DchaPwrFbMin_kW /end REF_CHARACTERISTIC
 /begin REF_MEASUREMENT VEMS_DchaPwrFbKi_kW VEMS_DchaPwrFbKp_kW /end REF_MEASUREMENT
/end GROUP
/begin GROUP S30_HysteresisA_SP "AppSwcVcu/EMS/EnergyManagementSystem/LowVolACCMgt/HysteresisA_SP" /begin REF_MEASUREMENT VEMS_TMSActSOCEnbl_flg /end REF_MEASUREMENT /end GROUP
/begin GROUP S31_CellVoltMaxClsLoop "AppSwcVcu/EMS/EnergyManagementSystem/PreProcess/CellVoltMaxClsLoop"
 /begin REF_CHARACTERISTIC KEMS_ChrgCurFbKiMax_A KEMS_ChrgCurFbKiMin_A KEMS_ChrgCurFbMax_A KEMS_ChrgCurFbMin_A MEMS_CellOverVoltThr_mV /end REF_CHARACTERISTIC
 /begin REF_MEASUREMENT VEMS_ChrgCurFbKi_A VEMS_ChrgCurFbKp_A VEMS_ChrgCurFb_A /end REF_MEASUREMENT
/end GROUP
/begin GROUP S31_CellVoltMinClsLoop "AppSwcVcu/EMS/EnergyManagementSystem/PreProcess/CellVoltMinClsLoop"
 /begin REF_CHARACTERISTIC KEMS_DchaCurFbKiMax_A KEMS_DchaCurFbKiMin_A KEMS_DchaCurFbMax_A KEMS_DchaCurFbMin_A MEMS_CellUndrVoltThr1_mV MEMS_CellUndrVoltThr2_mV /end REF_CHARACTERISTIC
 /begin REF_MEASUREMENT VEMS_DchaCurFbKi_A VEMS_DchaCurFbKp_A VEMS_DchaCurFb_A /end REF_MEASUREMENT
/end GROUP
/begin GROUP S31_RateLimit_R_IV "AppSwcVcu/EMS/EnergyManagementSystem/PreProcess/RateLimit_R_IV" /begin REF_MEASUREMENT VEMS_CellTempSyn_C /end REF_MEASUREMENT /end GROUP
/begin GROUP S99_BMS_Command_Time_out "AppSwcVcu/FaultDiag/BMS_FaultDiag/Model/BMS Command Time out"
 /begin REF_CHARACTERISTIC KDAG_BMSCmdTmOutFailTm1_s KDAG_BMSCmdTmOutFailTm2_s KDAG_BMSCmdTmOutFailTm3_s /end REF_CHARACTERISTIC
/end GROUP
/begin GROUP S99_BMS_SOC_Low "AppSwcVcu/FaultDiag/BMS_FaultDiag/Model/BMS SOC Low"
 /begin REF_CHARACTERISTIC MDAG_BMSSOCLoRecThr1_pct MDAG_BMSSOCLoRecThr2_pct MDAG_BMSSOCLoThr1_pct MDAG_BMSSOCLoThr2_pct /end REF_CHARACTERISTIC
/end GROUP
/begin GROUP S99_BMS_Under_Voltage "AppSwcVcu/FaultDiag/BMS_FaultDiag/Model/BMS Under Voltage"
 /begin REF_CHARACTERISTIC KDAG_BMSUndrVoltActnMsk1_enum KDAG_BMSUndrVoltActnMsk2_enum /end REF_CHARACTERISTIC
/end GROUP
/begin GROUP S99_FltMgt "AppSwcVcu/FaultDiag/BMS_FaultDiag/Model/FltMgt" /begin REF_MEASUREMENT VDAG_BMSCmdTmOutFltSt_enum /end REF_MEASUREMENT /end GROUP
/begin GROUP S99_FltMgt1 "AppSwcVcu/FaultDiag/BMS_FaultDiag/Model/FltMgt1" /begin REF_MEASUREMENT VDAG_HVIsoResistLoFltSt_enum /end REF_MEASUREMENT /end GROUP
/begin GROUP S99_FltMgt10 "AppSwcVcu/FaultDiag/BMS_FaultDiag/Model/FltMgt10" /begin REF_MEASUREMENT VDAG_DCSFailStaFltSt_enum /end REF_MEASUREMENT /end GROUP
/begin GROUP S99_FltMgt11 "AppSwcVcu/FaultDiag/BMS_FaultDiag/Model/FltMgt11" /begin REF_MEASUREMENT VDAG_DCSInletConnectFltSt_enum /end REF_MEASUREMENT /end GROUP
/begin GROUP S99_FltMgt12 "AppSwcVcu/FaultDiag/BMS_FaultDiag/Model/FltMgt12" /begin REF_MEASUREMENT VDAG_DCSChrgReqFltSt_enum /end REF_MEASUREMENT /end GROUP
/begin GROUP S99_FltMgt13 "AppSwcVcu/FaultDiag/BMS_FaultDiag/Model/FltMgt13" /begin REF_MEASUREMENT VDAG_DCSModeFailFltSt_enum /end REF_MEASUREMENT /end GROUP
/begin GROUP S99_FltMgt14 "AppSwcVcu/FaultDiag/BMS_FaultDiag/Model/FltMgt14" /begin REF_MEASUREMENT VDAG_ACSCmdTmOutFltSt_enum /end REF_MEASUREMENT /end GROUP
/begin GROUP S99_FltMgt2 "AppSwcVcu/FaultDiag/BMS_FaultDiag/Model/FltMgt2" /begin REF_MEASUREMENT VDAG_BMSSysFailLvl1FltSt_enum /end REF_MEASUREMENT /end GROUP
/begin GROUP S99_FltMgt3 "AppSwcVcu/FaultDiag/BMS_FaultDiag/Model/FltMgt3" /begin REF_MEASUREMENT VDAG_BMSSysFailLvl2FltSt_enum /end REF_MEASUREMENT /end GROUP
/begin GROUP S99_FltMgt4 "AppSwcVcu/FaultDiag/BMS_FaultDiag/Model/FltMgt4" /begin REF_MEASUREMENT VDAG_BMSSysFailLvl3FltSt_enum /end REF_MEASUREMENT /end GROUP
/begin GROUP S99_FltMgt5 "AppSwcVcu/FaultDiag/BMS_FaultDiag/Model/FltMgt5" /begin REF_MEASUREMENT VDAG_BMSSOCLoFltSt_enum /end REF_MEASUREMENT /end GROUP
/begin GROUP S99_FltMgt6 "AppSwcVcu/FaultDiag/BMS_FaultDiag/Model/FltMgt6" /begin REF_MEASUREMENT VDAG_BMSEmgcySdnFltSt_enum /end REF_MEASUREMENT /end GROUP
/begin GROUP S99_FltMgt7 "AppSwcVcu/FaultDiag/BMS_FaultDiag/Model/FltMgt7" /begin REF_MEASUREMENT VDAG_BMSUndrVoltFltSt_enum /end REF_MEASUREMENT /end GROUP
/begin GROUP S99_FltMgt8 "AppSwcVcu/FaultDiag/BMS_FaultDiag/Model/FltMgt8" /begin REF_MEASUREMENT VDAG_CellUndrVoltFltSt_enum /end REF_MEASUREMENT /end GROUP
/begin GROUP S99_FltMgt9 "AppSwcVcu/FaultDiag/BMS_FaultDiag/Model/FltMgt9" /begin REF_MEASUREMENT VDAG_DCSCmdTmOutFltSt_enum /end REF_MEASUREMENT /end GROUP
/begin GROUP S258_DCC_Command_Time_out "AppSwcVcu/FaultDiag/DCC_FaultDiag/Model/DCC Command Time out"
 /begin REF_CHARACTERISTIC KDAG_DCCCmdTmOutActnMsk1_enum KDAG_DCCCmdTmOutActnMsk2_enum /end REF_CHARACTERISTIC
/end GROUP
/begin GROUP S258_DCC_Fault_Level3 "AppSwcVcu/FaultDiag/DCC_FaultDiag/Model/DCC Fault Level3"
 /begin REF_CHARACTERISTIC KDAG_DCCSysFailLvl3ActnMsk1_enum KDAG_DCCSysFailLvl3ActnMsk2_enum /end REF_CHARACTERISTIC
/end GROUP
/begin GROUP S258_DCDC_Mode_Fault "AppSwcVcu/FaultDiag/DCC_FaultDiag/Model/DCDC Mode Fault" /begin REF_CHARACTERISTIC KDAG_DCCModeFltActnMsk1_enum KDAG_DCCModeFltActnMsk2_enum /end REF_CHARACTERISTIC /end GROUP
/begin GROUP S258_FltMgt2 "AppSwcVcu/FaultDiag/DCC_FaultDiag/Model/FltMgt2" /begin REF_MEASUREMENT VDAG_DCCSysFailLvl1FltSt_enum /end REF_MEASUREMENT /end GROUP
/begin GROUP S258_FltMgt3 "AppSwcVcu/FaultDiag/DCC_FaultDiag/Model/FltMgt3" /begin REF_MEASUREMENT VDAG_DCCSysFailLvl2FltSt_enum /end REF_MEASUREMENT /end GROUP
/begin GROUP S258_FltMgt4 "AppSwcVcu/FaultDiag/DCC_FaultDiag/Model/FltMgt4" /begin REF_MEASUREMENT VDAG_DCCSysFailLvl3FltSt_enum /end REF_MEASUREMENT /end GROUP
/begin GROUP S258_FltMgt5 "AppSwcVcu/FaultDiag/DCC_FaultDiag/Model/FltMgt5" /begin REF_MEASUREMENT VDAG_DCCSysFailLvl4FltSt_enum /end REF_MEASUREMENT /end GROUP
/begin GROUP S258_FltMgt6 "AppSwcVcu/FaultDiag/DCC_FaultDiag/Model/FltMgt6" /begin REF_MEASUREMENT VDAG_DCCModeFltFltSt_enum /end REF_MEASUREMENT /end GROUP
/begin GROUP S258_FltMgt7 "AppSwcVcu/FaultDiag/DCC_FaultDiag/Model/FltMgt7" /begin REF_MEASUREMENT VDAG_DCCCmdTmOutFltSt_enum /end REF_MEASUREMENT /end GROUP
/begin GROUP S258_FltMgt8 "AppSwcVcu/FaultDiag/DCC_FaultDiag/Model/FltMgt8" /begin REF_MEASUREMENT VDAG_DCCInVoltLoFltSt_enum /end REF_MEASUREMENT /end GROUP
/begin GROUP S258_FltMgt9 "AppSwcVcu/FaultDiag/DCC_FaultDiag/Model/FltMgt9" /begin REF_MEASUREMENT VDAG_INVInVoltLoFltSt_enum /end REF_MEASUREMENT /end GROUP
/begin GROUP S330_FltMgt2 "AppSwcVcu/FaultDiag/INV_FaultDiag/Model/FltMgt2" /begin REF_MEASUREMENT VDAG_INVFltLvl1FltSt_enum /end REF_MEASUREMENT /end GROUP
/begin GROUP S330_FltMgt3 "AppSwcVcu/FaultDiag/INV_FaultDiag/Model/FltMgt3" /begin REF_MEASUREMENT VDAG_INVFltLvl2FltSt_enum /end REF_MEASUREMENT /end GROUP
/begin GROUP S330_FltMgt4 "AppSwcVcu/FaultDiag/INV_FaultDiag/Model/FltMgt4" /begin REF_MEASUREMENT VDAG_INVFltLvl3FltSt_enum /end REF_MEASUREMENT /end GROUP
/begin GROUP S330_FltMgt5 "AppSwcVcu/FaultDiag/INV_FaultDiag/Model/FltMgt5" /begin REF_MEASUREMENT VDAG_INVFltLvl4FltSt_enum /end REF_MEASUREMENT /end GROUP
/begin GROUP S330_FltMgt6 "AppSwcVcu/FaultDiag/INV_FaultDiag/Model/FltMgt6" /begin REF_MEASUREMENT VDAG_INVRunCmdRespFltSt_enum /end REF_MEASUREMENT /end GROUP
/begin GROUP S354_FltMgt10 "AppSwcVcu/FaultDiag/OBC_FaultDiag/Model/FltMgt10" /begin REF_MEASUREMENT VDAG_OBCSysFailLvl4FltSt_enum /end REF_MEASUREMENT /end GROUP
/begin GROUP S354_FltMgt11 "AppSwcVcu/FaultDiag/OBC_FaultDiag/Model/FltMgt11" /begin REF_MEASUREMENT VDAG_ACDchaOverPwrFltSt_enum /end REF_MEASUREMENT /end GROUP
/begin GROUP S354_FltMgt12 "AppSwcVcu/FaultDiag/OBC_FaultDiag/Model/FltMgt12" /begin REF_MEASUREMENT VDAG_ACChrgStFailFltSt_enum /end REF_MEASUREMENT /end GROUP
/begin GROUP S354_FltMgt13 "AppSwcVcu/FaultDiag/OBC_FaultDiag/Model/FltMgt13" /begin REF_MEASUREMENT VDAG_OBCModeMsmtchFltSt_enum /end REF_MEASUREMENT /end GROUP
/begin GROUP S354_FltMgt14 "AppSwcVcu/FaultDiag/OBC_FaultDiag/Model/FltMgt14" /begin REF_MEASUREMENT VDAG_OBCConnectTmOutFltSt_enum /end REF_MEASUREMENT /end GROUP
/begin GROUP S354_FltMgt2 "AppSwcVcu/FaultDiag/OBC_FaultDiag/Model/FltMgt2" /begin REF_MEASUREMENT VDAG_OBCS2StatFltSt_enum /end REF_MEASUREMENT /end GROUP
/begin GROUP S354_FltMgt3 "AppSwcVcu/FaultDiag/OBC_FaultDiag/Model/FltMgt3" /begin REF_MEASUREMENT VDAG_OBCChrgReqFltSt_enum /end REF_MEASUREMENT /end GROUP
/begin GROUP S354_FltMgt4 "AppSwcVcu/FaultDiag/OBC_FaultDiag/Model/FltMgt4" /begin REF_MEASUREMENT VDAG_ACDchaBMSSOCLoFltSt_enum /end REF_MEASUREMENT /end GROUP
/begin GROUP S354_FltMgt5 "AppSwcVcu/FaultDiag/OBC_FaultDiag/Model/FltMgt5" /begin REF_MEASUREMENT VDAG_ACDchaBMSPwrLoFltSt_enum /end REF_MEASUREMENT /end GROUP
/begin GROUP S354_FltMgt6 "AppSwcVcu/FaultDiag/OBC_FaultDiag/Model/FltMgt6" /begin REF_MEASUREMENT VDAG_OBCInletConnectFltSt_enum /end REF_MEASUREMENT /end GROUP
/begin GROUP S354_FltMgt7 "AppSwcVcu/FaultDiag/OBC_FaultDiag/Model/FltMgt7" /begin REF_MEASUREMENT VDAG_OBCSysFailLvl1FltSt_enum /end REF_MEASUREMENT /end GROUP
/begin GROUP S354_FltMgt8 "AppSwcVcu/FaultDiag/OBC_FaultDiag/Model/FltMgt8" /begin REF_MEASUREMENT VDAG_OBCSysFailLvl2FltSt_enum /end REF_MEASUREMENT /end GROUP
/begin GROUP S354_FltMgt9 "AppSwcVcu/FaultDiag/OBC_FaultDiag/Model/FltMgt9" /begin REF_MEASUREMENT VDAG_OBCSysFailLvl3FltSt_enum /end REF_MEASUREMENT /end GROUP
/begin GROUP S354_OBC_Connect_Time_out "AppSwcVcu/FaultDiag/OBC_FaultDiag/Model/OBC Connect Time out"
 /begin REF_CHARACTERISTIC KDAG_OBCConnectTmOutFailTm1_s KDAG_OBCConnectTmOutFailTm2_s /end REF_CHARACTERISTIC
/end GROUP
/begin GROUP S416_FltMgt1 "AppSwcVcu/FaultDiag/OtherECU_FaultDiag/Model/FltMgt1" /begin REF_MEASUREMENT VDAG_SysPwrModeInvldFltSt_enum /end REF_MEASUREMENT /end GROUP
/begin GROUP S416_FltMgt10 "AppSwcVcu/FaultDiag/OtherECU_FaultDiag/Model/FltMgt10" /begin REF_MEASUREMENT VDAG_TMSFailLvl3FltSt_enum /end REF_MEASUREMENT /end GROUP
/begin GROUP S416_FltMgt11 "AppSwcVcu/FaultDiag/OtherECU_FaultDiag/Model/FltMgt11" /begin REF_MEASUREMENT VDAG_EHBFltLvl4FltSt_enum /end REF_MEASUREMENT /end GROUP
/begin GROUP S416_FltMgt12 "AppSwcVcu/FaultDiag/OtherECU_FaultDiag/Model/FltMgt12" /begin REF_MEASUREMENT VDAG_ESCFltLvl2FltSt_enum /end REF_MEASUREMENT /end GROUP
/begin GROUP S416_FltMgt13 "AppSwcVcu/FaultDiag/OtherECU_FaultDiag/Model/FltMgt13" /begin REF_MEASUREMENT VDAG_ESCFltLvl3FltSt_enum /end REF_MEASUREMENT /end GROUP
/begin GROUP S416_FltMgt14 "AppSwcVcu/FaultDiag/OtherECU_FaultDiag/Model/FltMgt14" /begin REF_MEASUREMENT VDAG_ESCFltLvl5FltSt_enum /end REF_MEASUREMENT /end GROUP
/begin GROUP S416_FltMgt2 "AppSwcVcu/FaultDiag/OtherECU_FaultDiag/Model/FltMgt2" /begin REF_MEASUREMENT VDAG_GearShftInvldFltSt_enum /end REF_MEASUREMENT /end GROUP
/begin GROUP S416_FltMgt3 "AppSwcVcu/FaultDiag/OtherECU_FaultDiag/Model/FltMgt3" /begin REF_MEASUREMENT VDAG_ESCVehSpdInvldFltSt_enum /end REF_MEASUREMENT /end GROUP
/begin GROUP S416_FltMgt4 "AppSwcVcu/FaultDiag/OtherECU_FaultDiag/Model/FltMgt4" /begin REF_MEASUREMENT VDAG_EHBFltLvl1FltSt_enum /end REF_MEASUREMENT /end GROUP
/begin GROUP S416_FltMgt5 "AppSwcVcu/FaultDiag/OtherECU_FaultDiag/Model/FltMgt5" /begin REF_MEASUREMENT VDAG_EHBFltLvl2FltSt_enum /end REF_MEASUREMENT /end GROUP
/begin GROUP S416_FltMgt6 "AppSwcVcu/FaultDiag/OtherECU_FaultDiag/Model/FltMgt6" /begin REF_MEASUREMENT VDAG_EHBFltLvl3FltSt_enum /end REF_MEASUREMENT /end GROUP
/begin GROUP S416_FltMgt7 "AppSwcVcu/FaultDiag/OtherECU_FaultDiag/Model/FltMgt7" /begin REF_MEASUREMENT VDAG_EHBFltLvl5FltSt_enum /end REF_MEASUREMENT /end GROUP
/begin GROUP S416_FltMgt8 "AppSwcVcu/FaultDiag/OtherECU_FaultDiag/Model/FltMgt8" /begin REF_MEASUREMENT VDAG_ESCFltLvl4FltSt_enum /end REF_MEASUREMENT /end GROUP
/begin GROUP S416_FltMgt9 "AppSwcVcu/FaultDiag/OtherECU_FaultDiag/Model/FltMgt9" /begin REF_MEASUREMENT VDAG_ESCFltLvl1FltSt_enum /end REF_MEASUREMENT /end GROUP
/begin GROUP S460_FltMgt1 "AppSwcVcu/FaultDiag/Other_FaultDiag/Model/FltMgt1" /begin REF_MEASUREMENT VDAG_LVBattSOHLoFltSt_enum /end REF_MEASUREMENT /end GROUP
/begin GROUP S460_FltMgt2 "AppSwcVcu/FaultDiag/Other_FaultDiag/Model/FltMgt2" /begin REF_MEASUREMENT VDAG_LVBattTempHiFltSt_enum /end REF_MEASUREMENT /end GROUP
/begin GROUP S460_FltMgt3 "AppSwcVcu/FaultDiag/Other_FaultDiag/Model/FltMgt3" /begin REF_MEASUREMENT VDAG_LVBattVoltLoFltSt_enum /end REF_MEASUREMENT /end GROUP
/begin GROUP S460_FltMgt4 "AppSwcVcu/FaultDiag/Other_FaultDiag/Model/FltMgt4" /begin REF_MEASUREMENT VDAG_LVBattVoltHiFltSt_enum /end REF_MEASUREMENT /end GROUP
/begin GROUP S460_FltMgt9 "AppSwcVcu/FaultDiag/Other_FaultDiag/Model/FltMgt9" /begin REF_MEASUREMENT VDAG_LVBattSOCLoFltSt_enum /end REF_MEASUREMENT /end GROUP
/begin GROUP S460_LV_Battery_Temperature_High "AppSwcVcu/FaultDiag/Other_FaultDiag/Model/LV Battery Temperature High"
 /begin REF_CHARACTERISTIC KDAG_LVBattTempHiActnMsk1_enum KDAG_LVBattTempHiActnMsk2_enum KDAG_LVBattTempHi_C /end REF_CHARACTERISTIC
/end GROUP
/begin GROUP S476_Accelerate_Pedal_Cross_Check_Fault "AppSwcVcu/FaultDiag/Sensor10ms_FaultDiag/Model/Accelerate Pedal Cross Check Fault" /begin REF_CHARACTERISTIC KDAG_AccPedCrsChkThr_pct /end REF_CHARACTERISTIC /end GROUP
/begin GROUP S476_FltMgt1 "AppSwcVcu/FaultDiag/Sensor10ms_FaultDiag/Model/FltMgt1" /begin REF_MEASUREMENT VDAG_VehCrashFltSt_enum /end REF_MEASUREMENT /end GROUP
/begin GROUP S476_FltMgt10 "AppSwcVcu/FaultDiag/Sensor10ms_FaultDiag/Model/FltMgt10" /begin REF_MEASUREMENT VDAG_AccPed2ShtBattFltSt_enum /end REF_MEASUREMENT /end GROUP
/begin GROUP S476_FltMgt11 "AppSwcVcu/FaultDiag/Sensor10ms_FaultDiag/Model/FltMgt11" /begin REF_MEASUREMENT VDAG_AccPedCrsChkFltSt_enum /end REF_MEASUREMENT /end GROUP
/begin GROUP S476_FltMgt12 "AppSwcVcu/FaultDiag/Sensor10ms_FaultDiag/Model/FltMgt12" /begin REF_MEASUREMENT VDAG_AccPedBothFailFltSt_enum /end REF_MEASUREMENT /end GROUP
/begin GROUP S476_FltMgt3 "AppSwcVcu/FaultDiag/Sensor10ms_FaultDiag/Model/FltMgt3" /begin REF_MEASUREMENT VDAG_AccPed1ShtGndFltSt_enum /end REF_MEASUREMENT /end GROUP
/begin GROUP S476_FltMgt6 "AppSwcVcu/FaultDiag/Sensor10ms_FaultDiag/Model/FltMgt6" /begin REF_MEASUREMENT VDAG_AccPed1SuplyShtCircFltSt_enum /end REF_MEASUREMENT /end GROUP
/begin GROUP S476_FltMgt7 "AppSwcVcu/FaultDiag/Sensor10ms_FaultDiag/Model/FltMgt7" /begin REF_MEASUREMENT VDAG_AccPed2SuplyShtCircFltSt_enum /end REF_MEASUREMENT /end GROUP
/begin GROUP S476_FltMgt8 "AppSwcVcu/FaultDiag/Sensor10ms_FaultDiag/Model/FltMgt8" /begin REF_MEASUREMENT VDAG_AccPed1ShtBattFltSt_enum /end REF_MEASUREMENT /end GROUP
/begin GROUP S476_FltMgt9 "AppSwcVcu/FaultDiag/Sensor10ms_FaultDiag/Model/FltMgt9" /begin REF_MEASUREMENT VDAG_AccPed2ShtGndFltSt_enum /end REF_MEASUREMENT /end GROUP
/begin GROUP S507_Brake_Switch_Cross_Check "AppSwcVcu/FaultDiag/Sensor20ms_FaultDiag/Model/Brake Switch Cross Check"
 /begin REF_CHARACTERISTIC KDAG_BrkSwCrsChkCntDec_cnt KDAG_BrkSwCrsChkCntHi_cnt KDAG_BrkSwCrsChkCntInc_cnt KDAG_BrkSwCrsChkCntLo_cnt KDAG_BrkSwCrsChkCntMax_cnt KDAG_BrkSwCrsChkIntvlTm_s KDAG_BrkSwDisagreeTmHi_s KDAG_BrkSwDisagreeTmLo_s KDAG_BrkSwDisagreeTmLong_s /end REF_CHARACTERISTIC
 /begin REF_MEASUREMENT VDAG_BrkSwCrsChkCnt_cnt /end REF_MEASUREMENT
/end GROUP
/begin GROUP S507_FltMgt1 "AppSwcVcu/FaultDiag/Sensor20ms_FaultDiag/Model/FltMgt1" /begin REF_MEASUREMENT VDAG_BrkPedShtGndFltSt_enum /end REF_MEASUREMENT /end GROUP
/begin GROUP S507_FltMgt12 "AppSwcVcu/FaultDiag/Sensor20ms_FaultDiag/Model/FltMgt12" /begin REF_MEASUREMENT VDAG_BrkSwCrsChkFltSt_enum /end REF_MEASUREMENT /end GROUP
/begin GROUP S507_FltMgt2 "AppSwcVcu/FaultDiag/Sensor20ms_FaultDiag/Model/FltMgt2" /begin REF_MEASUREMENT VDAG_BrkPedShtBattFltSt_enum /end REF_MEASUREMENT /end GROUP
/begin GROUP S507_FltMgt3 "AppSwcVcu/FaultDiag/Sensor20ms_FaultDiag/Model/FltMgt3" /begin REF_MEASUREMENT VDAG_HVILVoltLoFltSt_enum /end REF_MEASUREMENT /end GROUP
/begin GROUP S507_FltMgt4 "AppSwcVcu/FaultDiag/Sensor20ms_FaultDiag/Model/FltMgt4" /begin REF_MEASUREMENT VDAG_HVILVoltHiFltSt_enum /end REF_MEASUREMENT /end GROUP
/begin GROUP S507_HVIL_Voltage_High "AppSwcVcu/FaultDiag/Sensor20ms_FaultDiag/Model/HVIL Voltage High"
 /begin REF_CHARACTERISTIC KDAG_HVILVoltChkActnMsk1_enum KDAG_HVILVoltChkActnMsk2_enum KDAG_HVILVoltMax_mV /end REF_CHARACTERISTIC
/end GROUP
/begin GROUP S507_HVIL_Voltage_Low "AppSwcVcu/FaultDiag/Sensor20ms_FaultDiag/Model/HVIL Voltage Low"
 /begin REF_CHARACTERISTIC KDAG_HVILVoltChkActnMsk1_enum KDAG_HVILVoltChkActnMsk2_enum KDAG_HVILVoltMin_mV /end REF_CHARACTERISTIC
/end GROUP
/begin GROUP S530_FltMgt3 "AppSwcVcu/FaultDiag/Sensor50ms_FaultDiag/Model/FltMgt3" /begin REF_MEASUREMENT VDAG_WaterTempBlwThrFltSt_enum /end REF_MEASUREMENT /end GROUP
/begin GROUP S530_FltMgt8 "AppSwcVcu/FaultDiag/Sensor50ms_FaultDiag/Model/FltMgt8" /begin REF_MEASUREMENT VDAG_WaterTempAbvThrFltSt_enum /end REF_MEASUREMENT /end GROUP
/begin GROUP S578_BatCellTempHiWarn "AppSwcVcu/HMI/Model/FaultDiagnosis/BatCellTempHiWarn" /begin REF_CHARACTERISTIC KHMI_BatCellMaxTemWarning_C KHMI_CellOverTempTime_s /end REF_CHARACTERISTIC /end GROUP
/begin GROUP S578_BothThrottle_Brake "AppSwcVcu/HMI/Model/FaultDiagnosis/BothThrottle_Brake" /begin REF_CHARACTERISTIC KHMI_BothAccBrkTime_s /end REF_CHARACTERISTIC /end GROUP
/begin GROUP S578_DrivePowerLimitErr "AppSwcVcu/HMI/Model/FaultDiagnosis/DrivePowerLimitErr" /begin REF_CHARACTERISTIC KHMI_DriPwrLmtTime_s KHMI_DriPwrLmtVa_kw /end REF_CHARACTERISTIC /end GROUP
/begin GROUP S578_FobidShiftGear_OverSpd "AppSwcVcu/HMI/Model/FaultDiagnosis/FobidShiftGear_OverSpd" /begin REF_CHARACTERISTIC KGSM_GrShftMaxVehSpd_kph /end REF_CHARACTERISTIC /end GROUP
/begin GROUP S578_RecoverPowerLimitErr "AppSwcVcu/HMI/Model/FaultDiagnosis/RecoverPowerLimitErr" /begin REF_CHARACTERISTIC KHMI_RecPwrLmtTime_s KHMI_RecPwrLmtVa_kw /end REF_CHARACTERISTIC /end GROUP
/begin GROUP S578_SlidingWarning "AppSwcVcu/HMI/Model/FaultDiagnosis/SlidingWarning"
 /begin REF_CHARACTERISTIC KHMI_BackwSldgBgnEnd_kph KHMI_BackwSldgBgnSpd_kph KHMI_BackwSldgDst_m KHMI_FwdSldgBgnEnd_kph KHMI_FwdSldgBgnSpd_kph KHMI_FwdSldgDst_m /end REF_CHARACTERISTIC
 /begin REF_MEASUREMENT VHMI_GrDSldDist_m VHMI_GrDSldSw_flg VHMI_GrRSldDist_m VHMI_GrRSldSw_flg /end REF_MEASUREMENT
/end GROUP
/begin GROUP S578_SnowOverSpd "AppSwcVcu/HMI/Model/FaultDiagnosis/SnowOverSpd" /begin REF_CHARACTERISTIC KHMI_SnowModWarnSpd_kph /end REF_CHARACTERISTIC /end GROUP
/begin GROUP S578_skidding "AppSwcVcu/HMI/Model/FaultDiagnosis/skidding" /begin REF_CHARACTERISTIC KHMI_SpdWheelFRdiff_kph /end REF_CHARACTERISTIC /end GROUP
/begin GROUP S704_RS_Latch2 "AppSwcVcu/HvMgt/HighVoltageMgt/PreProcess/RS_Latch2" /begin REF_MEASUREMENT VHVM_VehHalt_flg /end REF_MEASUREMENT /end GROUP
/begin GROUP S705_ChrgTrans "AppSwcVcu/HvMgt/HighVoltageMgt/TransCond/ChrgTrans" /begin REF_CHARACTERISTIC KHVM_ChrgTransCfmTm_s /end REF_CHARACTERISTIC
 /begin REF_MEASUREMENT VHVM_ACChrging2Stop_flg VHVM_ACDschrging2Stop_flg VHVM_DCChrging2Over_flg /end REF_MEASUREMENT
/end GROUP
/begin GROUP S705_INVPreprogm "AppSwcVcu/HvMgt/HighVoltageMgt/TransCond/INVPreprogm" /begin REF_CHARACTERISTIC KHVM_INVPreprogm_ovrdflg KHVM_INVPreprogm_ovrdval /end REF_CHARACTERISTIC /begin REF_MEASUREMENT VHVM_INVPreprogmFlg_flg /end REF_MEASUREMENT /end GROUP
/begin GROUP S705_PTStdbyPTRdy "AppSwcVcu/HvMgt/HighVoltageMgt/TransCond/PTStdbyPTRdy"
 /begin REF_CHARACTERISTIC KHVM_PTRdy2PTStdby_ovrdflg KHVM_PTRdy2PTStdby_ovrdval KHVM_PTRdyBrkSwEffctvTm_s KHVM_PTStdby2PTRdy_ovrdflg KHVM_PTStdby2PTRdy_ovrdval /end REF_CHARACTERISTIC
 /begin REF_MEASUREMENT VHVM_PTRdy2PTStdby_flg VHVM_PTStdby2PTRdy_flg /end REF_MEASUREMENT
/end GROUP
/begin GROUP S705_PowUpSelfChek "AppSwcVcu/HvMgt/HighVoltageMgt/TransCond/PowUpSelfChek" /begin REF_CHARACTERISTIC KHVM_PowUpSelfChek_ovrdflg KHVM_PowUpSelfChek_ovrdval /end REF_CHARACTERISTIC /begin REF_MEASUREMENT VHVM_PowUpSelfChek_flg /end REF_MEASUREMENT /end GROUP
/begin GROUP S705_PwrOn2PwrDwn "AppSwcVcu/HvMgt/HighVoltageMgt/TransCond/PwrOn2PwrDwn"
 /begin REF_CHARACTERISTIC KHVM_KL15OffPwrDwnCfmTm_s KHVM_PwrOn2PwrDwn_ovrdflg KHVM_PwrOn2PwrDwn_ovrdval KHVM_SOCLoPwrDwnDlyTm_s /end REF_CHARACTERISTIC
 /begin REF_MEASUREMENT VHVM_PwrOn2PwrDwn_flg /end REF_MEASUREMENT
/end GROUP
/begin GROUP S705_WakeUp2PwrUp "AppSwcVcu/HvMgt/HighVoltageMgt/TransCond/WakeUp2PwrUp"
 /begin REF_CHARACTERISTIC KHVM_PwrUpACChrgEffctvTm_s KHVM_PwrUpDCChrgEffctvTm_s KHVM_PwrUpIBSDlyTm_s KHVM_PwrUpIBSEffctvTm_s KHVM_PwrUpKL15EffctvTm_s KHVM_WakeUp2PwrUp_ovrdflg KHVM_WakeUp2PwrUp_ovrdval /end REF_CHARACTERISTIC
 /begin REF_MEASUREMENT VHVM_ACChrgEnbl_flg VHVM_ACDchaEnbl_flg VHVM_DCChrgEnbl_flg VHVM_WakeUp2PwrUpACChrg_flg VHVM_WakeUp2PwrUpACDcha_flg VHVM_WakeUp2PwrUpDCChrg_flg VHVM_WakeUp2PwrUpIBS_flg VHVM_WakeUp2PwrUpKL15_flg VHVM_WakeUp2PwrUp_flg /end REF_MEASUREMENT
/end GROUP
/begin GROUP S705_WakeUpVCU "AppSwcVcu/HvMgt/HighVoltageMgt/TransCond/WakeUpVCU" /begin REF_CHARACTERISTIC KHVM_WakeUpVCU_ovrdflg KHVM_WakeUpVCU_ovrdval /end REF_CHARACTERISTIC /begin REF_MEASUREMENT VHVM_WakeUpVCU_flg /end REF_MEASUREMENT /end GROUP
/begin GROUP S824_DbndBckLsh "AppSwcVcu/InputProcess/Model/AccPedal/DbndBckLsh"
 /begin REF_CHARACTERISTIC KIPC_AccPedDbnd_pct KIPC_AccPedPstnLmt_pct KIPC_AccPedPstnOvrdSw_flg KIPC_AccPedPstnOvrdVal_pct KIPC_AccPedSwThr_pct /end REF_CHARACTERISTIC
 /begin REF_MEASUREMENT VIPC_AccPedPstn_pct VIPC_DrvSw_flg /end REF_MEASUREMENT
/end GROUP
/begin GROUP S824_MinPstnLrnd "AppSwcVcu/InputProcess/Model/AccPedal/MinPstnLrnd"
 /begin SUB_GROUP S831_Ch1MinPstnLrn S831_Ch1Scale S831_Ch2MinPstnLrn S831_Ch2Scale /end SUB_GROUP
/end GROUP
/begin GROUP S824_Normztn "AppSwcVcu/InputProcess/Model/AccPedal/Normztn" /begin REF_CHARACTERISTIC KIPC_AccPedNormzPstnFiltTm_s /end REF_CHARACTERISTIC
 /begin REF_MEASUREMENT VIPC_AccPed1Flt_flg VIPC_AccPed1NormzPstn_pct VIPC_AccPed2Flt_flg VIPC_AccPed2NormzPstn_pct /end REF_MEASUREMENT
/end GROUP
/begin GROUP S824_Stk "AppSwcVcu/InputProcess/Model/AccPedal/Stk" /begin SUB_GROUP S833_LPF1a_T_R_IV S833_RS_Latch S833_Stop_Watch_R_TH1 /end SUB_GROUP
 /begin REF_CHARACTERISTIC KIPC_AccPedInitTm_s KIPC_AccPedPrsdThr4Stk_pct KIPC_AccPedStkDiagEnbl_flg KIPC_AccPedStkFiltCoeff_rat KIPC_AccPedStkStabThr_pct KIPC_AccPedStkStabTm_s KIPC_AccPedZeroPstnDecRate_pctps KIPC_AccPedZeroPstnIncRate_pctps KIPC_BrkPedPrsdThr4Stk_pct KIPC_BrkPedReldThr4Stk_pct KIPC_EnblFltRstAccPedZP_flg /end REF_CHARACTERISTIC
 /begin REF_MEASUREMENT VIPC_AccPedStkActv_flg VIPC_AccPedStkPstn_pct VIPC_AccPedZeroPstn_pct VIPC_ZeroPstnRst_flg /end REF_MEASUREMENT
/end GROUP
/begin GROUP S824_Wght "AppSwcVcu/InputProcess/Model/AccPedal/Wght"
 /begin REF_MEASUREMENT VIPC_AccPedPstnVld_flg VIPC_AccPedSnsrSta_enum VIPC_AccPedWghtPstn_pct /end REF_MEASUREMENT
/end GROUP
/begin GROUP S827_AutoCreep "AppSwcVcu/InputProcess/Model/ModeCalc/AutoCreep" /begin SUB_GROUP S864_RS_Latch /end SUB_GROUP
 /begin REF_CHARACTERISTIC KIPC_EnblVpedAutoCrp_flg KIPC_ExitAutoCrpDrvDist_m KIPC_ExitAutoCrpPNDurTm_s KIPC_ExitAutoCrpVehSpd_kph /end REF_CHARACTERISTIC
/end GROUP
/begin GROUP S829_VehSpdDrvn "AppSwcVcu/InputProcess/Model/VehSpdCalcn/VehSpdDrvn" /begin REF_CHARACTERISTIC KIPC_ESCVehSpdPrio_flg KIPC_ESCWhlSpdPrio_flg /end REF_CHARACTERISTIC
 /begin REF_MEASUREMENT VIPC_VehSpdDrvnVld_flg VIPC_VehSpdDrvn_kph VIPC_VehSpdVld_flg VIPC_VehSpd_kph /end REF_MEASUREMENT
/end GROUP
/begin GROUP S829_VehSpdNonDrvn "AppSwcVcu/InputProcess/Model/VehSpdCalcn/VehSpdNonDrvn" /begin REF_MEASUREMENT VIPC_VehSpdNonDrvnVld_flg VIPC_VehSpdNonDrvn_kph /end REF_MEASUREMENT /end GROUP
/begin GROUP S906_CalPwrCnsmPerUnitKM "AppSwcVcu/RME/RME/RME_PwrCnsm/CalPwrCnsmPerUnitKM" /begin REF_CHARACTERISTIC KRME_CalPwrCnsmVehThr_kph MRME_WLTPStdPwrCnsm_kWh100km /end REF_CHARACTERISTIC
 /begin REF_MEASUREMENT VRME_CalPwrCnsmPerTrig_kWhpkm VRME_CalPwrCnsmTrig_flg VRME_VehTotPwrCurrCyc_kWh VRME_WLTPStdPwrCnsm_kWhpkm /end REF_MEASUREMENT
/end GROUP
/begin GROUP S906_CalPwrCnsmStore "AppSwcVcu/RME/RME/RME_PwrCnsm/CalPwrCnsmStore" /begin REF_CHARACTERISTIC KRME_PwrCnsmStorRst_enum /end REF_CHARACTERISTIC
 /begin REF_MEASUREMENT VRMEAvgPwrCnsm15km_kWhpkm VRME_AvgPwrCnsm100km_kWhpkm VRME_AvgPwrCnsm10km_kWhpkm VRME_AvgPwrCnsm25km_kWhpkm VRME_AvgPwrCnsm50km_kWhpkm VRME_AvgPwrCnsm5km_kWhpkm /end REF_MEASUREMENT
/end GROUP
/begin GROUP S907_SOCCnsmCal "AppSwcVcu/RME/RME/RME_WLTP/SOCCnsmCal"
 /begin REF_CHARACTERISTIC KRME_CalSOCCnsmTgtDist_m KRME_CalSOCCnsmVehThr_kph KRME_WLTPStdUpLimFac_c MRME_WLTPStdDwLimFac_c MRME_WLTPStdRmnMil_km MRME_WLTPStdSOCCnsm_pct100km /end REF_CHARACTERISTIC
 /begin REF_MEASUREMENT VRME_CalSOCCnsmPerTrig_pctptrig VRME_CalSOCCnsmPerkm_pctpkm VRME_CalSOCCnsmTgtDist_m VRME_CalSOCCnsmTrig_flg VRME_VehTotDistCurrCyc_km VRME_WLTPRmnMilEstDwLim_km VRME_WLTPRmnMilEstUpLim_km VRME_WLTPRmnMilEst_km VRME_WLTPStdSOCCnsm_pctpkm /end REF_MEASUREMENT
/end GROUP
/begin GROUP S907_SOCCnsmStore "AppSwcVcu/RME/RME/RME_WLTP/SOCCnsmStore"
 /begin REF_CHARACTERISTIC KRME_AvgSOCCnsm100NumWghtFac_c KRME_AvgSOCCnsm10NumWghtFac_c KRME_AvgSOCCnsm15NumWghtFac_c KRME_AvgSOCCnsm1NumWghtFac_c KRME_AvgSOCCnsm25NumWghtFac_c KRME_AvgSOCCnsm50NumWghtFac_c KRME_AvgSOCCnsm5NumWghtFac_c KRME_AvgSOCCnsmWghtSw_flg KRME_AvgSOCCnsmWghtVal_pctpkm KRME_SOCCnsmStorRst_enum /end REF_CHARACTERISTIC
 /begin REF_MEASUREMENT VRME_AvgSOCCnsm100Num_pctpkm VRME_AvgSOCCnsm10Num_pctpkm VRME_AvgSOCCnsm15Num_pctpkm VRME_AvgSOCCnsm25Num_pctpkm VRME_AvgSOCCnsm50Num_pctpkm VRME_AvgSOCCnsm5Num_pctpkm VRME_AvgSOCCnsmWght_pctpkm /end REF_MEASUREMENT
/end GROUP
/begin GROUP S907_WLTPControl "AppSwcVcu/RME/RME/RME_WLTP/WLTPControl"
 /begin REF_CHARACTERISTIC KRME_CalSOCCnsmVehThr_kph KRME_VehStpDlyTm_s KRME_WLTPCtrlModeSel_flg KRME_WLTPRmnMilEstVldOff_km KRME_WLTPRmnMilEstVldOn_km MRME_DynRmnMilEstChgStp_c /end REF_CHARACTERISTIC
 /begin REF_MEASUREMENT VRME_DynRmnMilEstChgFac_c VRME_DynRmnMilEstTgt_km VRME_DynRmnMilEstUpdTrig_flg VRME_DynRmnMilEstV_flg VRME_DynRmnMilEst_km VRME_VehStacEnbl_flg /end REF_MEASUREMENT
/end GROUP
/begin GROUP S952_RS_Latch "AppSwcVcu/SIBS/SIBS/Chrg_Cond/RS_Latch" /begin REF_MEASUREMENT VIBS_NMReq_flg /end REF_MEASUREMENT /end GROUP
/begin GROUP S953_Fault_Debounce "AppSwcVcu/SIBS/SIBS/PreProcess/Fault_Debounce" /begin REF_CHARACTERISTIC KIBS_KL30VoltDebNumThr_cnt /end REF_CHARACTERISTIC /end GROUP
/begin GROUP S953_LPF1a_T_IV "AppSwcVcu/SIBS/SIBS/PreProcess/LPF1a_T_IV" /begin REF_MEASUREMENT VIBS_HwKL30_V /end REF_MEASUREMENT /end GROUP
/begin GROUP S953_LPF1a_T_IV1 "AppSwcVcu/SIBS/SIBS/PreProcess/LPF1a_T_IV1" /begin REF_MEASUREMENT VIBS_EnvirTemp_C /end REF_MEASUREMENT /end GROUP
/begin GROUP S953_RS_Latch "AppSwcVcu/SIBS/SIBS/PreProcess/RS_Latch" /begin REF_MEASUREMENT VIBS_WupVoltAllow_flg /end REF_MEASUREMENT /end GROUP
/begin GROUP S953_RS_Latch1 "AppSwcVcu/SIBS/SIBS/PreProcess/RS_Latch1" /begin REF_MEASUREMENT BSW_RTCWakeup_flg /end REF_MEASUREMENT /end GROUP
/begin GROUP S953_Turn_On_Delay2 "AppSwcVcu/SIBS/SIBS/PreProcess/Turn_On_Delay2" /begin REF_MEASUREMENT VIBS_RTCWakeup_flg /end REF_MEASUREMENT /end GROUP
/begin GROUP S992_Limit "AppSwcVcu/VSO/RoadSlopeEstmn/Model/Limit" /begin REF_MEASUREMENT VVSO_RoadSlopTqEst_Nm /end REF_MEASUREMENT /end GROUP
/begin GROUP S998_DrvCond "AppSwcVcu/VSO/TPMS/Model/DrvCond"
 /begin REF_CHARACTERISTIC KVSO_DistErrHldSlip_kph KVSO_DistErrHldSpd_kph KVSO_DistErrHldStrg_kph /end REF_CHARACTERISTIC
 /begin REF_MEASUREMENT VVSO_VehSpd_kph VVSO_WhlDistErrHld_flg VVSO_iTPMSAvail_flg /end REF_MEASUREMENT
/end GROUP
/begin GROUP S998_WhlDistErrCalc "AppSwcVcu/VSO/TPMS/Model/WhlDistErrCalc" /begin SUB_GROUP S1006_XWhlDistErr /end SUB_GROUP /end GROUP
/begin GROUP S1014_LPF1_T_R_E_IV2 "AppSwcVcu/VSO/VehMassEstmn/Model/LPF1_T_R_E_IV2" /begin REF_MEASUREMENT VVSO_VehMassEst_kg /end REF_MEASUREMENT /end GROUP
/begin GROUP S1014_LPF1_T_R_E_IV3 "AppSwcVcu/VSO/VehMassEstmn/Model/LPF1_T_R_E_IV3" /begin REF_MEASUREMENT VVSO_SlopEst_rat /end REF_MEASUREMENT /end GROUP
/begin GROUP S1033_LPF1a_T_IV "AppSwcVcu/VTM/CPT/Model/LPF1a_T_IV" /begin REF_MEASUREMENT VCPT_MotorSpd_rpm /end REF_MEASUREMENT /end GROUP
/begin GROUP S1033_RateLimit_R_IV "AppSwcVcu/VTM/CPT/Model/RateLimit_R_IV" /begin REF_MEASUREMENT VCPT_MotorMotMaxTq_Nm /end REF_MEASUREMENT /end GROUP
/begin GROUP S1033_RateLimit_R_IV1 "AppSwcVcu/VTM/CPT/Model/RateLimit_R_IV1" /begin REF_MEASUREMENT VCPT_MotorGenMaxTq_Nm /end REF_MEASUREMENT /end GROUP
/begin GROUP S1046_CruiseControl "AppSwcVcu/VTM/DAC/Model/CruiseControl" /begin SUB_GROUP S1047_ACCControl S1047_CruiseControl /end SUB_GROUP /end GROUP
/begin GROUP S1046_HillDescentControl "AppSwcVcu/VTM/DAC/Model/HillDescentControl" /begin SUB_GROUP S1048_HDCSpdCtrl S1048_HDCVehSpd S1048_TransCond /end SUB_GROUP /begin REF_MEASUREMENT VDAC_HDCSt_enum VDAC_HDCTgtSpd_kph /end REF_MEASUREMENT /end GROUP
/begin GROUP S1046_OnePedalDrive "AppSwcVcu/VTM/DAC/Model/OnePedalDrive"
 /begin SUB_GROUP S1049_AutoHoldCmd S1049_OPDEnbl S1049_OPDSpdAcceltn S1049_OPDSpdCtrl /end SUB_GROUP
/end GROUP
/begin GROUP S1046_PostProcess "AppSwcVcu/VTM/DAC/Model/PostProcess" /begin SUB_GROUP S1050_RS_Latch /end SUB_GROUP
 /begin REF_CHARACTERISTIC KDAC_BrkPedPrsdOff_pct KDAC_BrkPedPrsdOn_pct KDAC_BrkTq2PresrCvrtCoeff_c KDAC_DrvAsstTqSplitEHBMin_Nm KDAC_HDCTqReqWhlAchvd_Nm KDAC_HDCTqReqWhlDec_Nmps KDAC_HDCTqReqWhlInc_Nmps KDAC_OPDTqRespFst_flg KDAC_OPDTqRespSprt_flg KDAC_VirtAccelPedPstnOff_pct KDAC_VirtAccelPedPstnOn_pct MDAC_INVMaxDrgTqWhl_Nm /end REF_CHARACTERISTIC
 /begin REF_MEASUREMENT VDAC_DrvAsstTqSplitEHB_Nm VDAC_DrvAsstTqSplitINV_Nm VDAC_DrvAsstTqSts_enum VDAC_DrvAsstTqTgt_Nm VDAC_MstrCylPresrReq_bar VDAC_VirtAccPedPstnSta_enum VDAC_VirtAccPedPstn_pct VDAC_VirtAccelPedPstnRaw_pct VDAC_VirtPedPstn_pct /end REF_MEASUREMENT
/end GROUP
/begin GROUP S1248_ABSActv "AppSwcVcu/VTM/TQC/Model/ABSActv" /begin SUB_GROUP S1249_Stop_Watch_R_IV /end SUB_GROUP
 /begin REF_CHARACTERISTIC KTQC_ABSorESPActvTm1_s KTQC_ABSorESPActvTm2_s KTQC_CstRegenLmtTqDecRecry_Nmps KTQC_CstRegenLmtTqDecSlow_Nmps KTQC_CstRegenLmtTqIncPhs1_Nmps KTQC_CstRegenLmtTqIncPhs2_Nmps KTQC_EnblBrkRsmCstRegen_flg KTQC_RsmCstRegenAccPed_pct KTQC_RsmCstRegenTqReq_Nm /end REF_CHARACTERISTIC
 /begin REF_MEASUREMENT VTQC_CstRegenLmtTq_Nm VTQC_DrvTqReqWhlABS_Nm /end REF_MEASUREMENT
/end GROUP
/begin GROUP S1248_ESPIntv "AppSwcVcu/VTM/TQC/Model/ESPIntv" /begin REF_MEASUREMENT VTQC_DrvTqReqWhl_Nm VTQC_MotorTqReq_Nm /end REF_MEASUREMENT /end GROUP
/begin GROUP S1248_RBSIntv "AppSwcVcu/VTM/TQC/Model/RBSIntv" /begin SUB_GROUP S1251_Limit S1251_RS_Latch /end SUB_GROUP
 /begin REF_CHARACTERISTIC KTQC_ABSInhbBrkRegen_flg KTQC_BrkRegenTgtTqDecRate_Nmps KTQC_BrkRegenTgtTqIncRate_Nmps KTQC_DrvTqHiDsblRBSDlyTm_s KTQC_DrvTqHiDsblRBSThr_Nm KTQC_DrvTqLoEnblRBSDlyTm_s KTQC_DrvTqLoEnblRBSThr_Nm KTQC_EnblESPIntvBrkTgtZero_flg KTQC_EnblRBSIntv_flg MTQC_RegenMaxTqDecRate_Nmps MTQC_RegenMaxTqIncRate_Nmps /end REF_CHARACTERISTIC
 /begin REF_MEASUREMENT VTQC_BrkRegenMaxTqWhl_Nm VTQC_BrkRegenTgtTqWhl_Nm /end REF_MEASUREMENT
/end GROUP
/begin GROUP S1266_DriverTqReqOriginal "AppSwcVcu/VTM/TQD/Model/DriverTqReqOriginal" /begin SUB_GROUP S1267_DrvTq S1267_RegenTq /end SUB_GROUP /begin REF_MEASUREMENT VTQD_PedalTqReqWhlRaw_Nm /end REF_MEASUREMENT /end GROUP
/begin GROUP S1266_TorqueLimit "AppSwcVcu/VTM/TQD/Model/TorqueLimit" /begin SUB_GROUP S1268_TorqZeroReq /end SUB_GROUP
 /begin REF_CHARACTERISTIC KTQD_WhlSpdDiffFiltCoeff_c MTQD_LimpHomeMaxTq_Nm MTQD_WhlSpdDiffMaxTqFac_c MTQD_WhlSpdDiffMaxTq_Nm /end REF_CHARACTERISTIC
 /begin REF_MEASUREMENT VTQD_DrvTqReqWhl_Nm /end REF_MEASUREMENT
/end GROUP
/begin GROUP S1266_TqSynthAndDerate "AppSwcVcu/VTM/TQD/Model/TqSynthAndDerate" /begin SUB_GROUP S1269_TorqDerateFactor S1269_TorqueSynthesize /end SUB_GROUP /end GROUP
/begin GROUP S1323_FilterSlewRate "AppSwcVcu/VTM/TQF/Model/FilterSlewRate" /begin SUB_GROUP S1324_TqRateLimCalDec S1324_TqRateLimCalInc /end SUB_GROUP /end GROUP
/begin GROUP S1323_TorqueDirection "AppSwcVcu/VTM/TQF/Model/TorqueDirection" /begin SUB_GROUP S1325_RS_Latch1 /end SUB_GROUP
 /begin REF_CHARACTERISTIC KTQF_TqDecDlyTm_s KTQF_TqDecThr_Nm KTQF_TqIncDlyTm_s KTQF_TqIncThr_Nm /end REF_CHARACTERISTIC
/end GROUP
/begin GROUP S1323_TorqueFilter "AppSwcVcu/VTM/TQF/Model/TorqueFilter" /begin SUB_GROUP S1326_TZXLimTq /end SUB_GROUP /begin REF_MEASUREMENT VTQF_DrvTqReqWhl_Nm /end REF_MEASUREMENT /end GROUP
/begin GROUP S1323_TqChgRate "AppSwcVcu/VTM/TQF/Model/TqChgRate" /begin SUB_GROUP S1327_LPF1a_T_IV S1327_LPF1a_T_IV1 /end SUB_GROUP
 /begin REF_CHARACTERISTIC KTQF_DsblEndFlgRateCond_flg KTQF_TqOutChgRateFilt_rat KTQF_TqRateDecMin_Nmps KTQF_TqRateIncMin_Nmps KTQF_TqRateLimEndErrFac_c KTQF_TqRateLimEndTm_s KTQF_TqRawChgRateFilt_rat MTQF_TqRateLimEndErrE_Nm MTQF_TqRateLimEndErrN_Nm MTQF_TqRateLimEndErrS_Nm /end REF_CHARACTERISTIC
 /begin REF_MEASUREMENT VTQF_TqRateLimEndg_flg /end REF_MEASUREMENT
/end GROUP
/begin GROUP S1349_ActiveSurgeDamping "AppSwcVcu/VTM/TQR/Model/ActiveSurgeDamping" /begin SUB_GROUP S1350_ASDSpdOsc S1350_ASDTqCal S1350_OscSpdPhaseComp /end SUB_GROUP /end GROUP
/begin GROUP S1349_MotorDampngEnbl "AppSwcVcu/VTM/TQR/Model/MotorDampngEnbl" /begin SUB_GROUP S1351_Limit /end SUB_GROUP
 /begin REF_CHARACTERISTIC KTQR_ABSActvDlyTm4Dampng_s KTQR_ASDEnbl_flg KTQR_AllZeroCrsDsblDamp_flg KTQR_MotDampngBrkout_pct KTQR_MotDampngLmtFac_c KTQR_MotDampngLmtMaxRate_Nmps KTQR_MotDampngLmtMin_Nm KTQR_MotDampngSpdOff_rpm KTQR_MotDampngSpdOn_rpm KTQR_MotorDampngDsblAZ_flg KTQR_MotorDampngDsblBZ_flg KTQR_MotorDampngDsblZX_flg KTQR_MotorDampngEnbl_flg /end REF_CHARACTERISTIC
 /begin REF_MEASUREMENT VTQR_ASDEnbl_flg VTQR_MotDampngEnbl_flg /end REF_MEASUREMENT
/end GROUP
/begin GROUP S1349_MotorDirReq "AppSwcVcu/VTM/TQR/Model/MotorDirReq" /begin REF_CHARACTERISTIC KTQR_MotorTqZeroDlyTm_s KTQR_MotorTqZero_Nm /end REF_CHARACTERISTIC /begin REF_MEASUREMENT VTQR_MotorDirReq_enum /end REF_MEASUREMENT /end GROUP
/begin GROUP S1349_MotorStandby "AppSwcVcu/VTM/TQR/Model/MotorStandby"
 /begin REF_CHARACTERISTIC KTQR_MotorStdbyDlyTm_s KTQR_MotorStdbyEnbl_flg KTQR_MotorStdbyVehHaltHi_kph KTQR_MotorStdbyVehHaltLo_kph /end REF_CHARACTERISTIC
 /begin REF_MEASUREMENT VTQR_MotorStdby_flg /end REF_MEASUREMENT
/end GROUP
/begin GROUP S1382_ClunkCtrl "AppSwcVcu/VTM/TZX/Model/ClunkCtrl" /begin SUB_GROUP S1383_RS_Latch /end SUB_GROUP /begin REF_MEASUREMENT VTZX_ClkZXTm_s VTZX_MotorTqReq_Nm /end REF_MEASUREMENT /end GROUP
/begin GROUP S1382_PreProc "AppSwcVcu/VTM/TZX/Model/PreProc" /begin SUB_GROUP S1384_BypassZeroX S1384_TorqueDirection /end SUB_GROUP /end GROUP
/begin GROUP S1382_TqReqPrdt "AppSwcVcu/VTM/TZX/Model/TqReqPrdt" /begin SUB_GROUP S1386_Limit S1386_RS_Latch1 /end SUB_GROUP /begin REF_CHARACTERISTIC MTZX_RampDecRate_Nmps MTZX_RampIncRate_Nmps /end REF_CHARACTERISTIC /end GROUP
/begin GROUP S1382_ZeroXPara "AppSwcVcu/VTM/TZX/Model/ZeroXPara"
 /begin REF_CHARACTERISTIC MTZX_AZDecRate_Nmps MTZX_AZIncRate_Nmps MTZX_BZDecRate_Nmps MTZX_BZIncRate_Nmps MTZX_ZeroTqOfstDec_Nm MTZX_ZeroTqOfstInc_Nm MTZX_ZeroXTmDec_s MTZX_ZeroXTmInc_s /end REF_CHARACTERISTIC
 /begin REF_MEASUREMENT VTZX_AZDecRate_Nmps VTZX_AZIncRate_Nmps VTZX_BZDecRate_Nmps VTZX_BZIncRate_Nmps VTZX_ZeroTqOfstDec_Nm VTZX_ZeroTqOfstInc_Nm VTZX_ZeroTqOfst_Nm VTZX_ZeroXTm_s /end REF_MEASUREMENT
/end GROUP
/begin GROUP S1382_ZeroXStat "AppSwcVcu/VTM/TZX/Model/ZeroXStat" /begin SUB_GROUP S1388_ZXCondCalc /end SUB_GROUP
 /begin REF_MEASUREMENT VTZX_MotorTqReqZX_Nm VTZX_TqZXSt_enum VTZX_ZeroTqHldDec_Nm VTZX_ZeroTqHldInc_Nm /end REF_MEASUREMENT
/end GROUP
/begin GROUP S1429_LPF1a_T_IV "AppSwcVcu/VTM/VTM_In/Model/LPF1a_T_IV" /begin REF_MEASUREMENT VVTM_VehSpd_kph /end REF_MEASUREMENT /end GROUP
/begin GROUP S1429_LPF1a_T_IV1 "AppSwcVcu/VTM/VTM_In/Model/LPF1a_T_IV1" /begin REF_MEASUREMENT VVTM_MotorSpd_rpm /end REF_MEASUREMENT /end GROUP
/begin GROUP S1429_LPF1a_T_IV4 "AppSwcVcu/VTM/VTM_In/Model/LPF1a_T_IV4" /begin REF_MEASUREMENT VVTM_VehAcceltn_mps2 /end REF_MEASUREMENT /end GROUP
/begin GROUP S1436_HysteresisB_SP "AppSwcVcu/VTM/VTM_Out/Display/HysteresisB_SP" /begin REF_MEASUREMENT VVTM_RegenReqBrkLampOn_flg /end REF_MEASUREMENT /end GROUP
/begin GROUP S1438_Backlash "AppSwcVcu/VTM/VTM_Out/PowerIndication/Backlash" /begin REF_MEASUREMENT VVTM_MotorActPwr_kW /end REF_MEASUREMENT /end GROUP
/begin GROUP S1494_GearPrecondition "AppSwcVcu/gsm/GearShift/GearLogical/GearPrecondition"
 /begin REF_CHARACTERISTIC KGSM_DRFlt2NSw_flg KGSM_DRFlt2NVal_flg KGSM_GrNReq2PSw_flg KGSM_GrNReq2PVal_flg KGSM_HldGearPSw_flg KGSM_HldGearPVal_flg /end REF_CHARACTERISTIC
 /begin REF_MEASUREMENT VGSM_DRFlt2N_flg VGSM_GrNReq2P_flg VGSM_HldGearP_flg /end REF_MEASUREMENT
/end GROUP
/begin GROUP S1494_GearReq "AppSwcVcu/gsm/GearShift/GearLogical/GearReq"
 /begin REF_MEASUREMENT VGSM_AsstDrvFbShft_flg VGSM_PGrSwSts_enum VGSM_ShftTgtGrReq_enum /end REF_MEASUREMENT
/end GROUP
/begin GROUP S1494_GearTransion "AppSwcVcu/gsm/GearShift/GearLogical/GearTransion"
 /begin SUB_GROUP S1502_DNRGearTrans S1502_EnterGearP S1502_ExitGearP S1502_VehTargetGearTransferEnum /end SUB_GROUP
 /begin REF_CHARACTERISTIC KGSM_GrShftMaxVehSpd_kph /end REF_CHARACTERISTIC
 /begin REF_MEASUREMENT VGSM_ReqEPBAply_flg VGSM_ReqEPBRels_flg VGSM_VehTgtGrReq_enum /end REF_MEASUREMENT
/end GROUP
/begin GROUP S1494_Turn_Off_Delay1 "AppSwcVcu/gsm/GearShift/GearLogical/Turn_Off_Delay1" /begin REF_MEASUREMENT VGSM_INVRunEnbl_flg /end REF_MEASUREMENT /end GROUP
/begin GROUP S831_Ch1MinPstnLrn "AppSwcVcu/InputProcess/Model/AccPedal/MinPstnLrnd/Ch1MinPstnLrn" /begin SUB_GROUP S835_LPF1a_T_IV S835_Stop_Watch_R_TH1 /end SUB_GROUP
 /begin REF_CHARACTERISTIC KIPC_AccPedLrnDwnFiltCoeff_rat KIPC_AccPedLrnDwnStabThr_pct KIPC_AccPedLrnDwnStabTm_s KIPC_AccPedMinPstnHi_pct KIPC_AccPedMinPstnLo_pct KIPC_AccPedMinPstnLrnUpHi_pct KIPC_AccPedMinPstnLrnUpLo_pct KIPC_AccPedMinPstnUpOfst_pct /end REF_CHARACTERISTIC
 /begin REF_MEASUREMENT VIPC_AccPed1LrnUpActv_flg VIPC_AccPed1MinPstnLrnd_pct /end REF_MEASUREMENT
/end GROUP
/begin GROUP S831_Ch1Scale "AppSwcVcu/InputProcess/Model/AccPedal/MinPstnLrnd/Ch1Scale" /begin REF_CHARACTERISTIC KIPC_AccPed1FullPstn_pct KIPC_AccPedSclRng_pct /end REF_CHARACTERISTIC /begin REF_MEASUREMENT VIPC_AccPed1SclPstn_pct /end REF_MEASUREMENT /end GROUP
/begin GROUP S831_Ch2MinPstnLrn "AppSwcVcu/InputProcess/Model/AccPedal/MinPstnLrnd/Ch2MinPstnLrn" /begin SUB_GROUP S837_LPF1a_T_IV S837_Stop_Watch_R_TH1 /end SUB_GROUP
 /begin REF_CHARACTERISTIC KIPC_AccPedLrnDwnFiltCoeff_rat KIPC_AccPedLrnDwnStabThr_pct KIPC_AccPedLrnDwnStabTm_s KIPC_AccPedMinPstnHi_pct KIPC_AccPedMinPstnLo_pct KIPC_AccPedMinPstnLrnUpHi_pct KIPC_AccPedMinPstnLrnUpLo_pct KIPC_AccPedMinPstnUpOfst_pct /end REF_CHARACTERISTIC
 /begin REF_MEASUREMENT VIPC_AccPed2LrnUpActv_flg VIPC_AccPed2MinPstnLrnd_pct /end REF_MEASUREMENT
/end GROUP
/begin GROUP S831_Ch2Scale "AppSwcVcu/InputProcess/Model/AccPedal/MinPstnLrnd/Ch2Scale" /begin REF_CHARACTERISTIC KIPC_AccPed2FullPstn_pct KIPC_AccPedSclRng_pct /end REF_CHARACTERISTIC /begin REF_MEASUREMENT VIPC_AccPed2SclPstn_pct /end REF_MEASUREMENT /end GROUP
/begin GROUP S833_LPF1a_T_R_IV "AppSwcVcu/InputProcess/Model/AccPedal/Stk/LPF1a_T_R_IV" /begin REF_MEASUREMENT VIPC_AccPedWghtAvg_pct /end REF_MEASUREMENT /end GROUP
/begin GROUP S833_RS_Latch "AppSwcVcu/InputProcess/Model/AccPedal/Stk/RS_Latch" /begin REF_MEASUREMENT VIPC_AccPedStkBrkPrsd_flg /end REF_MEASUREMENT /end GROUP
/begin GROUP S833_Stop_Watch_R_TH1 "AppSwcVcu/InputProcess/Model/AccPedal/Stk/Stop_Watch_R_TH1" /begin REF_MEASUREMENT VIPC_AccPedStkStab_flg /end REF_MEASUREMENT /end GROUP
/begin GROUP S864_RS_Latch "AppSwcVcu/InputProcess/Model/ModeCalc/AutoCreep/RS_Latch" /begin REF_MEASUREMENT VIPC_VpedAutoCrp_flg /end REF_MEASUREMENT /end GROUP
/begin GROUP S1006_XWhlDistErr "AppSwcVcu/VSO/TPMS/Model/WhlDistErrCalc/XWhlDistErr" /begin REF_CHARACTERISTIC KVSO_WhlDistErrRecThr_m KVSO_WhlDistErrRefRecThr_m /end REF_CHARACTERISTIC /begin REF_MEASUREMENT VVSO_DrvDist_m VVSO_XWhlDistErr_m /end REF_MEASUREMENT /end GROUP
/begin GROUP S1324_TqRateLimCalDec "AppSwcVcu/VTM/TQF/Model/FilterSlewRate/TqRateLimCalDec" /begin REF_CHARACTERISTIC KTQF_TqRateDecMin_Nmps /end REF_CHARACTERISTIC /end GROUP
/begin GROUP S1324_TqRateLimCalInc "AppSwcVcu/VTM/TQF/Model/FilterSlewRate/TqRateLimCalInc" /begin REF_CHARACTERISTIC KTQF_TqRateIncMin_Nmps /end REF_CHARACTERISTIC /end GROUP
/begin GROUP S1502_DNRGearTrans "AppSwcVcu/gsm/GearShift/GearLogical/GearTransion/DNRGearTrans" /begin REF_CHARACTERISTIC KGSM_GrShftMaxVehSpd_kph /end REF_CHARACTERISTIC /end GROUP
/begin GROUP S1144_TqRampFilt "AppSwcVcu/VTM/DAC/Model/HillDescentControl/HDCSpdCtrl/Active/TqRampFilt"
 /begin REF_CHARACTERISTIC KDAC_BrkTq2PresrCvrtCoeff_c KDAC_HDCTqReqWhlAchvd_Nm KDAC_HDCTqReqWhlDec_Nmps KDAC_HDCTqReqWhlInc_Nmps /end REF_CHARACTERISTIC
/end GROUP
/end MODULE
/end PROJECT
