/******************************************************************************
* ASAP2 file: AppSwcVcu.a2l
* Code generation for model "AppSwcVcu".
* Model version : 9.642
* Simulink Coder version : 9.8 (R2022b) 13-May-2022
* C source code generated on : Wed Nov 20 11:28:45 2024
* Target selection: autosar.tlc
* Embedded hardware selection: NXP->Cortex-M4
* Code generation objectives: Unspecified
* Validation result: Not run
* (add additional file header information here)
******************************************************************************/
/* Version 1.31 */
ASAP2_VERSION 1 31
/begin PROJECT ProjectName "Project Comment Goes Here"
/begin HEADER "Header Comments go here" /end HEADER
/begin MODULE ModuleName "Module Comment Goes Here"
/begin MOD_PAR "MOD PAR Comment Goes Here" /end MOD_PAR
/begin MOD_COMMON "Mod Common Comment Here" BYTE_ORDER MSB_LAST /end MOD_COMMON
/begin RECORD_LAYOUT Scalar_BOOLEAN FNC_VALUES 1 UBYTE COLUMN_DIR DIRECT /end RECORD_LAYOUT
/begin RECORD_LAYOUT Scalar_UBYTE FNC_VALUES 1 UBYTE COLUMN_DIR DIRECT /end RECORD_LAYOUT
/begin RECORD_LAYOUT Scalar_BYTE FNC_VALUES 1 SBYTE COLUMN_DIR DIRECT /end RECORD_LAYOUT
/begin RECORD_LAYOUT Scalar_UWORD FNC_VALUES 1 UWORD COLUMN_DIR DIRECT /end RECORD_LAYOUT
/begin RECORD_LAYOUT Scalar_SWORD FNC_VALUES 1 SWORD COLUMN_DIR DIRECT /end RECORD_LAYOUT
/begin RECORD_LAYOUT Scalar_LONG FNC_VALUES 1 SLONG COLUMN_DIR DIRECT /end RECORD_LAYOUT
/begin RECORD_LAYOUT Scalar_FLOAT32_IEEE FNC_VALUES 1 FLOAT32_IEEE COLUMN_DIR DIRECT /end RECORD_LAYOUT
/begin RECORD_LAYOUT Scalar_FLOAT64_IEEE FNC_VALUES 1 FLOAT64_IEEE COLUMN_DIR DIRECT /end RECORD_LAYOUT
/begin RECORD_LAYOUT Lookup1D_BOOLEAN FNC_VALUES 1 UBYTE COLUMN_DIR DIRECT /end RECORD_LAYOUT
/begin RECORD_LAYOUT Lookup1D_X_BOOLEAN AXIS_PTS_X 1 UBYTE INDEX_INCR DIRECT /end RECORD_LAYOUT
/begin RECORD_LAYOUT Lookup1D_BYTE FNC_VALUES 1 SBYTE COLUMN_DIR DIRECT /end RECORD_LAYOUT
/begin RECORD_LAYOUT Lookup1D_X_UBYTE AXIS_PTS_X 1 UBYTE INDEX_INCR DIRECT /end RECORD_LAYOUT
/begin RECORD_LAYOUT Lookup1D_UWORD FNC_VALUES 1 UWORD COLUMN_DIR DIRECT /end RECORD_LAYOUT
/begin RECORD_LAYOUT Lookup1D_WORD FNC_VALUES 1 SWORD COLUMN_DIR DIRECT /end RECORD_LAYOUT
/begin RECORD_LAYOUT Lookup1D_FLOAT32_IEEE FNC_VALUES 1 FLOAT32_IEEE COLUMN_DIR DIRECT /end RECORD_LAYOUT
/begin RECORD_LAYOUT Lookup1D_X_FLOAT32_IEEE AXIS_PTS_X 1 FLOAT32_IEEE INDEX_INCR DIRECT /end RECORD_LAYOUT
/begin RECORD_LAYOUT Lookup2D_X_UBYTE AXIS_PTS_X 1 UBYTE INDEX_INCR DIRECT /end RECORD_LAYOUT
/begin RECORD_LAYOUT Lookup2D_UWORD FNC_VALUES 1 UWORD COLUMN_DIR DIRECT /end RECORD_LAYOUT
/begin RECORD_LAYOUT Lookup2D_FLOAT32_IEEE FNC_VALUES 1 FLOAT32_IEEE COLUMN_DIR DIRECT /end RECORD_LAYOUT
/begin RECORD_LAYOUT Lookup2D_X_FLOAT32_IEEE AXIS_PTS_X 1 FLOAT32_IEEE INDEX_INCR DIRECT /end RECORD_LAYOUT
/begin AXIS_PTS ASYS_HVBatPackTyp_X_Ah "" 0x0000 /* @ECU_Address@ASYS_HVBatPackTyp_X_Ah@ */ NO_INPUT_QUANTITY Lookup2D_X_UBYTE 0 AppSwcVcu_CM_uint8_Ah 10 0.0 255.0 /end AXIS_PTS
/begin CHARACTERISTIC MDSA_VehDrgTq_Nm "" CURVE 0x0000 /* @ECU_Address@MDSA_VehDrgTq_Nm@ */ Lookup1D_FLOAT32_IEEE 0 AppSwcVcu_CM_single_Nm 0.0 10000.0
 /begin AXIS_DESCR COM_AXIS NO_INPUT_QUANTITY AppSwcVcu_CM_single_kph 15 0.0 500.0 AXIS_PTS_REF ADSA_SprtIdxVehSpd_X_kph /end AXIS_DESCR
/end CHARACTERISTIC
/begin AXIS_PTS ADSA_SprtIdxVehSpd_X_kph "" 0x0000 /* @ECU_Address@ADSA_SprtIdxVehSpd_X_kph@ */ NO_INPUT_QUANTITY Lookup1D_X_FLOAT32_IEEE 0 AppSwcVcu_CM_single_kph 15 0.0 500.0 /end AXIS_PTS
/begin CHARACTERISTIC MDSA_WildDrvMap_mps2 "" CURVE 0x0000 /* @ECU_Address@MDSA_WildDrvMap_mps2@ */ Lookup1D_FLOAT32_IEEE 0 AppSwcVcu_CM_single_mps2 -10000.0 10000.0
 /begin AXIS_DESCR COM_AXIS NO_INPUT_QUANTITY AppSwcVcu_CM_single_kph 15 0.0 500.0 AXIS_PTS_REF ADSA_SprtIdxVehSpd_X_kph /end AXIS_DESCR
/end CHARACTERISTIC
/begin CHARACTERISTIC MDSA_MildDrvMap_mps2 "" CURVE 0x0000 /* @ECU_Address@MDSA_MildDrvMap_mps2@ */ Lookup1D_FLOAT32_IEEE 0 AppSwcVcu_CM_single_mps2 -10000.0 10000.0
 /begin AXIS_DESCR COM_AXIS NO_INPUT_QUANTITY AppSwcVcu_CM_single_kph 15 0.0 500.0 AXIS_PTS_REF ADSA_SprtIdxVehSpd_X_kph /end AXIS_DESCR
/end CHARACTERISTIC
/begin CHARACTERISTIC MDSA_SprtIdxHldINVTq_Nm "" CURVE 0x0000 /* @ECU_Address@MDSA_SprtIdxHldINVTq_Nm@ */ Lookup1D_FLOAT32_IEEE 0 AppSwcVcu_CM_single_Nm -10000.0 10000.0
 /begin AXIS_DESCR COM_AXIS NO_INPUT_QUANTITY AppSwcVcu_CM_single_kph 15 0.0 500.0 AXIS_PTS_REF ADSA_SprtIdxVehSpd_X_kph /end AXIS_DESCR
/end CHARACTERISTIC
/begin CHARACTERISTIC MRME_CHTCStdRmnMil_km "标准续航CHTC查表值" MAP 0x0000 /* @ECU_Address@MRME_CHTCStdRmnMil_km@ */ Lookup2D_FLOAT32_IEEE 0 AppSwcVcu_CM_single_km 0.0 1000.0
 /begin AXIS_DESCR COM_AXIS NO_INPUT_QUANTITY AppSwcVcu_CM_single_pct 12 0.0 1000.0 AXIS_PTS_REF ARME_BMSBatRptSOC_Y_pct /end AXIS_DESCR
 /begin AXIS_DESCR COM_AXIS NO_INPUT_QUANTITY AppSwcVcu_CM_uint8_Ah 10 0.0 255.0 AXIS_PTS_REF ASYS_HVBatPackTyp_X_Ah /end AXIS_DESCR
/end CHARACTERISTIC
/begin AXIS_PTS ARME_BMSBatRptSOC_Y_pct "标准续航查表RPTSOC值" 0x0000 /* @ECU_Address@ARME_BMSBatRptSOC_Y_pct@ */ NO_INPUT_QUANTITY Lookup2D_X_FLOAT32_IEEE 0 AppSwcVcu_CM_single_pct 12 0.0 1000.0 /end AXIS_PTS
/begin CHARACTERISTIC MIBS_BMSBatSOCExtrmLo_pct "动力电池SOC极低，禁止或退出IBS补电_versteckt" CURVE 0x0000 /* @ECU_Address@MIBS_BMSBatSOCExtrmLo_pct@ */ Lookup1D_FLOAT32_IEEE 0 AppSwcVcu_CM_single_pct 0.0 100.0
 /begin AXIS_DESCR COM_AXIS NO_INPUT_QUANTITY AppSwcVcu_CM_uint8_Ah 10 0.0 255.0 AXIS_PTS_REF ASYS_HVBatPackTyp_X_Ah /end AXIS_DESCR
/end CHARACTERISTIC
/begin CHARACTERISTIC MIBS_IBSEnMinSOC_pct "IBS补电动力电池SOC阈值_versteckt" CURVE 0x0000 /* @ECU_Address@MIBS_IBSEnMinSOC_pct@ */ Lookup1D_FLOAT32_IEEE 0 AppSwcVcu_CM_single_pct 0.0 100.0
 /begin AXIS_DESCR COM_AXIS NO_INPUT_QUANTITY AppSwcVcu_CM_uint8_Ah 10 0.0 255.0 AXIS_PTS_REF ASYS_HVBatPackTyp_X_Ah /end AXIS_DESCR
/end CHARACTERISTIC
/begin CHARACTERISTIC MIBS_MustChrgVolt_V "IBS兜底电压_versteckt" CURVE 0x0000 /* @ECU_Address@MIBS_MustChrgVolt_V@ */ Lookup1D_FLOAT32_IEEE 0 AppSwcVcu_CM_single_V 0.0 20.0
 /begin AXIS_DESCR COM_AXIS VIBS_EnvirTemp_C AppSwcVcu_CM_single_C 6 -40.0 215.0 AXIS_PTS_REF AIBS_EnvirTemp_X_C /end AXIS_DESCR
/end CHARACTERISTIC
/begin AXIS_PTS AIBS_EnvirTemp_X_C "环境温度（X轴）_versteckt" 0x0000 /* @ECU_Address@AIBS_EnvirTemp_X_C@ */ VIBS_EnvirTemp_C Lookup1D_X_FLOAT32_IEEE 0 AppSwcVcu_CM_single_C 6 -40.0 215.0 /end AXIS_PTS
/begin CHARACTERISTIC MIBS_NextRtcWupThr_min "IBS下一次RTC唤醒时间阈值_versteckt" MAP 0x0000 /* @ECU_Address@MIBS_NextRtcWupThr_min@ */ Lookup2D_UWORD 0 AppSwcVcu_CM_uint16_min 0.0 10000.0
 /begin AXIS_DESCR COM_AXIS VIBS_HwKL30_V AppSwcVcu_CM_single_V 10 -40.0 215.0 AXIS_PTS_REF AIBS_KL30_Y_V /end AXIS_DESCR
 /begin AXIS_DESCR COM_AXIS VIBS_EnvirTemp_C AppSwcVcu_CM_single_C 6 -40.0 215.0 AXIS_PTS_REF AIBS_EnvirTemp_X_C /end AXIS_DESCR
/end CHARACTERISTIC
/begin AXIS_PTS AIBS_KL30_Y_V "KL30电压（Y轴）_versteckt" 0x0000 /* @ECU_Address@AIBS_KL30_Y_V@ */ VIBS_HwKL30_V Lookup2D_X_FLOAT32_IEEE 0 AppSwcVcu_CM_single_V 10 -40.0 215.0 /end AXIS_PTS
/begin CHARACTERISTIC MIBS_WupChgTmThr2_min "IBS补电时间阈值2_versteckt" MAP 0x0000 /* @ECU_Address@MIBS_WupChgTmThr2_min@ */ Lookup2D_UWORD 0 AppSwcVcu_CM_uint16_min 0.0 10000.0
 /begin AXIS_DESCR COM_AXIS VIBS_HwKL30_V AppSwcVcu_CM_single_V 10 -40.0 215.0 AXIS_PTS_REF AIBS_KL30_Y_V /end AXIS_DESCR
 /begin AXIS_DESCR COM_AXIS VIBS_EnvirTemp_C AppSwcVcu_CM_single_C 6 -40.0 215.0 AXIS_PTS_REF AIBS_EnvirTemp_X_C /end AXIS_DESCR
/end CHARACTERISTIC
/begin CHARACTERISTIC MIPC_TireRadius_m "" CURVE 0x0000 /* @ECU_Address@MIPC_TireRadius_m@ */ Lookup1D_FLOAT32_IEEE 0 AppSwcVcu_CM_single_m 0.1 10.0
 /begin AXIS_DESCR COM_AXIS NO_INPUT_QUANTITY AppSwcVcu_CM_uint8_enum 6 0.0 255.0 AXIS_PTS_REF AIPC_TireRadius_X_enum /end AXIS_DESCR
/end CHARACTERISTIC
/begin AXIS_PTS AIPC_TireRadius_X_enum "" 0x0000 /* @ECU_Address@AIPC_TireRadius_X_enum@ */ NO_INPUT_QUANTITY Lookup1D_X_UBYTE 0 AppSwcVcu_CM_uint8_enum 6 0.0 255.0 /end AXIS_PTS
/begin CHARACTERISTIC MEMS_CellOverVoltBgn_mV "过压修正Begin值（优先使用过压闭环）" CURVE 0x0000 /* @ECU_Address@MEMS_CellOverVoltBgn_mV@ */ Lookup1D_FLOAT32_IEEE 0 AppSwcVcu_CM_single_mV 0.0 10000.0
 /begin AXIS_DESCR COM_AXIS NO_INPUT_QUANTITY AppSwcVcu_CM_uint8_Ah 10 0.0 255.0 AXIS_PTS_REF ASYS_HVBatPackTyp_X_Ah /end AXIS_DESCR
/end CHARACTERISTIC
/begin CHARACTERISTIC MEMS_CellOverVoltRng_mV "过压修正Range值（优先使用过压闭环）" CURVE 0x0000 /* @ECU_Address@MEMS_CellOverVoltRng_mV@ */ Lookup1D_FLOAT32_IEEE 0 AppSwcVcu_CM_single_mV 0.0 10000.0
 /begin AXIS_DESCR COM_AXIS NO_INPUT_QUANTITY AppSwcVcu_CM_uint8_Ah 10 0.0 255.0 AXIS_PTS_REF ASYS_HVBatPackTyp_X_Ah /end AXIS_DESCR
/end CHARACTERISTIC
/begin CHARACTERISTIC MEMS_CellUndrVoltBgn1_mV "低温放电欠压修正Begin值（优先使用电压闭环）" CURVE 0x0000 /* @ECU_Address@MEMS_CellUndrVoltBgn1_mV@ */ Lookup1D_FLOAT32_IEEE 0 AppSwcVcu_CM_single_mV 0.0 10000.0
 /begin AXIS_DESCR COM_AXIS NO_INPUT_QUANTITY AppSwcVcu_CM_uint8_Ah 10 0.0 255.0 AXIS_PTS_REF ASYS_HVBatPackTyp_X_Ah /end AXIS_DESCR
/end CHARACTERISTIC
/begin CHARACTERISTIC MEMS_CellUndrVoltBgn2_mV "常温放电欠压修正Begin值(优先使用电压闭环)" CURVE 0x0000 /* @ECU_Address@MEMS_CellUndrVoltBgn2_mV@ */ Lookup1D_FLOAT32_IEEE 0 AppSwcVcu_CM_single_mV 0.0 10000.0
 /begin AXIS_DESCR COM_AXIS NO_INPUT_QUANTITY AppSwcVcu_CM_uint8_Ah 10 0.0 255.0 AXIS_PTS_REF ASYS_HVBatPackTyp_X_Ah /end AXIS_DESCR
/end CHARACTERISTIC
/begin CHARACTERISTIC MEMS_CellUndrVoltRng1_mV "低温放电欠压修正Rang值（优先使用电压闭环）" CURVE 0x0000 /* @ECU_Address@MEMS_CellUndrVoltRng1_mV@ */ Lookup1D_FLOAT32_IEEE 0 AppSwcVcu_CM_single_mV 0.0 10000.0
 /begin AXIS_DESCR COM_AXIS NO_INPUT_QUANTITY AppSwcVcu_CM_uint8_Ah 10 0.0 255.0 AXIS_PTS_REF ASYS_HVBatPackTyp_X_Ah /end AXIS_DESCR
/end CHARACTERISTIC
/begin CHARACTERISTIC MEMS_CellUndrVoltRng2_mV "常温放电欠压修正Rang值(优先使用电压闭环)" CURVE 0x0000 /* @ECU_Address@MEMS_CellUndrVoltRng2_mV@ */ Lookup1D_FLOAT32_IEEE 0 AppSwcVcu_CM_single_mV 0.0 10000.0
 /begin AXIS_DESCR COM_AXIS NO_INPUT_QUANTITY AppSwcVcu_CM_uint8_Ah 10 0.0 255.0 AXIS_PTS_REF ASYS_HVBatPackTyp_X_Ah /end AXIS_DESCR
/end CHARACTERISTIC
/begin CHARACTERISTIC MEMS_CellTempLoThr_C "电芯常温和低温区分值" CURVE 0x0000 /* @ECU_Address@MEMS_CellTempLoThr_C@ */ Lookup1D_FLOAT32_IEEE 0 AppSwcVcu_CM_single_C -100.0 100.0
 /begin AXIS_DESCR COM_AXIS NO_INPUT_QUANTITY AppSwcVcu_CM_uint8_Ah 10 0.0 255.0 AXIS_PTS_REF ASYS_HVBatPackTyp_X_Ah /end AXIS_DESCR
/end CHARACTERISTIC
/begin CHARACTERISTIC MDAG_CellTempLoThr_C "区分电芯温度高低的分界值" CURVE 0x0000 /* @ECU_Address@MDAG_CellTempLoThr_C@ */ Lookup1D_WORD 0 AppSwcVcu_CM_int16_C -100.0 100.0
 /begin AXIS_DESCR COM_AXIS NO_INPUT_QUANTITY AppSwcVcu_CM_uint8_Ah 10 0.0 255.0 AXIS_PTS_REF ASYS_HVBatPackTyp_X_Ah /end AXIS_DESCR
/end CHARACTERISTIC
/begin CHARACTERISTIC MDAG_CellUndrVoltThr1_mV "BMSCell欠压故障的电压门槛_低温" CURVE 0x0000 /* @ECU_Address@MDAG_CellUndrVoltThr1_mV@ */ Lookup1D_UWORD 0 AppSwcVcu_CM_uint16_mV 0.0 65535.0
 /begin AXIS_DESCR COM_AXIS NO_INPUT_QUANTITY AppSwcVcu_CM_uint8_Ah 10 0.0 255.0 AXIS_PTS_REF ASYS_HVBatPackTyp_X_Ah /end AXIS_DESCR
/end CHARACTERISTIC
/begin CHARACTERISTIC MDAG_CellUndrVoltThr2_mV "BMSCell欠压故障的电压门槛_高温" CURVE 0x0000 /* @ECU_Address@MDAG_CellUndrVoltThr2_mV@ */ Lookup1D_UWORD 0 AppSwcVcu_CM_uint16_mV 0.0 65535.0
 /begin AXIS_DESCR COM_AXIS NO_INPUT_QUANTITY AppSwcVcu_CM_uint8_Ah 10 0.0 255.0 AXIS_PTS_REF ASYS_HVBatPackTyp_X_Ah /end AXIS_DESCR
/end CHARACTERISTIC
/begin CHARACTERISTIC KCPT_GenMaxTqDecRate_Nmps "" VALUE 0x0000 /* @ECU_Address@KCPT_GenMaxTqDecRate_Nmps@ */ Scalar_FLOAT32_IEEE 0 AppSwcVcu_CM_single_Nmps -100000.0 0.0 /end CHARACTERISTIC
/begin CHARACTERISTIC KCPT_GenMaxTqIncRate_Nmps "" VALUE 0x0000 /* @ECU_Address@KCPT_GenMaxTqIncRate_Nmps@ */ Scalar_FLOAT32_IEEE 0 AppSwcVcu_CM_single_Nmps 0.0 100000.0 /end CHARACTERISTIC
/begin CHARACTERISTIC KCPT_MotMaxTqDecRate_Nmps "" VALUE 0x0000 /* @ECU_Address@KCPT_MotMaxTqDecRate_Nmps@ */ Scalar_FLOAT32_IEEE 0 AppSwcVcu_CM_single_Nmps -100000.0 0.0 /end CHARACTERISTIC
/begin CHARACTERISTIC KCPT_MotMaxTqFiltAchvd_Nm "" VALUE 0x0000 /* @ECU_Address@KCPT_MotMaxTqFiltAchvd_Nm@ */ Scalar_FLOAT32_IEEE 0 AppSwcVcu_CM_single_Nm -10000.0 10000.0 /end CHARACTERISTIC
/begin CHARACTERISTIC KCPT_MotMaxTqIncRate_Nmps "" VALUE 0x0000 /* @ECU_Address@KCPT_MotMaxTqIncRate_Nmps@ */ Scalar_FLOAT32_IEEE 0 AppSwcVcu_CM_single_Nmps 0.0 100000.0 /end CHARACTERISTIC
/begin CHARACTERISTIC KCPT_MotorDrgMaxTqAllwd_Nm "" VALUE 0x0000 /* @ECU_Address@KCPT_MotorDrgMaxTqAllwd_Nm@ */ Scalar_FLOAT32_IEEE 0 AppSwcVcu_CM_single_Nm -10000.0 0.0 /end CHARACTERISTIC
/begin CHARACTERISTIC KCPT_MotorMaxTqFiltCoeff_c "" VALUE 0x0000 /* @ECU_Address@KCPT_MotorMaxTqFiltCoeff_c@ */ Scalar_FLOAT32_IEEE 0 AppSwcVcu_CM_single_rat 0.0 1.0 /end CHARACTERISTIC
/begin CHARACTERISTIC KCPT_MotorRvrsSpdOffD_rpm "" VALUE 0x0000 /* @ECU_Address@KCPT_MotorRvrsSpdOffD_rpm@ */ Scalar_FLOAT32_IEEE 0 AppSwcVcu_CM_single_rpm -10000.0 10000.0 /end CHARACTERISTIC
/begin CHARACTERISTIC KCPT_MotorRvrsSpdOffR_rpm "" VALUE 0x0000 /* @ECU_Address@KCPT_MotorRvrsSpdOffR_rpm@ */ Scalar_FLOAT32_IEEE 0 AppSwcVcu_CM_single_rpm -10000.0 10000.0 /end CHARACTERISTIC
/begin CHARACTERISTIC KCPT_MotorRvrsSpdOnD_rpm "" VALUE 0x0000 /* @ECU_Address@KCPT_MotorRvrsSpdOnD_rpm@ */ Scalar_FLOAT32_IEEE 0 AppSwcVcu_CM_single_rpm -10000.0 10000.0 /end CHARACTERISTIC
/begin CHARACTERISTIC KCPT_MotorRvrsSpdOnR_rpm "" VALUE 0x0000 /* @ECU_Address@KCPT_MotorRvrsSpdOnR_rpm@ */ Scalar_FLOAT32_IEEE 0 AppSwcVcu_CM_single_rpm -10000.0 10000.0 /end CHARACTERISTIC
/begin CHARACTERISTIC KDAC_BrkTq2PresrCvrtCoeff_c "" VALUE 0x0000 /* @ECU_Address@KDAC_BrkTq2PresrCvrtCoeff_c@ */ Scalar_FLOAT32_IEEE 0 AppSwcVcu_CM_single_c 0.0 100000.0 /end CHARACTERISTIC
/begin CHARACTERISTIC KDAG_ACChrgStFailFailTm_s "ACChargeStateFail故障确认时间" VALUE 0x0000 /* @ECU_Address@KDAG_ACChrgStFailFailTm_s@ */ Scalar_FLOAT32_IEEE 0 AppSwcVcu_CM_single_s 0.0 3600.0 /end CHARACTERISTIC
/begin CHARACTERISTIC KDAG_ACDchaBMSPwrLoFailTm_s "AC放电BMS功率低确认时间" VALUE 0x0000 /* @ECU_Address@KDAG_ACDchaBMSPwrLoFailTm_s@ */ Scalar_FLOAT32_IEEE 0 AppSwcVcu_CM_single_s 0.0 3600.0 /end CHARACTERISTIC
/begin CHARACTERISTIC KDAG_ACDchaBMSPwrLo_A "AC放电BMS功率低电流能力门槛" VALUE 0x0000 /* @ECU_Address@KDAG_ACDchaBMSPwrLo_A@ */ Scalar_FLOAT32_IEEE 0 AppSwcVcu_CM_single_A 0.0 1000.0 /end CHARACTERISTIC
/begin CHARACTERISTIC KDAG_ACDchaBMSSOCLoFailTm_s "AC放电BMSSOC低确认时间" VALUE 0x0000 /* @ECU_Address@KDAG_ACDchaBMSSOCLoFailTm_s@ */ Scalar_FLOAT32_IEEE 0 AppSwcVcu_CM_single_s 0.0 3600.0 /end CHARACTERISTIC
/begin CHARACTERISTIC KDAG_ACDchaBMSSOCLo_pct "AC放电BMSSOC低触发门槛" VALUE 0x0000 /* @ECU_Address@KDAG_ACDchaBMSSOCLo_pct@ */ Scalar_FLOAT32_IEEE 0 AppSwcVcu_CM_single_pct 0.0 100.0 /end CHARACTERISTIC
/begin CHARACTERISTIC KDAG_ACDchaOverPwrFailTm_s "AC放电功率超限确认时间" VALUE 0x0000 /* @ECU_Address@KDAG_ACDchaOverPwrFailTm_s@ */ Scalar_FLOAT32_IEEE 0 AppSwcVcu_CM_single_s 0.0 3600.0 /end CHARACTERISTIC
/begin CHARACTERISTIC KDAG_ACSCmdTmOutFailTm_s "ACSCmd超时故障确认时间" VALUE 0x0000 /* @ECU_Address@KDAG_ACSCmdTmOutFailTm_s@ */ Scalar_FLOAT32_IEEE 0 AppSwcVcu_CM_single_s 0.0 3600.0 /end CHARACTERISTIC
/begin CHARACTERISTIC KDAG_BMSEmgcySdnFailTm_s "BMS紧急下电故障确认时间" VALUE 0x0000 /* @ECU_Address@KDAG_BMSEmgcySdnFailTm_s@ */ Scalar_FLOAT32_IEEE 0 AppSwcVcu_CM_single_s 0.0 3600.0 /end CHARACTERISTIC
/begin CHARACTERISTIC KDAG_BMSSOCLoFailTm_s "BMSSOC低故障确认时间" VALUE 0x0000 /* @ECU_Address@KDAG_BMSSOCLoFailTm_s@ */ Scalar_FLOAT32_IEEE 0 AppSwcVcu_CM_single_s 0.0 3600.0 /end CHARACTERISTIC
/begin CHARACTERISTIC KDAG_BMSSysFailFailTm_s "BMSFail故障确认时间" VALUE 0x0000 /* @ECU_Address@KDAG_BMSSysFailFailTm_s@ */ Scalar_FLOAT32_IEEE 0 AppSwcVcu_CM_single_s 0.0 3600.0 /end CHARACTERISTIC
/begin CHARACTERISTIC KDAG_BMSUndrVoltFailTm_s "BMSPack欠压故障确认时间" VALUE 0x0000 /* @ECU_Address@KDAG_BMSUndrVoltFailTm_s@ */ Scalar_FLOAT32_IEEE 0 AppSwcVcu_CM_single_s 0.0 3600.0 /end CHARACTERISTIC
/begin CHARACTERISTIC KDAG_CellUndrVoltFailTm_s "BMSCell欠压故障确认时间" VALUE 0x0000 /* @ECU_Address@KDAG_CellUndrVoltFailTm_s@ */ Scalar_FLOAT32_IEEE 0 AppSwcVcu_CM_single_s 0.0 3600.0 /end CHARACTERISTIC
/begin CHARACTERISTIC KDAG_DCCCmdTmOutFailTm_s "DCDC模式指令响应超时故障确认时间" VALUE 0x0000 /* @ECU_Address@KDAG_DCCCmdTmOutFailTm_s@ */ Scalar_FLOAT32_IEEE 0 AppSwcVcu_CM_single_s 0.0 3600.0 /end CHARACTERISTIC
/begin CHARACTERISTIC KDAG_DCCInVoltLoFailTm_s "DCDC输入电压低故障确认时间" VALUE 0x0000 /* @ECU_Address@KDAG_DCCInVoltLoFailTm_s@ */ Scalar_FLOAT32_IEEE 0 AppSwcVcu_CM_single_s 0.0 3600.0 /end CHARACTERISTIC
/begin CHARACTERISTIC KDAG_DCCModeFltFailTm_s "DCDCModeFault故障确认时间" VALUE 0x0000 /* @ECU_Address@KDAG_DCCModeFltFailTm_s@ */ Scalar_FLOAT32_IEEE 0 AppSwcVcu_CM_single_s 0.0 3600.0 /end CHARACTERISTIC
/begin CHARACTERISTIC KDAG_DCCSysFailFailTm_s "DCDCFail故障确认时间" VALUE 0x0000 /* @ECU_Address@KDAG_DCCSysFailFailTm_s@ */ Scalar_FLOAT32_IEEE 0 AppSwcVcu_CM_single_s 0.0 3600.0 /end CHARACTERISTIC
/begin CHARACTERISTIC KDAG_DCCSysFailLvl3FailTm_s "DCDCFaillevel3故障确认时间" VALUE 0x0000 /* @ECU_Address@KDAG_DCCSysFailLvl3FailTm_s@ */ Scalar_FLOAT32_IEEE 0 AppSwcVcu_CM_single_s 0.0 3600.0 /end CHARACTERISTIC
/begin CHARACTERISTIC KDAG_DCSChrgReqFailTm_s "DCSChargeRequest故障确认时间" VALUE 0x0000 /* @ECU_Address@KDAG_DCSChrgReqFailTm_s@ */ Scalar_FLOAT32_IEEE 0 AppSwcVcu_CM_single_s 0.0 3600.0 /end CHARACTERISTIC
/begin CHARACTERISTIC KDAG_DCSCmdTmOutFailTm_s "DCSCmd超时故障确认时间" VALUE 0x0000 /* @ECU_Address@KDAG_DCSCmdTmOutFailTm_s@ */ Scalar_FLOAT32_IEEE 0 AppSwcVcu_CM_single_s 0.0 3600.0 /end CHARACTERISTIC
/begin CHARACTERISTIC KDAG_DCSFailStaFailTm_s "DCSFailState故障确认时间" VALUE 0x0000 /* @ECU_Address@KDAG_DCSFailStaFailTm_s@ */ Scalar_FLOAT32_IEEE 0 AppSwcVcu_CM_single_s 0.0 3600.0 /end CHARACTERISTIC
/begin CHARACTERISTIC KDAG_DCSInletConnectFailTm_s "DCS插枪状态故障确认时间" VALUE 0x0000 /* @ECU_Address@KDAG_DCSInletConnectFailTm_s@ */ Scalar_FLOAT32_IEEE 0 AppSwcVcu_CM_single_s 0.0 3600.0 /end CHARACTERISTIC
/begin CHARACTERISTIC KDAG_DCSModeFailFailTm_s "DCSModeFail故障确认时间" VALUE 0x0000 /* @ECU_Address@KDAG_DCSModeFailFailTm_s@ */ Scalar_FLOAT32_IEEE 0 AppSwcVcu_CM_single_s 0.0 3600.0 /end CHARACTERISTIC
/begin CHARACTERISTIC KDAG_EHBFltFailTm_s "EHB故障确认时间" VALUE 0x0000 /* @ECU_Address@KDAG_EHBFltFailTm_s@ */ Scalar_FLOAT32_IEEE 0 AppSwcVcu_CM_single_s 0.0 3600.0 /end CHARACTERISTIC
/begin CHARACTERISTIC KDAG_ESCFltFailTm_s "ESC故障确认时间" VALUE 0x0000 /* @ECU_Address@KDAG_ESCFltFailTm_s@ */ Scalar_FLOAT32_IEEE 0 AppSwcVcu_CM_single_s 0.0 3600.0 /end CHARACTERISTIC
/begin CHARACTERISTIC KDAG_ESCVehSpdInvldFailTm_s "车速失效确认时间" VALUE 0x0000 /* @ECU_Address@KDAG_ESCVehSpdInvldFailTm_s@ */ Scalar_FLOAT32_IEEE 0 AppSwcVcu_CM_single_s 0.0 3600.0 /end CHARACTERISTIC
/begin CHARACTERISTIC KDAG_HVAccAcptBMSVoltFac_c "高压部件电压与电池电压比值的可接受比例系数" VALUE 0x0000 /* @ECU_Address@KDAG_HVAccAcptBMSVoltFac_c@ */ Scalar_FLOAT32_IEEE 0 AppSwcVcu_CM_single_c 0.0 1.0 /end CHARACTERISTIC
/begin CHARACTERISTIC KDAG_HVIsoResistLoFailTm_s "高压电池绝缘故障阻值低确认时间" VALUE 0x0000 /* @ECU_Address@KDAG_HVIsoResistLoFailTm_s@ */ Scalar_FLOAT32_IEEE 0 AppSwcVcu_CM_single_s 0.0 3600.0 /end CHARACTERISTIC
/begin CHARACTERISTIC KDAG_HVIsoResistLoPassTm_s "高压电池绝缘故障阻值低恢复时间" VALUE 0x0000 /* @ECU_Address@KDAG_HVIsoResistLoPassTm_s@ */ Scalar_FLOAT32_IEEE 0 AppSwcVcu_CM_single_s 0.0 3600.0 /end CHARACTERISTIC
/begin CHARACTERISTIC KDAG_HVIsoResistLoThr_kOhm "高压电池绝缘故障阻值门槛" VALUE 0x0000 /* @ECU_Address@KDAG_HVIsoResistLoThr_kOhm@ */ Scalar_FLOAT32_IEEE 0 AppSwcVcu_CM_single_kOhm 0.0 100000.0 /end CHARACTERISTIC
/begin CHARACTERISTIC KDAG_INVFltFailTm_s "INVFault故障确认时间" VALUE 0x0000 /* @ECU_Address@KDAG_INVFltFailTm_s@ */ Scalar_FLOAT32_IEEE 0 AppSwcVcu_CM_single_s 0.0 3600.0 /end CHARACTERISTIC
/begin CHARACTERISTIC KDAG_INVInVoltLoFailTm_s "INV输入电压低故障确认时间" VALUE 0x0000 /* @ECU_Address@KDAG_INVInVoltLoFailTm_s@ */ Scalar_FLOAT32_IEEE 0 AppSwcVcu_CM_single_s 0.0 3600.0 /end CHARACTERISTIC
/begin CHARACTERISTIC KDAG_INVRunCmdRespFailTm_s "INVRun指令响应超时故障确认时间" VALUE 0x0000 /* @ECU_Address@KDAG_INVRunCmdRespFailTm_s@ */ Scalar_FLOAT32_IEEE 0 AppSwcVcu_CM_single_s 0.0 3600.0 /end CHARACTERISTIC
/begin CHARACTERISTIC KDAG_OBCChrgReqFailTm_s "OBCChargeRequest故障确认时间" VALUE 0x0000 /* @ECU_Address@KDAG_OBCChrgReqFailTm_s@ */ Scalar_FLOAT32_IEEE 0 AppSwcVcu_CM_single_s 0.0 3600.0 /end CHARACTERISTIC
/begin CHARACTERISTIC KDAG_OBCInletConnectFailTm_s "OBC插枪状态故障确认时间" VALUE 0x0000 /* @ECU_Address@KDAG_OBCInletConnectFailTm_s@ */ Scalar_FLOAT32_IEEE 0 AppSwcVcu_CM_single_s 0.0 3600.0 /end CHARACTERISTIC
/begin CHARACTERISTIC KDAG_OBCModeMsmtchFailTm_s "OBC模式不匹配故障确认时间" VALUE 0x0000 /* @ECU_Address@KDAG_OBCModeMsmtchFailTm_s@ */ Scalar_FLOAT32_IEEE 0 AppSwcVcu_CM_single_s 0.0 3600.0 /end CHARACTERISTIC
/begin CHARACTERISTIC KDAG_OBCS2StatFailTm_s "OBCS2连接超时故障确认时间" VALUE 0x0000 /* @ECU_Address@KDAG_OBCS2StatFailTm_s@ */ Scalar_FLOAT32_IEEE 0 AppSwcVcu_CM_single_s 0.0 3600.0 /end CHARACTERISTIC
/begin CHARACTERISTIC KDAG_OBCSysFailFailTm_s "OBCFail故障确认时间" VALUE 0x0000 /* @ECU_Address@KDAG_OBCSysFailFailTm_s@ */ Scalar_FLOAT32_IEEE 0 AppSwcVcu_CM_single_s 0.0 3600.0 /end CHARACTERISTIC
/begin CHARACTERISTIC KDAG_SysPwrModeInvldFailTm_s "PowerMode失效确认时间" VALUE 0x0000 /* @ECU_Address@KDAG_SysPwrModeInvldFailTm_s@ */ Scalar_FLOAT32_IEEE 0 AppSwcVcu_CM_single_s 0.0 3600.0 /end CHARACTERISTIC
/begin CHARACTERISTIC KDAG_TMSFailLvl3FailTm_s "TMSRFailLevel3故障确认时间" VALUE 0x0000 /* @ECU_Address@KDAG_TMSFailLvl3FailTm_s@ */ Scalar_FLOAT32_IEEE 0 AppSwcVcu_CM_single_s 0.0 3600.0 /end CHARACTERISTIC
/begin CHARACTERISTIC KDAG_VehSpdLo_kph "低车速门槛，用于故障升级" VALUE 0x0000 /* @ECU_Address@KDAG_VehSpdLo_kph@ */ Scalar_FLOAT32_IEEE 0 AppSwcVcu_CM_single_kph 0.0 300.0 /end CHARACTERISTIC
/begin CHARACTERISTIC KDAG_VehStandStillSpd_kph "驻车清除故障的车速门槛_需基本绝对停止" VALUE 0x0000 /* @ECU_Address@KDAG_VehStandStillSpd_kph@ */ Scalar_FLOAT32_IEEE 0 AppSwcVcu_CM_single_kph 0.0 300.0 /end CHARACTERISTIC
/begin CHARACTERISTIC KDAG_WakeUpDlyTm_s "唤醒源拉高的信号延迟时间_即诊断开始的延迟时间" VALUE 0x0000 /* @ECU_Address@KDAG_WakeUpDlyTm_s@ */ Scalar_FLOAT32_IEEE 0 AppSwcVcu_CM_single_s -10.0 3600.0 /end CHARACTERISTIC
/begin CHARACTERISTIC KDSA_AcceltnIdxAvgInit_pct "" VALUE 0x0000 /* @ECU_Address@KDSA_AcceltnIdxAvgInit_pct@ */ Scalar_FLOAT32_IEEE 0 AppSwcVcu_CM_single_pct 0.0 100.0 /end CHARACTERISTIC
/begin CHARACTERISTIC KDSA_AcceltnIdxDecRate_pctps "" VALUE 0x0000 /* @ECU_Address@KDSA_AcceltnIdxDecRate_pctps@ */ Scalar_FLOAT32_IEEE 0 AppSwcVcu_CM_single_pctps -100000.0 0.0 /end CHARACTERISTIC
/begin CHARACTERISTIC KDSA_AcceltnIdxIncRate_pctps "" VALUE 0x0000 /* @ECU_Address@KDSA_AcceltnIdxIncRate_pctps@ */ Scalar_FLOAT32_IEEE 0 AppSwcVcu_CM_single_pctps 0.0 100000.0 /end CHARACTERISTIC
/begin CHARACTERISTIC KDSA_BrkPedPstnAvgInit_pct "" VALUE 0x0000 /* @ECU_Address@KDSA_BrkPedPstnAvgInit_pct@ */ Scalar_FLOAT32_IEEE 0 AppSwcVcu_CM_single_pct 0.0 100.0 /end CHARACTERISTIC
/begin CHARACTERISTIC KDSA_BrkPedPstnDecRate_pctps "" VALUE 0x0000 /* @ECU_Address@KDSA_BrkPedPstnDecRate_pctps@ */ Scalar_FLOAT32_IEEE 0 AppSwcVcu_CM_single_pctps -100000.0 0.0 /end CHARACTERISTIC
/begin CHARACTERISTIC KDSA_BrkPedPstnIncRate_pctps "" VALUE 0x0000 /* @ECU_Address@KDSA_BrkPedPstnIncRate_pctps@ */ Scalar_FLOAT32_IEEE 0 AppSwcVcu_CM_single_pctps 0.0 100000.0 /end CHARACTERISTIC
/begin CHARACTERISTIC KDSA_DrvSprtIdxMax_pct "" VALUE 0x0000 /* @ECU_Address@KDSA_DrvSprtIdxMax_pct@ */ Scalar_FLOAT32_IEEE 0 AppSwcVcu_CM_single_pct 0.0 100.0 /end CHARACTERISTIC
/begin CHARACTERISTIC KDSA_DrvSprtIdxMin_pct "" VALUE 0x0000 /* @ECU_Address@KDSA_DrvSprtIdxMin_pct@ */ Scalar_FLOAT32_IEEE 0 AppSwcVcu_CM_single_pct 0.0 100.0 /end CHARACTERISTIC
/begin CHARACTERISTIC KDSA_SprtIdxBrkPedRstSpd_kph "" VALUE 0x0000 /* @ECU_Address@KDSA_SprtIdxBrkPedRstSpd_kph@ */ Scalar_FLOAT32_IEEE 0 AppSwcVcu_CM_single_kph -100.0 500.0 /end CHARACTERISTIC
/begin CHARACTERISTIC KDSA_SprtIdxBrkPedRstTm_s "" VALUE 0x0000 /* @ECU_Address@KDSA_SprtIdxBrkPedRstTm_s@ */ Scalar_FLOAT32_IEEE 0 AppSwcVcu_CM_single_s 0.0 100000.0 /end CHARACTERISTIC
/begin CHARACTERISTIC KDSA_SprtIdxBrkPedRstVal_pct "" VALUE 0x0000 /* @ECU_Address@KDSA_SprtIdxBrkPedRstVal_pct@ */ Scalar_FLOAT32_IEEE 0 AppSwcVcu_CM_single_pct -100.0 150.0 /end CHARACTERISTIC
/begin CHARACTERISTIC KDSA_SprtIdxHldAccPed4Acc_pct "" VALUE 0x0000 /* @ECU_Address@KDSA_SprtIdxHldAccPed4Acc_pct@ */ Scalar_FLOAT32_IEEE 0 AppSwcVcu_CM_single_pct -100.0 100.0 /end CHARACTERISTIC
/begin CHARACTERISTIC KDSA_SprtIdxHldAccPed4Brk_pct "" VALUE 0x0000 /* @ECU_Address@KDSA_SprtIdxHldAccPed4Brk_pct@ */ Scalar_FLOAT32_IEEE 0 AppSwcVcu_CM_single_pct -100.0 500.0 /end CHARACTERISTIC
/begin CHARACTERISTIC KDSA_SprtIdxHldAccPedRlsDlyTm4Brk_s "" VALUE 0x0000 /* @ECU_Address@KDSA_SprtIdxHldAccPedRlsDlyTm4Brk_s@ */ Scalar_FLOAT32_IEEE 0 AppSwcVcu_CM_single_s 0.0 100000.0 /end CHARACTERISTIC
/begin CHARACTERISTIC KDSA_SprtIdxHldAcceltn4Acc_mps2 "" VALUE 0x0000 /* @ECU_Address@KDSA_SprtIdxHldAcceltn4Acc_mps2@ */ Scalar_FLOAT32_IEEE 0 AppSwcVcu_CM_single_mps2 -10000.0 10000.0 /end CHARACTERISTIC
/begin CHARACTERISTIC KDSA_SprtIdxHldDchaPwr_kW "" VALUE 0x0000 /* @ECU_Address@KDSA_SprtIdxHldDchaPwr_kW@ */ Scalar_FLOAT32_IEEE 0 AppSwcVcu_CM_single_kW -10000.0 10000.0 /end CHARACTERISTIC
/begin CHARACTERISTIC KDSA_SprtIdxHldVehSpd4Acc_kph "" VALUE 0x0000 /* @ECU_Address@KDSA_SprtIdxHldVehSpd4Acc_kph@ */ Scalar_FLOAT32_IEEE 0 AppSwcVcu_CM_single_kph -100.0 500.0 /end CHARACTERISTIC
/begin CHARACTERISTIC KDSA_SprtIdxHldVehSpd4Brk_kph "" VALUE 0x0000 /* @ECU_Address@KDSA_SprtIdxHldVehSpd4Brk_kph@ */ Scalar_FLOAT32_IEEE 0 AppSwcVcu_CM_single_kph -100.0 100.0 /end CHARACTERISTIC
/begin CHARACTERISTIC KDSA_SprtIdxHldWhlTq4Acc_Nm "" VALUE 0x0000 /* @ECU_Address@KDSA_SprtIdxHldWhlTq4Acc_Nm@ */ Scalar_FLOAT32_IEEE 0 AppSwcVcu_CM_single_Nm -10000.0 10000.0 /end CHARACTERISTIC
/begin CHARACTERISTIC KEMS_AccPwrDecFiltCoeff_c "放电附件功率滤波系数（只滤下降）" VALUE 0x0000 /* @ECU_Address@KEMS_AccPwrDecFiltCoeff_c@ */ Scalar_FLOAT32_IEEE 0 AppSwcVcu_CM_single_c 0.0 1.0 /end CHARACTERISTIC
/begin CHARACTERISTIC KEMS_AccPwrIncFiltCoeff_c "充电附件功率滤波系数（只滤上降）" VALUE 0x0000 /* @ECU_Address@KEMS_AccPwrIncFiltCoeff_c@ */ Scalar_FLOAT32_IEEE 0 AppSwcVcu_CM_single_c 0.0 1.0 /end CHARACTERISTIC
/begin CHARACTERISTIC KEMS_CellTempSynDecRate_Cps "电芯温度下降斜率" VALUE 0x0000 /* @ECU_Address@KEMS_CellTempSynDecRate_Cps@ */ Scalar_FLOAT32_IEEE 0 AppSwcVcu_CM_single_Cps -10000.0 0.0 /end CHARACTERISTIC
/begin CHARACTERISTIC KEMS_CellTempSynIncRate_Cps "电芯温度上升斜率" VALUE 0x0000 /* @ECU_Address@KEMS_CellTempSynIncRate_Cps@ */ Scalar_FLOAT32_IEEE 0 AppSwcVcu_CM_single_Cps 0.0 10000.0 /end CHARACTERISTIC
/begin CHARACTERISTIC KEMS_ChrgFbActvDlyTm_s "充电功率闭环退出延迟时间" VALUE 0x0000 /* @ECU_Address@KEMS_ChrgFbActvDlyTm_s@ */ Scalar_FLOAT32_IEEE 0 AppSwcVcu_CM_single_s 0.0 1000.0 /end CHARACTERISTIC
/begin CHARACTERISTIC KEMS_ChrgPwr2MotRawFiltCoeff_c "充电总功率滤波系数（只滤下降）" VALUE 0x0000 /* @ECU_Address@KEMS_ChrgPwr2MotRawFiltCoeff_c@ */ Scalar_FLOAT32_IEEE 0 AppSwcVcu_CM_single_c 0.0 1.0 /end CHARACTERISTIC
/begin CHARACTERISTIC KEMS_ChrgPwrFbFiltCoeff_c "充电功率闭环滤波系数" VALUE 0x0000 /* @ECU_Address@KEMS_ChrgPwrFbFiltCoeff_c@ */ Scalar_FLOAT32_IEEE 0 AppSwcVcu_CM_single_c 0.0 1.0 /end CHARACTERISTIC
/begin CHARACTERISTIC KEMS_ChrgPwrFbOff_kW "充电功率闭环进入阀值" VALUE 0x0000 /* @ECU_Address@KEMS_ChrgPwrFbOff_kW@ */ Scalar_FLOAT32_IEEE 0 AppSwcVcu_CM_single_kW -1000.0 1000.0 /end CHARACTERISTIC
/begin CHARACTERISTIC KEMS_ChrgPwrFbOn_kW "充电功率闭环退出阀值" VALUE 0x0000 /* @ECU_Address@KEMS_ChrgPwrFbOn_kW@ */ Scalar_FLOAT32_IEEE 0 AppSwcVcu_CM_single_kW -1000.0 1000.0 /end CHARACTERISTIC
/begin CHARACTERISTIC KEMS_DCCSurgePwr_kW "DCC涌动功率" VALUE 0x0000 /* @ECU_Address@KEMS_DCCSurgePwr_kW@ */ Scalar_FLOAT32_IEEE 0 AppSwcVcu_CM_single_kW 0.0 1000.0 /end CHARACTERISTIC
/begin CHARACTERISTIC KEMS_DchaFbActvDlyTm_s "放电功率闭环退出延迟时间" VALUE 0x0000 /* @ECU_Address@KEMS_DchaFbActvDlyTm_s@ */ Scalar_FLOAT32_IEEE 0 AppSwcVcu_CM_single_s 0.0 1000.0 /end CHARACTERISTIC
/begin CHARACTERISTIC KEMS_DchaPwr2MotRawFiltCoeff_c "放电总功率滤波系数（只滤上升）" VALUE 0x0000 /* @ECU_Address@KEMS_DchaPwr2MotRawFiltCoeff_c@ */ Scalar_FLOAT32_IEEE 0 AppSwcVcu_CM_single_c 0.0 1.0 /end CHARACTERISTIC
/begin CHARACTERISTIC KEMS_DchaPwrFbFiltCoeff_c "放电功率闭环滤波系数" VALUE 0x0000 /* @ECU_Address@KEMS_DchaPwrFbFiltCoeff_c@ */ Scalar_FLOAT32_IEEE 0 AppSwcVcu_CM_single_c 0.0 1.0 /end CHARACTERISTIC
/begin CHARACTERISTIC KEMS_DchaPwrFbOff_kW "放电功率闭环退出阀值" VALUE 0x0000 /* @ECU_Address@KEMS_DchaPwrFbOff_kW@ */ Scalar_FLOAT32_IEEE 0 AppSwcVcu_CM_single_kW -1000.0 1000.0 /end CHARACTERISTIC
/begin CHARACTERISTIC KEMS_DchaPwrFbOn_kW "放电功率闭环进入阀值" VALUE 0x0000 /* @ECU_Address@KEMS_DchaPwrFbOn_kW@ */ Scalar_FLOAT32_IEEE 0 AppSwcVcu_CM_single_kW -1000.0 1000.0 /end CHARACTERISTIC
/begin CHARACTERISTIC KEMS_HVBatActCurrExcdThr_A "实际电流异常超限值" VALUE 0x0000 /* @ECU_Address@KEMS_HVBatActCurrExcdThr_A@ */ Scalar_FLOAT32_IEEE 0 AppSwcVcu_CM_single_A -10000.0 10000.0 /end CHARACTERISTIC
/begin CHARACTERISTIC KEMS_HVBatActCurrExcdVal_A "实际电流异常超限替代值（驱动超限）" VALUE 0x0000 /* @ECU_Address@KEMS_HVBatActCurrExcdVal_A@ */ Scalar_FLOAT32_IEEE 0 AppSwcVcu_CM_single_A -10000.0 10000.0 /end CHARACTERISTIC
/begin CHARACTERISTIC KEMS_HVBatCurrBelowConChrgDlyTm_s "Con持续回收切Ins瞬时回收" VALUE 0x0000 /* @ECU_Address@KEMS_HVBatCurrBelowConChrgDlyTm_s@ */ Scalar_FLOAT32_IEEE 0 AppSwcVcu_CM_single_s 0.0 6000.0 /end CHARACTERISTIC
/begin CHARACTERISTIC KEMS_HVBatCurrBelowConDlyTm_s "Con持续切Ins瞬时" VALUE 0x0000 /* @ECU_Address@KEMS_HVBatCurrBelowConDlyTm_s@ */ Scalar_FLOAT32_IEEE 0 AppSwcVcu_CM_single_s 0.0 6000.0 /end CHARACTERISTIC
/begin CHARACTERISTIC KEMS_HVBatCurrOverConChrgDlyTm_s "Ins瞬时回收切Con持续回收" VALUE 0x0000 /* @ECU_Address@KEMS_HVBatCurrOverConChrgDlyTm_s@ */ Scalar_FLOAT32_IEEE 0 AppSwcVcu_CM_single_s 0.0 6000.0 /end CHARACTERISTIC
/begin CHARACTERISTIC KEMS_HVBatCurrOverConDlyTm_s "Ins瞬时切Con持续" VALUE 0x0000 /* @ECU_Address@KEMS_HVBatCurrOverConDlyTm_s@ */ Scalar_FLOAT32_IEEE 0 AppSwcVcu_CM_single_s 0.0 6000.0 /end CHARACTERISTIC
/begin CHARACTERISTIC KEMS_MaxChrgCurDecRate_Aps "最大充电电流下降斜率" VALUE 0x0000 /* @ECU_Address@KEMS_MaxChrgCurDecRate_Aps@ */ Scalar_FLOAT32_IEEE 0 AppSwcVcu_CM_single_Aps -100000.0 0.0 /end CHARACTERISTIC
/begin CHARACTERISTIC KEMS_MaxChrgCurFiltAchvd_A "最大充电电流滤波结束值" VALUE 0x0000 /* @ECU_Address@KEMS_MaxChrgCurFiltAchvd_A@ */ Scalar_FLOAT32_IEEE 0 AppSwcVcu_CM_single_A 0.0 1000.0 /end CHARACTERISTIC
/begin CHARACTERISTIC KEMS_MaxChrgCurIncRate_Aps "最大充电电流上升斜率" VALUE 0x0000 /* @ECU_Address@KEMS_MaxChrgCurIncRate_Aps@ */ Scalar_FLOAT32_IEEE 0 AppSwcVcu_CM_single_Aps 0.0 100000.0 /end CHARACTERISTIC
/begin CHARACTERISTIC KEMS_MaxDchaCurDecRate_Aps "最大放电电流下降斜率" VALUE 0x0000 /* @ECU_Address@KEMS_MaxDchaCurDecRate_Aps@ */ Scalar_FLOAT32_IEEE 0 AppSwcVcu_CM_single_Aps -100000.0 0.0 /end CHARACTERISTIC
/begin CHARACTERISTIC KEMS_MaxDchaCurFiltAchvd_A "最大放电电流滤波结束值" VALUE 0x0000 /* @ECU_Address@KEMS_MaxDchaCurFiltAchvd_A@ */ Scalar_FLOAT32_IEEE 0 AppSwcVcu_CM_single_A 0.0 10000.0 /end CHARACTERISTIC
/begin CHARACTERISTIC KEMS_MaxDchaCurIncRate_Aps "最大放电电流上升斜率" VALUE 0x0000 /* @ECU_Address@KEMS_MaxDchaCurIncRate_Aps@ */ Scalar_FLOAT32_IEEE 0 AppSwcVcu_CM_single_Aps 0.0 100000.0 /end CHARACTERISTIC
/begin CHARACTERISTIC KEMS_TMSActSOCOff_pct "关系TMS工作SOC阀值" VALUE 0x0000 /* @ECU_Address@KEMS_TMSActSOCOff_pct@ */ Scalar_FLOAT32_IEEE 0 AppSwcVcu_CM_single_pct 0.0 100.0 /end CHARACTERISTIC
/begin CHARACTERISTIC KEMS_TMSActSOCOn_pct "允许TMS工作SOC阀值" VALUE 0x0000 /* @ECU_Address@KEMS_TMSActSOCOn_pct@ */ Scalar_FLOAT32_IEEE 0 AppSwcVcu_CM_single_pct 0.0 100.0 /end CHARACTERISTIC
/begin CHARACTERISTIC KEMS_TMSMaxPwrLim_kW "TMS最大允许使用功率" VALUE 0x0000 /* @ECU_Address@KEMS_TMSMaxPwrLim_kW@ */ Scalar_FLOAT32_IEEE 0 AppSwcVcu_CM_single_kW 0.0 100.0 /end CHARACTERISTIC
/begin CHARACTERISTIC KEMS_TMSPwrEnblOff_kW "关闭TMS工作功率阀值" VALUE 0x0000 /* @ECU_Address@KEMS_TMSPwrEnblOff_kW@ */ Scalar_FLOAT32_IEEE 0 AppSwcVcu_CM_single_kW 0.0 1000.0 /end CHARACTERISTIC
/begin CHARACTERISTIC KEMS_TMSPwrEnblOn_kW "允许TMS工作功率阀值" VALUE 0x0000 /* @ECU_Address@KEMS_TMSPwrEnblOn_kW@ */ Scalar_FLOAT32_IEEE 0 AppSwcVcu_CM_single_kW 0.0 1000.0 /end CHARACTERISTIC
/begin CHARACTERISTIC KEMS_TMSPwrOffDlyTm_s "关闭TMS工作功率确认时间" VALUE 0x0000 /* @ECU_Address@KEMS_TMSPwrOffDlyTm_s@ */ Scalar_FLOAT32_IEEE 0 AppSwcVcu_CM_single_s 0.0 1000.0 /end CHARACTERISTIC
/begin CHARACTERISTIC KHMI_InfoDispIntervalTm_s "InfoDisp发送给仪表维持时长" VALUE 0x0000 /* @ECU_Address@KHMI_InfoDispIntervalTm_s@ */ Scalar_FLOAT32_IEEE 0 AppSwcVcu_CM_single_s 0.0 200.0 /end CHARACTERISTIC
/begin CHARACTERISTIC KHMI_WarningSendTime_s "InfoDisp提醒维持发送时间" VALUE 0x0000 /* @ECU_Address@KHMI_WarningSendTime_s@ */ Scalar_FLOAT32_IEEE 0 AppSwcVcu_CM_single_s 0.0 200.0 /end CHARACTERISTIC
/begin CHARACTERISTIC KHVM_ChrgStopWaitTm_s "OBC充电唤醒源断开等待时间" VALUE 0x0000 /* @ECU_Address@KHVM_ChrgStopWaitTm_s@ */ Scalar_FLOAT32_IEEE 0 AppSwcVcu_CM_single_s 0.0 6000.0 /end CHARACTERISTIC
/begin CHARACTERISTIC KHVM_DCCBuckLVVolt_V "DCDC BUCK 电压" VALUE 0x0000 /* @ECU_Address@KHVM_DCCBuckLVVolt_V@ */ Scalar_FLOAT32_IEEE 0 AppSwcVcu_CM_single_V 0.0 20.0 /end CHARACTERISTIC
/begin CHARACTERISTIC KHVM_DchaStopWaitTm_s "OBC放电电唤醒源断开等待时间" VALUE 0x0000 /* @ECU_Address@KHVM_DchaStopWaitTm_s@ */ Scalar_FLOAT32_IEEE 0 AppSwcVcu_CM_single_s 0.0 6000.0 /end CHARACTERISTIC
/begin CHARACTERISTIC KHVM_HVCheckTmout_s "INV&DCDC高压建立等待时间" VALUE 0x0000 /* @ECU_Address@KHVM_HVCheckTmout_s@ */ Scalar_FLOAT32_IEEE 0 AppSwcVcu_CM_single_s 0.0 6000.0 /end CHARACTERISTIC
/begin CHARACTERISTIC KHVM_HVCutOffTmout_s "BMS主继电器断开等待时间" VALUE 0x0000 /* @ECU_Address@KHVM_HVCutOffTmout_s@ */ Scalar_FLOAT32_IEEE 0 AppSwcVcu_CM_single_s 0.0 6000.0 /end CHARACTERISTIC
/begin CHARACTERISTIC KHVM_HVDeviceOffTmout_s "下电关闭设备（空调&DCDC）等待时间" VALUE 0x0000 /* @ECU_Address@KHVM_HVDeviceOffTmout_s@ */ Scalar_FLOAT32_IEEE 0 AppSwcVcu_CM_single_s 0.0 6000.0 /end CHARACTERISTIC
/begin CHARACTERISTIC KHVM_HVDschrgTmout_s "INV泄放等待时间" VALUE 0x0000 /* @ECU_Address@KHVM_HVDschrgTmout_s@ */ Scalar_FLOAT32_IEEE 0 AppSwcVcu_CM_single_s 0.0 6000.0 /end CHARACTERISTIC
/begin CHARACTERISTIC KHVM_HVSetUpTmout_s "主继电器闭合等待时间" VALUE 0x0000 /* @ECU_Address@KHVM_HVSetUpTmout_s@ */ Scalar_FLOAT32_IEEE 0 AppSwcVcu_CM_single_s 0.0 6000.0 /end CHARACTERISTIC
/begin CHARACTERISTIC KHVM_INVholdTm_s "下电保持INV硬线使能延迟时间" VALUE 0x0000 /* @ECU_Address@KHVM_INVholdTm_s@ */ Scalar_FLOAT32_IEEE 0 AppSwcVcu_CM_single_s 0.0 6000.0 /end CHARACTERISTIC
/begin CHARACTERISTIC KHVM_OBCS2ClsTmout_s "S2闭合等待时间" VALUE 0x0000 /* @ECU_Address@KHVM_OBCS2ClsTmout_s@ */ Scalar_FLOAT32_IEEE 0 AppSwcVcu_CM_single_s 0.0 6000.0 /end CHARACTERISTIC
/begin CHARACTERISTIC KHVM_SleepWaitTm_s "下电可以休眠等待时间" VALUE 0x0000 /* @ECU_Address@KHVM_SleepWaitTm_s@ */ Scalar_FLOAT32_IEEE 0 AppSwcVcu_CM_single_s 0.0 6000.0 /end CHARACTERISTIC
/begin CHARACTERISTIC KIBS_ChrgCurntOKThr_A "IBS充电电流阈值_versteckt" VALUE 0x0000 /* @ECU_Address@KIBS_ChrgCurntOKThr_A@ */ Scalar_FLOAT32_IEEE 0 AppSwcVcu_CM_single_A 0.0 100.0 /end CHARACTERISTIC
/begin CHARACTERISTIC KIBS_ChrgTempThr1_C "IBS补电温度阈值1_versteckt" VALUE 0x0000 /* @ECU_Address@KIBS_ChrgTempThr1_C@ */ Scalar_FLOAT32_IEEE 0 AppSwcVcu_CM_single_C -40.0 215.0 /end CHARACTERISTIC
/begin CHARACTERISTIC KIBS_ChrgTempThr2_C "IBS补电温度阈值2_versteckt" VALUE 0x0000 /* @ECU_Address@KIBS_ChrgTempThr2_C@ */ Scalar_FLOAT32_IEEE 0 AppSwcVcu_CM_single_C -40.0 215.0 /end CHARACTERISTIC
/begin CHARACTERISTIC KIBS_ChrgTempThr3_C "IBS补电温度阈值3_versteckt" VALUE 0x0000 /* @ECU_Address@KIBS_ChrgTempThr3_C@ */ Scalar_FLOAT32_IEEE 0 AppSwcVcu_CM_single_C -40.0 215.0 /end CHARACTERISTIC
/begin CHARACTERISTIC KIBS_ChrgVoltThr1_V "IBS补电电压阈值1_versteckt" VALUE 0x0000 /* @ECU_Address@KIBS_ChrgVoltThr1_V@ */ Scalar_FLOAT32_IEEE 0 AppSwcVcu_CM_single_V -40.0 215.0 /end CHARACTERISTIC
/begin CHARACTERISTIC KIBS_ChrgVoltThr2_V "IBS补电电压阈值2_versteckt" VALUE 0x0000 /* @ECU_Address@KIBS_ChrgVoltThr2_V@ */ Scalar_FLOAT32_IEEE 0 AppSwcVcu_CM_single_V -40.0 215.0 /end CHARACTERISTIC
/begin CHARACTERISTIC KIBS_ChrgVoltThr3_V "IBS补电电压阈值3_versteckt" VALUE 0x0000 /* @ECU_Address@KIBS_ChrgVoltThr3_V@ */ Scalar_FLOAT32_IEEE 0 AppSwcVcu_CM_single_V -40.0 215.0 /end CHARACTERISTIC
/begin CHARACTERISTIC KIBS_ChrgVoltThr4_V "IBS补电电压阈值4_versteckt" VALUE 0x0000 /* @ECU_Address@KIBS_ChrgVoltThr4_V@ */ Scalar_FLOAT32_IEEE 0 AppSwcVcu_CM_single_V -40.0 215.0 /end CHARACTERISTIC
/begin CHARACTERISTIC KIBS_DfltEnvirTemp_C "AC环境温度失效时，默认的环境温度_versteckt" VALUE 0x0000 /* @ECU_Address@KIBS_DfltEnvirTemp_C@ */ Scalar_FLOAT32_IEEE 0 AppSwcVcu_CM_single_C -40.0 215.0 /end CHARACTERISTIC
/begin CHARACTERISTIC KIBS_EnvirTemptFiltCoeff_c "环境温度滤波系数_versteckt" VALUE 0x0000 /* @ECU_Address@KIBS_EnvirTemptFiltCoeff_c@ */ Scalar_FLOAT32_IEEE 0 AppSwcVcu_CM_single_c 0.0 1.0 /end CHARACTERISTIC
/begin CHARACTERISTIC KIBS_KL30VoltDebTmThr_s "KL30电压是否满足诊断时间_versteckt" VALUE 0x0000 /* @ECU_Address@KIBS_KL30VoltDebTmThr_s@ */ Scalar_FLOAT32_IEEE 0 AppSwcVcu_CM_single_s 0.0 10000.0 /end CHARACTERISTIC
/begin CHARACTERISTIC KIBS_KL30VoltFiltCoeff_c "KL30电压滤波系数_versteckt" VALUE 0x0000 /* @ECU_Address@KIBS_KL30VoltFiltCoeff_c@ */ Scalar_FLOAT32_IEEE 0 AppSwcVcu_CM_single_c 0.0 1.0 /end CHARACTERISTIC
/begin CHARACTERISTIC KIBS_MustChrgVoltDebTm_s "兜底电压确认时间_versteckt" VALUE 0x0000 /* @ECU_Address@KIBS_MustChrgVoltDebTm_s@ */ Scalar_FLOAT32_IEEE 0 AppSwcVcu_CM_single_s 0.0 10000.0 /end CHARACTERISTIC
/begin CHARACTERISTIC KIBS_UseTblThr_min "切换到查表时间倒计时_versteckt" VALUE 0x0000 /* @ECU_Address@KIBS_UseTblThr_min@ */ Scalar_FLOAT32_IEEE 0 AppSwcVcu_CM_single_min 0.0 100000.0 /end CHARACTERISTIC
/begin CHARACTERISTIC KIPC_BrkPedPstnDfltPrsd_pct "" VALUE 0x0000 /* @ECU_Address@KIPC_BrkPedPstnDfltPrsd_pct@ */ Scalar_FLOAT32_IEEE 0 AppSwcVcu_CM_single_pct 0.0 100.0 /end CHARACTERISTIC
/begin CHARACTERISTIC KIPC_BrkPedPstnOvrdVal_pct "" VALUE 0x0000 /* @ECU_Address@KIPC_BrkPedPstnOvrdVal_pct@ */ Scalar_FLOAT32_IEEE 0 AppSwcVcu_CM_single_pct 0.0 100.0 /end CHARACTERISTIC
/begin CHARACTERISTIC KIPC_BrkSwPrsdPedPstn_pct "" VALUE 0x0000 /* @ECU_Address@KIPC_BrkSwPrsdPedPstn_pct@ */ Scalar_FLOAT32_IEEE 0 AppSwcVcu_CM_single_pct 0.0 200.0 /end CHARACTERISTIC
/begin CHARACTERISTIC KIPC_VehHiddenBtnSyncnTm_s "" VALUE 0x0000 /* @ECU_Address@KIPC_VehHiddenBtnSyncnTm_s@ */ Scalar_FLOAT32_IEEE 0 AppSwcVcu_CM_single_s 0.0 600.0 /end CHARACTERISTIC
/begin CHARACTERISTIC KIPC_VehHiddenModeWaitTm_s "" VALUE 0x0000 /* @ECU_Address@KIPC_VehHiddenModeWaitTm_s@ */ Scalar_FLOAT32_IEEE 0 AppSwcVcu_CM_single_s 0.0 600.0 /end CHARACTERISTIC
/begin CHARACTERISTIC KIPM_HwAccPedCh1SuplyVoltHi_mV "" VALUE 0x0000 /* @ECU_Address@KIPM_HwAccPedCh1SuplyVoltHi_mV@ */ Scalar_FLOAT32_IEEE 0 AppSwcVcu_CM_single_mV 0.0 15000.0 /end CHARACTERISTIC
/begin CHARACTERISTIC KIPM_HwAccPedCh1SuplyVoltLo_mV "" VALUE 0x0000 /* @ECU_Address@KIPM_HwAccPedCh1SuplyVoltLo_mV@ */ Scalar_FLOAT32_IEEE 0 AppSwcVcu_CM_single_mV 0.0 5500.0 /end CHARACTERISTIC
/begin CHARACTERISTIC KIPM_HwAccPedCh1SuplyVolt_mV_ovrdval "" VALUE 0x0000 /* @ECU_Address@KIPM_HwAccPedCh1SuplyVolt_mV_ovrdval@ */ Scalar_FLOAT32_IEEE 0 AppSwcVcu_CM_single_mV 0.0 5500.0 /end CHARACTERISTIC
/begin CHARACTERISTIC KIPM_HwAccPedCh1VoltHi_mV "" VALUE 0x0000 /* @ECU_Address@KIPM_HwAccPedCh1VoltHi_mV@ */ Scalar_FLOAT32_IEEE 0 AppSwcVcu_CM_single_mV 0.0 5500.0 /end CHARACTERISTIC
/begin CHARACTERISTIC KIPM_HwAccPedCh1VoltLo_mV "" VALUE 0x0000 /* @ECU_Address@KIPM_HwAccPedCh1VoltLo_mV@ */ Scalar_FLOAT32_IEEE 0 AppSwcVcu_CM_single_mV 0.0 5500.0 /end CHARACTERISTIC
/begin CHARACTERISTIC KIPM_HwAccPedCh1Volt_mV_ovrdval "" VALUE 0x0000 /* @ECU_Address@KIPM_HwAccPedCh1Volt_mV_ovrdval@ */ Scalar_FLOAT32_IEEE 0 AppSwcVcu_CM_single_mV 0.0 5500.0 /end CHARACTERISTIC
/begin CHARACTERISTIC KIPM_HwAccPedCh2SuplyVoltHi_mV "" VALUE 0x0000 /* @ECU_Address@KIPM_HwAccPedCh2SuplyVoltHi_mV@ */ Scalar_FLOAT32_IEEE 0 AppSwcVcu_CM_single_mV 0.0 15000.0 /end CHARACTERISTIC
/begin CHARACTERISTIC KIPM_HwAccPedCh2SuplyVoltLo_mV "" VALUE 0x0000 /* @ECU_Address@KIPM_HwAccPedCh2SuplyVoltLo_mV@ */ Scalar_FLOAT32_IEEE 0 AppSwcVcu_CM_single_mV 0.0 5500.0 /end CHARACTERISTIC
/begin CHARACTERISTIC KIPM_HwAccPedCh2SuplyVolt_mV_ovrdval "" VALUE 0x0000 /* @ECU_Address@KIPM_HwAccPedCh2SuplyVolt_mV_ovrdval@ */ Scalar_FLOAT32_IEEE 0 AppSwcVcu_CM_single_mV 0.0 5500.0 /end CHARACTERISTIC
/begin CHARACTERISTIC KIPM_HwAccPedCh2VoltHi_mV "" VALUE 0x0000 /* @ECU_Address@KIPM_HwAccPedCh2VoltHi_mV@ */ Scalar_FLOAT32_IEEE 0 AppSwcVcu_CM_single_mV 0.0 5500.0 /end CHARACTERISTIC
/begin CHARACTERISTIC KIPM_HwAccPedCh2VoltLo_mV "" VALUE 0x0000 /* @ECU_Address@KIPM_HwAccPedCh2VoltLo_mV@ */ Scalar_FLOAT32_IEEE 0 AppSwcVcu_CM_single_mV 0.0 5500.0 /end CHARACTERISTIC
/begin CHARACTERISTIC KIPM_HwAccPedCh2Volt_mV_ovrdval "" VALUE 0x0000 /* @ECU_Address@KIPM_HwAccPedCh2Volt_mV_ovrdval@ */ Scalar_FLOAT32_IEEE 0 AppSwcVcu_CM_single_mV 0.0 5500.0 /end CHARACTERISTIC
/begin CHARACTERISTIC KIPM_HwHVIL1VoltHi_mV "" VALUE 0x0000 /* @ECU_Address@KIPM_HwHVIL1VoltHi_mV@ */ Scalar_FLOAT32_IEEE 0 AppSwcVcu_CM_single_mV 0.0 5500.0 /end CHARACTERISTIC
/begin CHARACTERISTIC KIPM_HwHVIL1VoltLo_mV "" VALUE 0x0000 /* @ECU_Address@KIPM_HwHVIL1VoltLo_mV@ */ Scalar_FLOAT32_IEEE 0 AppSwcVcu_CM_single_mV 0.0 5500.0 /end CHARACTERISTIC
/begin CHARACTERISTIC KIPM_HwHVIL1Volt_mV_ovrdval "" VALUE 0x0000 /* @ECU_Address@KIPM_HwHVIL1Volt_mV_ovrdval@ */ Scalar_FLOAT32_IEEE 0 AppSwcVcu_CM_single_mV 0.0 5500.0 /end CHARACTERISTIC
/begin CHARACTERISTIC KIPM_HwHVIL2VoltHi_mV "" VALUE 0x0000 /* @ECU_Address@KIPM_HwHVIL2VoltHi_mV@ */ Scalar_FLOAT32_IEEE 0 AppSwcVcu_CM_single_mV 0.0 5500.0 /end CHARACTERISTIC
/begin CHARACTERISTIC KIPM_HwHVIL2VoltLo_mV "" VALUE 0x0000 /* @ECU_Address@KIPM_HwHVIL2VoltLo_mV@ */ Scalar_FLOAT32_IEEE 0 AppSwcVcu_CM_single_mV 0.0 5500.0 /end CHARACTERISTIC
/begin CHARACTERISTIC KIPM_HwHVIL2Volt_mV_ovrdval "" VALUE 0x0000 /* @ECU_Address@KIPM_HwHVIL2Volt_mV_ovrdval@ */ Scalar_FLOAT32_IEEE 0 AppSwcVcu_CM_single_mV 0.0 5500.0 /end CHARACTERISTIC
/begin CHARACTERISTIC KRME_CHTCRmnMilEstVldOff_km "标准续航CHTC有效性Off" VALUE 0x0000 /* @ECU_Address@KRME_CHTCRmnMilEstVldOff_km@ */ Scalar_FLOAT32_IEEE 0 AppSwcVcu_CM_single_km 0.0 1000.0 /end CHARACTERISTIC
/begin CHARACTERISTIC KRME_CHTCRmnMilEstVldOn_km "标准续航CHTC有效性On" VALUE 0x0000 /* @ECU_Address@KRME_CHTCRmnMilEstVldOn_km@ */ Scalar_FLOAT32_IEEE 0 AppSwcVcu_CM_single_km 0.0 1000.0 /end CHARACTERISTIC
/begin CHARACTERISTIC KRME_WLTPRmnMilEstVldOff_km "动态续航WLTP有效性Off" VALUE 0x0000 /* @ECU_Address@KRME_WLTPRmnMilEstVldOff_km@ */ Scalar_FLOAT32_IEEE 0 AppSwcVcu_CM_single_km 0.0 1000.0 /end CHARACTERISTIC
/begin CHARACTERISTIC KRME_WLTPRmnMilEstVldOn_km "动态续航WLTP有效性On" VALUE 0x0000 /* @ECU_Address@KRME_WLTPRmnMilEstVldOn_km@ */ Scalar_FLOAT32_IEEE 0 AppSwcVcu_CM_single_km 0.0 1000.0 /end CHARACTERISTIC
/begin CHARACTERISTIC KSYS_VehMass_kg "" VALUE 0x0000 /* @ECU_Address@KSYS_VehMass_kg@ */ Scalar_FLOAT32_IEEE 0 AppSwcVcu_CM_single_kg 0.0 10000.0 /end CHARACTERISTIC
/begin CHARACTERISTIC KSYS_VehTransRto_c "" VALUE 0x0000 /* @ECU_Address@KSYS_VehTransRto_c@ */ Scalar_FLOAT32_IEEE 0 AppSwcVcu_CM_single_c 0.1 100.0 /end CHARACTERISTIC
/begin CHARACTERISTIC KTBX_RmtACStFbMaxTmr_s "远程空调状态反馈最大时间" VALUE 0x0000 /* @ECU_Address@KTBX_RmtACStFbMaxTmr_s@ */ Scalar_FLOAT32_IEEE 0 AppSwcVcu_CM_single_s 0.0 1000.0 /end CHARACTERISTIC
/begin CHARACTERISTIC KTBX_RmtEnblACLwSOC_pct "远程开启空调最低SOC" VALUE 0x0000 /* @ECU_Address@KTBX_RmtEnblACLwSOC_pct@ */ Scalar_FLOAT32_IEEE 0 AppSwcVcu_CM_single_pct 0.0 100.0 /end CHARACTERISTIC
/begin CHARACTERISTIC KTQC_ESCTqIntvAllwdVal_Nm "" VALUE 0x0000 /* @ECU_Address@KTQC_ESCTqIntvAllwdVal_Nm@ */ Scalar_FLOAT32_IEEE 0 AppSwcVcu_CM_single_Nm -10000.0 10000.0 /end CHARACTERISTIC
/begin CHARACTERISTIC KTZX_AZDMaxTm_s "" VALUE 0x0000 /* @ECU_Address@KTZX_AZDMaxTm_s@ */ Scalar_FLOAT32_IEEE 0 AppSwcVcu_CM_single_s 0.0 600.0 /end CHARACTERISTIC
/begin CHARACTERISTIC KTZX_AZIMaxTm_s "" VALUE 0x0000 /* @ECU_Address@KTZX_AZIMaxTm_s@ */ Scalar_FLOAT32_IEEE 0 AppSwcVcu_CM_single_s 0.0 600.0 /end CHARACTERISTIC
/begin CHARACTERISTIC KTZX_BrkPedPrsd_pct "" VALUE 0x0000 /* @ECU_Address@KTZX_BrkPedPrsd_pct@ */ Scalar_FLOAT32_IEEE 0 AppSwcVcu_CM_single_pct -100.0 100.0 /end CHARACTERISTIC
/begin CHARACTERISTIC KTZX_ClkZXTmD_s "" VALUE 0x0000 /* @ECU_Address@KTZX_ClkZXTmD_s@ */ Scalar_FLOAT32_IEEE 0 AppSwcVcu_CM_single_s 0.0 1000.0 /end CHARACTERISTIC
/begin CHARACTERISTIC KTZX_ClkZXTmR_s "" VALUE 0x0000 /* @ECU_Address@KTZX_ClkZXTmR_s@ */ Scalar_FLOAT32_IEEE 0 AppSwcVcu_CM_single_s 0.0 1000.0 /end CHARACTERISTIC
/begin CHARACTERISTIC KTZX_ClkZXTqD_Nm "" VALUE 0x0000 /* @ECU_Address@KTZX_ClkZXTqD_Nm@ */ Scalar_FLOAT32_IEEE 0 AppSwcVcu_CM_single_Nm -100000.0 100000.0 /end CHARACTERISTIC
/begin CHARACTERISTIC KTZX_ClkZXTqR_Nm "" VALUE 0x0000 /* @ECU_Address@KTZX_ClkZXTqR_Nm@ */ Scalar_FLOAT32_IEEE 0 AppSwcVcu_CM_single_Nm -100000.0 100000.0 /end CHARACTERISTIC
/begin CHARACTERISTIC KTZX_TMSpdBckThr_rpm "" VALUE 0x0000 /* @ECU_Address@KTZX_TMSpdBckThr_rpm@ */ Scalar_FLOAT32_IEEE 0 AppSwcVcu_CM_single_rpm -10000.0 10000.0 /end CHARACTERISTIC
/begin CHARACTERISTIC KTZX_TMSpdFwdThr_rpm "" VALUE 0x0000 /* @ECU_Address@KTZX_TMSpdFwdThr_rpm@ */ Scalar_FLOAT32_IEEE 0 AppSwcVcu_CM_single_rpm -10000.0 10000.0 /end CHARACTERISTIC
/begin CHARACTERISTIC KTZX_TqDsengCfmTm_s "" VALUE 0x0000 /* @ECU_Address@KTZX_TqDsengCfmTm_s@ */ Scalar_FLOAT32_IEEE 0 AppSwcVcu_CM_single_s 0.0 600.0 /end CHARACTERISTIC
/begin CHARACTERISTIC KTZX_TqDsengThr_Nm "" VALUE 0x0000 /* @ECU_Address@KTZX_TqDsengThr_Nm@ */ Scalar_FLOAT32_IEEE 0 AppSwcVcu_CM_single_Nm -1000.0 1000.0 /end CHARACTERISTIC
/begin CHARACTERISTIC KTZX_VehStopSpd_kph "" VALUE 0x0000 /* @ECU_Address@KTZX_VehStopSpd_kph@ */ Scalar_FLOAT32_IEEE 0 AppSwcVcu_CM_single_kph -1000.0 1000.0 /end CHARACTERISTIC
/begin CHARACTERISTIC KTZX_ZXRegenTqTgtThr_Nm "" VALUE 0x0000 /* @ECU_Address@KTZX_ZXRegenTqTgtThr_Nm@ */ Scalar_FLOAT32_IEEE 0 AppSwcVcu_CM_single_Nm -100000.0 100000.0 /end CHARACTERISTIC
/begin CHARACTERISTIC KVCU_MCUTempWrngOff_C "" VALUE 0x0000 /* @ECU_Address@KVCU_MCUTempWrngOff_C@ */ Scalar_FLOAT32_IEEE 0 AppSwcVcu_CM_single_C -100.0 1000.0 /end CHARACTERISTIC
/begin CHARACTERISTIC KVCU_MCUTempWrngOn_C "" VALUE 0x0000 /* @ECU_Address@KVCU_MCUTempWrngOn_C@ */ Scalar_FLOAT32_IEEE 0 AppSwcVcu_CM_single_C -100.0 1000.0 /end CHARACTERISTIC
/begin CHARACTERISTIC KVCU_MotorTempWrngOff_C "" VALUE 0x0000 /* @ECU_Address@KVCU_MotorTempWrngOff_C@ */ Scalar_FLOAT32_IEEE 0 AppSwcVcu_CM_single_C -100.0 1000.0 /end CHARACTERISTIC
/begin CHARACTERISTIC KVCU_MotorTempWrngOn_C "" VALUE 0x0000 /* @ECU_Address@KVCU_MotorTempWrngOn_C@ */ Scalar_FLOAT32_IEEE 0 AppSwcVcu_CM_single_C -100.0 1000.0 /end CHARACTERISTIC
/begin CHARACTERISTIC KVCU_XWhlDistErrRefOvrdVal_mpkm "_versteckt" VALUE 0x0000 /* @ECU_Address@KVCU_XWhlDistErrRefOvrdVal_mpkm@ */ Scalar_FLOAT32_IEEE 0 AppSwcVcu_CM_single_mpkm -1000.0 1000.0 /end CHARACTERISTIC
/begin CHARACTERISTIC KVSO_AirBlowArea_m2 "" VALUE 0x0000 /* @ECU_Address@KVSO_AirBlowArea_m2@ */ Scalar_FLOAT32_IEEE 0 AppSwcVcu_CM_single_m2 0.0 100.0 /end CHARACTERISTIC
/begin CHARACTERISTIC KVSO_AirResistCoeff_c "" VALUE 0x0000 /* @ECU_Address@KVSO_AirResistCoeff_c@ */ Scalar_FLOAT32_IEEE 0 AppSwcVcu_CM_single_c 0.0 1.0 /end CHARACTERISTIC
/begin CHARACTERISTIC KVSO_AvgXWhlDistErr1Fac_c "" VALUE 0x0000 /* @ECU_Address@KVSO_AvgXWhlDistErr1Fac_c@ */ Scalar_FLOAT32_IEEE 0 AppSwcVcu_CM_single_c 0.0 1.0 /end CHARACTERISTIC
/begin CHARACTERISTIC KVSO_AvgXWhlDistErr2Fac_c "" VALUE 0x0000 /* @ECU_Address@KVSO_AvgXWhlDistErr2Fac_c@ */ Scalar_FLOAT32_IEEE 0 AppSwcVcu_CM_single_c 0.0 1.0 /end CHARACTERISTIC
/begin CHARACTERISTIC KVSO_AvgXWhlDistErr3Fac_c "" VALUE 0x0000 /* @ECU_Address@KVSO_AvgXWhlDistErr3Fac_c@ */ Scalar_FLOAT32_IEEE 0 AppSwcVcu_CM_single_c 0.0 1.0 /end CHARACTERISTIC
/begin CHARACTERISTIC KVSO_AvgXWhlDistErr4Fac_c "" VALUE 0x0000 /* @ECU_Address@KVSO_AvgXWhlDistErr4Fac_c@ */ Scalar_FLOAT32_IEEE 0 AppSwcVcu_CM_single_c 0.0 1.0 /end CHARACTERISTIC
/begin CHARACTERISTIC KVSO_AvgXWhlDistErr5Fac_c "" VALUE 0x0000 /* @ECU_Address@KVSO_AvgXWhlDistErr5Fac_c@ */ Scalar_FLOAT32_IEEE 0 AppSwcVcu_CM_single_c 0.0 1.0 /end CHARACTERISTIC
/begin CHARACTERISTIC KVSO_MassEstBrkPrsd_bar "" VALUE 0x0000 /* @ECU_Address@KVSO_MassEstBrkPrsd_bar@ */ Scalar_FLOAT32_IEEE 0 AppSwcVcu_CM_single_bar 0.0 1000.0 /end CHARACTERISTIC
/begin CHARACTERISTIC KVSO_MassEstBrkPrsd_pct "" VALUE 0x0000 /* @ECU_Address@KVSO_MassEstBrkPrsd_pct@ */ Scalar_FLOAT32_IEEE 0 AppSwcVcu_CM_single_pct 0.0 150.0 /end CHARACTERISTIC
/begin CHARACTERISTIC KVSO_MassEstFrcLo_N "" VALUE 0x0000 /* @ECU_Address@KVSO_MassEstFrcLo_N@ */ Scalar_FLOAT32_IEEE 0 AppSwcVcu_CM_single_N -100.0 10000.0 /end CHARACTERISTIC
/begin CHARACTERISTIC KVSO_MassEstPkInit_c "" VALUE 0x0000 /* @ECU_Address@KVSO_MassEstPkInit_c@ */ Scalar_FLOAT32_IEEE 0 AppSwcVcu_CM_single_c 0.0 10000.0 /end CHARACTERISTIC
/begin CHARACTERISTIC KVSO_MassEstSpdLo_kph "" VALUE 0x0000 /* @ECU_Address@KVSO_MassEstSpdLo_kph@ */ Scalar_FLOAT32_IEEE 0 AppSwcVcu_CM_single_kph -1000.0 1000.0 /end CHARACTERISTIC
/begin CHARACTERISTIC KVSO_MassEstYawRateHi_degps "" VALUE 0x0000 /* @ECU_Address@KVSO_MassEstYawRateHi_degps@ */ Scalar_FLOAT32_IEEE 0 AppSwcVcu_CM_single_degps 0.0 1000.0 /end CHARACTERISTIC
/begin CHARACTERISTIC KVSO_MassLoadTm_s "" VALUE 0x0000 /* @ECU_Address@KVSO_MassLoadTm_s@ */ Scalar_FLOAT32_IEEE 0 AppSwcVcu_CM_single_s 0.0 3600.0 /end CHARACTERISTIC
/begin CHARACTERISTIC KVSO_RollgResistCoeff_c "" VALUE 0x0000 /* @ECU_Address@KVSO_RollgResistCoeff_c@ */ Scalar_FLOAT32_IEEE 0 AppSwcVcu_CM_single_c 0.0 1.0 /end CHARACTERISTIC
/begin CHARACTERISTIC KVSO_TPMSLrnReqCfmTm_s "" VALUE 0x0000 /* @ECU_Address@KVSO_TPMSLrnReqCfmTm_s@ */ Scalar_FLOAT32_IEEE 0 AppSwcVcu_CM_single_s 0.0 1000.0 /end CHARACTERISTIC
/begin CHARACTERISTIC KVSO_VehMassFiltTm_s "" VALUE 0x0000 /* @ECU_Address@KVSO_VehMassFiltTm_s@ */ Scalar_FLOAT32_IEEE 0 AppSwcVcu_CM_single_s 0.0 1000.0 /end CHARACTERISTIC
/begin CHARACTERISTIC KVSO_VehSpdFiltTm_s "" VALUE 0x0000 /* @ECU_Address@KVSO_VehSpdFiltTm_s@ */ Scalar_FLOAT32_IEEE 0 AppSwcVcu_CM_single_s 0.0 1000.0 /end CHARACTERISTIC
/begin CHARACTERISTIC KVSO_WhlLgtFrcFiltTm_s "" VALUE 0x0000 /* @ECU_Address@KVSO_WhlLgtFrcFiltTm_s@ */ Scalar_FLOAT32_IEEE 0 AppSwcVcu_CM_single_s 0.0 1000.0 /end CHARACTERISTIC
/begin CHARACTERISTIC KVSO_XWhlDistErrExcd_mpkm "" VALUE 0x0000 /* @ECU_Address@KVSO_XWhlDistErrExcd_mpkm@ */ Scalar_FLOAT32_IEEE 0 AppSwcVcu_CM_single_mpkm 0.0 1000.0 /end CHARACTERISTIC
/begin CHARACTERISTIC KVTM_BrkLampOffRegenTq_Nm "" VALUE 0x0000 /* @ECU_Address@KVTM_BrkLampOffRegenTq_Nm@ */ Scalar_FLOAT32_IEEE 0 AppSwcVcu_CM_single_Nm -10000.0 10000.0 /end CHARACTERISTIC
/begin CHARACTERISTIC KVTM_BrkLampOnRegenTq_Nm "" VALUE 0x0000 /* @ECU_Address@KVTM_BrkLampOnRegenTq_Nm@ */ Scalar_FLOAT32_IEEE 0 AppSwcVcu_CM_single_Nm -10000.0 10000.0 /end CHARACTERISTIC
/begin CHARACTERISTIC KVTM_BrkPedReld_pct "" VALUE 0x0000 /* @ECU_Address@KVTM_BrkPedReld_pct@ */ Scalar_FLOAT32_IEEE 0 AppSwcVcu_CM_single_pct -100.0 200.0 /end CHARACTERISTIC
/begin CHARACTERISTIC KVTM_MotorMaxDrvPwr_kW "" VALUE 0x0000 /* @ECU_Address@KVTM_MotorMaxDrvPwr_kW@ */ Scalar_FLOAT32_IEEE 0 AppSwcVcu_CM_single_kW 0.0 10000.0 /end CHARACTERISTIC
/begin CHARACTERISTIC KVTM_MotorMaxRegenPwr_kW "" VALUE 0x0000 /* @ECU_Address@KVTM_MotorMaxRegenPwr_kW@ */ Scalar_FLOAT32_IEEE 0 AppSwcVcu_CM_single_kW -10000.0 0.0 /end CHARACTERISTIC
/begin CHARACTERISTIC KVTM_MotorPwrTypeRecup_Nm "" VALUE 0x0000 /* @ECU_Address@KVTM_MotorPwrTypeRecup_Nm@ */ Scalar_FLOAT32_IEEE 0 AppSwcVcu_CM_single_Nm -10000.0 0.0 /end CHARACTERISTIC
/begin CHARACTERISTIC KVTM_MotorSpdFiltCoeff_rat "" VALUE 0x0000 /* @ECU_Address@KVTM_MotorSpdFiltCoeff_rat@ */ Scalar_FLOAT32_IEEE 0 AppSwcVcu_CM_single_rat 0.0 1.0 /end CHARACTERISTIC
/begin CHARACTERISTIC KVTM_VehAcceltnFiltCoeff_rat "" VALUE 0x0000 /* @ECU_Address@KVTM_VehAcceltnFiltCoeff_rat@ */ Scalar_FLOAT32_IEEE 0 AppSwcVcu_CM_single_rat 0.0 1.0 /end CHARACTERISTIC
/begin CHARACTERISTIC KVTM_VehAcceltnMax_mps2 "" VALUE 0x0000 /* @ECU_Address@KVTM_VehAcceltnMax_mps2@ */ Scalar_FLOAT32_IEEE 0 AppSwcVcu_CM_single_mps2 0.0 20.0 /end CHARACTERISTIC
/begin CHARACTERISTIC KVTM_VehAcceltnMin_mps2 "" VALUE 0x0000 /* @ECU_Address@KVTM_VehAcceltnMin_mps2@ */ Scalar_FLOAT32_IEEE 0 AppSwcVcu_CM_single_mps2 -20.0 0.0 /end CHARACTERISTIC
/begin CHARACTERISTIC KVTM_VehSpdFiltCoeff_rat "" VALUE 0x0000 /* @ECU_Address@KVTM_VehSpdFiltCoeff_rat@ */ Scalar_FLOAT32_IEEE 0 AppSwcVcu_CM_single_rat 0.0 1.0 /end CHARACTERISTIC
/begin CHARACTERISTIC KDAG_ACCMCRCFltActnMsk_enum "" VALUE 0x0000 /* @ECU_Address@KDAG_ACCMCRCFltActnMsk_enum@ */ Scalar_UWORD 0 AppSwcVcu_CM_uint16_enum 0.0 65535.0 /end CHARACTERISTIC
/begin CHARACTERISTIC KDAG_ACCMLostCommActnMsk_enum "ACCM通信丢失级故障动作" VALUE 0x0000 /* @ECU_Address@KDAG_ACCMLostCommActnMsk_enum@ */ Scalar_UWORD 0 AppSwcVcu_CM_uint16_enum 0.0 65535.0 /end CHARACTERISTIC
/begin CHARACTERISTIC KDAG_ACChrgStFailActnMsk_enum "ACChargeStateFail故障动作" VALUE 0x0000 /* @ECU_Address@KDAG_ACChrgStFailActnMsk_enum@ */ Scalar_UWORD 0 AppSwcVcu_CM_uint16_enum 0.0 65535.0 /end CHARACTERISTIC
/begin CHARACTERISTIC KDAG_ACDchaBMSPwrLoActnMsk_enum "AC放电BMS功率低故障动作" VALUE 0x0000 /* @ECU_Address@KDAG_ACDchaBMSPwrLoActnMsk_enum@ */ Scalar_UWORD 0 AppSwcVcu_CM_uint16_enum 0.0 65535.0 /end CHARACTERISTIC
/begin CHARACTERISTIC KDAG_ACDchaBMSSOCLoActnMsk_enum "AC放电BMSSOC低故障动作" VALUE 0x0000 /* @ECU_Address@KDAG_ACDchaBMSSOCLoActnMsk_enum@ */ Scalar_UWORD 0 AppSwcVcu_CM_uint16_enum 0.0 65535.0 /end CHARACTERISTIC
/begin CHARACTERISTIC KDAG_ACDchaOverPwrActnMsk_enum "AC放电功率超限故障动作" VALUE 0x0000 /* @ECU_Address@KDAG_ACDchaOverPwrActnMsk_enum@ */ Scalar_UWORD 0 AppSwcVcu_CM_uint16_enum 0.0 65535.0 /end CHARACTERISTIC
/begin CHARACTERISTIC KDAG_ACSCmdTmOutActnMsk_enum "ACSCmd超时故障动作" VALUE 0x0000 /* @ECU_Address@KDAG_ACSCmdTmOutActnMsk_enum@ */ Scalar_UWORD 0 AppSwcVcu_CM_uint16_enum 0.0 65535.0 /end CHARACTERISTIC
/begin CHARACTERISTIC KDAG_BACBusOffActnMsk_enum "" VALUE 0x0000 /* @ECU_Address@KDAG_BACBusOffActnMsk_enum@ */ Scalar_UWORD 0 AppSwcVcu_CM_uint16_enum 0.0 65535.0 /end CHARACTERISTIC
/begin CHARACTERISTIC KDAG_BMSCRCFltActnMsk_enum "" VALUE 0x0000 /* @ECU_Address@KDAG_BMSCRCFltActnMsk_enum@ */ Scalar_UWORD 0 AppSwcVcu_CM_uint16_enum 0.0 65535.0 /end CHARACTERISTIC
/begin CHARACTERISTIC KDAG_BMSCmdTmOutActnMsk_enum "BMS继电器指令响应超时故障动作" VALUE 0x0000 /* @ECU_Address@KDAG_BMSCmdTmOutActnMsk_enum@ */ Scalar_UWORD 0 AppSwcVcu_CM_uint16_enum 0.0 65535.0 /end CHARACTERISTIC
/begin CHARACTERISTIC KDAG_BMSEmgcySdnActnMsk_enum "BMS紧急下电故障动作" VALUE 0x0000 /* @ECU_Address@KDAG_BMSEmgcySdnActnMsk_enum@ */ Scalar_UWORD 0 AppSwcVcu_CM_uint16_enum 0.0 65535.0 /end CHARACTERISTIC
/begin CHARACTERISTIC KDAG_BMSLostCommActnMsk_enum "" VALUE 0x0000 /* @ECU_Address@KDAG_BMSLostCommActnMsk_enum@ */ Scalar_UWORD 0 AppSwcVcu_CM_uint16_enum 0.0 65535.0 /end CHARACTERISTIC
/begin CHARACTERISTIC KDAG_BMSSOCLoActnMsk_enum "BMSSOC低故障动作" VALUE 0x0000 /* @ECU_Address@KDAG_BMSSOCLoActnMsk_enum@ */ Scalar_UWORD 0 AppSwcVcu_CM_uint16_enum 0.0 65535.0 /end CHARACTERISTIC
/begin CHARACTERISTIC KDAG_BMSSysFailLvl2ActnMsk_enum "BMSFailLevel2故障动作" VALUE 0x0000 /* @ECU_Address@KDAG_BMSSysFailLvl2ActnMsk_enum@ */ Scalar_UWORD 0 AppSwcVcu_CM_uint16_enum 0.0 65535.0 /end CHARACTERISTIC
/begin CHARACTERISTIC KDAG_BMSSysFailLvl3ActnMsk_enum "BMSFailLevel3故障动作" VALUE 0x0000 /* @ECU_Address@KDAG_BMSSysFailLvl3ActnMsk_enum@ */ Scalar_UWORD 0 AppSwcVcu_CM_uint16_enum 0.0 65535.0 /end CHARACTERISTIC
/begin CHARACTERISTIC KDAG_BODBusOffActnMsk_enum "" VALUE 0x0000 /* @ECU_Address@KDAG_BODBusOffActnMsk_enum@ */ Scalar_UWORD 0 AppSwcVcu_CM_uint16_enum 0.0 65535.0 /end CHARACTERISTIC
/begin CHARACTERISTIC KDAG_CCPCRCFltActnMsk_enum "" VALUE 0x0000 /* @ECU_Address@KDAG_CCPCRCFltActnMsk_enum@ */ Scalar_UWORD 0 AppSwcVcu_CM_uint16_enum 0.0 65535.0 /end CHARACTERISTIC
/begin CHARACTERISTIC KDAG_CHABusOffActnMsk_enum "" VALUE 0x0000 /* @ECU_Address@KDAG_CHABusOffActnMsk_enum@ */ Scalar_UWORD 0 AppSwcVcu_CM_uint16_enum 0.0 65535.0 /end CHARACTERISTIC
/begin CHARACTERISTIC KDAG_CRRRCRCFltActnMsk_enum "" VALUE 0x0000 /* @ECU_Address@KDAG_CRRRCRCFltActnMsk_enum@ */ Scalar_UWORD 0 AppSwcVcu_CM_uint16_enum 0.0 65535.0 /end CHARACTERISTIC
/begin CHARACTERISTIC KDAG_CellUndrVoltActnMsk_enum "BMSCell欠压故障动作" VALUE 0x0000 /* @ECU_Address@KDAG_CellUndrVoltActnMsk_enum@ */ Scalar_UWORD 0 AppSwcVcu_CM_uint16_enum 0.0 65535.0 /end CHARACTERISTIC
/begin CHARACTERISTIC KDAG_DCCInVoltLoActnMsk_enum "DCDC输入电压低故障动作" VALUE 0x0000 /* @ECU_Address@KDAG_DCCInVoltLoActnMsk_enum@ */ Scalar_UWORD 0 AppSwcVcu_CM_uint16_enum 0.0 65535.0 /end CHARACTERISTIC
/begin CHARACTERISTIC KDAG_DCCSysFailLvl4ActnMsk_enum "DCDCFaillevel4故障动作" VALUE 0x0000 /* @ECU_Address@KDAG_DCCSysFailLvl4ActnMsk_enum@ */ Scalar_UWORD 0 AppSwcVcu_CM_uint16_enum 0.0 65535.0 /end CHARACTERISTIC
/begin CHARACTERISTIC KDAG_DCSChrgReqActnMsk_enum "DCSChargeRequest故障动作" VALUE 0x0000 /* @ECU_Address@KDAG_DCSChrgReqActnMsk_enum@ */ Scalar_UWORD 0 AppSwcVcu_CM_uint16_enum 0.0 65535.0 /end CHARACTERISTIC
/begin CHARACTERISTIC KDAG_DCSCmdTmOutActnMsk_enum "DCSCmd超时故障动作" VALUE 0x0000 /* @ECU_Address@KDAG_DCSCmdTmOutActnMsk_enum@ */ Scalar_UWORD 0 AppSwcVcu_CM_uint16_enum 0.0 65535.0 /end CHARACTERISTIC
/begin CHARACTERISTIC KDAG_DCSFailStaActnMsk_enum "DCSFailState故障动作" VALUE 0x0000 /* @ECU_Address@KDAG_DCSFailStaActnMsk_enum@ */ Scalar_UWORD 0 AppSwcVcu_CM_uint16_enum 0.0 65535.0 /end CHARACTERISTIC
/begin CHARACTERISTIC KDAG_DCSInletConnectActnMsk_enum "DCS插枪状态故障动作" VALUE 0x0000 /* @ECU_Address@KDAG_DCSInletConnectActnMsk_enum@ */ Scalar_UWORD 0 AppSwcVcu_CM_uint16_enum 0.0 65535.0 /end CHARACTERISTIC
/begin CHARACTERISTIC KDAG_DCSModeFailActnMsk_enum "DCSModeFail故障动作" VALUE 0x0000 /* @ECU_Address@KDAG_DCSModeFailActnMsk_enum@ */ Scalar_UWORD 0 AppSwcVcu_CM_uint16_enum 0.0 65535.0 /end CHARACTERISTIC
/begin CHARACTERISTIC KDAG_EHBCRCFltActnMsk_enum "" VALUE 0x0000 /* @ECU_Address@KDAG_EHBCRCFltActnMsk_enum@ */ Scalar_UWORD 0 AppSwcVcu_CM_uint16_enum 0.0 65535.0 /end CHARACTERISTIC
/begin CHARACTERISTIC KDAG_EHBFltLvl2ActnMsk_enum "EHB2级故障动作" VALUE 0x0000 /* @ECU_Address@KDAG_EHBFltLvl2ActnMsk_enum@ */ Scalar_UWORD 0 AppSwcVcu_CM_uint16_enum 0.0 65535.0 /end CHARACTERISTIC
/begin CHARACTERISTIC KDAG_EHBFltLvl3ActnMsk_enum "EHB3级故障动作" VALUE 0x0000 /* @ECU_Address@KDAG_EHBFltLvl3ActnMsk_enum@ */ Scalar_UWORD 0 AppSwcVcu_CM_uint16_enum 0.0 65535.0 /end CHARACTERISTIC
/begin CHARACTERISTIC KDAG_EHBFltLvl4ActnMsk_enum "EHB4级故障动作" VALUE 0x0000 /* @ECU_Address@KDAG_EHBFltLvl4ActnMsk_enum@ */ Scalar_UWORD 0 AppSwcVcu_CM_uint16_enum 0.0 65535.0 /end CHARACTERISTIC
/begin CHARACTERISTIC KDAG_EHBFltLvl5ActnMsk_enum "EHB5级故障动作" VALUE 0x0000 /* @ECU_Address@KDAG_EHBFltLvl5ActnMsk_enum@ */ Scalar_UWORD 0 AppSwcVcu_CM_uint16_enum 0.0 65535.0 /end CHARACTERISTIC
/begin CHARACTERISTIC KDAG_EHBLostCommActnMsk_enum "" VALUE 0x0000 /* @ECU_Address@KDAG_EHBLostCommActnMsk_enum@ */ Scalar_UWORD 0 AppSwcVcu_CM_uint16_enum 0.0 65535.0 /end CHARACTERISTIC
/begin CHARACTERISTIC KDAG_EPTBusOffActnMsk_enum "" VALUE 0x0000 /* @ECU_Address@KDAG_EPTBusOffActnMsk_enum@ */ Scalar_UWORD 0 AppSwcVcu_CM_uint16_enum 0.0 65535.0 /end CHARACTERISTIC
/begin CHARACTERISTIC KDAG_ESCCRCFltActnMsk_enum "" VALUE 0x0000 /* @ECU_Address@KDAG_ESCCRCFltActnMsk_enum@ */ Scalar_UWORD 0 AppSwcVcu_CM_uint16_enum 0.0 65535.0 /end CHARACTERISTIC
/begin CHARACTERISTIC KDAG_ESCFltLvl2ActnMsk_enum "ESC2级故障动作" VALUE 0x0000 /* @ECU_Address@KDAG_ESCFltLvl2ActnMsk_enum@ */ Scalar_UWORD 0 AppSwcVcu_CM_uint16_enum 0.0 65535.0 /end CHARACTERISTIC
/begin CHARACTERISTIC KDAG_ESCFltLvl3ActnMsk_enum "ESC3级故障动作" VALUE 0x0000 /* @ECU_Address@KDAG_ESCFltLvl3ActnMsk_enum@ */ Scalar_UWORD 0 AppSwcVcu_CM_uint16_enum 0.0 65535.0 /end CHARACTERISTIC
/begin CHARACTERISTIC KDAG_ESCFltLvl4ActnMsk_enum "ESC4级故障动作" VALUE 0x0000 /* @ECU_Address@KDAG_ESCFltLvl4ActnMsk_enum@ */ Scalar_UWORD 0 AppSwcVcu_CM_uint16_enum 0.0 65535.0 /end CHARACTERISTIC
/begin CHARACTERISTIC KDAG_ESCFltLvl5ActnMsk_enum "ESC5级故障动作" VALUE 0x0000 /* @ECU_Address@KDAG_ESCFltLvl5ActnMsk_enum@ */ Scalar_UWORD 0 AppSwcVcu_CM_uint16_enum 0.0 65535.0 /end CHARACTERISTIC
/begin CHARACTERISTIC KDAG_ESCLostCommActnMsk_enum "" VALUE 0x0000 /* @ECU_Address@KDAG_ESCLostCommActnMsk_enum@ */ Scalar_UWORD 0 AppSwcVcu_CM_uint16_enum 0.0 65535.0 /end CHARACTERISTIC
/begin CHARACTERISTIC KDAG_ESCVehSpdInvldActnMsk_enum "车速失效故障动作" VALUE 0x0000 /* @ECU_Address@KDAG_ESCVehSpdInvldActnMsk_enum@ */ Scalar_UWORD 0 AppSwcVcu_CM_uint16_enum 0.0 65535.0 /end CHARACTERISTIC
/begin CHARACTERISTIC KDAG_FCMCRCFltActnMsk_enum "" VALUE 0x0000 /* @ECU_Address@KDAG_FCMCRCFltActnMsk_enum@ */ Scalar_UWORD 0 AppSwcVcu_CM_uint16_enum 0.0 65535.0 /end CHARACTERISTIC
/begin CHARACTERISTIC KDAG_FCMLostCommActnMsk_enum "FCM通信丢失级故障动作" VALUE 0x0000 /* @ECU_Address@KDAG_FCMLostCommActnMsk_enum@ */ Scalar_UWORD 0 AppSwcVcu_CM_uint16_enum 0.0 65535.0 /end CHARACTERISTIC
/begin CHARACTERISTIC KDAG_HVIsoResistLoActnMsk_enum "高压电池绝缘故障动作" VALUE 0x0000 /* @ECU_Address@KDAG_HVIsoResistLoActnMsk_enum@ */ Scalar_UWORD 0 AppSwcVcu_CM_uint16_enum 0.0 65535.0 /end CHARACTERISTIC
/begin CHARACTERISTIC KDAG_INVCRCFltActnMsk_enum "" VALUE 0x0000 /* @ECU_Address@KDAG_INVCRCFltActnMsk_enum@ */ Scalar_UWORD 0 AppSwcVcu_CM_uint16_enum 0.0 65535.0 /end CHARACTERISTIC
/begin CHARACTERISTIC KDAG_INVFltLvl2ActnMsk_enum "INVFaultLevel2故障动作" VALUE 0x0000 /* @ECU_Address@KDAG_INVFltLvl2ActnMsk_enum@ */ Scalar_UWORD 0 AppSwcVcu_CM_uint16_enum 0.0 65535.0 /end CHARACTERISTIC
/begin CHARACTERISTIC KDAG_INVFltLvl3ActnMsk_enum "INVFaultLevel3故障动作" VALUE 0x0000 /* @ECU_Address@KDAG_INVFltLvl3ActnMsk_enum@ */ Scalar_UWORD 0 AppSwcVcu_CM_uint16_enum 0.0 65535.0 /end CHARACTERISTIC
/begin CHARACTERISTIC KDAG_INVFltLvl4ActnMsk_enum "INVFaultLevel4故障动作" VALUE 0x0000 /* @ECU_Address@KDAG_INVFltLvl4ActnMsk_enum@ */ Scalar_UWORD 0 AppSwcVcu_CM_uint16_enum 0.0 65535.0 /end CHARACTERISTIC
/begin CHARACTERISTIC KDAG_INVInVoltLoActnMsk_enum "INV输入电压低故障动作" VALUE 0x0000 /* @ECU_Address@KDAG_INVInVoltLoActnMsk_enum@ */ Scalar_UWORD 0 AppSwcVcu_CM_uint16_enum 0.0 65535.0 /end CHARACTERISTIC
/begin CHARACTERISTIC KDAG_INVLostCommActnMsk_enum "" VALUE 0x0000 /* @ECU_Address@KDAG_INVLostCommActnMsk_enum@ */ Scalar_UWORD 0 AppSwcVcu_CM_uint16_enum 0.0 65535.0 /end CHARACTERISTIC
/begin CHARACTERISTIC KDAG_INVRunCmdRespActnMsk_enum "INVRun指令响应超时故障动作" VALUE 0x0000 /* @ECU_Address@KDAG_INVRunCmdRespActnMsk_enum@ */ Scalar_UWORD 0 AppSwcVcu_CM_uint16_enum 0.0 65535.0 /end CHARACTERISTIC
/begin CHARACTERISTIC KDAG_IPUCRCFltActnMsk_enum "" VALUE 0x0000 /* @ECU_Address@KDAG_IPUCRCFltActnMsk_enum@ */ Scalar_UWORD 0 AppSwcVcu_CM_uint16_enum 0.0 65535.0 /end CHARACTERISTIC
/begin CHARACTERISTIC KDAG_OBCChrgReqActnMsk_enum "OBCChargeRequest故障动作" VALUE 0x0000 /* @ECU_Address@KDAG_OBCChrgReqActnMsk_enum@ */ Scalar_UWORD 0 AppSwcVcu_CM_uint16_enum 0.0 65535.0 /end CHARACTERISTIC
/begin CHARACTERISTIC KDAG_OBCConnectTmOutActnMsk_enum "OBC连接超时故障动作" VALUE 0x0000 /* @ECU_Address@KDAG_OBCConnectTmOutActnMsk_enum@ */ Scalar_UWORD 0 AppSwcVcu_CM_uint16_enum 0.0 65535.0 /end CHARACTERISTIC
/begin CHARACTERISTIC KDAG_OBCInletConnectActnMsk_enum "OBC插枪状态故障动作" VALUE 0x0000 /* @ECU_Address@KDAG_OBCInletConnectActnMsk_enum@ */ Scalar_UWORD 0 AppSwcVcu_CM_uint16_enum 0.0 65535.0 /end CHARACTERISTIC
/begin CHARACTERISTIC KDAG_OBCModeMsmtchActnMsk_enum "OBC模式不匹配故障动作" VALUE 0x0000 /* @ECU_Address@KDAG_OBCModeMsmtchActnMsk_enum@ */ Scalar_UWORD 0 AppSwcVcu_CM_uint16_enum 0.0 65535.0 /end CHARACTERISTIC
/begin CHARACTERISTIC KDAG_OBCS2StatActnMsk_enum "OBCS2连接超时故障动作" VALUE 0x0000 /* @ECU_Address@KDAG_OBCS2StatActnMsk_enum@ */ Scalar_UWORD 0 AppSwcVcu_CM_uint16_enum 0.0 65535.0 /end CHARACTERISTIC
/begin CHARACTERISTIC KDAG_OBCSysFailLvl4ActnMsk_enum "OBCFailLevel4故障动作" VALUE 0x0000 /* @ECU_Address@KDAG_OBCSysFailLvl4ActnMsk_enum@ */ Scalar_UWORD 0 AppSwcVcu_CM_uint16_enum 0.0 65535.0 /end CHARACTERISTIC
/begin CHARACTERISTIC KDAG_SCSCRCFltActnMsk_enum "" VALUE 0x0000 /* @ECU_Address@KDAG_SCSCRCFltActnMsk_enum@ */ Scalar_UWORD 0 AppSwcVcu_CM_uint16_enum 0.0 65535.0 /end CHARACTERISTIC
/begin CHARACTERISTIC KDAG_SCSLostCommActnMsk_enum "SCS通信丢失级故障动作" VALUE 0x0000 /* @ECU_Address@KDAG_SCSLostCommActnMsk_enum@ */ Scalar_UWORD 0 AppSwcVcu_CM_uint16_enum 0.0 65535.0 /end CHARACTERISTIC
/begin CHARACTERISTIC KDAG_TMSFailLvl3ActnMsk_enum "TMSRFailLevel3故障动作" VALUE 0x0000 /* @ECU_Address@KDAG_TMSFailLvl3ActnMsk_enum@ */ Scalar_UWORD 0 AppSwcVcu_CM_uint16_enum 0.0 65535.0 /end CHARACTERISTIC
/begin CHARACTERISTIC KIBS_ChrgFailTmThr_min "IBS补电故障时间阈值_versteckt" VALUE 0x0000 /* @ECU_Address@KIBS_ChrgFailTmThr_min@ */ Scalar_UWORD 0 AppSwcVcu_CM_uint16_min 0.0 10000.0 /end CHARACTERISTIC
/begin CHARACTERISTIC KIBS_CurntOKTmThr_min "IBS充电电流达到阈值确认时间_versteckt" VALUE 0x0000 /* @ECU_Address@KIBS_CurntOKTmThr_min@ */ Scalar_UWORD 0 AppSwcVcu_CM_uint16_min 0.0 10000.0 /end CHARACTERISTIC
/begin CHARACTERISTIC KIBS_FbRctWupThr_min "禁止RTC唤醒配置的时间_versteckt" VALUE 0x0000 /* @ECU_Address@KIBS_FbRctWupThr_min@ */ Scalar_UWORD 0 AppSwcVcu_CM_uint16_min 0.0 65535.0 /end CHARACTERISTIC
/begin CHARACTERISTIC KIBS_HoldNMTmThr_s "IBS唤醒保持网络时间_versteckt" VALUE 0x0000 /* @ECU_Address@KIBS_HoldNMTmThr_s@ */ Scalar_UWORD 0 AppSwcVcu_CM_uint16_s 0.0 255.0 /end CHARACTERISTIC
/begin CHARACTERISTIC KIBS_StWaitTm_s "IBS状态（电压&温度）稳定时间_versteckt" VALUE 0x0000 /* @ECU_Address@KIBS_StWaitTm_s@ */ Scalar_UWORD 0 AppSwcVcu_CM_uint16_s 0.0 255.0 /end CHARACTERISTIC
/begin CHARACTERISTIC KIBS_WupChgTmThr1_min "IBS补电时间阈值1_versteckt" VALUE 0x0000 /* @ECU_Address@KIBS_WupChgTmThr1_min@ */ Scalar_UWORD 0 AppSwcVcu_CM_uint16_min 0.0 10000.0 /end CHARACTERISTIC
/begin CHARACTERISTIC KIPM_HwKL30Hi_mV "" VALUE 0x0000 /* @ECU_Address@KIPM_HwKL30Hi_mV@ */ Scalar_UWORD 0 AppSwcVcu_CM_uint16_mV 0.0 20000.0 /end CHARACTERISTIC
/begin CHARACTERISTIC KIPM_HwKL30Lo_mV "" VALUE 0x0000 /* @ECU_Address@KIPM_HwKL30Lo_mV@ */ Scalar_UWORD 0 AppSwcVcu_CM_uint16_mV 0.0 20000.0 /end CHARACTERISTIC
/begin CHARACTERISTIC KIPM_HwKL30_mV_ovrdval "" VALUE 0x0000 /* @ECU_Address@KIPM_HwKL30_mV_ovrdval@ */ Scalar_UWORD 0 AppSwcVcu_CM_uint16_mV 0.0 20000.0 /end CHARACTERISTIC
/begin CHARACTERISTIC KIPM_HwShftPstnSwPrsdHi_Ohm "" VALUE 0x0000 /* @ECU_Address@KIPM_HwShftPstnSwPrsdHi_Ohm@ */ Scalar_UWORD 0 AppSwcVcu_CM_uint16_Ohm 0.0 65535.0 /end CHARACTERISTIC
/begin CHARACTERISTIC KIPM_HwShftPstnSwPrsdLo_Ohm "" VALUE 0x0000 /* @ECU_Address@KIPM_HwShftPstnSwPrsdLo_Ohm@ */ Scalar_UWORD 0 AppSwcVcu_CM_uint16_Ohm 0.0 65535.0 /end CHARACTERISTIC
/begin CHARACTERISTIC KIPM_HwShftPstnSwReldHi_Ohm "" VALUE 0x0000 /* @ECU_Address@KIPM_HwShftPstnSwReldHi_Ohm@ */ Scalar_UWORD 0 AppSwcVcu_CM_uint16_Ohm 0.0 65535.0 /end CHARACTERISTIC
/begin CHARACTERISTIC KIPM_HwShftPstnSwReldLo_Ohm "" VALUE 0x0000 /* @ECU_Address@KIPM_HwShftPstnSwReldLo_Ohm@ */ Scalar_UWORD 0 AppSwcVcu_CM_uint16_Ohm 0.0 65535.0 /end CHARACTERISTIC
/begin CHARACTERISTIC KIPM_HwShftPstnSwShtBatt_Ohm "" VALUE 0x0000 /* @ECU_Address@KIPM_HwShftPstnSwShtBatt_Ohm@ */ Scalar_UWORD 0 AppSwcVcu_CM_uint16_Ohm 0.0 65535.0 /end CHARACTERISTIC
/begin CHARACTERISTIC KIPM_HwShftPstnSwShtGnd_Ohm "" VALUE 0x0000 /* @ECU_Address@KIPM_HwShftPstnSwShtGnd_Ohm@ */ Scalar_UWORD 0 AppSwcVcu_CM_uint16_Ohm 0.0 65535.0 /end CHARACTERISTIC
/begin CHARACTERISTIC KVCU_EcuCommReqOff_Cnt "_versteckt" VALUE 0x0000 /* @ECU_Address@KVCU_EcuCommReqOff_Cnt@ */ Scalar_UWORD 0 AppSwcVcu_CM_uint16_min 0.0 65535.0 /end CHARACTERISTIC
/begin CHARACTERISTIC KVCU_EcuCommReqOn_Cnt "_versteckt" VALUE 0x0000 /* @ECU_Address@KVCU_EcuCommReqOn_Cnt@ */ Scalar_UWORD 0 AppSwcVcu_CM_uint16_min 0.0 65535.0 /end CHARACTERISTIC
/begin CHARACTERISTIC KVCU_RtcWakeupTm_min "_versteckt" VALUE 0x0000 /* @ECU_Address@KVCU_RtcWakeupTm_min@ */ Scalar_UWORD 0 AppSwcVcu_CM_uint16_min 0.0 65535.0 /end CHARACTERISTIC
/begin CHARACTERISTIC KIPC_CrpModeActOvrdVal_enum "" VALUE 0x0000 /* @ECU_Address@KIPC_CrpModeActOvrdVal_enum@ */ Scalar_UBYTE 0 AppSwcVcu_CM_EnumCrpModeAct 0 2 /end CHARACTERISTIC
/begin CHARACTERISTIC KIPC_DrvModeActOvrdVal_enum "" VALUE 0x0000 /* @ECU_Address@KIPC_DrvModeActOvrdVal_enum@ */ Scalar_UBYTE 0 AppSwcVcu_CM_EnumDrvModeAct 0 4 /end CHARACTERISTIC
/begin CHARACTERISTIC KIPM_HwShftPstnSwSts_enum_ovrdval "" VALUE 0x0000 /* @ECU_Address@KIPM_HwShftPstnSwSts_enum_ovrdval@ */ Scalar_UBYTE 0 AppSwcVcu_CM_EnumPGearSwSts 0 4 /end CHARACTERISTIC
/begin CHARACTERISTIC KIPC_RegenModeActOvrdVal_enum "" VALUE 0x0000 /* @ECU_Address@KIPC_RegenModeActOvrdVal_enum@ */ Scalar_UBYTE 0 AppSwcVcu_CM_EnumRegenModeAct 0 2 /end CHARACTERISTIC
/begin CHARACTERISTIC KDAG_EmgcyShtdwnOvrdSw_flg "" VALUE 0x0000 /* @ECU_Address@KDAG_EmgcyShtdwnOvrdSw_flg@ */ Scalar_BOOLEAN 0 AppSwcVcu_CM_boolean_flg 0.0 1.0 /end CHARACTERISTIC
/begin CHARACTERISTIC KDAG_EmgcyShtdwnOvrdVal_flg "" VALUE 0x0000 /* @ECU_Address@KDAG_EmgcyShtdwnOvrdVal_flg@ */ Scalar_BOOLEAN 0 AppSwcVcu_CM_boolean_flg 0.0 1.0 /end CHARACTERISTIC
/begin CHARACTERISTIC KDAG_FanFullSpdOnOvrdSw_flg "" VALUE 0x0000 /* @ECU_Address@KDAG_FanFullSpdOnOvrdSw_flg@ */ Scalar_BOOLEAN 0 AppSwcVcu_CM_boolean_flg 0.0 1.0 /end CHARACTERISTIC
/begin CHARACTERISTIC KDAG_FanFullSpdOnOvrdVal_flg "" VALUE 0x0000 /* @ECU_Address@KDAG_FanFullSpdOnOvrdVal_flg@ */ Scalar_BOOLEAN 0 AppSwcVcu_CM_boolean_flg 0.0 1.0 /end CHARACTERISTIC
/begin CHARACTERISTIC KDAG_FbdACCOvrdSw_flg "" VALUE 0x0000 /* @ECU_Address@KDAG_FbdACCOvrdSw_flg@ */ Scalar_BOOLEAN 0 AppSwcVcu_CM_boolean_flg 0.0 1.0 /end CHARACTERISTIC
/begin CHARACTERISTIC KDAG_FbdACCOvrdVal_flg "" VALUE 0x0000 /* @ECU_Address@KDAG_FbdACCOvrdVal_flg@ */ Scalar_BOOLEAN 0 AppSwcVcu_CM_boolean_flg 0.0 1.0 /end CHARACTERISTIC
/begin CHARACTERISTIC KDAG_FbdACChrgOvrdSw_flg "" VALUE 0x0000 /* @ECU_Address@KDAG_FbdACChrgOvrdSw_flg@ */ Scalar_BOOLEAN 0 AppSwcVcu_CM_boolean_flg 0.0 1.0 /end CHARACTERISTIC
/begin CHARACTERISTIC KDAG_FbdACChrgOvrdVal_flg "" VALUE 0x0000 /* @ECU_Address@KDAG_FbdACChrgOvrdVal_flg@ */ Scalar_BOOLEAN 0 AppSwcVcu_CM_boolean_flg 0.0 1.0 /end CHARACTERISTIC
/begin CHARACTERISTIC KDAG_FbdACDchaOvrdSw_flg "" VALUE 0x0000 /* @ECU_Address@KDAG_FbdACDchaOvrdSw_flg@ */ Scalar_BOOLEAN 0 AppSwcVcu_CM_boolean_flg 0.0 1.0 /end CHARACTERISTIC
/begin CHARACTERISTIC KDAG_FbdACDchaOvrdVal_flg "" VALUE 0x0000 /* @ECU_Address@KDAG_FbdACDchaOvrdVal_flg@ */ Scalar_BOOLEAN 0 AppSwcVcu_CM_boolean_flg 0.0 1.0 /end CHARACTERISTIC
/begin CHARACTERISTIC KDAG_FbdACOvrdSw_flg "" VALUE 0x0000 /* @ECU_Address@KDAG_FbdACOvrdSw_flg@ */ Scalar_BOOLEAN 0 AppSwcVcu_CM_boolean_flg 0.0 1.0 /end CHARACTERISTIC
/begin CHARACTERISTIC KDAG_FbdACOvrdVal_flg "" VALUE 0x0000 /* @ECU_Address@KDAG_FbdACOvrdVal_flg@ */ Scalar_BOOLEAN 0 AppSwcVcu_CM_boolean_flg 0.0 1.0 /end CHARACTERISTIC
/begin CHARACTERISTIC KDAG_FbdCCOvrdSw_flg "" VALUE 0x0000 /* @ECU_Address@KDAG_FbdCCOvrdSw_flg@ */ Scalar_BOOLEAN 0 AppSwcVcu_CM_boolean_flg 0.0 1.0 /end CHARACTERISTIC
/begin CHARACTERISTIC KDAG_FbdCCOvrdVal_flg "" VALUE 0x0000 /* @ECU_Address@KDAG_FbdCCOvrdVal_flg@ */ Scalar_BOOLEAN 0 AppSwcVcu_CM_boolean_flg 0.0 1.0 /end CHARACTERISTIC
/begin CHARACTERISTIC KDAG_FbdDCChrgOvrdSw_flg "" VALUE 0x0000 /* @ECU_Address@KDAG_FbdDCChrgOvrdSw_flg@ */ Scalar_BOOLEAN 0 AppSwcVcu_CM_boolean_flg 0.0 1.0 /end CHARACTERISTIC
/begin CHARACTERISTIC KDAG_FbdDCChrgOvrdVal_flg "" VALUE 0x0000 /* @ECU_Address@KDAG_FbdDCChrgOvrdVal_flg@ */ Scalar_BOOLEAN 0 AppSwcVcu_CM_boolean_flg 0.0 1.0 /end CHARACTERISTIC
/begin CHARACTERISTIC KDAG_FbdDCDCOvrdSw_flg "" VALUE 0x0000 /* @ECU_Address@KDAG_FbdDCDCOvrdSw_flg@ */ Scalar_BOOLEAN 0 AppSwcVcu_CM_boolean_flg 0.0 1.0 /end CHARACTERISTIC
/begin CHARACTERISTIC KDAG_FbdDCDCOvrdVal_flg "" VALUE 0x0000 /* @ECU_Address@KDAG_FbdDCDCOvrdVal_flg@ */ Scalar_BOOLEAN 0 AppSwcVcu_CM_boolean_flg 0.0 1.0 /end CHARACTERISTIC
/begin CHARACTERISTIC KDAG_FbdDRGrOvrdSw_flg "" VALUE 0x0000 /* @ECU_Address@KDAG_FbdDRGrOvrdSw_flg@ */ Scalar_BOOLEAN 0 AppSwcVcu_CM_boolean_flg 0.0 1.0 /end CHARACTERISTIC
/begin CHARACTERISTIC KDAG_FbdDRGrOvrdVal_flg "" VALUE 0x0000 /* @ECU_Address@KDAG_FbdDRGrOvrdVal_flg@ */ Scalar_BOOLEAN 0 AppSwcVcu_CM_boolean_flg 0.0 1.0 /end CHARACTERISTIC
/begin CHARACTERISTIC KDAG_FbdDrvTqOvrdSw_flg "" VALUE 0x0000 /* @ECU_Address@KDAG_FbdDrvTqOvrdSw_flg@ */ Scalar_BOOLEAN 0 AppSwcVcu_CM_boolean_flg 0.0 1.0 /end CHARACTERISTIC
/begin CHARACTERISTIC KDAG_FbdDrvTqOvrdVal_flg "" VALUE 0x0000 /* @ECU_Address@KDAG_FbdDrvTqOvrdVal_flg@ */ Scalar_BOOLEAN 0 AppSwcVcu_CM_boolean_flg 0.0 1.0 /end CHARACTERISTIC
/begin CHARACTERISTIC KDAG_FbdHVOvrdSw_flg "" VALUE 0x0000 /* @ECU_Address@KDAG_FbdHVOvrdSw_flg@ */ Scalar_BOOLEAN 0 AppSwcVcu_CM_boolean_flg 0.0 1.0 /end CHARACTERISTIC
/begin CHARACTERISTIC KDAG_FbdHVOvrdVal_flg "" VALUE 0x0000 /* @ECU_Address@KDAG_FbdHVOvrdVal_flg@ */ Scalar_BOOLEAN 0 AppSwcVcu_CM_boolean_flg 0.0 1.0 /end CHARACTERISTIC
/begin CHARACTERISTIC KDAG_FbdLSPOvrdSw_flg "" VALUE 0x0000 /* @ECU_Address@KDAG_FbdLSPOvrdSw_flg@ */ Scalar_BOOLEAN 0 AppSwcVcu_CM_boolean_flg 0.0 1.0 /end CHARACTERISTIC
/begin CHARACTERISTIC KDAG_FbdLSPOvrdVal_flg "" VALUE 0x0000 /* @ECU_Address@KDAG_FbdLSPOvrdVal_flg@ */ Scalar_BOOLEAN 0 AppSwcVcu_CM_boolean_flg 0.0 1.0 /end CHARACTERISTIC
/begin CHARACTERISTIC KDAG_FltLampOnOvrdSw_flg "" VALUE 0x0000 /* @ECU_Address@KDAG_FltLampOnOvrdSw_flg@ */ Scalar_BOOLEAN 0 AppSwcVcu_CM_boolean_flg 0.0 1.0 /end CHARACTERISTIC
/begin CHARACTERISTIC KDAG_FltLampOnOvrdVal_flg "" VALUE 0x0000 /* @ECU_Address@KDAG_FltLampOnOvrdVal_flg@ */ Scalar_BOOLEAN 0 AppSwcVcu_CM_boolean_flg 0.0 1.0 /end CHARACTERISTIC
/begin CHARACTERISTIC KDAG_LVBatLampOnOvrdSw_flg "" VALUE 0x0000 /* @ECU_Address@KDAG_LVBatLampOnOvrdSw_flg@ */ Scalar_BOOLEAN 0 AppSwcVcu_CM_boolean_flg 0.0 1.0 /end CHARACTERISTIC
/begin CHARACTERISTIC KDAG_LVBatLampOnOvrdVal_flg "" VALUE 0x0000 /* @ECU_Address@KDAG_LVBatLampOnOvrdVal_flg@ */ Scalar_BOOLEAN 0 AppSwcVcu_CM_boolean_flg 0.0 1.0 /end CHARACTERISTIC
/begin CHARACTERISTIC KDAG_LimpHomeOvrdSw_flg "" VALUE 0x0000 /* @ECU_Address@KDAG_LimpHomeOvrdSw_flg@ */ Scalar_BOOLEAN 0 AppSwcVcu_CM_boolean_flg 0.0 1.0 /end CHARACTERISTIC
/begin CHARACTERISTIC KDAG_LimpHomeOvrdVal_flg "" VALUE 0x0000 /* @ECU_Address@KDAG_LimpHomeOvrdVal_flg@ */ Scalar_BOOLEAN 0 AppSwcVcu_CM_boolean_flg 0.0 1.0 /end CHARACTERISTIC
/begin CHARACTERISTIC KDAG_LmtDrvTqOvrdSw_flg "" VALUE 0x0000 /* @ECU_Address@KDAG_LmtDrvTqOvrdSw_flg@ */ Scalar_BOOLEAN 0 AppSwcVcu_CM_boolean_flg 0.0 1.0 /end CHARACTERISTIC
/begin CHARACTERISTIC KDAG_LmtDrvTqOvrdVal_flg "" VALUE 0x0000 /* @ECU_Address@KDAG_LmtDrvTqOvrdVal_flg@ */ Scalar_BOOLEAN 0 AppSwcVcu_CM_boolean_flg 0.0 1.0 /end CHARACTERISTIC
/begin CHARACTERISTIC KDAG_VehStandStillBypasBrk_flg "驻车清除故障不看刹车的标定量_建议标成1不用看刹车_满足停车和PN挡即可" VALUE 0x0000 /* @ECU_Address@KDAG_VehStandStillBypasBrk_flg@ */ Scalar_BOOLEAN 0 AppSwcVcu_CM_boolean_flg 0.0 1.0 /end CHARACTERISTIC
/begin CHARACTERISTIC KDSA_UseTqCalcAcceltn_flg "" VALUE 0x0000 /* @ECU_Address@KDSA_UseTqCalcAcceltn_flg@ */ Scalar_BOOLEAN 0 AppSwcVcu_CM_boolean_flg 0.0 1.0 /end CHARACTERISTIC
/begin CHARACTERISTIC KIBS_FbIBSWup_flg "禁止IBS唤醒手动开关_versteckt" VALUE 0x0000 /* @ECU_Address@KIBS_FbIBSWup_flg@ */ Scalar_BOOLEAN 0 AppSwcVcu_CM_boolean_flg 0.0 1.0 /end CHARACTERISTIC
/begin CHARACTERISTIC KIPC_ACCCfgOvrdSw_flg "" VALUE 0x0000 /* @ECU_Address@KIPC_ACCCfgOvrdSw_flg@ */ Scalar_BOOLEAN 0 AppSwcVcu_CM_boolean_flg 0.0 1.0 /end CHARACTERISTIC
/begin CHARACTERISTIC KIPC_ACCCfgOvrdVal_flg "" VALUE 0x0000 /* @ECU_Address@KIPC_ACCCfgOvrdVal_flg@ */ Scalar_BOOLEAN 0 AppSwcVcu_CM_boolean_flg 0.0 1.0 /end CHARACTERISTIC
/begin CHARACTERISTIC KIPC_BrkPedPstnOvrdSw_flg "" VALUE 0x0000 /* @ECU_Address@KIPC_BrkPedPstnOvrdSw_flg@ */ Scalar_BOOLEAN 0 AppSwcVcu_CM_boolean_flg 0.0 1.0 /end CHARACTERISTIC
/begin CHARACTERISTIC KIPC_CCSCfgOvrdSw_flg "" VALUE 0x0000 /* @ECU_Address@KIPC_CCSCfgOvrdSw_flg@ */ Scalar_BOOLEAN 0 AppSwcVcu_CM_boolean_flg 0.0 1.0 /end CHARACTERISTIC
/begin CHARACTERISTIC KIPC_CCSCfgOvrdVal_flg "" VALUE 0x0000 /* @ECU_Address@KIPC_CCSCfgOvrdVal_flg@ */ Scalar_BOOLEAN 0 AppSwcVcu_CM_boolean_flg 0.0 1.0 /end CHARACTERISTIC
/begin CHARACTERISTIC KIPC_CrpCtrlCfgOvrdSw_flg "" VALUE 0x0000 /* @ECU_Address@KIPC_CrpCtrlCfgOvrdSw_flg@ */ Scalar_BOOLEAN 0 AppSwcVcu_CM_boolean_flg 0.0 1.0 /end CHARACTERISTIC
/begin CHARACTERISTIC KIPC_CrpCtrlCfgOvrdVal_flg "" VALUE 0x0000 /* @ECU_Address@KIPC_CrpCtrlCfgOvrdVal_flg@ */ Scalar_BOOLEAN 0 AppSwcVcu_CM_boolean_flg 0.0 1.0 /end CHARACTERISTIC
/begin CHARACTERISTIC KIPC_CrpModeActOvrdSw_flg "" VALUE 0x0000 /* @ECU_Address@KIPC_CrpModeActOvrdSw_flg@ */ Scalar_BOOLEAN 0 AppSwcVcu_CM_boolean_flg 0.0 1.0 /end CHARACTERISTIC
/begin CHARACTERISTIC KIPC_DrvModeActOvrdSw_flg "" VALUE 0x0000 /* @ECU_Address@KIPC_DrvModeActOvrdSw_flg@ */ Scalar_BOOLEAN 0 AppSwcVcu_CM_boolean_flg 0.0 1.0 /end CHARACTERISTIC
/begin CHARACTERISTIC KIPC_DrvPwrIntnstyOvrdSw_flg "" VALUE 0x0000 /* @ECU_Address@KIPC_DrvPwrIntnstyOvrdSw_flg@ */ Scalar_BOOLEAN 0 AppSwcVcu_CM_boolean_flg 0.0 1.0 /end CHARACTERISTIC
/begin CHARACTERISTIC KIPC_HDCCfgOvrdSw_flg "" VALUE 0x0000 /* @ECU_Address@KIPC_HDCCfgOvrdSw_flg@ */ Scalar_BOOLEAN 0 AppSwcVcu_CM_boolean_flg 0.0 1.0 /end CHARACTERISTIC
/begin CHARACTERISTIC KIPC_HDCCfgOvrdVal_flg "" VALUE 0x0000 /* @ECU_Address@KIPC_HDCCfgOvrdVal_flg@ */ Scalar_BOOLEAN 0 AppSwcVcu_CM_boolean_flg 0.0 1.0 /end CHARACTERISTIC
/begin CHARACTERISTIC KIPC_RegenModeActOvrdSw_flg "" VALUE 0x0000 /* @ECU_Address@KIPC_RegenModeActOvrdSw_flg@ */ Scalar_BOOLEAN 0 AppSwcVcu_CM_boolean_flg 0.0 1.0 /end CHARACTERISTIC
/begin CHARACTERISTIC KIPC_RegenPwrIntnstyOvrdSw_flg "" VALUE 0x0000 /* @ECU_Address@KIPC_RegenPwrIntnstyOvrdSw_flg@ */ Scalar_BOOLEAN 0 AppSwcVcu_CM_boolean_flg 0.0 1.0 /end CHARACTERISTIC
/begin CHARACTERISTIC KIPC_SnowModeDft_flg "" VALUE 0x0000 /* @ECU_Address@KIPC_SnowModeDft_flg@ */ Scalar_BOOLEAN 0 AppSwcVcu_CM_boolean_flg 0.0 1.0 /end CHARACTERISTIC
/begin CHARACTERISTIC KIPC_SnowModeOvrdSw_flg "" VALUE 0x0000 /* @ECU_Address@KIPC_SnowModeOvrdSw_flg@ */ Scalar_BOOLEAN 0 AppSwcVcu_CM_boolean_flg 0.0 1.0 /end CHARACTERISTIC
/begin CHARACTERISTIC KIPC_SnowModeOvrdVal_flg "" VALUE 0x0000 /* @ECU_Address@KIPC_SnowModeOvrdVal_flg@ */ Scalar_BOOLEAN 0 AppSwcVcu_CM_boolean_flg 0.0 1.0 /end CHARACTERISTIC
/begin CHARACTERISTIC KIPC_iTPMSCfgOvrdSw_flg "" VALUE 0x0000 /* @ECU_Address@KIPC_iTPMSCfgOvrdSw_flg@ */ Scalar_BOOLEAN 0 AppSwcVcu_CM_boolean_flg 0.0 1.0 /end CHARACTERISTIC
/begin CHARACTERISTIC KIPC_iTPMSCfgOvrdVal_flg "" VALUE 0x0000 /* @ECU_Address@KIPC_iTPMSCfgOvrdVal_flg@ */ Scalar_BOOLEAN 0 AppSwcVcu_CM_boolean_flg 0.0 1.0 /end CHARACTERISTIC
/begin CHARACTERISTIC KIPM_HwAccPedCh1SuplyVolt_mV_ovrdflg "" VALUE 0x0000 /* @ECU_Address@KIPM_HwAccPedCh1SuplyVolt_mV_ovrdflg@ */ Scalar_BOOLEAN 0 AppSwcVcu_CM_boolean_flg 0.0 1.0 /end CHARACTERISTIC
/begin CHARACTERISTIC KIPM_HwAccPedCh1Volt_mV_ovrdflg "" VALUE 0x0000 /* @ECU_Address@KIPM_HwAccPedCh1Volt_mV_ovrdflg@ */ Scalar_BOOLEAN 0 AppSwcVcu_CM_boolean_flg 0.0 1.0 /end CHARACTERISTIC
/begin CHARACTERISTIC KIPM_HwAccPedCh2SuplyVolt_mV_ovrdflg "" VALUE 0x0000 /* @ECU_Address@KIPM_HwAccPedCh2SuplyVolt_mV_ovrdflg@ */ Scalar_BOOLEAN 0 AppSwcVcu_CM_boolean_flg 0.0 1.0 /end CHARACTERISTIC
/begin CHARACTERISTIC KIPM_HwAccPedCh2Volt_mV_ovrdflg "" VALUE 0x0000 /* @ECU_Address@KIPM_HwAccPedCh2Volt_mV_ovrdflg@ */ Scalar_BOOLEAN 0 AppSwcVcu_CM_boolean_flg 0.0 1.0 /end CHARACTERISTIC
/begin CHARACTERISTIC KIPM_HwBMSWakeup_flg_ovrdflg "" VALUE 0x0000 /* @ECU_Address@KIPM_HwBMSWakeup_flg_ovrdflg@ */ Scalar_BOOLEAN 0 AppSwcVcu_CM_boolean_flg 0.0 1.0 /end CHARACTERISTIC
/begin CHARACTERISTIC KIPM_HwBMSWakeup_flg_ovrdval "" VALUE 0x0000 /* @ECU_Address@KIPM_HwBMSWakeup_flg_ovrdval@ */ Scalar_BOOLEAN 0 AppSwcVcu_CM_boolean_flg 0.0 1.0 /end CHARACTERISTIC
/begin CHARACTERISTIC KIPM_HwBrkSwHi_flg_ovrdflg "" VALUE 0x0000 /* @ECU_Address@KIPM_HwBrkSwHi_flg_ovrdflg@ */ Scalar_BOOLEAN 0 AppSwcVcu_CM_boolean_flg 0.0 1.0 /end CHARACTERISTIC
/begin CHARACTERISTIC KIPM_HwBrkSwHi_flg_ovrdval "" VALUE 0x0000 /* @ECU_Address@KIPM_HwBrkSwHi_flg_ovrdval@ */ Scalar_BOOLEAN 0 AppSwcVcu_CM_boolean_flg 0.0 1.0 /end CHARACTERISTIC
/begin CHARACTERISTIC KIPM_HwBrkSwLo_flg_ovrdflg "" VALUE 0x0000 /* @ECU_Address@KIPM_HwBrkSwLo_flg_ovrdflg@ */ Scalar_BOOLEAN 0 AppSwcVcu_CM_boolean_flg 0.0 1.0 /end CHARACTERISTIC
/begin CHARACTERISTIC KIPM_HwBrkSwLo_flg_ovrdval "" VALUE 0x0000 /* @ECU_Address@KIPM_HwBrkSwLo_flg_ovrdval@ */ Scalar_BOOLEAN 0 AppSwcVcu_CM_boolean_flg 0.0 1.0 /end CHARACTERISTIC
/begin CHARACTERISTIC KIPM_HwCrpModeSw_flg_ovrdflg "" VALUE 0x0000 /* @ECU_Address@KIPM_HwCrpModeSw_flg_ovrdflg@ */ Scalar_BOOLEAN 0 AppSwcVcu_CM_boolean_flg 0.0 1.0 /end CHARACTERISTIC
/begin CHARACTERISTIC KIPM_HwCrpModeSw_flg_ovrdval "" VALUE 0x0000 /* @ECU_Address@KIPM_HwCrpModeSw_flg_ovrdval@ */ Scalar_BOOLEAN 0 AppSwcVcu_CM_boolean_flg 0.0 1.0 /end CHARACTERISTIC
/begin CHARACTERISTIC KIPM_HwDrvModeSw_flg_ovrdflg "" VALUE 0x0000 /* @ECU_Address@KIPM_HwDrvModeSw_flg_ovrdflg@ */ Scalar_BOOLEAN 0 AppSwcVcu_CM_boolean_flg 0.0 1.0 /end CHARACTERISTIC
/begin CHARACTERISTIC KIPM_HwDrvModeSw_flg_ovrdval "" VALUE 0x0000 /* @ECU_Address@KIPM_HwDrvModeSw_flg_ovrdval@ */ Scalar_BOOLEAN 0 AppSwcVcu_CM_boolean_flg 0.0 1.0 /end CHARACTERISTIC
/begin CHARACTERISTIC KIPM_HwEmgcyShutOff_flg_ovrdflg "" VALUE 0x0000 /* @ECU_Address@KIPM_HwEmgcyShutOff_flg_ovrdflg@ */ Scalar_BOOLEAN 0 AppSwcVcu_CM_boolean_flg 0.0 1.0 /end CHARACTERISTIC
/begin CHARACTERISTIC KIPM_HwEmgcyShutOff_flg_ovrdval "" VALUE 0x0000 /* @ECU_Address@KIPM_HwEmgcyShutOff_flg_ovrdval@ */ Scalar_BOOLEAN 0 AppSwcVcu_CM_boolean_flg 0.0 1.0 /end CHARACTERISTIC
/begin CHARACTERISTIC KIPM_HwHVIL1Volt_mV_ovrdflg "" VALUE 0x0000 /* @ECU_Address@KIPM_HwHVIL1Volt_mV_ovrdflg@ */ Scalar_BOOLEAN 0 AppSwcVcu_CM_boolean_flg 0.0 1.0 /end CHARACTERISTIC
/begin CHARACTERISTIC KIPM_HwHVIL2Volt_mV_ovrdflg "" VALUE 0x0000 /* @ECU_Address@KIPM_HwHVIL2Volt_mV_ovrdflg@ */ Scalar_BOOLEAN 0 AppSwcVcu_CM_boolean_flg 0.0 1.0 /end CHARACTERISTIC
/begin CHARACTERISTIC KIPM_HwKL15A_flg_ovrdflg "" VALUE 0x0000 /* @ECU_Address@KIPM_HwKL15A_flg_ovrdflg@ */ Scalar_BOOLEAN 0 AppSwcVcu_CM_boolean_flg 0.0 1.0 /end CHARACTERISTIC
/begin CHARACTERISTIC KIPM_HwKL15A_flg_ovrdval "" VALUE 0x0000 /* @ECU_Address@KIPM_HwKL15A_flg_ovrdval@ */ Scalar_BOOLEAN 0 AppSwcVcu_CM_boolean_flg 0.0 1.0 /end CHARACTERISTIC
/begin CHARACTERISTIC KIPM_HwKL15B_flg_ovrdflg "" VALUE 0x0000 /* @ECU_Address@KIPM_HwKL15B_flg_ovrdflg@ */ Scalar_BOOLEAN 0 AppSwcVcu_CM_boolean_flg 0.0 1.0 /end CHARACTERISTIC
/begin CHARACTERISTIC KIPM_HwKL15B_flg_ovrdval "" VALUE 0x0000 /* @ECU_Address@KIPM_HwKL15B_flg_ovrdval@ */ Scalar_BOOLEAN 0 AppSwcVcu_CM_boolean_flg 0.0 1.0 /end CHARACTERISTIC
/begin CHARACTERISTIC KIPM_HwKL30_mV_ovrdflg "" VALUE 0x0000 /* @ECU_Address@KIPM_HwKL30_mV_ovrdflg@ */ Scalar_BOOLEAN 0 AppSwcVcu_CM_boolean_flg 0.0 1.0 /end CHARACTERISTIC
/begin CHARACTERISTIC KIPM_HwOBCWakeup_flg_ovrdflg "" VALUE 0x0000 /* @ECU_Address@KIPM_HwOBCWakeup_flg_ovrdflg@ */ Scalar_BOOLEAN 0 AppSwcVcu_CM_boolean_flg 0.0 1.0 /end CHARACTERISTIC
/begin CHARACTERISTIC KIPM_HwOBCWakeup_flg_ovrdval "" VALUE 0x0000 /* @ECU_Address@KIPM_HwOBCWakeup_flg_ovrdval@ */ Scalar_BOOLEAN 0 AppSwcVcu_CM_boolean_flg 0.0 1.0 /end CHARACTERISTIC
/begin CHARACTERISTIC KIPM_HwRearFogLampSwt_flg_ovrdflg "" VALUE 0x0000 /* @ECU_Address@KIPM_HwRearFogLampSwt_flg_ovrdflg@ */ Scalar_BOOLEAN 0 AppSwcVcu_CM_boolean_flg 0.0 1.0 /end CHARACTERISTIC
/begin CHARACTERISTIC KIPM_HwRearFogLampSwt_flg_ovrdval "" VALUE 0x0000 /* @ECU_Address@KIPM_HwRearFogLampSwt_flg_ovrdval@ */ Scalar_BOOLEAN 0 AppSwcVcu_CM_boolean_flg 0.0 1.0 /end CHARACTERISTIC
/begin CHARACTERISTIC KIPM_HwShftPstnSwSts_enum_ovrdflg "" VALUE 0x0000 /* @ECU_Address@KIPM_HwShftPstnSwSts_enum_ovrdflg@ */ Scalar_BOOLEAN 0 AppSwcVcu_CM_boolean_flg 0.0 1.0 /end CHARACTERISTIC
/begin CHARACTERISTIC KIPM_HwVehCrash_flg_ovrdflg "" VALUE 0x0000 /* @ECU_Address@KIPM_HwVehCrash_flg_ovrdflg@ */ Scalar_BOOLEAN 0 AppSwcVcu_CM_boolean_flg 0.0 1.0 /end CHARACTERISTIC
/begin CHARACTERISTIC KIPM_HwVehCrash_flg_ovrdval "" VALUE 0x0000 /* @ECU_Address@KIPM_HwVehCrash_flg_ovrdval@ */ Scalar_BOOLEAN 0 AppSwcVcu_CM_boolean_flg 0.0 1.0 /end CHARACTERISTIC
/begin CHARACTERISTIC KOPM_HwWakeupBMS_flg_ovrdflg "" VALUE 0x0000 /* @ECU_Address@KOPM_HwWakeupBMS_flg_ovrdflg@ */ Scalar_BOOLEAN 0 AppSwcVcu_CM_boolean_flg 0.0 1.0 /end CHARACTERISTIC
/begin CHARACTERISTIC KOPM_HwWakeupBMS_flg_ovrdval "" VALUE 0x0000 /* @ECU_Address@KOPM_HwWakeupBMS_flg_ovrdval@ */ Scalar_BOOLEAN 0 AppSwcVcu_CM_boolean_flg 0.0 1.0 /end CHARACTERISTIC
/begin CHARACTERISTIC KRME_SOHCrctFacEnbl_flg "使用SOH对RptSOC修正" VALUE 0x0000 /* @ECU_Address@KRME_SOHCrctFacEnbl_flg@ */ Scalar_BOOLEAN 0 AppSwcVcu_CM_boolean_c 0.0 1.0 /end CHARACTERISTIC
/begin CHARACTERISTIC KRME_WLTPDynModeEnbl_flg "WLTP控制方式选择:0-查表WLTP续航 1-动态续航 " VALUE 0x0000 /* @ECU_Address@KRME_WLTPDynModeEnbl_flg@ */ Scalar_BOOLEAN 0 AppSwcVcu_CM_boolean_flg 0.0 1.0 /end CHARACTERISTIC
/begin CHARACTERISTIC KSYS_ChkTaskRunCnt_flg "" VALUE 0x0000 /* @ECU_Address@KSYS_ChkTaskRunCnt_flg@ */ Scalar_BOOLEAN 0 AppSwcVcu_CM_boolean_flg 0.0 1.0 /end CHARACTERISTIC
/begin CHARACTERISTIC KVCU_EcuCommReq_flg "_versteckt" VALUE 0x0000 /* @ECU_Address@KVCU_EcuCommReq_flg@ */ Scalar_BOOLEAN 0 AppSwcVcu_CM_boolean_flg 0.0 1.0 /end CHARACTERISTIC
/begin CHARACTERISTIC KVCU_XWhlDistErrRefOvrdSw_flg "_versteckt" VALUE 0x0000 /* @ECU_Address@KVCU_XWhlDistErrRefOvrdSw_flg@ */ Scalar_BOOLEAN 0 AppSwcVcu_CM_boolean_flg 0.0 1.0 /end CHARACTERISTIC
/begin CHARACTERISTIC KVCU_XWhlDistErrRefStatOvrdSw_flg "_versteckt" VALUE 0x0000 /* @ECU_Address@KVCU_XWhlDistErrRefStatOvrdSw_flg@ */ Scalar_BOOLEAN 0 AppSwcVcu_CM_boolean_flg 0.0 1.0 /end CHARACTERISTIC
/begin CHARACTERISTIC KVCU_iTPMSWrngOvrdSw_flg "_versteckt" VALUE 0x0000 /* @ECU_Address@KVCU_iTPMSWrngOvrdSw_flg@ */ Scalar_BOOLEAN 0 AppSwcVcu_CM_boolean_flg 0.0 1.0 /end CHARACTERISTIC
/begin CHARACTERISTIC KVCU_iTPMSWrngOvrdVal_flg "_versteckt" VALUE 0x0000 /* @ECU_Address@KVCU_iTPMSWrngOvrdVal_flg@ */ Scalar_BOOLEAN 0 AppSwcVcu_CM_boolean_flg 0.0 1.0 /end CHARACTERISTIC
/begin CHARACTERISTIC KDAG_Did0xF163WrtData_cnt "CCU_FlashDriver软件" VAL_BLK 0x0000 /* @ECU_Address@KDAG_Did0xF163WrtData_cnt@ */ Scalar_UBYTE 0 AppSwcVcu_CM_uint8_cnt 0.0 9.0 NUMBER 4 /end CHARACTERISTIC
/begin CHARACTERISTIC KDAG_Did0xF180WrtData_cnt "CCU_Boot软件" VAL_BLK 0x0000 /* @ECU_Address@KDAG_Did0xF180WrtData_cnt@ */ Scalar_UBYTE 0 AppSwcVcu_CM_uint8_cnt 0.0 9.0 NUMBER 4 /end CHARACTERISTIC
/begin CHARACTERISTIC KDAG_Did0xF187WrtData_cnt "总成号" VAL_BLK 0x0000 /* @ECU_Address@KDAG_Did0xF187WrtData_cnt@ */ Scalar_UBYTE 0 AppSwcVcu_CM_uint8_cnt 0.0 9.0 NUMBER 2 /end CHARACTERISTIC
/begin CHARACTERISTIC KDAG_Did0xF188WrtData_cnt "CCU_App软件" VAL_BLK 0x0000 /* @ECU_Address@KDAG_Did0xF188WrtData_cnt@ */ Scalar_UBYTE 0 AppSwcVcu_CM_uint8_cnt 0.0 9.0 NUMBER 4 /end CHARACTERISTIC
/begin CHARACTERISTIC KDAG_Did0xF191WrtData_cnt "CCU硬件" VAL_BLK 0x0000 /* @ECU_Address@KDAG_Did0xF191WrtData_cnt@ */ Scalar_UBYTE 0 AppSwcVcu_CM_uint8_cnt 0.0 9.0 NUMBER 4 /end CHARACTERISTIC
/begin CHARACTERISTIC KDAG_ManlClrDTCReq_enum "手动清除所有故障的标定_从0改成255时触发起一次作用" VALUE 0x0000 /* @ECU_Address@KDAG_ManlClrDTCReq_enum@ */ Scalar_UBYTE 0 AppSwcVcu_CM_uint8_enum 0.0 255.0 /end CHARACTERISTIC
/begin CHARACTERISTIC KIBS_ChgMaxNumThr_cnt "最大补电次数阈值_versteckt" VALUE 0x0000 /* @ECU_Address@KIBS_ChgMaxNumThr_cnt@ */ Scalar_UBYTE 0 AppSwcVcu_CM_uint8_cnt 0.0 255.0 /end CHARACTERISTIC
/begin CHARACTERISTIC KIBS_FailChgNumThr_cnt "最大补电失败次数阈值_versteckt" VALUE 0x0000 /* @ECU_Address@KIBS_FailChgNumThr_cnt@ */ Scalar_UBYTE 0 AppSwcVcu_CM_uint8_cnt 0.0 255.0 /end CHARACTERISTIC
/begin CHARACTERISTIC KIBS_WakeupReas_enum "底层唤醒原因枚举值_versteckt" VALUE 0x0000 /* @ECU_Address@KIBS_WakeupReas_enum@ */ Scalar_UBYTE 0 AppSwcVcu_CM_uint8_enum 0.0 255.0 /end CHARACTERISTIC
/begin CHARACTERISTIC KIPC_DrvPwrIntnstyOvrdVal_pct "" VALUE 0x0000 /* @ECU_Address@KIPC_DrvPwrIntnstyOvrdVal_pct@ */ Scalar_UBYTE 0 AppSwcVcu_CM_uint8_pct 0.0 150.0 /end CHARACTERISTIC
/begin CHARACTERISTIC KIPC_RegenPwrIntnstyOvrdVal_pct "" VALUE 0x0000 /* @ECU_Address@KIPC_RegenPwrIntnstyOvrdVal_pct@ */ Scalar_UBYTE 0 AppSwcVcu_CM_uint8_pct 0.0 150.0 /end CHARACTERISTIC
/begin CHARACTERISTIC KSYS_CalVer_cnt "" VALUE 0x0000 /* @ECU_Address@KSYS_CalVer_cnt@ */ Scalar_UBYTE 0 AppSwcVcu_CM_uint8_Ah 0.0 255.0 /end CHARACTERISTIC
/begin CHARACTERISTIC KVCU_XWhlDistErrRefStatOvrdVal_enum "_versteckt" VALUE 0x0000 /* @ECU_Address@KVCU_XWhlDistErrRefStatOvrdVal_enum@ */ Scalar_UBYTE 0 AppSwcVcu_CM_uint8_enum 0.0 255.0 /end CHARACTERISTIC
/begin MEASUREMENT VNVM_XWhlDistErrRef_mpkm "" FLOAT32_IEEE AppSwcVcu_CM_single_mpkm 0 0 -100000.0 100000.0 ECU_ADDRESS 0x0000 /* @ECU_Address@VNVM_XWhlDistErrRef_mpkm@ */ /end MEASUREMENT
/begin MEASUREMENT VNVM_AvgPwrCnsm_kWh100km "" FLOAT32_IEEE AppSwcVcu_CM_single_kWhp100km 0 0 -100000.0 100000.0 ECU_ADDRESS 0x0000 /* @ECU_Address@VNVM_AvgPwrCnsm_kWh100km@ */ /end MEASUREMENT
/begin MEASUREMENT VNVM_AvgSOCCnsmWght_pctp100km "" FLOAT32_IEEE AppSwcVcu_CM_single_pctp100km 0 0 -100000.0 100000.0 ECU_ADDRESS 0x0000 /* @ECU_Address@VNVM_AvgSOCCnsmWght_pctp100km@ */ /end MEASUREMENT
/begin MEASUREMENT VNVM_DynRmnMilEst_km "" FLOAT32_IEEE AppSwcVcu_CM_single_km 0 0 -100000.0 100000.0 ECU_ADDRESS 0x0000 /* @ECU_Address@VNVM_DynRmnMilEst_km@ */ /end MEASUREMENT
/begin MEASUREMENT VIPM_HwHVIL2Volt_mV "" FLOAT32_IEEE AppSwcVcu_CM_single_mV 0 0 -100000.0 100000.0 ECU_ADDRESS 0x0000 /* @ECU_Address@VIPM_HwHVIL2Volt_mV@ */ /end MEASUREMENT
/begin MEASUREMENT VIPM_HwHVIL1Volt_mV "" FLOAT32_IEEE AppSwcVcu_CM_single_mV 0 0 -100000.0 100000.0 ECU_ADDRESS 0x0000 /* @ECU_Address@VIPM_HwHVIL1Volt_mV@ */ /end MEASUREMENT
/begin MEASUREMENT VIPM_HwAccPedCh2Volt_mV "" FLOAT32_IEEE AppSwcVcu_CM_single_mV 0 0 -100000.0 100000.0 ECU_ADDRESS 0x0000 /* @ECU_Address@VIPM_HwAccPedCh2Volt_mV@ */ /end MEASUREMENT
/begin MEASUREMENT VIPM_HwAccPedCh2SuplyVolt_mV "" FLOAT32_IEEE AppSwcVcu_CM_single_mV 0 0 -100000.0 100000.0 ECU_ADDRESS 0x0000 /* @ECU_Address@VIPM_HwAccPedCh2SuplyVolt_mV@ */ /end MEASUREMENT
/begin MEASUREMENT VIPM_HwAccPedCh1Volt_mV "" FLOAT32_IEEE AppSwcVcu_CM_single_mV 0 0 -100000.0 100000.0 ECU_ADDRESS 0x0000 /* @ECU_Address@VIPM_HwAccPedCh1Volt_mV@ */ /end MEASUREMENT
/begin MEASUREMENT VIPM_HwAccPedCh1SuplyVolt_mV "" FLOAT32_IEEE AppSwcVcu_CM_single_mV 0 0 -100000.0 100000.0 ECU_ADDRESS 0x0000 /* @ECU_Address@VIPM_HwAccPedCh1SuplyVolt_mV@ */ /end MEASUREMENT
/begin MEASUREMENT VEMS_MaxConChrgCur_A "" FLOAT32_IEEE AppSwcVcu_CM_single_A 0 0 -100000.0 100000.0 ECU_ADDRESS 0x0000 /* @ECU_Address@VEMS_MaxConChrgCur_A@ */ /end MEASUREMENT
/begin MEASUREMENT VEMS_MaxInsChrgCur_A "" FLOAT32_IEEE AppSwcVcu_CM_single_A 0 0 -100000.0 100000.0 ECU_ADDRESS 0x0000 /* @ECU_Address@VEMS_MaxInsChrgCur_A@ */ /end MEASUREMENT
/begin MEASUREMENT VEMS_MaxChrgCur_A "" FLOAT32_IEEE AppSwcVcu_CM_single_A 0 0 -100000.0 100000.0 ECU_ADDRESS 0x0000 /* @ECU_Address@VEMS_MaxChrgCur_A@ */ /end MEASUREMENT
/begin MEASUREMENT VEMS_MaxChrgPwr_kW "" FLOAT32_IEEE AppSwcVcu_CM_single_kW 0 0 -100000.0 100000.0 ECU_ADDRESS 0x0000 /* @ECU_Address@VEMS_MaxChrgPwr_kW@ */ /end MEASUREMENT
/begin MEASUREMENT VEMS_AccPwrRaw_kW "" FLOAT32_IEEE AppSwcVcu_CM_single_kW 0 0 -100000.0 100000.0 ECU_ADDRESS 0x0000 /* @ECU_Address@VEMS_AccPwrRaw_kW@ */ /end MEASUREMENT
/begin MEASUREMENT VEMS_MaxChrgPwr2MotRaw_kW "" FLOAT32_IEEE AppSwcVcu_CM_single_kW 0 0 -100000.0 100000.0 ECU_ADDRESS 0x0000 /* @ECU_Address@VEMS_MaxChrgPwr2MotRaw_kW@ */ /end MEASUREMENT
/begin MEASUREMENT VEMS_HVBatPwrAct_kW "" FLOAT32_IEEE AppSwcVcu_CM_single_kW 0 0 -100000.0 100000.0 ECU_ADDRESS 0x0000 /* @ECU_Address@VEMS_HVBatPwrAct_kW@ */ /end MEASUREMENT
/begin MEASUREMENT VEMS_ChrgOvrshtPwr_kW "" FLOAT32_IEEE AppSwcVcu_CM_single_kW 0 0 -100000.0 100000.0 ECU_ADDRESS 0x0000 /* @ECU_Address@VEMS_ChrgOvrshtPwr_kW@ */ /end MEASUREMENT
/begin MEASUREMENT VEMS_ChrgPwrFb_kW "" FLOAT32_IEEE AppSwcVcu_CM_single_kW 0 0 -100000.0 100000.0 ECU_ADDRESS 0x0000 /* @ECU_Address@VEMS_ChrgPwrFb_kW@ */ /end MEASUREMENT
/begin MEASUREMENT VEMS_MaxChrgPwr2Mot_kW "" FLOAT32_IEEE AppSwcVcu_CM_single_kW 0 0 -100000.0 100000.0 ECU_ADDRESS 0x0000 /* @ECU_Address@VEMS_MaxChrgPwr2Mot_kW@ */ /end MEASUREMENT
/begin MEASUREMENT VEMS_MaxConDchaCur_A "" FLOAT32_IEEE AppSwcVcu_CM_single_A 0 0 -100000.0 100000.0 ECU_ADDRESS 0x0000 /* @ECU_Address@VEMS_MaxConDchaCur_A@ */ /end MEASUREMENT
/begin MEASUREMENT VEMS_MaxInsDchaCur_A "" FLOAT32_IEEE AppSwcVcu_CM_single_A 0 0 -100000.0 100000.0 ECU_ADDRESS 0x0000 /* @ECU_Address@VEMS_MaxInsDchaCur_A@ */ /end MEASUREMENT
/begin MEASUREMENT VEMS_CellUndrVoltDrtFac_c "" FLOAT32_IEEE AppSwcVcu_CM_single_c 0 0 0.0 1.0 ECU_ADDRESS 0x0000 /* @ECU_Address@VEMS_CellUndrVoltDrtFac_c@ */ /end MEASUREMENT
/begin MEASUREMENT VEMS_MaxDchaCur_A "" FLOAT32_IEEE AppSwcVcu_CM_single_A 0 0 -100000.0 100000.0 ECU_ADDRESS 0x0000 /* @ECU_Address@VEMS_MaxDchaCur_A@ */ /end MEASUREMENT
/begin MEASUREMENT VEMS_MaxDchaPwr_kW "" FLOAT32_IEEE AppSwcVcu_CM_single_kW 0 0 -100000.0 100000.0 ECU_ADDRESS 0x0000 /* @ECU_Address@VEMS_MaxDchaPwr_kW@ */ /end MEASUREMENT
/begin MEASUREMENT VEMS_MaxDchaPwr2MotRaw_kW "" FLOAT32_IEEE AppSwcVcu_CM_single_kW 0 0 -100000.0 100000.0 ECU_ADDRESS 0x0000 /* @ECU_Address@VEMS_MaxDchaPwr2MotRaw_kW@ */ /end MEASUREMENT
/begin MEASUREMENT VEMS_DchaOvrshtPwr_kW "" FLOAT32_IEEE AppSwcVcu_CM_single_kW 0 0 -100000.0 100000.0 ECU_ADDRESS 0x0000 /* @ECU_Address@VEMS_DchaOvrshtPwr_kW@ */ /end MEASUREMENT
/begin MEASUREMENT VEMS_DchaPwrFb_kW "" FLOAT32_IEEE AppSwcVcu_CM_single_kW 0 0 -100000.0 100000.0 ECU_ADDRESS 0x0000 /* @ECU_Address@VEMS_DchaPwrFb_kW@ */ /end MEASUREMENT
/begin MEASUREMENT VEMS_MaxDchaPwr2Mot_kW "" FLOAT32_IEEE AppSwcVcu_CM_single_kW 0 0 -100000.0 100000.0 ECU_ADDRESS 0x0000 /* @ECU_Address@VEMS_MaxDchaPwr2Mot_kW@ */ /end MEASUREMENT
/begin MEASUREMENT VEMS_TMSUsePwr_kW "TMS可用功率" FLOAT32_IEEE AppSwcVcu_CM_single_kW 0 0 -100000.0 100000.0 ECU_ADDRESS 0x0000 /* @ECU_Address@VEMS_TMSUsePwr_kW@ */ /end MEASUREMENT
/begin MEASUREMENT VHVM_MaxChrgVoltDC_V "VCU允许BMS直流充电最大电压对应CAN信号：VCU_MaxChrgVol_DC" FLOAT32_IEEE AppSwcVcu_CM_single_V 0 0 -1.0E+6 1.0E+6 ECU_ADDRESS 0x0000 /* @ECU_Address@VHVM_MaxChrgVoltDC_V@ */ /end MEASUREMENT
/begin MEASUREMENT VHVM_MaxChrgCurntDC_A "VCU允许BMS直流充电最大电流对应CAN信号：VCU_MaxChrgCrnt_DC" FLOAT32_IEEE AppSwcVcu_CM_single_A 0 0 -1.0E+6 1.0E+6 ECU_ADDRESS 0x0000 /* @ECU_Address@VHVM_MaxChrgCurntDC_A@ */ /end MEASUREMENT
/begin MEASUREMENT VHVM_MaxHVDCVoltAC_V "VCU允许OBC交流充电最大电压对应CAN信号：VCU_MaxHVDC_Vol_AC" FLOAT32_IEEE AppSwcVcu_CM_single_V 0 0 -1.0E+6 1.0E+6 ECU_ADDRESS 0x0000 /* @ECU_Address@VHVM_MaxHVDCVoltAC_V@ */ /end MEASUREMENT
/begin MEASUREMENT VHVM_MaxHVDCCurntAC_A "VCU允许OBC交流充电最大电流对应CAN信号：VCU_MaxHVDC_Cur_AC" FLOAT32_IEEE AppSwcVcu_CM_single_A 0 0 -1.0E+6 1.0E+6 ECU_ADDRESS 0x0000 /* @ECU_Address@VHVM_MaxHVDCCurntAC_A@ */ /end MEASUREMENT
/begin MEASUREMENT VHVM_DCCBuckLVVolt_V "VCU控制DCDC BUCK电压值对应CAN信号：VCU_DCCBuckLV_Vol" FLOAT32_IEEE AppSwcVcu_CM_single_V 0 0 -1.0E+6 1.0E+6 ECU_ADDRESS 0x0000 /* @ECU_Address@VHVM_DCCBuckLVVolt_V@ */ /end MEASUREMENT
/begin MEASUREMENT VVSO_VehSpd_mps "" FLOAT32_IEEE AppSwcVcu_CM_single_mps 0 0 -100000.0 100000.0 ECU_ADDRESS 0x0000 /* @ECU_Address@VVSO_VehSpd_mps@ */ /end MEASUREMENT
/begin MEASUREMENT VVSO_AvgXWhlDistErr_mpkm "" FLOAT32_IEEE AppSwcVcu_CM_single_mpkm 0 0 -100000.0 100000.0 ECU_ADDRESS 0x0000 /* @ECU_Address@VVSO_AvgXWhlDistErr_mpkm@ */ /end MEASUREMENT
/begin MEASUREMENT VVSO_XWhlDistErrRef_mpkm "" FLOAT32_IEEE AppSwcVcu_CM_single_mpkm 0 0 -100000.0 100000.0 ECU_ADDRESS 0x0000 /* @ECU_Address@VVSO_XWhlDistErrRef_mpkm@ */ /end MEASUREMENT
/begin MEASUREMENT VVSO_AvgXWhlDistErr1_mpkm "" FLOAT32_IEEE AppSwcVcu_CM_single_mpkm 0 0 -100000.0 100000.0 ECU_ADDRESS 0x0000 /* @ECU_Address@VVSO_AvgXWhlDistErr1_mpkm@ */ /end MEASUREMENT
/begin MEASUREMENT VVSO_AvgXWhlDistErr2_mpkm "" FLOAT32_IEEE AppSwcVcu_CM_single_mpkm 0 0 -100000.0 100000.0 ECU_ADDRESS 0x0000 /* @ECU_Address@VVSO_AvgXWhlDistErr2_mpkm@ */ /end MEASUREMENT
/begin MEASUREMENT VVSO_AvgXWhlDistErr3_mpkm "" FLOAT32_IEEE AppSwcVcu_CM_single_mpkm 0 0 -100000.0 100000.0 ECU_ADDRESS 0x0000 /* @ECU_Address@VVSO_AvgXWhlDistErr3_mpkm@ */ /end MEASUREMENT
/begin MEASUREMENT VVSO_AvgXWhlDistErr4_mpkm "" FLOAT32_IEEE AppSwcVcu_CM_single_mpkm 0 0 -100000.0 100000.0 ECU_ADDRESS 0x0000 /* @ECU_Address@VVSO_AvgXWhlDistErr4_mpkm@ */ /end MEASUREMENT
/begin MEASUREMENT VVSO_AvgXWhlDistErr5_mpkm "" FLOAT32_IEEE AppSwcVcu_CM_single_mpkm 0 0 -100000.0 100000.0 ECU_ADDRESS 0x0000 /* @ECU_Address@VVSO_AvgXWhlDistErr5_mpkm@ */ /end MEASUREMENT
/begin MEASUREMENT VVTM_RsrvRecupPwr_kW "" FLOAT32_IEEE AppSwcVcu_CM_single_kW 0 0 -100000.0 100000.0 ECU_ADDRESS 0x0000 /* @ECU_Address@VVTM_RsrvRecupPwr_kW@ */ /end MEASUREMENT
/begin MEASUREMENT VVTM_RsrvPwr_kW "" FLOAT32_IEEE AppSwcVcu_CM_single_kW 0 0 -100000.0 100000.0 ECU_ADDRESS 0x0000 /* @ECU_Address@VVTM_RsrvPwr_kW@ */ /end MEASUREMENT
/begin MEASUREMENT VTQR_MotorSpdReq_rpm "" FLOAT32_IEEE AppSwcVcu_CM_single_rpm 0 0 -100000.0 100000.0 ECU_ADDRESS 0x0000 /* @ECU_Address@VTQR_MotorSpdReq_rpm@ */ /end MEASUREMENT
/begin MEASUREMENT VTQR_MotorTqReq_Nm "" FLOAT32_IEEE AppSwcVcu_CM_single_Nm 0 0 -100000.0 100000.0 ECU_ADDRESS 0x0000 /* @ECU_Address@VTQR_MotorTqReq_Nm@ */ /end MEASUREMENT
/begin MEASUREMENT VCPT_WhlDrgMaxTq_Nm "" FLOAT32_IEEE AppSwcVcu_CM_single_Nm 0 0 -100000.0 100000.0 ECU_ADDRESS 0x0000 /* @ECU_Address@VCPT_WhlDrgMaxTq_Nm@ */ /end MEASUREMENT
/begin MEASUREMENT VCPT_MotorDrgMaxTq_Nm "" FLOAT32_IEEE AppSwcVcu_CM_single_Nm 0 0 -100000.0 100000.0 ECU_ADDRESS 0x0000 /* @ECU_Address@VCPT_MotorDrgMaxTq_Nm@ */ /end MEASUREMENT
/begin MEASUREMENT VCPT_MotorDrvMaxTq_Nm "" FLOAT32_IEEE AppSwcVcu_CM_single_Nm 0 0 -100000.0 100000.0 ECU_ADDRESS 0x0000 /* @ECU_Address@VCPT_MotorDrvMaxTq_Nm@ */ /end MEASUREMENT
/begin MEASUREMENT VCPT_WhlDrvMaxTq_Nm "" FLOAT32_IEEE AppSwcVcu_CM_single_Nm 0 0 -100000.0 100000.0 ECU_ADDRESS 0x0000 /* @ECU_Address@VCPT_WhlDrvMaxTq_Nm@ */ /end MEASUREMENT
/begin MEASUREMENT VIPC_BrkPedPstn_pct "" FLOAT32_IEEE AppSwcVcu_CM_single_pct 0 0 -100000.0 100000.0 ECU_ADDRESS 0x0000 /* @ECU_Address@VIPC_BrkPedPstn_pct@ */ /end MEASUREMENT
/begin MEASUREMENT VIPC_TireRadius_m "" FLOAT32_IEEE AppSwcVcu_CM_single_m 0 0 -100000.0 100000.0 ECU_ADDRESS 0x0000 /* @ECU_Address@VIPC_TireRadius_m@ */ /end MEASUREMENT
/begin MEASUREMENT VIPC_VehSpdDrvnMotor_kph "" FLOAT32_IEEE AppSwcVcu_CM_single_kph 0 0 -100000.0 100000.0 ECU_ADDRESS 0x0000 /* @ECU_Address@VIPC_VehSpdDrvnMotor_kph@ */ /end MEASUREMENT
/begin MEASUREMENT VDSA_TqCalcAcceltn_mps2 "" FLOAT32_IEEE AppSwcVcu_CM_single_mps2 0 0 -100000.0 100000.0 ECU_ADDRESS 0x0000 /* @ECU_Address@VDSA_TqCalcAcceltn_mps2@ */ /end MEASUREMENT
/begin MEASUREMENT VDSA_AcceltnIdxRaw_pct "" FLOAT32_IEEE AppSwcVcu_CM_single_pct 0 0 -100000.0 100000.0 ECU_ADDRESS 0x0000 /* @ECU_Address@VDSA_AcceltnIdxRaw_pct@ */ /end MEASUREMENT
/begin MEASUREMENT VDSA_DrvSprtIdx_pct "" FLOAT32_IEEE AppSwcVcu_CM_single_pct 0 0 -100000.0 100000.0 ECU_ADDRESS 0x0000 /* @ECU_Address@VDSA_DrvSprtIdx_pct@ */ /end MEASUREMENT
/begin MEASUREMENT VDSA_BrkPedPstnAvg_pct "" FLOAT32_IEEE AppSwcVcu_CM_single_pct 0 0 -100000.0 100000.0 ECU_ADDRESS 0x0000 /* @ECU_Address@VDSA_BrkPedPstnAvg_pct@ */ /end MEASUREMENT
/begin MEASUREMENT VDSA_AcceltnIdxAvg_pct "" FLOAT32_IEEE AppSwcVcu_CM_single_pct 0 0 -100000.0 100000.0 ECU_ADDRESS 0x0000 /* @ECU_Address@VDSA_AcceltnIdxAvg_pct@ */ /end MEASUREMENT
/begin MEASUREMENT VIBS_MustChrgVolt_V "兜底电压_versteckt" FLOAT32_IEEE AppSwcVcu_CM_single_V 0 0 0.0 20.0 ECU_ADDRESS 0x0000 /* @ECU_Address@VIBS_MustChrgVolt_V@ */ /end MEASUREMENT
/begin MEASUREMENT VIBS_ChrgVoltThr_V "补电电压阈值_versteckt" FLOAT32_IEEE AppSwcVcu_CM_single_V 0 0 -40.0 215.0 ECU_ADDRESS 0x0000 /* @ECU_Address@VIBS_ChrgVoltThr_V@ */ /end MEASUREMENT
/begin MEASUREMENT VRME_CHTCRmnMilEst_km "CHTC标准续航查表值" FLOAT32_IEEE AppSwcVcu_CM_single_km 0 0 0.0 1000.0 ECU_ADDRESS 0x0000 /* @ECU_Address@VRME_CHTCRmnMilEst_km@ */ /end MEASUREMENT
/begin MEASUREMENT VIPM_HwShftPstnSw_Ohm "" UWORD AppSwcVcu_CM_uint16_Ohm 0 0 0.0 65535.0 ECU_ADDRESS 0x0000 /* @ECU_Address@VIPM_HwShftPstnSw_Ohm@ */ /end MEASUREMENT
/begin MEASUREMENT VIPM_HwKL30_mV "" UWORD AppSwcVcu_CM_uint16_mV 0 0 0.0 65535.0 ECU_ADDRESS 0x0000 /* @ECU_Address@VIPM_HwKL30_mV@ */ /end MEASUREMENT
/begin MEASUREMENT VDAG_ErrCode_enum "" UWORD AppSwcVcu_CM_uint16_enum 0 0 0.0 65535.0 ECU_ADDRESS 0x0000 /* @ECU_Address@VDAG_ErrCode_enum@ */ /end MEASUREMENT
/begin MEASUREMENT VTQD_TaskRunCounter_cnt "test signal, to be deleted" UWORD AppSwcVcu_CM_uint16_cnt 0 0 0.0 65535.0 ECU_ADDRESS 0x0000 /* @ECU_Address@VTQD_TaskRunCounter_cnt@ */ /end MEASUREMENT
/begin MEASUREMENT VIBS_WupChgTmThr_min "IBS补电时间阈值_versteckt" UWORD AppSwcVcu_CM_uint16_min 0 0 0.0 65535.0 ECU_ADDRESS 0x0000 /* @ECU_Address@VIBS_WupChgTmThr_min@ */ /end MEASUREMENT
/begin MEASUREMENT VIBS_NextRtcWupThr_min "下次补电唤醒RTC的时间_versteckt" UWORD AppSwcVcu_CM_uint16_min 0 0 0.0 65535.0 ECU_ADDRESS 0x0000 /* @ECU_Address@VIBS_NextRtcWupThr_min@ */ /end MEASUREMENT
/begin MEASUREMENT VNVM_EE01ReadOK_nu "" UBYTE AppSwcVcu_CM_uint8_nu 0 0 0.0 255.0 ECU_ADDRESS 0x0000 /* @ECU_Address@VNVM_EE01ReadOK_nu@ */ /end MEASUREMENT
/begin MEASUREMENT VBSW_WakeupReasn_enum "" UBYTE AppSwcVcu_CM_uint8_enum 0 0 0.0 255.0 ECU_ADDRESS 0x0000 /* @ECU_Address@VBSW_WakeupReasn_enum@ */ /end MEASUREMENT
/begin MEASUREMENT VNVM_IBSChrgNum_cnt "" UBYTE AppSwcVcu_CM_uint8_cnt 0 0 0.0 255.0 ECU_ADDRESS 0x0000 /* @ECU_Address@VNVM_IBSChrgNum_cnt@ */ /end MEASUREMENT
/begin MEASUREMENT VNVM_IBSChrgFailNum_cnt "" UBYTE AppSwcVcu_CM_uint8_cnt 0 0 0.0 255.0 ECU_ADDRESS 0x0000 /* @ECU_Address@VNVM_IBSChrgFailNum_cnt@ */ /end MEASUREMENT
/begin MEASUREMENT VNVM_DrvPwrIntnsty_pct "" UBYTE AppSwcVcu_CM_uint8_pct 0 0 0.0 255.0 ECU_ADDRESS 0x0000 /* @ECU_Address@VNVM_DrvPwrIntnsty_pct@ */ /end MEASUREMENT
/begin MEASUREMENT VNVM_RegenPwrIntnsty_pct "" UBYTE AppSwcVcu_CM_uint8_pct 0 0 0.0 255.0 ECU_ADDRESS 0x0000 /* @ECU_Address@VNVM_RegenPwrIntnsty_pct@ */ /end MEASUREMENT
/begin MEASUREMENT VNVM_ACChrgMaxCurrFb_A "" UBYTE AppSwcVcu_CM_uint8_A 0 0 0.0 255.0 ECU_ADDRESS 0x0000 /* @ECU_Address@VNVM_ACChrgMaxCurrFb_A@ */ /end MEASUREMENT
/begin MEASUREMENT VNVM_ACChrgModeFb_enum "" UBYTE AppSwcVcu_CM_uint8_enum 0 0 0.0 255.0 ECU_ADDRESS 0x0000 /* @ECU_Address@VNVM_ACChrgModeFb_enum@ */ /end MEASUREMENT
/begin MEASUREMENT VNVM_EEImdtReadOK_nu "" UBYTE AppSwcVcu_CM_uint8_nu 0 0 0.0 255.0 ECU_ADDRESS 0x0000 /* @ECU_Address@VNVM_EEImdtReadOK_nu@ */ /end MEASUREMENT
/begin MEASUREMENT VHVM_ChrgEnaAC_enum "VCU控制OBC交流充电使能指令对应CAN信号：VCU_ChrgEna_AC" UBYTE AppSwcVcu_CM_uint8_enum 0 0 0.0 255.0 ECU_ADDRESS 0x0000 /* @ECU_Address@VHVM_ChrgEnaAC_enum@ */ /end MEASUREMENT
/begin MEASUREMENT UDS_TBOX_BJS_Time_Year "" UBYTE AppSwcVcu_CM_uint8 0 0 0.0 255.0 ECU_ADDRESS 0x0000 /* @ECU_Address@UDS_TBOX_BJS_Time_Year@ */ /end MEASUREMENT
/begin MEASUREMENT UDS_TBOX_BJS_Time_Month "" UBYTE AppSwcVcu_CM_uint8 0 0 0.0 255.0 ECU_ADDRESS 0x0000 /* @ECU_Address@UDS_TBOX_BJS_Time_Month@ */ /end MEASUREMENT
/begin MEASUREMENT UDS_TBOX_BJS_Time_Day "" UBYTE AppSwcVcu_CM_uint8 0 0 0.0 255.0 ECU_ADDRESS 0x0000 /* @ECU_Address@UDS_TBOX_BJS_Time_Day@ */ /end MEASUREMENT
/begin MEASUREMENT UDS_TBOX_BJS_Time_Hour "" UBYTE AppSwcVcu_CM_uint8 0 0 0.0 255.0 ECU_ADDRESS 0x0000 /* @ECU_Address@UDS_TBOX_BJS_Time_Hour@ */ /end MEASUREMENT
/begin MEASUREMENT UDS_TBOX_BJS_Time_Min "" UBYTE AppSwcVcu_CM_uint8 0 0 0.0 255.0 ECU_ADDRESS 0x0000 /* @ECU_Address@UDS_TBOX_BJS_Time_Min@ */ /end MEASUREMENT
/begin MEASUREMENT UDS_TBOX_BJS_Time_Sec "" UBYTE AppSwcVcu_CM_uint8 0 0 0.0 255.0 ECU_ADDRESS 0x0000 /* @ECU_Address@UDS_TBOX_BJS_Time_Sec@ */ /end MEASUREMENT
/begin MEASUREMENT VDAG_FltLvl_enum "" UBYTE AppSwcVcu_CM_uint8_enum 0 0 0.0 255.0 ECU_ADDRESS 0x0000 /* @ECU_Address@VDAG_FltLvl_enum@ */ /end MEASUREMENT
/begin MEASUREMENT VVSO_VehMassDistb_enum "" UBYTE AppSwcVcu_CM_uint8_enum 0 0 0.0 255.0 ECU_ADDRESS 0x0000 /* @ECU_Address@VVSO_VehMassDistb_enum@ */ /end MEASUREMENT
/begin MEASUREMENT VVTM_DrvMotorSta_enum "" UBYTE AppSwcVcu_CM_uint8_enum 0 0 0.0 255.0 ECU_ADDRESS 0x0000 /* @ECU_Address@VVTM_DrvMotorSta_enum@ */ /end MEASUREMENT
/begin MEASUREMENT VVTM_VehActGrPstn_enum "" UBYTE AppSwcVcu_CM_uint8_enum 0 0 0.0 255.0 ECU_ADDRESS 0x0000 /* @ECU_Address@VVTM_VehActGrPstn_enum@ */ /end MEASUREMENT
/begin MEASUREMENT VIPC_DrvPwrIntnsty_pct "" UBYTE AppSwcVcu_CM_uint8_pct 0 0 0.0 255.0 ECU_ADDRESS 0x0000 /* @ECU_Address@VIPC_DrvPwrIntnsty_pct@ */ /end MEASUREMENT
/begin MEASUREMENT VIPC_RegenPwrIntnsty_pct "" UBYTE AppSwcVcu_CM_uint8_pct 0 0 0.0 255.0 ECU_ADDRESS 0x0000 /* @ECU_Address@VIPC_RegenPwrIntnsty_pct@ */ /end MEASUREMENT
/begin MEASUREMENT VIPC_VehHiddenMode_enum "" UBYTE AppSwcVcu_CM_uint8_enum 0 0 0.0 255.0 ECU_ADDRESS 0x0000 /* @ECU_Address@VIPC_VehHiddenMode_enum@ */ /end MEASUREMENT
/begin MEASUREMENT VHMI_12VBatLowVolSta_enum "" UBYTE AppSwcVcu_CM_uint8_enum 0 0 0.0 255.0 ECU_ADDRESS 0x0000 /* @ECU_Address@VHMI_12VBatLowVolSta_enum@ */ /end MEASUREMENT
/begin MEASUREMENT VHMI_InfoDisp_enum "仪表弹窗值" UBYTE AppSwcVcu_CM_uint8_enum 0 0 0.0 255.0 ECU_ADDRESS 0x0000 /* @ECU_Address@VHMI_InfoDisp_enum@ */ /end MEASUREMENT
/begin MEASUREMENT VIBS_ChgNum_cnt "IBS补电次数_versteckt" UBYTE AppSwcVcu_CM_uint8_cnt 0 0 0.0 255.0 ECU_ADDRESS 0x0000 /* @ECU_Address@VIBS_ChgNum_cnt@ */ /end MEASUREMENT
/begin MEASUREMENT VIBS_FailChgNum_cnt "IBS补电失败次数_versteckt" UBYTE AppSwcVcu_CM_uint8_cnt 0 0 0.0 255.0 ECU_ADDRESS 0x0000 /* @ECU_Address@VIBS_FailChgNum_cnt@ */ /end MEASUREMENT
/begin MEASUREMENT VOPM_HwWakeupBMS_flg "" UBYTE AppSwcVcu_CM_boolean_flg 0 0 0.0 1.0 ECU_ADDRESS 0x0000 /* @ECU_Address@VOPM_HwWakeupBMS_flg@ */ /end MEASUREMENT
/begin MEASUREMENT VNVM_iTPMSWrng_flg "" UBYTE AppSwcVcu_CM_boolean_flg 0 0 0.0 1.0 ECU_ADDRESS 0x0000 /* @ECU_Address@VNVM_iTPMSWrng_flg@ */ /end MEASUREMENT
/begin MEASUREMENT VNVM_VCUVerFb_flg "" UBYTE AppSwcVcu_CM_boolean_flg 0 0 0.0 1.0 ECU_ADDRESS 0x0000 /* @ECU_Address@VNVM_VCUVerFb_flg@ */ /end MEASUREMENT
/begin MEASUREMENT VNVM_TBOXOffline_flg "" UBYTE AppSwcVcu_CM_boolean_flg 0 0 0.0 1.0 ECU_ADDRESS 0x0000 /* @ECU_Address@VNVM_TBOXOffline_flg@ */ /end MEASUREMENT
/begin MEASUREMENT VIPM_HwVehCrash_flg "" UBYTE AppSwcVcu_CM_boolean_flg 0 0 0.0 1.0 ECU_ADDRESS 0x0000 /* @ECU_Address@VIPM_HwVehCrash_flg@ */ /end MEASUREMENT
/begin MEASUREMENT VIPM_HwRearFogLampSwt_flg "" UBYTE AppSwcVcu_CM_boolean_flg 0 0 0.0 1.0 ECU_ADDRESS 0x0000 /* @ECU_Address@VIPM_HwRearFogLampSwt_flg@ */ /end MEASUREMENT
/begin MEASUREMENT VIPM_HwOBCWakeup_flg "" UBYTE AppSwcVcu_CM_boolean_flg 0 0 0.0 1.0 ECU_ADDRESS 0x0000 /* @ECU_Address@VIPM_HwOBCWakeup_flg@ */ /end MEASUREMENT
/begin MEASUREMENT VIPM_HwKL15B_flg "" UBYTE AppSwcVcu_CM_boolean_flg 0 0 0.0 1.0 ECU_ADDRESS 0x0000 /* @ECU_Address@VIPM_HwKL15B_flg@ */ /end MEASUREMENT
/begin MEASUREMENT VIPM_HwKL15A_flg "" UBYTE AppSwcVcu_CM_boolean_flg 0 0 0.0 1.0 ECU_ADDRESS 0x0000 /* @ECU_Address@VIPM_HwKL15A_flg@ */ /end MEASUREMENT
/begin MEASUREMENT VIPM_HwEmgcyShutOff_flg "" UBYTE AppSwcVcu_CM_boolean_flg 0 0 0.0 1.0 ECU_ADDRESS 0x0000 /* @ECU_Address@VIPM_HwEmgcyShutOff_flg@ */ /end MEASUREMENT
/begin MEASUREMENT VIPM_HwDrvModeSw_flg "" UBYTE AppSwcVcu_CM_boolean_flg 0 0 0.0 1.0 ECU_ADDRESS 0x0000 /* @ECU_Address@VIPM_HwDrvModeSw_flg@ */ /end MEASUREMENT
/begin MEASUREMENT VIPM_HwCrpModeSw_flg "" UBYTE AppSwcVcu_CM_boolean_flg 0 0 0.0 1.0 ECU_ADDRESS 0x0000 /* @ECU_Address@VIPM_HwCrpModeSw_flg@ */ /end MEASUREMENT
/begin MEASUREMENT VIPM_HwBrkSwLo_flg "" UBYTE AppSwcVcu_CM_boolean_flg 0 0 0.0 1.0 ECU_ADDRESS 0x0000 /* @ECU_Address@VIPM_HwBrkSwLo_flg@ */ /end MEASUREMENT
/begin MEASUREMENT VIPM_HwBrkSwHi_flg "" UBYTE AppSwcVcu_CM_boolean_flg 0 0 0.0 1.0 ECU_ADDRESS 0x0000 /* @ECU_Address@VIPM_HwBrkSwHi_flg@ */ /end MEASUREMENT
/begin MEASUREMENT VIPM_HwBMSWakeup_flg "" UBYTE AppSwcVcu_CM_boolean_flg 0 0 0.0 1.0 ECU_ADDRESS 0x0000 /* @ECU_Address@VIPM_HwBMSWakeup_flg@ */ /end MEASUREMENT
/begin MEASUREMENT VEMS_TMSPwrEnbl_flg "功率是否限制TMS" UBYTE AppSwcVcu_CM_boolean_flg 0 0 0.0 1.0 ECU_ADDRESS 0x0000 /* @ECU_Address@VEMS_TMSPwrEnbl_flg@ */ /end MEASUREMENT
/begin MEASUREMENT VEMS_ACCMOprtCmd_flg "使能ACCM" UBYTE AppSwcVcu_CM_boolean_flg 0 0 0.0 1.0 ECU_ADDRESS 0x0000 /* @ECU_Address@VEMS_ACCMOprtCmd_flg@ */ /end MEASUREMENT
/begin MEASUREMENT VHVM_EmgcySdn_flg "VCU给INV发送紧急下电指令(INV强制停机)对应CAN信号：VCU_1_EmShutDown" UBYTE AppSwcVcu_CM_boolean_flg 0 0 0.0 1.0 ECU_ADDRESS 0x0000 /* @ECU_Address@VHVM_EmgcySdn_flg@ */ /end MEASUREMENT
/begin MEASUREMENT VHVM_WakeUpBMS_flg "VCU硬线唤醒BMS" UBYTE AppSwcVcu_CM_boolean_flg 0 0 0.0 1.0 ECU_ADDRESS 0x0000 /* @ECU_Address@VHVM_WakeUpBMS_flg@ */ /end MEASUREMENT
/begin MEASUREMENT VHVM_Bat2DrvTrainEnbl_flg "VCU控制主继电器指令对应CAN信号：VCU_Bat2DrvTrainEnb" UBYTE AppSwcVcu_CM_boolean_flg 0 0 0.0 1.0 ECU_ADDRESS 0x0000 /* @ECU_Address@VHVM_Bat2DrvTrainEnbl_flg@ */ /end MEASUREMENT
/begin MEASUREMENT VHVM_INVEnbl_flg "VCU硬线唤醒INV" UBYTE AppSwcVcu_CM_boolean_flg 0 0 0.0 1.0 ECU_ADDRESS 0x0000 /* @ECU_Address@VHVM_INVEnbl_flg@ */ /end MEASUREMENT
/begin MEASUREMENT VHVM_EnaDisChg_flg "VCU控制INV泄放指令对应CAN信号：VCU_1_EnaDisChg" UBYTE AppSwcVcu_CM_boolean_flg 0 0 0.0 1.0 ECU_ADDRESS 0x0000 /* @ECU_Address@VHVM_EnaDisChg_flg@ */ /end MEASUREMENT
/begin MEASUREMENT VHVM_ECUSleepAllwd_flg "允许底层休眠标志位" UBYTE AppSwcVcu_CM_boolean_flg 0 0 0.0 1.0 ECU_ADDRESS 0x0000 /* @ECU_Address@VHVM_ECUSleepAllwd_flg@ */ /end MEASUREMENT
/begin MEASUREMENT VHVM_ChrgEnaDC_flg "VCU控制BMS直流充电使能指令对应CAN信号：VCU_ChrgEna_DC" UBYTE AppSwcVcu_CM_boolean_flg 0 0 0.0 1.0 ECU_ADDRESS 0x0000 /* @ECU_Address@VHVM_ChrgEnaDC_flg@ */ /end MEASUREMENT
/begin MEASUREMENT VDAG_FbdDrvTq_flg "" UBYTE AppSwcVcu_CM_boolean_flg 0 0 0.0 1.0 ECU_ADDRESS 0x0000 /* @ECU_Address@VDAG_FbdDrvTq_flg@ */ /end MEASUREMENT
/begin MEASUREMENT VDAG_LimpHome_flg "" UBYTE AppSwcVcu_CM_boolean_flg 0 0 0.0 1.0 ECU_ADDRESS 0x0000 /* @ECU_Address@VDAG_LimpHome_flg@ */ /end MEASUREMENT
/begin MEASUREMENT VDAG_LmtDrvTq_flg "" UBYTE AppSwcVcu_CM_boolean_flg 0 0 0.0 1.0 ECU_ADDRESS 0x0000 /* @ECU_Address@VDAG_LmtDrvTq_flg@ */ /end MEASUREMENT
/begin MEASUREMENT VDAG_FbdDRGr_flg "" UBYTE AppSwcVcu_CM_boolean_flg 0 0 0.0 1.0 ECU_ADDRESS 0x0000 /* @ECU_Address@VDAG_FbdDRGr_flg@ */ /end MEASUREMENT
/begin MEASUREMENT VDAG_FbdCC_flg "" UBYTE AppSwcVcu_CM_boolean_flg 0 0 0.0 1.0 ECU_ADDRESS 0x0000 /* @ECU_Address@VDAG_FbdCC_flg@ */ /end MEASUREMENT
/begin MEASUREMENT VDAG_FbdLSP_flg "" UBYTE AppSwcVcu_CM_boolean_flg 0 0 0.0 1.0 ECU_ADDRESS 0x0000 /* @ECU_Address@VDAG_FbdLSP_flg@ */ /end MEASUREMENT
/begin MEASUREMENT VDAG_FbdACC_flg "" UBYTE AppSwcVcu_CM_boolean_flg 0 0 0.0 1.0 ECU_ADDRESS 0x0000 /* @ECU_Address@VDAG_FbdACC_flg@ */ /end MEASUREMENT
/begin MEASUREMENT VDAG_FbdHV_flg "" UBYTE AppSwcVcu_CM_boolean_flg 0 0 0.0 1.0 ECU_ADDRESS 0x0000 /* @ECU_Address@VDAG_FbdHV_flg@ */ /end MEASUREMENT
/begin MEASUREMENT VDAG_EmgcyShtdwn_flg "" UBYTE AppSwcVcu_CM_boolean_flg 0 0 0.0 1.0 ECU_ADDRESS 0x0000 /* @ECU_Address@VDAG_EmgcyShtdwn_flg@ */ /end MEASUREMENT
/begin MEASUREMENT VDAG_FbdDCDC_flg "" UBYTE AppSwcVcu_CM_boolean_flg 0 0 0.0 1.0 ECU_ADDRESS 0x0000 /* @ECU_Address@VDAG_FbdDCDC_flg@ */ /end MEASUREMENT
/begin MEASUREMENT VDAG_FbdACChrg_flg "" UBYTE AppSwcVcu_CM_boolean_flg 0 0 0.0 1.0 ECU_ADDRESS 0x0000 /* @ECU_Address@VDAG_FbdACChrg_flg@ */ /end MEASUREMENT
/begin MEASUREMENT VDAG_FbdDCChrg_flg "" UBYTE AppSwcVcu_CM_boolean_flg 0 0 0.0 1.0 ECU_ADDRESS 0x0000 /* @ECU_Address@VDAG_FbdDCChrg_flg@ */ /end MEASUREMENT
/begin MEASUREMENT VDAG_FbdACDcha_flg "" UBYTE AppSwcVcu_CM_boolean_flg 0 0 0.0 1.0 ECU_ADDRESS 0x0000 /* @ECU_Address@VDAG_FbdACDcha_flg@ */ /end MEASUREMENT
/begin MEASUREMENT VDAG_FbdAC_flg "" UBYTE AppSwcVcu_CM_boolean_flg 0 0 0.0 1.0 ECU_ADDRESS 0x0000 /* @ECU_Address@VDAG_FbdAC_flg@ */ /end MEASUREMENT
/begin MEASUREMENT VDAG_FltLampOn_flg "" UBYTE AppSwcVcu_CM_boolean_flg 0 0 0.0 1.0 ECU_ADDRESS 0x0000 /* @ECU_Address@VDAG_FltLampOn_flg@ */ /end MEASUREMENT
/begin MEASUREMENT VDAG_LVBatLampOn_flg "" UBYTE AppSwcVcu_CM_boolean_flg 0 0 0.0 1.0 ECU_ADDRESS 0x0000 /* @ECU_Address@VDAG_LVBatLampOn_flg@ */ /end MEASUREMENT
/begin MEASUREMENT VDAG_FanFullSpdOn_flg "" UBYTE AppSwcVcu_CM_boolean_flg 0 0 0.0 1.0 ECU_ADDRESS 0x0000 /* @ECU_Address@VDAG_FanFullSpdOn_flg@ */ /end MEASUREMENT
/begin MEASUREMENT VDAG_WakeUp_flg "硬线唤醒或者IBSLIN唤醒标志" UBYTE AppSwcVcu_CM_boolean_flg 0 0 0.0 1.0 ECU_ADDRESS 0x0000 /* @ECU_Address@VDAG_WakeUp_flg@ */ /end MEASUREMENT
/begin MEASUREMENT VVSO_VehMassConf_flg "" UBYTE AppSwcVcu_CM_boolean_flg 0 0 0.0 1.0 ECU_ADDRESS 0x0000 /* @ECU_Address@VVSO_VehMassConf_flg@ */ /end MEASUREMENT
/begin MEASUREMENT VVSO_iTPMSWrng_flg "" UBYTE AppSwcVcu_CM_boolean_flg 0 0 0.0 1.0 ECU_ADDRESS 0x0000 /* @ECU_Address@VVSO_iTPMSWrng_flg@ */ /end MEASUREMENT
/begin MEASUREMENT VVTM_PCUFailSta_flg "" UBYTE AppSwcVcu_CM_boolean_flg 0 0 0.0 1.0 ECU_ADDRESS 0x0000 /* @ECU_Address@VVTM_PCUFailSta_flg@ */ /end MEASUREMENT
/begin MEASUREMENT VCPT_MotorSpdRvrs_flg "" UBYTE AppSwcVcu_CM_boolean_flg 0 0 0.0 1.0 ECU_ADDRESS 0x0000 /* @ECU_Address@VCPT_MotorSpdRvrs_flg@ */ /end MEASUREMENT
/begin MEASUREMENT VVTM_ESPIntvActv_flg "" UBYTE AppSwcVcu_CM_boolean_flg 0 0 0.0 1.0 ECU_ADDRESS 0x0000 /* @ECU_Address@VVTM_ESPIntvActv_flg@ */ /end MEASUREMENT
/begin MEASUREMENT VVTM_BrkPedReld_flg "" UBYTE AppSwcVcu_CM_boolean_flg 0 0 0.0 1.0 ECU_ADDRESS 0x0000 /* @ECU_Address@VVTM_BrkPedReld_flg@ */ /end MEASUREMENT
/begin MEASUREMENT VIPC_BrkPedPstnVld_flg "" UBYTE AppSwcVcu_CM_boolean_flg 0 0 0.0 1.0 ECU_ADDRESS 0x0000 /* @ECU_Address@VIPC_BrkPedPstnVld_flg@ */ /end MEASUREMENT
/begin MEASUREMENT VIPC_BrkSwActv_flg "" UBYTE AppSwcVcu_CM_boolean_flg 0 0 0.0 1.0 ECU_ADDRESS 0x0000 /* @ECU_Address@VIPC_BrkSwActv_flg@ */ /end MEASUREMENT
/begin MEASUREMENT VIPC_CCSCfgd_flg "" UBYTE AppSwcVcu_CM_boolean_flg 0 0 0.0 1.0 ECU_ADDRESS 0x0000 /* @ECU_Address@VIPC_CCSCfgd_flg@ */ /end MEASUREMENT
/begin MEASUREMENT VIPC_ACCCfgd_flg "" UBYTE AppSwcVcu_CM_boolean_flg 0 0 0.0 1.0 ECU_ADDRESS 0x0000 /* @ECU_Address@VIPC_ACCCfgd_flg@ */ /end MEASUREMENT
/begin MEASUREMENT VIPC_HDCCfgd_flg "" UBYTE AppSwcVcu_CM_boolean_flg 0 0 0.0 1.0 ECU_ADDRESS 0x0000 /* @ECU_Address@VIPC_HDCCfgd_flg@ */ /end MEASUREMENT
/begin MEASUREMENT VIPC_iTPMSCfgd_flg "" UBYTE AppSwcVcu_CM_boolean_flg 0 0 0.0 1.0 ECU_ADDRESS 0x0000 /* @ECU_Address@VIPC_iTPMSCfgd_flg@ */ /end MEASUREMENT
/begin MEASUREMENT VIPC_EPBAppld_flg "" UBYTE AppSwcVcu_CM_boolean_flg 0 0 0.0 1.0 ECU_ADDRESS 0x0000 /* @ECU_Address@VIPC_EPBAppld_flg@ */ /end MEASUREMENT
/begin MEASUREMENT VIPC_EPBReld_flg "" UBYTE AppSwcVcu_CM_boolean_flg 0 0 0.0 1.0 ECU_ADDRESS 0x0000 /* @ECU_Address@VIPC_EPBReld_flg@ */ /end MEASUREMENT
/begin MEASUREMENT VIPC_SnowMode_flg "" UBYTE AppSwcVcu_CM_boolean_flg 0 0 0.0 1.0 ECU_ADDRESS 0x0000 /* @ECU_Address@VIPC_SnowMode_flg@ */ /end MEASUREMENT
/begin MEASUREMENT VIPC_CrpCtrlCfgd_flg "" UBYTE AppSwcVcu_CM_boolean_flg 0 0 0.0 1.0 ECU_ADDRESS 0x0000 /* @ECU_Address@VIPC_CrpCtrlCfgd_flg@ */ /end MEASUREMENT
/begin MEASUREMENT VDSA_SprtIdxHldAcc_flg "" UBYTE AppSwcVcu_CM_boolean_flg 0 0 0.0 1.0 ECU_ADDRESS 0x0000 /* @ECU_Address@VDSA_SprtIdxHldAcc_flg@ */ /end MEASUREMENT
/begin MEASUREMENT VDSA_SprtIdxHldBrk_flg "" UBYTE AppSwcVcu_CM_boolean_flg 0 0 0.0 1.0 ECU_ADDRESS 0x0000 /* @ECU_Address@VDSA_SprtIdxHldBrk_flg@ */ /end MEASUREMENT
/begin MEASUREMENT VIBS_RTCWakeup_flg "RTC唤醒标志位（含延迟时间）_versteckt" UBYTE AppSwcVcu_CM_boolean_flg 0 0 0.0 1.0 ECU_ADDRESS 0x0000 /* @ECU_Address@VIBS_RTCWakeup_flg@ */ /end MEASUREMENT
/begin MEASUREMENT VIBS_ChgNumAllow_flg "补电次数允许标志位_versteckt" UBYTE AppSwcVcu_CM_boolean_flg 0 0 0.0 1.0 ECU_ADDRESS 0x0000 /* @ECU_Address@VIBS_ChgNumAllow_flg@ */ /end MEASUREMENT
/begin MEASUREMENT VIBS_ChrgBascCond_flg "补电基本条件满足（补电次数及电压）_versteckt" UBYTE AppSwcVcu_CM_boolean_flg 0 0 0.0 1.0 ECU_ADDRESS 0x0000 /* @ECU_Address@VIBS_ChrgBascCond_flg@ */ /end MEASUREMENT
/begin MEASUREMENT VIBS_BMSBatSOCAllow_flg "动力电池SOC允许补电标志位_versteckt" UBYTE AppSwcVcu_CM_boolean_flg 0 0 0.0 1.0 ECU_ADDRESS 0x0000 /* @ECU_Address@VIBS_BMSBatSOCAllow_flg@ */ /end MEASUREMENT
/begin MEASUREMENT VIBS_ChrgEnbl_flg "IBS充电使能标志位_versteckt" UBYTE AppSwcVcu_CM_boolean_flg 0 0 0.0 1.0 ECU_ADDRESS 0x0000 /* @ECU_Address@VIBS_ChrgEnbl_flg@ */ /end MEASUREMENT
/begin MEASUREMENT VIBS_HVReq_flg "IBS请求上高压标志位_versteckt" UBYTE AppSwcVcu_CM_boolean_flg 0 0 0.0 1.0 ECU_ADDRESS 0x0000 /* @ECU_Address@VIBS_HVReq_flg@ */ /end MEASUREMENT
/begin MEASUREMENT VIBS_FbRctWup_flg "IBS禁止RTC唤醒标志位_versteckt" UBYTE AppSwcVcu_CM_boolean_flg 0 0 0.0 1.0 ECU_ADDRESS 0x0000 /* @ECU_Address@VIBS_FbRctWup_flg@ */ /end MEASUREMENT
/begin MEASUREMENT VIBS_SleepAllwd_flg "IBS允许底层休眠标志位_versteckt" UBYTE AppSwcVcu_CM_boolean_flg 0 0 0.0 1.0 ECU_ADDRESS 0x0000 /* @ECU_Address@VIBS_SleepAllwd_flg@ */ /end MEASUREMENT
/begin MEASUREMENT VIBS_ChrgOver_flg "IBS补电结束标志位_versteckt" UBYTE AppSwcVcu_CM_boolean_flg 0 0 0.0 1.0 ECU_ADDRESS 0x0000 /* @ECU_Address@VIBS_ChrgOver_flg@ */ /end MEASUREMENT
/begin MEASUREMENT VRME_CHTCRmnMilEstV_flg "CHTC标准续航里程有效性" UBYTE AppSwcVcu_CM_boolean_flg 0 0 0.0 1.0 ECU_ADDRESS 0x0000 /* @ECU_Address@VRME_CHTCRmnMilEstV_flg@ */ /end MEASUREMENT
/begin MEASUREMENT VRME_DynRmnMilEstV_flg "动态续航有效性" UBYTE AppSwcVcu_CM_boolean_flg 0 0 0.0 1.0 ECU_ADDRESS 0x0000 /* @ECU_Address@VRME_DynRmnMilEstV_flg@ */ /end MEASUREMENT
/begin MEASUREMENT VVSO_iTPMSState_enum "" UBYTE AppSwcVcu_CM_EnumiTPMSSt 0 0 0 6 ECU_ADDRESS 0x0000 /* @ECU_Address@VVSO_iTPMSState_enum@ */ /end MEASUREMENT
/begin MEASUREMENT VNVM_XWhlDistErrRefStat_enum "" UBYTE AppSwcVcu_CM_EnumXWhlDistErrRefSt 0 0 0 2 ECU_ADDRESS 0x0000 /* @ECU_Address@VNVM_XWhlDistErrRefStat_enum@ */ /end MEASUREMENT
/begin MEASUREMENT VVSO_XWhlDistErrRefStat_enum "" UBYTE AppSwcVcu_CM_EnumXWhlDistErrRefSt 0 0 0 2 ECU_ADDRESS 0x0000 /* @ECU_Address@VVSO_XWhlDistErrRefStat_enum@ */ /end MEASUREMENT
/begin MEASUREMENT VHVM_VCUMode_enum "高压主转态" UBYTE AppSwcVcu_CM_EnumVCUMode 0 0 0 7 ECU_ADDRESS 0x0000 /* @ECU_Address@VHVM_VCUMode_enum@ */ /end MEASUREMENT
/begin MEASUREMENT VNVM_VCUSpdLimSt_enum "" UBYTE AppSwcVcu_CM_EnumTBOXLimSt 0 0 0 4 ECU_ADDRESS 0x0000 /* @ECU_Address@VNVM_VCUSpdLimSt_enum@ */ /end MEASUREMENT
/begin MEASUREMENT VHVM_SysSta_enum "高压子状态" UBYTE AppSwcVcu_CM_EnumSysSta 0 0 0 73 ECU_ADDRESS 0x0000 /* @ECU_Address@VHVM_SysSta_enum@ */ /end MEASUREMENT
/begin MEASUREMENT VNVM_RegenModeAct_enum "" UBYTE AppSwcVcu_CM_EnumRegenModeAct 0 0 0 2 ECU_ADDRESS 0x0000 /* @ECU_Address@VNVM_RegenModeAct_enum@ */ /end MEASUREMENT
/begin MEASUREMENT VIPC_RegenModeAct_enum "" UBYTE AppSwcVcu_CM_EnumRegenModeAct 0 0 0 2 ECU_ADDRESS 0x0000 /* @ECU_Address@VIPC_RegenModeAct_enum@ */ /end MEASUREMENT
/begin MEASUREMENT VHVM_PTActOprtMode_enum "高压PT状态" UBYTE AppSwcVcu_CM_EnumPTActMd 0 0 0 3 ECU_ADDRESS 0x0000 /* @ECU_Address@VHVM_PTActOprtMode_enum@ */ /end MEASUREMENT
/begin MEASUREMENT VIPM_HwShftPstnSwSts_enum "" UBYTE AppSwcVcu_CM_EnumPGearSwSts 0 0 0 4 ECU_ADDRESS 0x0000 /* @ECU_Address@VIPM_HwShftPstnSwSts_enum@ */ /end MEASUREMENT
/begin MEASUREMENT VTQR_MotorModeReq_enum "" UBYTE AppSwcVcu_CM_EnumMotorModeReq 0 0 0 2 ECU_ADDRESS 0x0000 /* @ECU_Address@VTQR_MotorModeReq_enum@ */ /end MEASUREMENT
/begin MEASUREMENT VIBS_RTCChrgSt_enum "IBS补电状态_versteckt" UBYTE AppSwcVcu_CM_EnumIBSChrgSt 0 0 0 3 ECU_ADDRESS 0x0000 /* @ECU_Address@VIBS_RTCChrgSt_enum@ */ /end MEASUREMENT
/begin MEASUREMENT VNVM_DrvModeAct_enum "" UBYTE AppSwcVcu_CM_EnumDrvModeAct 0 0 0 4 ECU_ADDRESS 0x0000 /* @ECU_Address@VNVM_DrvModeAct_enum@ */ /end MEASUREMENT
/begin MEASUREMENT VIPC_DrvModeAct_enum "" UBYTE AppSwcVcu_CM_EnumDrvModeAct 0 0 0 4 ECU_ADDRESS 0x0000 /* @ECU_Address@VIPC_DrvModeAct_enum@ */ /end MEASUREMENT
/begin MEASUREMENT VHVM_DCCOprtCmd_enum "VCU控制DCDC工作模式指令对应CAN信号：VCU_DCCOprtCmd" UBYTE AppSwcVcu_CM_EnumDCCOprtCmd 0 0 0 4 ECU_ADDRESS 0x0000 /* @ECU_Address@VHVM_DCCOprtCmd_enum@ */ /end MEASUREMENT
/begin MEASUREMENT VNVM_CrpModeAct_enum "" UBYTE AppSwcVcu_CM_EnumCrpModeAct 0 0 0 2 ECU_ADDRESS 0x0000 /* @ECU_Address@VNVM_CrpModeAct_enum@ */ /end MEASUREMENT
/begin MEASUREMENT VIPC_CrpModeAct_enum "" UBYTE AppSwcVcu_CM_EnumCrpModeAct 0 0 0 2 ECU_ADDRESS 0x0000 /* @ECU_Address@VIPC_CrpModeAct_enum@ */ /end MEASUREMENT
/begin MEASUREMENT VHVM_ChrgAllowCmd_enum "VCU发送允许充电指令对应CAN信号：VCU_ChrgAllowCmd" UBYTE AppSwcVcu_CM_EnumChrgAllwCmd 0 0 0 3 ECU_ADDRESS 0x0000 /* @ECU_Address@VHVM_ChrgAllowCmd_enum@ */ /end MEASUREMENT
/begin MEASUREMENT VHVM_BMSWakeUpMode_enum "VCU唤醒BMS的方式对应CAN信号：VCU_BMS_WakeupMode" UBYTE AppSwcVcu_CM_EnumBMSWakeUpMd 0 0 0 3 ECU_ADDRESS 0x0000 /* @ECU_Address@VHVM_BMSWakeUpMode_enum@ */ /end MEASUREMENT
/begin MEASUREMENT VHVM_BMSShutdown_enum "VCU关闭BMS指令对应CAN信号：VCU_BMS_Shutdown" UBYTE AppSwcVcu_CM_EnumBMSSdnCmd 0 0 0 3 ECU_ADDRESS 0x0000 /* @ECU_Address@VHVM_BMSShutdown_enum@ */ /end MEASUREMENT
/begin MEASUREMENT VBSW_BswVer0_cnt "" UBYTE AppSwcVcu_CM_uint8_cnt 0 0 0.0 255.0 ECU_ADDRESS 0x0000 /* @ECU_Address@VBSW_BswVer0_cnt@ */ /end MEASUREMENT
/begin MEASUREMENT VBSW_BswVer1_cnt "" UBYTE AppSwcVcu_CM_uint8_cnt 0 0 0.0 255.0 ECU_ADDRESS 0x0000 /* @ECU_Address@VBSW_BswVer1_cnt@ */ /end MEASUREMENT
/begin COMPU_METHOD AppSwcVcu_CM_single_pct "Q = V" RAT_FUNC "%8.6" "pct" COEFFS 0 1 0 0 0 1 /end COMPU_METHOD
/begin COMPU_METHOD AppSwcVcu_CM_single_rat "Q = V" RAT_FUNC "%8.6" "rat" COEFFS 0 1 0 0 0 1 /end COMPU_METHOD
/begin COMPU_METHOD AppSwcVcu_CM_single_kph "Q = V" RAT_FUNC "%8.6" "kph" COEFFS 0 1 0 0 0 1 /end COMPU_METHOD
/begin COMPU_METHOD AppSwcVcu_CM_single_rpm "Q = V" RAT_FUNC "%8.6" "rpm" COEFFS 0 1 0 0 0 1 /end COMPU_METHOD
/begin COMPU_METHOD AppSwcVcu_CM_single_c "Q = V" RAT_FUNC "%8.6" "c" COEFFS 0 1 0 0 0 1 /end COMPU_METHOD
/begin COMPU_METHOD AppSwcVcu_CM_single_C "Q = V" RAT_FUNC "%8.6" "C" COEFFS 0 1 0 0 0 1 /end COMPU_METHOD
/begin COMPU_METHOD AppSwcVcu_CM_single_V "Q = V" RAT_FUNC "%8.6" "V" COEFFS 0 1 0 0 0 1 /end COMPU_METHOD
/begin COMPU_METHOD AppSwcVcu_CM_single_Nm "Q = V" RAT_FUNC "%8.6" "Nm" COEFFS 0 1 0 0 0 1 /end COMPU_METHOD
/begin COMPU_METHOD AppSwcVcu_CM_single_kW "Q = V" RAT_FUNC "%8.6" "kW" COEFFS 0 1 0 0 0 1 /end COMPU_METHOD
/begin COMPU_METHOD AppSwcVcu_CM_single_mps2 "Q = V" RAT_FUNC "%8.6" "mps2" COEFFS 0 1 0 0 0 1 /end COMPU_METHOD
/begin COMPU_METHOD AppSwcVcu_CM_single_Nmps "Q = V" RAT_FUNC "%8.6" "Nmps" COEFFS 0 1 0 0 0 1 /end COMPU_METHOD
/begin COMPU_METHOD AppSwcVcu_CM_single_s "Q = V" RAT_FUNC "%8.6" "s" COEFFS 0 1 0 0 0 1 /end COMPU_METHOD
/begin COMPU_METHOD AppSwcVcu_CM_single_A "Q = V" RAT_FUNC "%8.6" "A" COEFFS 0 1 0 0 0 1 /end COMPU_METHOD
/begin COMPU_METHOD AppSwcVcu_CM_uint8_Ah "Q = V" RAT_FUNC "%3.0" "Ah" COEFFS 0 1 0 0 0 1 /end COMPU_METHOD
/begin COMPU_METHOD AppSwcVcu_CM_single_mV "Q = V" RAT_FUNC "%8.6" "mV" COEFFS 0 1 0 0 0 1 /end COMPU_METHOD
/begin COMPU_METHOD AppSwcVcu_CM_single_km "Q = V" RAT_FUNC "%8.6" "km" COEFFS 0 1 0 0 0 1 /end COMPU_METHOD
/begin COMPU_METHOD AppSwcVcu_CM_uint16_min "Q = V" RAT_FUNC "%5.0" "min" COEFFS 0 1 0 0 0 1 /end COMPU_METHOD
/begin COMPU_METHOD AppSwcVcu_CM_single_m "Q = V" RAT_FUNC "%8.6" "m" COEFFS 0 1 0 0 0 1 /end COMPU_METHOD
/begin COMPU_METHOD AppSwcVcu_CM_uint8_enum "Q = V" RAT_FUNC "%3.0" "enum" COEFFS 0 1 0 0 0 1 /end COMPU_METHOD
/begin COMPU_METHOD AppSwcVcu_CM_int16_C "Q = V" RAT_FUNC "%5.0" "C" COEFFS 0 1 0 0 0 1 /end COMPU_METHOD
/begin COMPU_METHOD AppSwcVcu_CM_uint16_mV "Q = V" RAT_FUNC "%5.0" "mV" COEFFS 0 1 0 0 0 1 /end COMPU_METHOD
/begin COMPU_METHOD AppSwcVcu_CM_single_N "Q = V" RAT_FUNC "%8.6" "N" COEFFS 0 1 0 0 0 1 /end COMPU_METHOD
/begin COMPU_METHOD AppSwcVcu_CM_single_kOhm "Q = V" RAT_FUNC "%8.6" "kOhm" COEFFS 0 1 0 0 0 1 /end COMPU_METHOD
/begin COMPU_METHOD AppSwcVcu_CM_single_pctps "Q = V" RAT_FUNC "%8.6" "pctps" COEFFS 0 1 0 0 0 1 /end COMPU_METHOD
/begin COMPU_METHOD AppSwcVcu_CM_single_Cps "Q = V" RAT_FUNC "%8.6" "Cps" COEFFS 0 1 0 0 0 1 /end COMPU_METHOD
/begin COMPU_METHOD AppSwcVcu_CM_single_Aps "Q = V" RAT_FUNC "%8.6" "Aps" COEFFS 0 1 0 0 0 1 /end COMPU_METHOD
/begin COMPU_METHOD AppSwcVcu_CM_single_min "Q = V" RAT_FUNC "%8.6" "min" COEFFS 0 1 0 0 0 1 /end COMPU_METHOD
/begin COMPU_METHOD AppSwcVcu_CM_single_pctp100km "Q = V" RAT_FUNC "%8.6" "pctp100km" COEFFS 0 1 0 0 0 1 /end COMPU_METHOD
/begin COMPU_METHOD AppSwcVcu_CM_single_kg "Q = V" RAT_FUNC "%8.6" "kg" COEFFS 0 1 0 0 0 1 /end COMPU_METHOD
/begin COMPU_METHOD AppSwcVcu_CM_single_mpkm "Q = V" RAT_FUNC "%8.6" "mpkm" COEFFS 0 1 0 0 0 1 /end COMPU_METHOD
/begin COMPU_METHOD AppSwcVcu_CM_single_m2 "Q = V" RAT_FUNC "%8.6" "m2" COEFFS 0 1 0 0 0 1 /end COMPU_METHOD
/begin COMPU_METHOD AppSwcVcu_CM_single_bar "Q = V" RAT_FUNC "%8.6" "bar" COEFFS 0 1 0 0 0 1 /end COMPU_METHOD
/begin COMPU_METHOD AppSwcVcu_CM_single_degps "Q = V" RAT_FUNC "%8.6" "degps" COEFFS 0 1 0 0 0 1 /end COMPU_METHOD
/begin COMPU_METHOD AppSwcVcu_CM_single_mps "Q = V" RAT_FUNC "%8.6" "mps" COEFFS 0 1 0 0 0 1 /end COMPU_METHOD
/begin COMPU_METHOD AppSwcVcu_CM_uint16_enum "Q = V" RAT_FUNC "%5.0" "enum" COEFFS 0 1 0 0 0 1 /end COMPU_METHOD
/begin COMPU_METHOD AppSwcVcu_CM_uint16_s "Q = V" RAT_FUNC "%5.0" "s" COEFFS 0 1 0 0 0 1 /end COMPU_METHOD
/begin COMPU_METHOD AppSwcVcu_CM_uint16_Ohm "Q = V" RAT_FUNC "%5.0" "Ohm" COEFFS 0 1 0 0 0 1 /end COMPU_METHOD
/begin COMPU_METHOD AppSwcVcu_CM_EnumCrpModeAct "Enumerated data type: EnumCrpModeAct" TAB_VERB "%0.6" "" COMPU_TAB_REF VTAB_FOR_AppSwcVcu_CM_EnumCrpModeAct /end COMPU_METHOD
/begin COMPU_VTAB VTAB_FOR_AppSwcVcu_CM_EnumCrpModeAct "Enumerated data type: EnumCrpModeAct" TAB_VERB 3 0 "EnumCrpModeAct_Open" 1 "EnumCrpModeAct_Closed" 2 "EnumCrpModeAct_StandStill" /end COMPU_VTAB
/begin COMPU_METHOD AppSwcVcu_CM_EnumDrvModeAct "Enumerated data type: EnumDrvModeAct" TAB_VERB "%0.6" "" COMPU_TAB_REF VTAB_FOR_AppSwcVcu_CM_EnumDrvModeAct /end COMPU_METHOD
/begin COMPU_VTAB VTAB_FOR_AppSwcVcu_CM_EnumDrvModeAct "Enumerated data type: EnumDrvModeAct" TAB_VERB 5 0 "EnumDrvModeAct_Invalid" 1 "EnumDrvModeAct_Eco" 2 "EnumDrvModeAct_Auto" 3 "EnumDrvModeAct_Manual" 4 "EnumDrvModeAct_Eped" /end COMPU_VTAB
/begin COMPU_METHOD AppSwcVcu_CM_EnumPGearSwSts "Enumerated data type: EnumPGearSwSts" TAB_VERB "%0.6" "" COMPU_TAB_REF VTAB_FOR_AppSwcVcu_CM_EnumPGearSwSts /end COMPU_METHOD
/begin COMPU_VTAB VTAB_FOR_AppSwcVcu_CM_EnumPGearSwSts "Enumerated data type: EnumPGearSwSts" TAB_VERB 5 0 "EnumPGearSwSts_Reld" 1 "EnumPGearSwSts_Prsd" 2 "EnumPGearSwSts_ShtGnd" 3 "EnumPGearSwSts_ShtBat" 4 "EnumPGearSwSts_Unknown" /end COMPU_VTAB
/begin COMPU_METHOD AppSwcVcu_CM_EnumRegenModeAct "Enumerated data type: EnumRegenModeAct" TAB_VERB "%0.6" "" COMPU_TAB_REF VTAB_FOR_AppSwcVcu_CM_EnumRegenModeAct /end COMPU_METHOD
/begin COMPU_VTAB VTAB_FOR_AppSwcVcu_CM_EnumRegenModeAct "Enumerated data type: EnumRegenModeAct" TAB_VERB 3 0 "EnumRegenModeAct_Off" 1 "EnumRegenModeAct_Weak" 2 "EnumRegenModeAct_Strong" /end COMPU_VTAB
/begin COMPU_METHOD AppSwcVcu_CM_boolean_flg "Q = V" RAT_FUNC "%1.0" "flg" COEFFS 0 1 0 0 0 1 /end COMPU_METHOD
/begin COMPU_METHOD AppSwcVcu_CM_boolean_c "Q = V" RAT_FUNC "%1.0" "c" COEFFS 0 1 0 0 0 1 /end COMPU_METHOD
/begin COMPU_METHOD AppSwcVcu_CM_uint8_cnt "Q = V" RAT_FUNC "%3.0" "cnt" COEFFS 0 1 0 0 0 1 /end COMPU_METHOD
/begin COMPU_METHOD AppSwcVcu_CM_uint8_pct "Q = V" RAT_FUNC "%3.0" "pct" COEFFS 0 1 0 0 0 1 /end COMPU_METHOD
/begin COMPU_METHOD AppSwcVcu_CM_single_kWhp100km "Q = V" RAT_FUNC "%8.6" "kWhp100km" COEFFS 0 1 0 0 0 1 /end COMPU_METHOD
/begin COMPU_METHOD AppSwcVcu_CM_uint16_cnt "Q = V" RAT_FUNC "%5.0" "cnt" COEFFS 0 1 0 0 0 1 /end COMPU_METHOD
/begin COMPU_METHOD AppSwcVcu_CM_uint8_nu "Q = V" RAT_FUNC "%3.0" "nu" COEFFS 0 1 0 0 0 1 /end COMPU_METHOD
/begin COMPU_METHOD AppSwcVcu_CM_uint8_A "Q = V" RAT_FUNC "%3.0" "A" COEFFS 0 1 0 0 0 1 /end COMPU_METHOD
/begin COMPU_METHOD AppSwcVcu_CM_uint8 "Q = V" RAT_FUNC "%3.0" "" COEFFS 0 1 0 0 0 1 /end COMPU_METHOD
/begin COMPU_METHOD AppSwcVcu_CM_EnumiTPMSSt "Enumerated data type: EnumiTPMSSt" TAB_VERB "%0.6" "" COMPU_TAB_REF VTAB_FOR_AppSwcVcu_CM_EnumiTPMSSt /end COMPU_METHOD
/begin COMPU_VTAB VTAB_FOR_AppSwcVcu_CM_EnumiTPMSSt "Enumerated data type: EnumiTPMSSt" TAB_VERB 7 0 "EnumiTPMSSt_Init" 1 "EnumiTPMSSt_WaitLrn" 2 "EnumiTPMSSt_Lrning" 3 "EnumiTPMSSt_LrnFail" 4 "EnumiTPMSSt_Normal" 5 "EnumiTPMSSt_Warning" 6 "EnumiTPMSSt_Fault" /end COMPU_VTAB
/begin COMPU_METHOD AppSwcVcu_CM_EnumXWhlDistErrRefSt "Enumerated data type: EnumXWhlDistErrRefSt" TAB_VERB "%0.6" "" COMPU_TAB_REF VTAB_FOR_AppSwcVcu_CM_EnumXWhlDistErrRefSt /end COMPU_METHOD
/begin COMPU_VTAB VTAB_FOR_AppSwcVcu_CM_EnumXWhlDistErrRefSt "Enumerated data type: EnumXWhlDistErrRefSt" TAB_VERB 3 0 "EnumXWhlDistErrRefSt_Init" 1 "EnumXWhlDistErrRefSt_Uncmplt" 2 "EnumXWhlDistErrRefSt_Cmpltd" /end COMPU_VTAB
/begin COMPU_METHOD AppSwcVcu_CM_EnumVCUMode "Enumerated data type: EnumVCUMode" TAB_VERB "%0.6" "" COMPU_TAB_REF VTAB_FOR_AppSwcVcu_CM_EnumVCUMode /end COMPU_METHOD
/begin COMPU_VTAB VTAB_FOR_AppSwcVcu_CM_EnumVCUMode "Enumerated data type: EnumVCUMode" TAB_VERB 8 0 "EnumVCUMode_PwrOff" 1 "EnumVCUMode_WakeUp" 2 "EnumVCUMode_PwrUp" 3 "EnumVCUMode_PwrOnDrv" 4 "EnumVCUMode_PwrOnDCChrg" 5 "EnumVCUMode_PwrOnACChrg" 6 "EnumVCUMode_PwrOnACDcha" 7 "EnumVCUMode_PwrDwn" /end COMPU_VTAB
/begin COMPU_METHOD AppSwcVcu_CM_EnumTBOXLimSt "Enumerated data type: EnumTBOXLimSt" TAB_VERB "%0.6" "" COMPU_TAB_REF VTAB_FOR_AppSwcVcu_CM_EnumTBOXLimSt /end COMPU_METHOD
/begin COMPU_VTAB VTAB_FOR_AppSwcVcu_CM_EnumTBOXLimSt "Enumerated data type: EnumTBOXLimSt" TAB_VERB 5 0 "EnumTBOXLimSt_Normal" 1 "EnumTBOXLimSt_Level1" 2 "EnumTBOXLimSt_Level2" 3 "EnumTBOXLimSt_Level3" 4 "EnumTBOXLimSt_Storage" /end COMPU_VTAB
/begin COMPU_METHOD AppSwcVcu_CM_EnumSysSta "Enumerated data type: EnumSysSta" TAB_VERB "%0.6" "" COMPU_TAB_REF VTAB_FOR_AppSwcVcu_CM_EnumSysSta /end COMPU_METHOD
/begin COMPU_VTAB VTAB_FOR_AppSwcVcu_CM_EnumSysSta "Enumerated data type: EnumSysSta" TAB_VERB 19 0 "EnumSysSta_Sleep" 10 "EnumSysSta_WakeUp" 20 "EnumSysSta_HVSetUp" 21 "EnumSysSta_HVCheck" 30 "EnumSysSta_PTStby" 31 "EnumSysSta_PTRdy" 40 "EnumSysSta_DCChrging" 41 "EnumSysSta_DCChrgOver" 50 "EnumSysSta_ACChrgEnbl" 51 "EnumSysSta_ACChrging" 52 "EnumSysSta_ACChrgStop" 53 "EnumSysSta_ACChrgOver" 60 "EnumSysSta_ACDschrging" 61 "EnumSysSta_ACDchaStop" 62 "EnumSysSta_ACDchaOver" 70 "EnumSysSta_HVDeviceOff" 71 "EnumSysSta_HVCutOff" 72 "EnumSysSta_HVDschrg" 73 "EnumSysSta_EmgcyPwrDwn" /end COMPU_VTAB
/begin COMPU_METHOD AppSwcVcu_CM_EnumPTActMd "Enumerated data type: EnumPTActMd" TAB_VERB "%0.6" "" COMPU_TAB_REF VTAB_FOR_AppSwcVcu_CM_EnumPTActMd /end COMPU_METHOD
/begin COMPU_VTAB VTAB_FOR_AppSwcVcu_CM_EnumPTActMd "Enumerated data type: EnumPTActMd" TAB_VERB 4 0 "EnumPTActMd_OFF" 1 "EnumPTActMd_Standby" 2 "EnumPTActMd_Ready" 3 "EnumPTActMd_EmgcySdn" /end COMPU_VTAB
/begin COMPU_METHOD AppSwcVcu_CM_EnumMotorModeReq "Enumerated data type: EnumMotorModeReq" TAB_VERB "%0.6" "" COMPU_TAB_REF VTAB_FOR_AppSwcVcu_CM_EnumMotorModeReq /end COMPU_METHOD
/begin COMPU_VTAB VTAB_FOR_AppSwcVcu_CM_EnumMotorModeReq "Enumerated data type: EnumMotorModeReq" TAB_VERB 3 0 "EnumMotorModeReq_Stdby" 1 "EnumMotorModeReq_TqCtrl" 2 "EnumMotorModeReq_SpdCtrl" /end COMPU_VTAB
/begin COMPU_METHOD AppSwcVcu_CM_EnumIBSChrgSt "Enumerated data type: EnumIBSChrgSt" TAB_VERB "%0.6" "" COMPU_TAB_REF VTAB_FOR_AppSwcVcu_CM_EnumIBSChrgSt /end COMPU_METHOD
/begin COMPU_VTAB VTAB_FOR_AppSwcVcu_CM_EnumIBSChrgSt "Enumerated data type: EnumIBSChrgSt" TAB_VERB 4 0 "EnumIBSChrgSt_Idle" 1 "EnumIBSChrgSt_Charging" 2 "EnumIBSChrgSt_ChrgCmpld" 3 "EnumIBSChrgSt_Fail" /end COMPU_VTAB
/begin COMPU_METHOD AppSwcVcu_CM_EnumDCCOprtCmd "Enumerated data type: EnumDCCOprtCmd" TAB_VERB "%0.6" "" COMPU_TAB_REF VTAB_FOR_AppSwcVcu_CM_EnumDCCOprtCmd /end COMPU_METHOD
/begin COMPU_VTAB VTAB_FOR_AppSwcVcu_CM_EnumDCCOprtCmd "Enumerated data type: EnumDCCOprtCmd" TAB_VERB 4 4 "EnumDCCOprtCmd_Off" 0 "EnumDCCOprtCmd_Standby" 2 "EnumDCCOprtCmd_Buck" 3 "EnumDCCOprtCmd_Boost" /end COMPU_VTAB
/begin COMPU_METHOD AppSwcVcu_CM_EnumChrgAllwCmd "Enumerated data type: EnumChrgAllwCmd" TAB_VERB "%0.6" "" COMPU_TAB_REF VTAB_FOR_AppSwcVcu_CM_EnumChrgAllwCmd /end COMPU_METHOD
/begin COMPU_VTAB VTAB_FOR_AppSwcVcu_CM_EnumChrgAllwCmd "Enumerated data type: EnumChrgAllwCmd" TAB_VERB 4 0 "EnumChrgAllwCmd_NotAllwd" 1 "EnumChrgAllwCmd_DCChrg" 2 "EnumChrgAllwCmd_ACChrg" 3 "EnumChrgAllwCmd_ACDcha" /end COMPU_VTAB
/begin COMPU_METHOD AppSwcVcu_CM_EnumBMSWakeUpMd "Enumerated data type: EnumBMSWakeUpMd" TAB_VERB "%0.6" "" COMPU_TAB_REF VTAB_FOR_AppSwcVcu_CM_EnumBMSWakeUpMd /end COMPU_METHOD
/begin COMPU_VTAB VTAB_FOR_AppSwcVcu_CM_EnumBMSWakeUpMd "Enumerated data type: EnumBMSWakeUpMd" TAB_VERB 4 0 "EnumBMSWakeUpMd_Invld" 1 "EnumBMSWakeUpMd_ACChrg" 2 "EnumBMSWakeUpMd_ACDcha" 3 "EnumBMSWakeUpMd_DisChrg" /end COMPU_VTAB
/begin COMPU_METHOD AppSwcVcu_CM_EnumBMSSdnCmd "Enumerated data type: EnumBMSSdnCmd" TAB_VERB "%0.6" "" COMPU_TAB_REF VTAB_FOR_AppSwcVcu_CM_EnumBMSSdnCmd /end COMPU_METHOD
/begin COMPU_VTAB VTAB_FOR_AppSwcVcu_CM_EnumBMSSdnCmd "Enumerated data type: EnumBMSSdnCmd" TAB_VERB 4 0 "EnumBMSSdnCmd_Normal" 1 "EnumBMSSdnCmd_Shutdwn" 2 "EnumBMSSdnCmd_EmgcySdn" 3 "EnumBMSSdnCmd_Rsrvd" /end COMPU_VTAB
/begin GROUP AppSwcVcu "AppSwcVcu" /* Root */ ROOT
 /begin SUB_GROUP Root_VcuRx Root_VcuTx Root_Vcu_100ms Root_Vcu_10ms Root_Vcu_20ms /end SUB_GROUP
/end GROUP
/begin GROUP Root_VcuRx "AppSwcVcu/VcuRx" /begin SUB_GROUP S2_HwInVCU S2_SNM_NVM /end SUB_GROUP /end GROUP
/begin GROUP Root_VcuTx "AppSwcVcu/VcuTx" /begin SUB_GROUP S3_HwOutVCU S3_SNM S3_SNM_NVM S3_Vcu2Opm /end SUB_GROUP /end GROUP
/begin GROUP Root_Vcu_100ms "AppSwcVcu/Vcu_100ms" /begin SUB_GROUP S4_DrvStyleAdapt S4_HMI S4_RME S4_SIBS S4_TBOX /end SUB_GROUP /end GROUP
/begin GROUP Root_Vcu_10ms "AppSwcVcu/Vcu_10ms" /begin SUB_GROUP S5_InputProcess S5_VSO S5_VTM /end SUB_GROUP /end GROUP
/begin GROUP Root_Vcu_20ms "AppSwcVcu/Vcu_20ms" /begin SUB_GROUP S6_EMS S6_FaultDiag S6_HvMgt S6_gsm /end SUB_GROUP /end GROUP
/begin GROUP S2_HwInVCU "AppSwcVcu/VcuRx/HwInVCU"
 /begin SUB_GROUP S7_Subsys_VIPM_HwAccPedCh1SuplyVolt_mV S7_Subsys_VIPM_HwAccPedCh1Volt_mV S7_Subsys_VIPM_HwAccPedCh2SuplyVolt_mV S7_Subsys_VIPM_HwAccPedCh2Volt_mV S7_Subsys_VIPM_HwBMSWakeup_flg S7_Subsys_VIPM_HwBrkSwHi_flg S7_Subsys_VIPM_HwBrkSwLo_flg S7_Subsys_VIPM_HwCrpModeSw S7_Subsys_VIPM_HwDrvModeSw_flg S7_Subsys_VIPM_HwEmgcyShutOff_flg S7_Subsys_VIPM_HwHVIL1Volt_mV S7_Subsys_VIPM_HwHVIL2Volt_mV S7_Subsys_VIPM_HwKL15A_flg S7_Subsys_VIPM_HwKL15B_flg S7_Subsys_VIPM_HwKL30_mV S7_Subsys_VIPM_HwOBCWakeup_flg S7_Subsys_VIPM_HwRearFogLampSwt_flg S7_Subsys_VIPM_HwShftPstnSwSts_enum S7_Subsys_VIPM_HwVehCrash_flg S7_Subsystem /end SUB_GROUP
 /begin REF_MEASUREMENT VIPM_HwShftPstnSw_Ohm /end REF_MEASUREMENT
/end GROUP
/begin GROUP S2_SNM_NVM "AppSwcVcu/VcuRx/SNM_NVM"
 /begin REF_MEASUREMENT VBSW_WakeupReasn_enum VNVM_ACChrgMaxCurrFb_A VNVM_ACChrgModeFb_enum VNVM_AvgPwrCnsm_kWh100km VNVM_AvgSOCCnsmWght_pctp100km VNVM_CrpModeAct_enum VNVM_DrvModeAct_enum VNVM_DrvPwrIntnsty_pct VNVM_DynRmnMilEst_km VNVM_EE01ReadOK_nu VNVM_EEImdtReadOK_nu VNVM_IBSChrgFailNum_cnt VNVM_IBSChrgNum_cnt VNVM_RegenModeAct_enum VNVM_RegenPwrIntnsty_pct VNVM_TBOXOffline_flg VNVM_VCUSpdLimSt_enum VNVM_VCUVerFb_flg VNVM_XWhlDistErrRefStat_enum VNVM_XWhlDistErrRef_mpkm VNVM_iTPMSWrng_flg /end REF_MEASUREMENT
/end GROUP
/begin GROUP S3_HwOutVCU "AppSwcVcu/VcuTx/HwOutVCU" /begin SUB_GROUP S36_Subsys_VOPM_HwWakeupBMS_flg /end SUB_GROUP /end GROUP
/begin GROUP S3_SNM "AppSwcVcu/VcuTx/SNM"
 /begin REF_CHARACTERISTIC KVCU_EcuCommReqOff_Cnt KVCU_EcuCommReqOn_Cnt KVCU_EcuCommReq_flg KVCU_RtcWakeupTm_min /end REF_CHARACTERISTIC
/end GROUP
/begin GROUP S3_SNM_NVM "AppSwcVcu/VcuTx/SNM_NVM"
 /begin REF_CHARACTERISTIC KVCU_XWhlDistErrRefOvrdSw_flg KVCU_XWhlDistErrRefOvrdVal_mpkm KVCU_XWhlDistErrRefStatOvrdSw_flg KVCU_XWhlDistErrRefStatOvrdVal_enum KVCU_iTPMSWrngOvrdSw_flg KVCU_iTPMSWrngOvrdVal_flg /end REF_CHARACTERISTIC
/end GROUP
/begin GROUP S3_Vcu2Opm "AppSwcVcu/VcuTx/Vcu2Opm"
 /begin REF_CHARACTERISTIC KSYS_CalVer_cnt KSYS_ChkTaskRunCnt_flg KVCU_MCUTempWrngOff_C KVCU_MCUTempWrngOn_C KVCU_MotorTempWrngOff_C KVCU_MotorTempWrngOn_C /end REF_CHARACTERISTIC
 /begin REF_MEASUREMENT VBSW_BswVer0_cnt VBSW_BswVer1_cnt /end REF_MEASUREMENT
/end GROUP
/begin GROUP S4_DrvStyleAdapt "AppSwcVcu/Vcu_100ms/DrvStyleAdapt" /begin SUB_GROUP S56_Model /end SUB_GROUP /end GROUP
/begin GROUP S4_HMI "AppSwcVcu/Vcu_100ms/HMI" /begin SUB_GROUP S57_Model /end SUB_GROUP /end GROUP
/begin GROUP S4_RME "AppSwcVcu/Vcu_100ms/RME" /begin SUB_GROUP S58_RME /end SUB_GROUP /end GROUP
/begin GROUP S4_SIBS "AppSwcVcu/Vcu_100ms/SIBS" /begin SUB_GROUP S59_SIBS /end SUB_GROUP /end GROUP
/begin GROUP S4_TBOX "AppSwcVcu/Vcu_100ms/TBOX" /begin SUB_GROUP S60_TboxModel /end SUB_GROUP /end GROUP
/begin GROUP S5_InputProcess "AppSwcVcu/Vcu_10ms/InputProcess" /begin SUB_GROUP S347_Model /end SUB_GROUP /end GROUP
/begin GROUP S5_VSO "AppSwcVcu/Vcu_10ms/VSO"
 /begin SUB_GROUP S349_Preprocess S349_RoadSlopeEstmn S349_TPMS S349_VehMassEstmn /end SUB_GROUP
/end GROUP
/begin GROUP S5_VTM "AppSwcVcu/Vcu_10ms/VTM"
 /begin SUB_GROUP S350_CPT S350_DAC S350_TQC S350_TQD S350_TQF S350_TQR S350_TZX S350_VTM_In S350_VTM_Out /end SUB_GROUP
/end GROUP
/begin GROUP S6_EMS "AppSwcVcu/Vcu_20ms/EMS" /begin SUB_GROUP S883_EnergyManagementSystem /end SUB_GROUP /end GROUP
/begin GROUP S6_FaultDiag "AppSwcVcu/Vcu_20ms/FaultDiag"
 /begin SUB_GROUP S884_BMS_FaultDiag S884_Comm_FaultDiag S884_DCC_FaultDiag S884_Error_Code S884_FaultDiag_PreProc S884_Fault_Action S884_INV_FaultDiag S884_OBC_FaultDiag S884_OtherECU_FaultDiag S884_Other_FaultDiag S884_Sensor10ms_FaultDiag S884_Sensor20ms_FaultDiag S884_Sensor50ms_FaultDiag S884_UDSData /end SUB_GROUP
/end GROUP
/begin GROUP S6_HvMgt "AppSwcVcu/Vcu_20ms/HvMgt" /begin SUB_GROUP S885_HighVoltageMgt /end SUB_GROUP /end GROUP
/begin GROUP S6_gsm "AppSwcVcu/Vcu_20ms/gsm" /begin SUB_GROUP S887_GearShift /end SUB_GROUP /end GROUP
/begin GROUP S7_Subsys_VIPM_HwAccPedCh1SuplyVolt_mV "AppSwcVcu/VcuRx/HwInVCU/Subsys_VIPM_HwAccPedCh1SuplyVolt_mV"
 /begin REF_CHARACTERISTIC KIPM_HwAccPedCh1SuplyVoltHi_mV KIPM_HwAccPedCh1SuplyVoltLo_mV KIPM_HwAccPedCh1SuplyVolt_mV_ovrdflg KIPM_HwAccPedCh1SuplyVolt_mV_ovrdval /end REF_CHARACTERISTIC
 /begin REF_MEASUREMENT VIPM_HwAccPedCh1SuplyVolt_mV /end REF_MEASUREMENT
/end GROUP
/begin GROUP S7_Subsys_VIPM_HwAccPedCh1Volt_mV "AppSwcVcu/VcuRx/HwInVCU/Subsys_VIPM_HwAccPedCh1Volt_mV"
 /begin REF_CHARACTERISTIC KIPM_HwAccPedCh1VoltHi_mV KIPM_HwAccPedCh1VoltLo_mV KIPM_HwAccPedCh1Volt_mV_ovrdflg KIPM_HwAccPedCh1Volt_mV_ovrdval /end REF_CHARACTERISTIC
 /begin REF_MEASUREMENT VIPM_HwAccPedCh1Volt_mV /end REF_MEASUREMENT
/end GROUP
/begin GROUP S7_Subsys_VIPM_HwAccPedCh2SuplyVolt_mV "AppSwcVcu/VcuRx/HwInVCU/Subsys_VIPM_HwAccPedCh2SuplyVolt_mV"
 /begin REF_CHARACTERISTIC KIPM_HwAccPedCh2SuplyVoltHi_mV KIPM_HwAccPedCh2SuplyVoltLo_mV KIPM_HwAccPedCh2SuplyVolt_mV_ovrdflg KIPM_HwAccPedCh2SuplyVolt_mV_ovrdval /end REF_CHARACTERISTIC
 /begin REF_MEASUREMENT VIPM_HwAccPedCh2SuplyVolt_mV /end REF_MEASUREMENT
/end GROUP
/begin GROUP S7_Subsys_VIPM_HwAccPedCh2Volt_mV "AppSwcVcu/VcuRx/HwInVCU/Subsys_VIPM_HwAccPedCh2Volt_mV"
 /begin REF_CHARACTERISTIC KIPM_HwAccPedCh2VoltHi_mV KIPM_HwAccPedCh2VoltLo_mV KIPM_HwAccPedCh2Volt_mV_ovrdflg KIPM_HwAccPedCh2Volt_mV_ovrdval /end REF_CHARACTERISTIC
 /begin REF_MEASUREMENT VIPM_HwAccPedCh2Volt_mV /end REF_MEASUREMENT
/end GROUP
/begin GROUP S7_Subsys_VIPM_HwBMSWakeup_flg "AppSwcVcu/VcuRx/HwInVCU/Subsys_VIPM_HwBMSWakeup_flg" /begin REF_CHARACTERISTIC KIPM_HwBMSWakeup_flg_ovrdflg KIPM_HwBMSWakeup_flg_ovrdval /end REF_CHARACTERISTIC /begin REF_MEASUREMENT VIPM_HwBMSWakeup_flg /end REF_MEASUREMENT /end GROUP
/begin GROUP S7_Subsys_VIPM_HwBrkSwHi_flg "AppSwcVcu/VcuRx/HwInVCU/Subsys_VIPM_HwBrkSwHi_flg" /begin REF_CHARACTERISTIC KIPM_HwBrkSwHi_flg_ovrdflg KIPM_HwBrkSwHi_flg_ovrdval /end REF_CHARACTERISTIC /begin REF_MEASUREMENT VIPM_HwBrkSwHi_flg /end REF_MEASUREMENT /end GROUP
/begin GROUP S7_Subsys_VIPM_HwBrkSwLo_flg "AppSwcVcu/VcuRx/HwInVCU/Subsys_VIPM_HwBrkSwLo_flg" /begin REF_CHARACTERISTIC KIPM_HwBrkSwLo_flg_ovrdflg KIPM_HwBrkSwLo_flg_ovrdval /end REF_CHARACTERISTIC /begin REF_MEASUREMENT VIPM_HwBrkSwLo_flg /end REF_MEASUREMENT /end GROUP
/begin GROUP S7_Subsys_VIPM_HwCrpModeSw "AppSwcVcu/VcuRx/HwInVCU/Subsys_VIPM_HwCrpModeSw" /begin REF_CHARACTERISTIC KIPM_HwCrpModeSw_flg_ovrdflg KIPM_HwCrpModeSw_flg_ovrdval /end REF_CHARACTERISTIC /begin REF_MEASUREMENT VIPM_HwCrpModeSw_flg /end REF_MEASUREMENT /end GROUP
/begin GROUP S7_Subsys_VIPM_HwDrvModeSw_flg "AppSwcVcu/VcuRx/HwInVCU/Subsys_VIPM_HwDrvModeSw_flg" /begin REF_CHARACTERISTIC KIPM_HwDrvModeSw_flg_ovrdflg KIPM_HwDrvModeSw_flg_ovrdval /end REF_CHARACTERISTIC /begin REF_MEASUREMENT VIPM_HwDrvModeSw_flg /end REF_MEASUREMENT /end GROUP
/begin GROUP S7_Subsys_VIPM_HwEmgcyShutOff_flg "AppSwcVcu/VcuRx/HwInVCU/Subsys_VIPM_HwEmgcyShutOff_flg"
 /begin REF_CHARACTERISTIC KIPM_HwEmgcyShutOff_flg_ovrdflg KIPM_HwEmgcyShutOff_flg_ovrdval /end REF_CHARACTERISTIC
 /begin REF_MEASUREMENT VIPM_HwEmgcyShutOff_flg /end REF_MEASUREMENT
/end GROUP
/begin GROUP S7_Subsys_VIPM_HwHVIL1Volt_mV "AppSwcVcu/VcuRx/HwInVCU/Subsys_VIPM_HwHVIL1Volt_mV"
 /begin REF_CHARACTERISTIC KIPM_HwHVIL1VoltHi_mV KIPM_HwHVIL1VoltLo_mV KIPM_HwHVIL1Volt_mV_ovrdflg KIPM_HwHVIL1Volt_mV_ovrdval /end REF_CHARACTERISTIC
 /begin REF_MEASUREMENT VIPM_HwHVIL1Volt_mV /end REF_MEASUREMENT
/end GROUP
/begin GROUP S7_Subsys_VIPM_HwHVIL2Volt_mV "AppSwcVcu/VcuRx/HwInVCU/Subsys_VIPM_HwHVIL2Volt_mV"
 /begin REF_CHARACTERISTIC KIPM_HwHVIL2VoltHi_mV KIPM_HwHVIL2VoltLo_mV KIPM_HwHVIL2Volt_mV_ovrdflg KIPM_HwHVIL2Volt_mV_ovrdval /end REF_CHARACTERISTIC
 /begin REF_MEASUREMENT VIPM_HwHVIL2Volt_mV /end REF_MEASUREMENT
/end GROUP
/begin GROUP S7_Subsys_VIPM_HwKL15A_flg "AppSwcVcu/VcuRx/HwInVCU/Subsys_VIPM_HwKL15A_flg" /begin REF_CHARACTERISTIC KIPM_HwKL15A_flg_ovrdflg KIPM_HwKL15A_flg_ovrdval /end REF_CHARACTERISTIC /begin REF_MEASUREMENT VIPM_HwKL15A_flg /end REF_MEASUREMENT /end GROUP
/begin GROUP S7_Subsys_VIPM_HwKL15B_flg "AppSwcVcu/VcuRx/HwInVCU/Subsys_VIPM_HwKL15B_flg" /begin REF_CHARACTERISTIC KIPM_HwKL15B_flg_ovrdflg KIPM_HwKL15B_flg_ovrdval /end REF_CHARACTERISTIC /begin REF_MEASUREMENT VIPM_HwKL15B_flg /end REF_MEASUREMENT /end GROUP
/begin GROUP S7_Subsys_VIPM_HwKL30_mV "AppSwcVcu/VcuRx/HwInVCU/Subsys_VIPM_HwKL30_mV"
 /begin REF_CHARACTERISTIC KIPM_HwKL30Hi_mV KIPM_HwKL30Lo_mV KIPM_HwKL30_mV_ovrdflg KIPM_HwKL30_mV_ovrdval /end REF_CHARACTERISTIC
 /begin REF_MEASUREMENT VIPM_HwKL30_mV /end REF_MEASUREMENT
/end GROUP
/begin GROUP S7_Subsys_VIPM_HwOBCWakeup_flg "AppSwcVcu/VcuRx/HwInVCU/Subsys_VIPM_HwOBCWakeup_flg" /begin REF_CHARACTERISTIC KIPM_HwOBCWakeup_flg_ovrdflg KIPM_HwOBCWakeup_flg_ovrdval /end REF_CHARACTERISTIC /begin REF_MEASUREMENT VIPM_HwOBCWakeup_flg /end REF_MEASUREMENT /end GROUP
/begin GROUP S7_Subsys_VIPM_HwRearFogLampSwt_flg "AppSwcVcu/VcuRx/HwInVCU/Subsys_VIPM_HwRearFogLampSwt_flg"
 /begin REF_CHARACTERISTIC KIPM_HwRearFogLampSwt_flg_ovrdflg KIPM_HwRearFogLampSwt_flg_ovrdval /end REF_CHARACTERISTIC
 /begin REF_MEASUREMENT VIPM_HwRearFogLampSwt_flg /end REF_MEASUREMENT
/end GROUP
/begin GROUP S7_Subsys_VIPM_HwShftPstnSwSts_enum "AppSwcVcu/VcuRx/HwInVCU/Subsys_VIPM_HwShftPstnSwSts_enum"
 /begin REF_CHARACTERISTIC KIPM_HwShftPstnSwSts_enum_ovrdflg KIPM_HwShftPstnSwSts_enum_ovrdval /end REF_CHARACTERISTIC
 /begin REF_MEASUREMENT VIPM_HwShftPstnSwSts_enum /end REF_MEASUREMENT
/end GROUP
/begin GROUP S7_Subsys_VIPM_HwVehCrash_flg "AppSwcVcu/VcuRx/HwInVCU/Subsys_VIPM_HwVehCrash_flg" /begin REF_CHARACTERISTIC KIPM_HwVehCrash_flg_ovrdflg KIPM_HwVehCrash_flg_ovrdval /end REF_CHARACTERISTIC /begin REF_MEASUREMENT VIPM_HwVehCrash_flg /end REF_MEASUREMENT /end GROUP
/begin GROUP S7_Subsystem "AppSwcVcu/VcuRx/HwInVCU/Subsystem"
 /begin REF_CHARACTERISTIC KIPM_HwShftPstnSwPrsdHi_Ohm KIPM_HwShftPstnSwPrsdLo_Ohm KIPM_HwShftPstnSwReldHi_Ohm KIPM_HwShftPstnSwReldLo_Ohm KIPM_HwShftPstnSwShtBatt_Ohm KIPM_HwShftPstnSwShtGnd_Ohm /end REF_CHARACTERISTIC
/end GROUP
/begin GROUP S36_Subsys_VOPM_HwWakeupBMS_flg "AppSwcVcu/VcuTx/HwOutVCU/Subsys_VOPM_HwWakeupBMS_flg" /begin REF_CHARACTERISTIC KOPM_HwWakeupBMS_flg_ovrdflg KOPM_HwWakeupBMS_flg_ovrdval /end REF_CHARACTERISTIC /begin REF_MEASUREMENT VOPM_HwWakeupBMS_flg /end REF_MEASUREMENT /end GROUP
/begin GROUP S56_Model "AppSwcVcu/Vcu_100ms/DrvStyleAdapt/Model" /begin SUB_GROUP S62_SportIndex /end SUB_GROUP /end GROUP
/begin GROUP S57_Model "AppSwcVcu/Vcu_100ms/HMI/Model" /begin SUB_GROUP S71_12VBatWarn S71_FaultDiagnosis S71_InfoDisp /end SUB_GROUP /end GROUP
/begin GROUP S58_RME "AppSwcVcu/Vcu_100ms/RME/RME" /begin SUB_GROUP S197_RME_CHTC S197_RME_PwrCnsm S197_RME_WLTP /end SUB_GROUP /end GROUP
/begin GROUP S59_SIBS "AppSwcVcu/Vcu_100ms/SIBS/SIBS" /begin SUB_GROUP S248_Chrg_Cond S248_PreProcess /end SUB_GROUP
 /begin REF_CHARACTERISTIC KIBS_ChrgCurntOKThr_A KIBS_ChrgFailTmThr_min KIBS_CurntOKTmThr_min KIBS_WupChgTmThr1_min /end REF_CHARACTERISTIC
 /begin REF_MEASUREMENT VIBS_ChrgOver_flg VIBS_RTCChrgSt_enum /end REF_MEASUREMENT
/end GROUP
/begin GROUP S60_TboxModel "AppSwcVcu/Vcu_100ms/TBOX/TboxModel" /begin SUB_GROUP S287_TBoxRemoteaAirControl S287_TboxLimitSpeedLogical /end SUB_GROUP /end GROUP
/begin GROUP S347_Model "AppSwcVcu/Vcu_10ms/InputProcess/Model"
 /begin SUB_GROUP S351_AccPedal S351_BrkPedal S351_EPBState S351_ModeCalc S351_VehConfig S351_VehSpdCalcn /end SUB_GROUP
/end GROUP
/begin GROUP S349_Preprocess "AppSwcVcu/Vcu_10ms/VSO/Preprocess" /begin SUB_GROUP S432_Model /end SUB_GROUP /end GROUP
/begin GROUP S349_RoadSlopeEstmn "AppSwcVcu/Vcu_10ms/VSO/RoadSlopeEstmn" /begin SUB_GROUP S433_Model /end SUB_GROUP /end GROUP
/begin GROUP S349_TPMS "AppSwcVcu/Vcu_10ms/VSO/TPMS" /begin SUB_GROUP S435_Model /end SUB_GROUP /end GROUP
/begin GROUP S349_VehMassEstmn "AppSwcVcu/Vcu_10ms/VSO/VehMassEstmn" /begin SUB_GROUP S437_Model /end SUB_GROUP /end GROUP
/begin GROUP S350_CPT "AppSwcVcu/Vcu_10ms/VTM/CPT" /begin SUB_GROUP S531_Model /end SUB_GROUP /end GROUP
/begin GROUP S350_DAC "AppSwcVcu/Vcu_10ms/VTM/DAC" /begin SUB_GROUP S532_Model /end SUB_GROUP /end GROUP
/begin GROUP S350_TQC "AppSwcVcu/Vcu_10ms/VTM/TQC" /begin SUB_GROUP S533_Model /end SUB_GROUP /end GROUP
/begin GROUP S350_TQD "AppSwcVcu/Vcu_10ms/VTM/TQD" /begin SUB_GROUP S534_Model /end SUB_GROUP /end GROUP
/begin GROUP S350_TQF "AppSwcVcu/Vcu_10ms/VTM/TQF" /begin SUB_GROUP S535_Model /end SUB_GROUP /end GROUP
/begin GROUP S350_TQR "AppSwcVcu/Vcu_10ms/VTM/TQR" /begin SUB_GROUP S536_Model /end SUB_GROUP /end GROUP
/begin GROUP S350_TZX "AppSwcVcu/Vcu_10ms/VTM/TZX" /begin SUB_GROUP S537_Model /end SUB_GROUP /end GROUP
/begin GROUP S350_VTM_In "AppSwcVcu/Vcu_10ms/VTM/VTM_In" /begin SUB_GROUP S538_Model /end SUB_GROUP /begin REF_MEASUREMENT VTQD_TaskRunCounter_cnt /end REF_MEASUREMENT /end GROUP
/begin GROUP S350_VTM_Out "AppSwcVcu/Vcu_10ms/VTM/VTM_Out" /begin SUB_GROUP S539_Display S539_EscInterface S539_PowerIndication /end SUB_GROUP /end GROUP
/begin GROUP S883_EnergyManagementSystem "AppSwcVcu/Vcu_20ms/EMS/EnergyManagementSystem"
 /begin SUB_GROUP S888_ChrgPwrCalc S888_ChrgPwrPICtrl S888_DchaPwrCalc S888_DchaPwrPICtrl S888_LowVolACCMgt S888_PreProcess /end SUB_GROUP
/end GROUP
/begin GROUP S884_BMS_FaultDiag "AppSwcVcu/Vcu_20ms/FaultDiag/BMS_FaultDiag" /begin SUB_GROUP S949_Model /end SUB_GROUP /end GROUP
/begin GROUP S884_Comm_FaultDiag "AppSwcVcu/Vcu_20ms/FaultDiag/Comm_FaultDiag" /begin SUB_GROUP S950_Model /end SUB_GROUP /end GROUP
/begin GROUP S884_DCC_FaultDiag "AppSwcVcu/Vcu_20ms/FaultDiag/DCC_FaultDiag" /begin SUB_GROUP S951_Model /end SUB_GROUP /end GROUP
/begin GROUP S884_Error_Code "AppSwcVcu/Vcu_20ms/FaultDiag/Error_Code" /begin REF_MEASUREMENT VDAG_ErrCode_enum /end REF_MEASUREMENT /end GROUP
/begin GROUP S884_FaultDiag_PreProc "AppSwcVcu/Vcu_20ms/FaultDiag/FaultDiag_PreProc" /begin SUB_GROUP S953_Turn_On_Delay /end SUB_GROUP
 /begin REF_CHARACTERISTIC KDAG_ManlClrDTCReq_enum KDAG_VehSpdLo_kph KDAG_VehStandStillBypasBrk_flg KDAG_VehStandStillSpd_kph KDAG_WakeUpDlyTm_s /end REF_CHARACTERISTIC
/end GROUP
/begin GROUP S884_Fault_Action "AppSwcVcu/Vcu_20ms/FaultDiag/Fault_Action"
 /begin REF_CHARACTERISTIC KDAG_EmgcyShtdwnOvrdSw_flg KDAG_EmgcyShtdwnOvrdVal_flg KDAG_FanFullSpdOnOvrdSw_flg KDAG_FanFullSpdOnOvrdVal_flg KDAG_FbdACCOvrdSw_flg KDAG_FbdACCOvrdVal_flg KDAG_FbdACChrgOvrdSw_flg KDAG_FbdACChrgOvrdVal_flg KDAG_FbdACDchaOvrdSw_flg KDAG_FbdACDchaOvrdVal_flg KDAG_FbdACOvrdSw_flg KDAG_FbdACOvrdVal_flg KDAG_FbdCCOvrdSw_flg KDAG_FbdCCOvrdVal_flg KDAG_FbdDCChrgOvrdSw_flg KDAG_FbdDCChrgOvrdVal_flg KDAG_FbdDCDCOvrdSw_flg KDAG_FbdDCDCOvrdVal_flg KDAG_FbdDRGrOvrdSw_flg KDAG_FbdDRGrOvrdVal_flg KDAG_FbdDrvTqOvrdSw_flg KDAG_FbdDrvTqOvrdVal_flg KDAG_FbdHVOvrdSw_flg KDAG_FbdHVOvrdVal_flg KDAG_FbdLSPOvrdSw_flg KDAG_FbdLSPOvrdVal_flg KDAG_FltLampOnOvrdSw_flg KDAG_FltLampOnOvrdVal_flg KDAG_LVBatLampOnOvrdSw_flg KDAG_LVBatLampOnOvrdVal_flg KDAG_LimpHomeOvrdSw_flg KDAG_LimpHomeOvrdVal_flg KDAG_LmtDrvTqOvrdSw_flg KDAG_LmtDrvTqOvrdVal_flg /end REF_CHARACTERISTIC
 /begin REF_MEASUREMENT VDAG_EmgcyShtdwn_flg VDAG_FanFullSpdOn_flg VDAG_FbdACC_flg VDAG_FbdACChrg_flg VDAG_FbdACDcha_flg VDAG_FbdAC_flg VDAG_FbdCC_flg VDAG_FbdDCChrg_flg VDAG_FbdDCDC_flg VDAG_FbdDRGr_flg VDAG_FbdDrvTq_flg VDAG_FbdHV_flg VDAG_FbdLSP_flg VDAG_FltLampOn_flg VDAG_FltLvl_enum VDAG_LVBatLampOn_flg VDAG_LimpHome_flg VDAG_LmtDrvTq_flg /end REF_MEASUREMENT
/end GROUP
/begin GROUP S884_INV_FaultDiag "AppSwcVcu/Vcu_20ms/FaultDiag/INV_FaultDiag" /begin SUB_GROUP S955_Model /end SUB_GROUP /end GROUP
/begin GROUP S884_OBC_FaultDiag "AppSwcVcu/Vcu_20ms/FaultDiag/OBC_FaultDiag" /begin SUB_GROUP S956_Model /end SUB_GROUP /end GROUP
/begin GROUP S884_OtherECU_FaultDiag "AppSwcVcu/Vcu_20ms/FaultDiag/OtherECU_FaultDiag" /begin SUB_GROUP S957_Model /end SUB_GROUP /end GROUP
/begin GROUP S884_Other_FaultDiag "AppSwcVcu/Vcu_20ms/FaultDiag/Other_FaultDiag" /begin SUB_GROUP S958_Model /end SUB_GROUP /end GROUP
/begin GROUP S884_Sensor10ms_FaultDiag "AppSwcVcu/Vcu_20ms/FaultDiag/Sensor10ms_FaultDiag" /begin SUB_GROUP S960_Model /end SUB_GROUP /end GROUP
/begin GROUP S884_Sensor20ms_FaultDiag "AppSwcVcu/Vcu_20ms/FaultDiag/Sensor20ms_FaultDiag" /begin SUB_GROUP S961_Model /end SUB_GROUP /end GROUP
/begin GROUP S884_Sensor50ms_FaultDiag "AppSwcVcu/Vcu_20ms/FaultDiag/Sensor50ms_FaultDiag" /begin SUB_GROUP S962_Model /end SUB_GROUP /end GROUP
/begin GROUP S884_UDSData "AppSwcVcu/Vcu_20ms/FaultDiag/UDSData"
 /begin REF_CHARACTERISTIC KDAG_Did0xF163WrtData_cnt KDAG_Did0xF180WrtData_cnt KDAG_Did0xF187WrtData_cnt KDAG_Did0xF188WrtData_cnt KDAG_Did0xF191WrtData_cnt /end REF_CHARACTERISTIC
 /begin REF_MEASUREMENT UDS_TBOX_BJS_Time_Day UDS_TBOX_BJS_Time_Hour UDS_TBOX_BJS_Time_Min UDS_TBOX_BJS_Time_Month UDS_TBOX_BJS_Time_Sec UDS_TBOX_BJS_Time_Year /end REF_MEASUREMENT
/end GROUP
/begin GROUP S885_HighVoltageMgt "AppSwcVcu/Vcu_20ms/HvMgt/HighVoltageMgt" /begin SUB_GROUP S1500_DCandACChrgLmt S1500_PreProcess S1500_TransCond /end SUB_GROUP
 /begin REF_CHARACTERISTIC KHVM_ChrgStopWaitTm_s KHVM_DCCBuckLVVolt_V KHVM_DchaStopWaitTm_s KHVM_HVCheckTmout_s KHVM_HVCutOffTmout_s KHVM_HVDeviceOffTmout_s KHVM_HVDschrgTmout_s KHVM_HVSetUpTmout_s KHVM_INVholdTm_s KHVM_OBCS2ClsTmout_s KHVM_SleepWaitTm_s /end REF_CHARACTERISTIC
 /begin REF_MEASUREMENT VHVM_BMSShutdown_enum VHVM_BMSWakeUpMode_enum VHVM_Bat2DrvTrainEnbl_flg VHVM_ChrgAllowCmd_enum VHVM_ChrgEnaAC_enum VHVM_ChrgEnaDC_flg VHVM_DCCBuckLVVolt_V VHVM_DCCOprtCmd_enum VHVM_ECUSleepAllwd_flg VHVM_EmgcySdn_flg VHVM_EnaDisChg_flg VHVM_INVEnbl_flg VHVM_MaxChrgCurntDC_A VHVM_MaxChrgVoltDC_V VHVM_MaxHVDCCurntAC_A VHVM_MaxHVDCVoltAC_V VHVM_PTActOprtMode_enum VHVM_SysSta_enum VHVM_VCUMode_enum VHVM_WakeUpBMS_flg /end REF_MEASUREMENT
/end GROUP
/begin GROUP S887_GearShift "AppSwcVcu/Vcu_20ms/gsm/GearShift" /begin SUB_GROUP S1635_EPBControl S1635_GearLogical /end SUB_GROUP /end GROUP
/begin GROUP S62_SportIndex "AppSwcVcu/Vcu_100ms/DrvStyleAdapt/Model/SportIndex"
 /begin REF_CHARACTERISTIC KDSA_AcceltnIdxAvgInit_pct KDSA_AcceltnIdxDecRate_pctps KDSA_AcceltnIdxIncRate_pctps KDSA_BrkPedPstnAvgInit_pct KDSA_BrkPedPstnDecRate_pctps KDSA_BrkPedPstnIncRate_pctps KDSA_DrvSprtIdxMax_pct KDSA_DrvSprtIdxMin_pct KDSA_SprtIdxBrkPedRstSpd_kph KDSA_SprtIdxBrkPedRstTm_s KDSA_SprtIdxBrkPedRstVal_pct KDSA_SprtIdxHldAccPed4Acc_pct KDSA_SprtIdxHldAccPed4Brk_pct KDSA_SprtIdxHldAccPedRlsDlyTm4Brk_s KDSA_SprtIdxHldAcceltn4Acc_mps2 KDSA_SprtIdxHldDchaPwr_kW KDSA_SprtIdxHldVehSpd4Acc_kph KDSA_SprtIdxHldVehSpd4Brk_kph KDSA_SprtIdxHldWhlTq4Acc_Nm KDSA_UseTqCalcAcceltn_flg KSYS_VehMass_kg MDSA_MildDrvMap_mps2 MDSA_SprtIdxHldINVTq_Nm MDSA_VehDrgTq_Nm MDSA_WildDrvMap_mps2 /end REF_CHARACTERISTIC
 /begin REF_MEASUREMENT VDSA_AcceltnIdxAvg_pct VDSA_AcceltnIdxRaw_pct VDSA_BrkPedPstnAvg_pct VDSA_DrvSprtIdx_pct VDSA_SprtIdxHldAcc_flg VDSA_SprtIdxHldBrk_flg VDSA_TqCalcAcceltn_mps2 /end REF_MEASUREMENT
/end GROUP
/begin GROUP S71_12VBatWarn "AppSwcVcu/Vcu_100ms/HMI/Model/12VBatWarn" /begin REF_MEASUREMENT VHMI_12VBatLowVolSta_enum /end REF_MEASUREMENT /end GROUP
/begin GROUP S71_FaultDiagnosis "AppSwcVcu/Vcu_100ms/HMI/Model/FaultDiagnosis"
 /begin SUB_GROUP S74_BatCellTempHiWarn S74_BothThrottle_Brake S74_DrivePowerLimitErr S74_FobidShiftGear_OverSpd S74_RecoverPowerLimitErr S74_SlidingWarning S74_SnowOverSpd S74_skidding /end SUB_GROUP
/end GROUP
/begin GROUP S71_InfoDisp "AppSwcVcu/Vcu_100ms/HMI/Model/InfoDisp" /begin REF_CHARACTERISTIC KHMI_InfoDispIntervalTm_s KHMI_WarningSendTime_s /end REF_CHARACTERISTIC /begin REF_MEASUREMENT VHMI_InfoDisp_enum /end REF_MEASUREMENT /end GROUP
/begin GROUP S197_RME_CHTC "AppSwcVcu/Vcu_100ms/RME/RME/RME_CHTC"
 /begin REF_CHARACTERISTIC KRME_CHTCRmnMilEstVldOff_km KRME_CHTCRmnMilEstVldOn_km KRME_SOHCrctFacEnbl_flg MRME_CHTCStdRmnMil_km /end REF_CHARACTERISTIC
 /begin REF_MEASUREMENT VRME_CHTCRmnMilEstV_flg VRME_CHTCRmnMilEst_km /end REF_MEASUREMENT
/end GROUP
/begin GROUP S197_RME_PwrCnsm "AppSwcVcu/Vcu_100ms/RME/RME/RME_PwrCnsm" /begin SUB_GROUP S199_CalPwrCnsmPerUnitKM /end SUB_GROUP /end GROUP
/begin GROUP S197_RME_WLTP "AppSwcVcu/Vcu_100ms/RME/RME/RME_WLTP" /begin SUB_GROUP S200_Dynamic S200_WLTPStandardEndurance_____________ /end SUB_GROUP
 /begin REF_CHARACTERISTIC KRME_WLTPDynModeEnbl_flg KRME_WLTPRmnMilEstVldOff_km KRME_WLTPRmnMilEstVldOn_km /end REF_CHARACTERISTIC
 /begin REF_MEASUREMENT VRME_DynRmnMilEstV_flg /end REF_MEASUREMENT
/end GROUP
/begin GROUP S248_Chrg_Cond "AppSwcVcu/Vcu_100ms/SIBS/SIBS/Chrg_Cond" /begin SUB_GROUP S250_RS_Latch /end SUB_GROUP
 /begin REF_CHARACTERISTIC KIBS_ChgMaxNumThr_cnt KIBS_FailChgNumThr_cnt KIBS_FbIBSWup_flg KIBS_HoldNMTmThr_s MIBS_BMSBatSOCExtrmLo_pct MIBS_IBSEnMinSOC_pct /end REF_CHARACTERISTIC
 /begin REF_MEASUREMENT VIBS_BMSBatSOCAllow_flg VIBS_ChgNumAllow_flg VIBS_ChgNum_cnt VIBS_ChrgBascCond_flg VIBS_ChrgEnbl_flg VIBS_FailChgNum_cnt VIBS_FbRctWup_flg VIBS_HVReq_flg VIBS_SleepAllwd_flg /end REF_MEASUREMENT
/end GROUP
/begin GROUP S248_PreProcess "AppSwcVcu/Vcu_100ms/SIBS/SIBS/PreProcess"
 /begin SUB_GROUP S251_Fault_Debounce S251_LPF1a_T_IV S251_LPF1a_T_IV1 S251_RS_Latch S251_RS_Latch1 S251_Turn_On_Delay3 /end SUB_GROUP
 /begin REF_CHARACTERISTIC KIBS_ChrgTempThr1_C KIBS_ChrgTempThr2_C KIBS_ChrgTempThr3_C KIBS_ChrgVoltThr1_V KIBS_ChrgVoltThr2_V KIBS_ChrgVoltThr3_V KIBS_ChrgVoltThr4_V KIBS_DfltEnvirTemp_C KIBS_EnvirTemptFiltCoeff_c KIBS_FbRctWupThr_min KIBS_KL30VoltDebTmThr_s KIBS_KL30VoltFiltCoeff_c KIBS_MustChrgVoltDebTm_s KIBS_StWaitTm_s KIBS_UseTblThr_min KIBS_WakeupReas_enum MIBS_MustChrgVolt_V MIBS_NextRtcWupThr_min MIBS_WupChgTmThr2_min /end REF_CHARACTERISTIC
 /begin REF_MEASUREMENT VIBS_ChrgVoltThr_V VIBS_MustChrgVolt_V VIBS_NextRtcWupThr_min VIBS_RTCWakeup_flg VIBS_WupChgTmThr_min /end REF_MEASUREMENT
/end GROUP
/begin GROUP S287_TBoxRemoteaAirControl "AppSwcVcu/Vcu_100ms/TBOX/TboxModel/TBoxRemoteaAirControl" /begin REF_CHARACTERISTIC KTBX_RmtACStFbMaxTmr_s KTBX_RmtEnblACLwSOC_pct /end REF_CHARACTERISTIC /end GROUP
/begin GROUP S287_TboxLimitSpeedLogical "AppSwcVcu/Vcu_100ms/TBOX/TboxModel/TboxLimitSpeedLogical" /begin SUB_GROUP S289_ExecuteSpeedLimit S289_SpeedLimitBaseCondition /end SUB_GROUP /end GROUP
/begin GROUP S351_AccPedal "AppSwcVcu/Vcu_10ms/InputProcess/Model/AccPedal"
 /begin SUB_GROUP S352_DbndBckLsh S352_MinPstnLrnd S352_Normztn S352_Stk S352_Wght /end SUB_GROUP
/end GROUP
/begin GROUP S351_BrkPedal "AppSwcVcu/Vcu_10ms/InputProcess/Model/BrkPedal"
 /begin REF_CHARACTERISTIC KIPC_BrkPedPstnDfltPrsd_pct KIPC_BrkPedPstnOvrdSw_flg KIPC_BrkPedPstnOvrdVal_pct KIPC_BrkSwPrsdPedPstn_pct /end REF_CHARACTERISTIC
 /begin REF_MEASUREMENT VIPC_BrkPedPstnVld_flg VIPC_BrkPedPstn_pct VIPC_BrkSwActv_flg /end REF_MEASUREMENT
/end GROUP
/begin GROUP S351_EPBState "AppSwcVcu/Vcu_10ms/InputProcess/Model/EPBState" /begin REF_MEASUREMENT VIPC_EPBAppld_flg VIPC_EPBReld_flg /end REF_MEASUREMENT /end GROUP
/begin GROUP S351_ModeCalc "AppSwcVcu/Vcu_10ms/InputProcess/Model/ModeCalc" /begin SUB_GROUP S355_AutoCreep /end SUB_GROUP
 /begin REF_CHARACTERISTIC KIPC_CrpModeActOvrdSw_flg KIPC_CrpModeActOvrdVal_enum KIPC_DrvModeActOvrdSw_flg KIPC_DrvModeActOvrdVal_enum KIPC_DrvPwrIntnstyOvrdSw_flg KIPC_DrvPwrIntnstyOvrdVal_pct KIPC_RegenModeActOvrdSw_flg KIPC_RegenModeActOvrdVal_enum KIPC_RegenPwrIntnstyOvrdSw_flg KIPC_RegenPwrIntnstyOvrdVal_pct KIPC_SnowModeDft_flg KIPC_SnowModeOvrdSw_flg KIPC_SnowModeOvrdVal_flg KIPC_VehHiddenBtnSyncnTm_s KIPC_VehHiddenModeWaitTm_s /end REF_CHARACTERISTIC
 /begin REF_MEASUREMENT VIPC_CrpModeAct_enum VIPC_DrvModeAct_enum VIPC_DrvPwrIntnsty_pct VIPC_RegenModeAct_enum VIPC_RegenPwrIntnsty_pct VIPC_SnowMode_flg VIPC_VehHiddenMode_enum /end REF_MEASUREMENT
/end GROUP
/begin GROUP S351_VehConfig "AppSwcVcu/Vcu_10ms/InputProcess/Model/VehConfig"
 /begin REF_CHARACTERISTIC KIPC_ACCCfgOvrdSw_flg KIPC_ACCCfgOvrdVal_flg KIPC_CCSCfgOvrdSw_flg KIPC_CCSCfgOvrdVal_flg KIPC_CrpCtrlCfgOvrdSw_flg KIPC_CrpCtrlCfgOvrdVal_flg KIPC_HDCCfgOvrdSw_flg KIPC_HDCCfgOvrdVal_flg KIPC_iTPMSCfgOvrdSw_flg KIPC_iTPMSCfgOvrdVal_flg MIPC_TireRadius_m /end REF_CHARACTERISTIC
 /begin REF_MEASUREMENT VIPC_ACCCfgd_flg VIPC_CCSCfgd_flg VIPC_CrpCtrlCfgd_flg VIPC_HDCCfgd_flg VIPC_TireRadius_m VIPC_iTPMSCfgd_flg /end REF_MEASUREMENT
/end GROUP
/begin GROUP S351_VehSpdCalcn "AppSwcVcu/Vcu_10ms/InputProcess/Model/VehSpdCalcn" /begin SUB_GROUP S357_VehSpdDrvn S357_VehSpdNonDrvn /end SUB_GROUP /begin REF_CHARACTERISTIC KSYS_VehTransRto_c /end REF_CHARACTERISTIC /begin REF_MEASUREMENT VIPC_VehSpdDrvnMotor_kph /end REF_MEASUREMENT /end GROUP
/begin GROUP S432_Model "AppSwcVcu/Vcu_10ms/VSO/Preprocess/Model" /begin SUB_GROUP S438_IMU S438_WhlSpdAcceltn /end SUB_GROUP /end GROUP
/begin GROUP S433_Model "AppSwcVcu/Vcu_10ms/VSO/RoadSlopeEstmn/Model"
 /begin SUB_GROUP S470_FinalSlopeCalculation S470_RawSlopeCalculation S470_RetardingTqCalc S470_SignalConfidence /end SUB_GROUP
/end GROUP
/begin GROUP S435_Model "AppSwcVcu/Vcu_10ms/VSO/TPMS/Model" /begin SUB_GROUP S503_DrvCond S503_WhlDistErrCalc /end SUB_GROUP
 /begin REF_CHARACTERISTIC KVSO_AvgXWhlDistErr1Fac_c KVSO_AvgXWhlDistErr2Fac_c KVSO_AvgXWhlDistErr3Fac_c KVSO_AvgXWhlDistErr4Fac_c KVSO_AvgXWhlDistErr5Fac_c KVSO_TPMSLrnReqCfmTm_s KVSO_XWhlDistErrExcd_mpkm /end REF_CHARACTERISTIC
 /begin REF_MEASUREMENT VVSO_AvgXWhlDistErr1_mpkm VVSO_AvgXWhlDistErr2_mpkm VVSO_AvgXWhlDistErr3_mpkm VVSO_AvgXWhlDistErr4_mpkm VVSO_AvgXWhlDistErr5_mpkm VVSO_AvgXWhlDistErr_mpkm VVSO_XWhlDistErrRefStat_enum VVSO_XWhlDistErrRef_mpkm VVSO_iTPMSState_enum VVSO_iTPMSWrng_flg /end REF_MEASUREMENT
/end GROUP
/begin GROUP S437_Model "AppSwcVcu/Vcu_10ms/VSO/VehMassEstmn/Model" /begin SUB_GROUP S519_LPF1_T_IV2 S519_TireForceCalc /end SUB_GROUP
 /begin REF_CHARACTERISTIC KSYS_VehMass_kg KVSO_AirBlowArea_m2 KVSO_AirResistCoeff_c KVSO_MassEstBrkPrsd_bar KVSO_MassEstBrkPrsd_pct KVSO_MassEstFrcLo_N KVSO_MassEstPkInit_c KVSO_MassEstSpdLo_kph KVSO_MassEstYawRateHi_degps KVSO_MassLoadTm_s KVSO_RollgResistCoeff_c KVSO_VehMassFiltTm_s KVSO_VehSpdFiltTm_s KVSO_WhlLgtFrcFiltTm_s /end REF_CHARACTERISTIC
 /begin REF_MEASUREMENT VVSO_VehMassConf_flg VVSO_VehMassDistb_enum VVSO_VehSpd_mps /end REF_MEASUREMENT
/end GROUP
/begin GROUP S531_Model "AppSwcVcu/Vcu_10ms/VTM/CPT/Model" /begin SUB_GROUP S541_LPF1a_T_IV S541_RateLimit_R_IV S541_RateLimit_R_IV1 /end SUB_GROUP
 /begin REF_CHARACTERISTIC KCPT_GenMaxTqDecRate_Nmps KCPT_GenMaxTqIncRate_Nmps KCPT_MotMaxTqDecRate_Nmps KCPT_MotMaxTqFiltAchvd_Nm KCPT_MotMaxTqIncRate_Nmps KCPT_MotorDrgMaxTqAllwd_Nm KCPT_MotorMaxTqFiltCoeff_c KCPT_MotorRvrsSpdOffD_rpm KCPT_MotorRvrsSpdOffR_rpm KCPT_MotorRvrsSpdOnD_rpm KCPT_MotorRvrsSpdOnR_rpm KSYS_VehTransRto_c /end REF_CHARACTERISTIC
 /begin REF_MEASUREMENT VCPT_MotorDrgMaxTq_Nm VCPT_MotorDrvMaxTq_Nm VCPT_MotorSpdRvrs_flg VCPT_WhlDrgMaxTq_Nm VCPT_WhlDrvMaxTq_Nm /end REF_MEASUREMENT
/end GROUP
/begin GROUP S532_Model "AppSwcVcu/Vcu_10ms/VTM/DAC/Model"
 /begin SUB_GROUP S554_CruiseControl S554_HillDescentControl S554_PostProcess /end SUB_GROUP
/end GROUP
/begin GROUP S533_Model "AppSwcVcu/Vcu_10ms/VTM/TQC/Model" /begin SUB_GROUP S682_ABSActv S682_ESPIntv S682_RBSIntv /end SUB_GROUP /end GROUP
/begin GROUP S534_Model "AppSwcVcu/Vcu_10ms/VTM/TQD/Model"
 /begin SUB_GROUP S700_DriverTqReqOriginal S700_TorqueLimit S700_TqSynthAndDerate /end SUB_GROUP
/end GROUP
/begin GROUP S535_Model "AppSwcVcu/Vcu_10ms/VTM/TQF/Model"
 /begin SUB_GROUP S758_FilterSlewRate S758_TorqueDirection S758_TorqueFilter S758_TqChgRate /end SUB_GROUP
/end GROUP
/begin GROUP S536_Model "AppSwcVcu/Vcu_10ms/VTM/TQR/Model"
 /begin SUB_GROUP S784_ActiveSurgeDamping S784_MotorDampngEnbl S784_MotorDirReq S784_MotorStandby /end SUB_GROUP
 /begin REF_MEASUREMENT VTQR_MotorModeReq_enum VTQR_MotorSpdReq_rpm VTQR_MotorTqReq_Nm /end REF_MEASUREMENT
/end GROUP
/begin GROUP S537_Model "AppSwcVcu/Vcu_10ms/VTM/TZX/Model"
 /begin SUB_GROUP S817_ClunkCtrl S817_PreProc S817_TqReqPrdt S817_ZeroXPara S817_ZeroXStat /end SUB_GROUP
 /begin REF_CHARACTERISTIC KTZX_AZDMaxTm_s KTZX_AZIMaxTm_s KTZX_BrkPedPrsd_pct KTZX_ClkZXTmD_s KTZX_ClkZXTmR_s KTZX_ClkZXTqD_Nm KTZX_ClkZXTqR_Nm KTZX_TMSpdBckThr_rpm KTZX_TMSpdFwdThr_rpm KTZX_TqDsengCfmTm_s KTZX_TqDsengThr_Nm KTZX_VehStopSpd_kph KTZX_ZXRegenTqTgtThr_Nm /end REF_CHARACTERISTIC
/end GROUP
/begin GROUP S538_Model "AppSwcVcu/Vcu_10ms/VTM/VTM_In/Model" /begin SUB_GROUP S864_LPF1a_T_IV S864_LPF1a_T_IV1 S864_LPF1a_T_IV4 /end SUB_GROUP
 /begin REF_CHARACTERISTIC KTQC_ESCTqIntvAllwdVal_Nm KVTM_BrkPedReld_pct KVTM_MotorSpdFiltCoeff_rat KVTM_VehAcceltnFiltCoeff_rat KVTM_VehAcceltnMax_mps2 KVTM_VehAcceltnMin_mps2 KVTM_VehSpdFiltCoeff_rat /end REF_CHARACTERISTIC
 /begin REF_MEASUREMENT VVTM_BrkPedReld_flg VVTM_ESPIntvActv_flg VVTM_VehActGrPstn_enum /end REF_MEASUREMENT
/end GROUP
/begin GROUP S539_Display "AppSwcVcu/Vcu_10ms/VTM/VTM_Out/Display" /begin SUB_GROUP S871_HysteresisB_SP /end SUB_GROUP
 /begin REF_CHARACTERISTIC KDAC_BrkTq2PresrCvrtCoeff_c KSYS_VehTransRto_c KVTM_BrkLampOffRegenTq_Nm KVTM_BrkLampOnRegenTq_Nm /end REF_CHARACTERISTIC
 /begin REF_MEASUREMENT VVTM_DrvMotorSta_enum VVTM_PCUFailSta_flg /end REF_MEASUREMENT
/end GROUP
/begin GROUP S539_EscInterface "AppSwcVcu/Vcu_10ms/VTM/VTM_Out/EscInterface" /begin REF_CHARACTERISTIC KSYS_VehTransRto_c /end REF_CHARACTERISTIC /end GROUP
/begin GROUP S539_PowerIndication "AppSwcVcu/Vcu_10ms/VTM/VTM_Out/PowerIndication" /begin SUB_GROUP S873_Backlash /end SUB_GROUP
 /begin REF_CHARACTERISTIC KVTM_MotorMaxDrvPwr_kW KVTM_MotorMaxRegenPwr_kW KVTM_MotorPwrTypeRecup_Nm /end REF_CHARACTERISTIC
 /begin REF_MEASUREMENT VVTM_RsrvPwr_kW VVTM_RsrvRecupPwr_kW /end REF_MEASUREMENT
/end GROUP
/begin GROUP S888_ChrgPwrCalc "AppSwcVcu/Vcu_20ms/EMS/EnergyManagementSystem/ChrgPwrCalc" /begin SUB_GROUP S889_RS_Latch /end SUB_GROUP
 /begin REF_CHARACTERISTIC KEMS_AccPwrIncFiltCoeff_c KEMS_ChrgPwr2MotRawFiltCoeff_c KEMS_HVBatCurrBelowConChrgDlyTm_s KEMS_HVBatCurrOverConChrgDlyTm_s KEMS_MaxChrgCurDecRate_Aps KEMS_MaxChrgCurFiltAchvd_A KEMS_MaxChrgCurIncRate_Aps MEMS_CellOverVoltBgn_mV MEMS_CellOverVoltRng_mV /end REF_CHARACTERISTIC
 /begin REF_MEASUREMENT VEMS_MaxChrgCur_A VEMS_MaxChrgPwr2MotRaw_kW VEMS_MaxChrgPwr_kW VEMS_MaxConChrgCur_A VEMS_MaxInsChrgCur_A /end REF_MEASUREMENT
/end GROUP
/begin GROUP S888_ChrgPwrPICtrl "AppSwcVcu/Vcu_20ms/EMS/EnergyManagementSystem/ChrgPwrPICtrl" /begin SUB_GROUP S890_PIPwrClsLoop /end SUB_GROUP
 /begin REF_CHARACTERISTIC KEMS_ChrgFbActvDlyTm_s KEMS_ChrgPwrFbFiltCoeff_c KEMS_ChrgPwrFbOff_kW KEMS_ChrgPwrFbOn_kW /end REF_CHARACTERISTIC
 /begin REF_MEASUREMENT VEMS_ChrgOvrshtPwr_kW VEMS_ChrgPwrFb_kW VEMS_MaxChrgPwr2Mot_kW /end REF_MEASUREMENT
/end GROUP
/begin GROUP S888_DchaPwrCalc "AppSwcVcu/Vcu_20ms/EMS/EnergyManagementSystem/DchaPwrCalc" /begin SUB_GROUP S891_RS_Latch /end SUB_GROUP
 /begin REF_CHARACTERISTIC KEMS_AccPwrDecFiltCoeff_c KEMS_DchaPwr2MotRawFiltCoeff_c KEMS_HVBatCurrBelowConDlyTm_s KEMS_HVBatCurrOverConDlyTm_s KEMS_MaxDchaCurDecRate_Aps KEMS_MaxDchaCurFiltAchvd_A KEMS_MaxDchaCurIncRate_Aps MEMS_CellUndrVoltBgn1_mV MEMS_CellUndrVoltBgn2_mV MEMS_CellUndrVoltRng1_mV MEMS_CellUndrVoltRng2_mV /end REF_CHARACTERISTIC
 /begin REF_MEASUREMENT VEMS_CellUndrVoltDrtFac_c VEMS_MaxConDchaCur_A VEMS_MaxDchaCur_A VEMS_MaxDchaPwr2MotRaw_kW VEMS_MaxDchaPwr_kW VEMS_MaxInsDchaCur_A /end REF_MEASUREMENT
/end GROUP
/begin GROUP S888_DchaPwrPICtrl "AppSwcVcu/Vcu_20ms/EMS/EnergyManagementSystem/DchaPwrPICtrl" /begin SUB_GROUP S892_PIPwrClsLoop /end SUB_GROUP
 /begin REF_CHARACTERISTIC KEMS_DchaFbActvDlyTm_s KEMS_DchaPwrFbFiltCoeff_c KEMS_DchaPwrFbOff_kW KEMS_DchaPwrFbOn_kW /end REF_CHARACTERISTIC
 /begin REF_MEASUREMENT VEMS_DchaOvrshtPwr_kW VEMS_DchaPwrFb_kW VEMS_MaxDchaPwr2Mot_kW /end REF_MEASUREMENT
/end GROUP
/begin GROUP S888_LowVolACCMgt "AppSwcVcu/Vcu_20ms/EMS/EnergyManagementSystem/LowVolACCMgt" /begin SUB_GROUP S893_HysteresisA_SP /end SUB_GROUP
 /begin REF_CHARACTERISTIC KEMS_DCCSurgePwr_kW KEMS_TMSActSOCOff_pct KEMS_TMSActSOCOn_pct KEMS_TMSMaxPwrLim_kW KEMS_TMSPwrEnblOff_kW KEMS_TMSPwrEnblOn_kW KEMS_TMSPwrOffDlyTm_s /end REF_CHARACTERISTIC
 /begin REF_MEASUREMENT VEMS_ACCMOprtCmd_flg VEMS_TMSPwrEnbl_flg VEMS_TMSUsePwr_kW /end REF_MEASUREMENT
/end GROUP
/begin GROUP S888_PreProcess "AppSwcVcu/Vcu_20ms/EMS/EnergyManagementSystem/PreProcess"
 /begin SUB_GROUP S894_CellVoltMaxClsLoop S894_CellVoltMinClsLoop S894_RateLimit_R_IV /end SUB_GROUP
 /begin REF_CHARACTERISTIC KEMS_CellTempSynDecRate_Cps KEMS_CellTempSynIncRate_Cps KEMS_HVBatActCurrExcdThr_A KEMS_HVBatActCurrExcdVal_A MEMS_CellTempLoThr_C /end REF_CHARACTERISTIC
 /begin REF_MEASUREMENT VEMS_AccPwrRaw_kW VEMS_HVBatPwrAct_kW /end REF_MEASUREMENT
/end GROUP
/begin GROUP S949_Model "AppSwcVcu/Vcu_20ms/FaultDiag/BMS_FaultDiag/Model"
 /begin SUB_GROUP S964_BMS_Command_Time_out S964_BMS_SOC_Low S964_BMS_Under_Voltage S964_FltMgt S964_FltMgt1 S964_FltMgt10 S964_FltMgt11 S964_FltMgt12 S964_FltMgt13 S964_FltMgt14 S964_FltMgt2 S964_FltMgt3 S964_FltMgt4 S964_FltMgt5 S964_FltMgt6 S964_FltMgt7 S964_FltMgt8 S964_FltMgt9 /end SUB_GROUP
 /begin REF_CHARACTERISTIC KDAG_ACSCmdTmOutActnMsk_enum KDAG_ACSCmdTmOutFailTm_s KDAG_BMSCmdTmOutActnMsk_enum KDAG_BMSEmgcySdnActnMsk_enum KDAG_BMSEmgcySdnFailTm_s KDAG_BMSSOCLoActnMsk_enum KDAG_BMSSOCLoFailTm_s KDAG_BMSSysFailFailTm_s KDAG_BMSSysFailLvl2ActnMsk_enum KDAG_BMSSysFailLvl3ActnMsk_enum KDAG_BMSUndrVoltFailTm_s KDAG_CellUndrVoltActnMsk_enum KDAG_CellUndrVoltFailTm_s KDAG_DCSChrgReqActnMsk_enum KDAG_DCSChrgReqFailTm_s KDAG_DCSCmdTmOutActnMsk_enum KDAG_DCSCmdTmOutFailTm_s KDAG_DCSFailStaActnMsk_enum KDAG_DCSFailStaFailTm_s KDAG_DCSInletConnectActnMsk_enum KDAG_DCSInletConnectFailTm_s KDAG_DCSModeFailActnMsk_enum KDAG_DCSModeFailFailTm_s KDAG_HVIsoResistLoActnMsk_enum KDAG_HVIsoResistLoFailTm_s KDAG_HVIsoResistLoPassTm_s KDAG_HVIsoResistLoThr_kOhm MDAG_CellTempLoThr_C MDAG_CellUndrVoltThr1_mV MDAG_CellUndrVoltThr2_mV /end REF_CHARACTERISTIC
/end GROUP
/begin GROUP S950_Model "AppSwcVcu/Vcu_20ms/FaultDiag/Comm_FaultDiag/Model" /begin SUB_GROUP S1028_Subsystem /end SUB_GROUP
 /begin REF_CHARACTERISTIC KDAG_ACCMCRCFltActnMsk_enum KDAG_ACCMLostCommActnMsk_enum KDAG_BACBusOffActnMsk_enum KDAG_BMSCRCFltActnMsk_enum KDAG_BMSLostCommActnMsk_enum KDAG_BODBusOffActnMsk_enum KDAG_CCPCRCFltActnMsk_enum KDAG_CHABusOffActnMsk_enum KDAG_CRRRCRCFltActnMsk_enum KDAG_EHBCRCFltActnMsk_enum KDAG_EHBLostCommActnMsk_enum KDAG_EPTBusOffActnMsk_enum KDAG_ESCCRCFltActnMsk_enum KDAG_ESCLostCommActnMsk_enum KDAG_FCMCRCFltActnMsk_enum KDAG_FCMLostCommActnMsk_enum KDAG_INVCRCFltActnMsk_enum KDAG_INVLostCommActnMsk_enum KDAG_IPUCRCFltActnMsk_enum KDAG_SCSCRCFltActnMsk_enum KDAG_SCSLostCommActnMsk_enum /end REF_CHARACTERISTIC
/end GROUP
/begin GROUP S951_Model "AppSwcVcu/Vcu_20ms/FaultDiag/DCC_FaultDiag/Model"
 /begin SUB_GROUP S1142_DCC_Command_Time_out S1142_DCC_Fault_Level3 S1142_DCDC_Mode_Fault S1142_FltMgt2 S1142_FltMgt3 S1142_FltMgt4 S1142_FltMgt5 S1142_FltMgt6 S1142_FltMgt7 S1142_FltMgt8 S1142_FltMgt9 /end SUB_GROUP
 /begin REF_CHARACTERISTIC KDAG_DCCCmdTmOutFailTm_s KDAG_DCCInVoltLoActnMsk_enum KDAG_DCCInVoltLoFailTm_s KDAG_DCCModeFltFailTm_s KDAG_DCCSysFailFailTm_s KDAG_DCCSysFailLvl3FailTm_s KDAG_DCCSysFailLvl4ActnMsk_enum KDAG_HVAccAcptBMSVoltFac_c KDAG_INVInVoltLoActnMsk_enum KDAG_INVInVoltLoFailTm_s /end REF_CHARACTERISTIC
/end GROUP
/begin GROUP S953_Turn_On_Delay "AppSwcVcu/Vcu_20ms/FaultDiag/FaultDiag_PreProc/Turn_On_Delay" /begin REF_MEASUREMENT VDAG_WakeUp_flg /end REF_MEASUREMENT /end GROUP
/begin GROUP S955_Model "AppSwcVcu/Vcu_20ms/FaultDiag/INV_FaultDiag/Model"
 /begin SUB_GROUP S1214_FltMgt2 S1214_FltMgt3 S1214_FltMgt4 S1214_FltMgt5 S1214_FltMgt6 /end SUB_GROUP
 /begin REF_CHARACTERISTIC KDAG_INVFltFailTm_s KDAG_INVFltLvl2ActnMsk_enum KDAG_INVFltLvl3ActnMsk_enum KDAG_INVFltLvl4ActnMsk_enum KDAG_INVRunCmdRespActnMsk_enum KDAG_INVRunCmdRespFailTm_s /end REF_CHARACTERISTIC
/end GROUP
/begin GROUP S956_Model "AppSwcVcu/Vcu_20ms/FaultDiag/OBC_FaultDiag/Model"
 /begin SUB_GROUP S1240_AC_Discharge_Over_Power S1240_FltMgt10 S1240_FltMgt11 S1240_FltMgt12 S1240_FltMgt13 S1240_FltMgt14 S1240_FltMgt2 S1240_FltMgt3 S1240_FltMgt4 S1240_FltMgt5 S1240_FltMgt6 S1240_FltMgt7 S1240_FltMgt8 S1240_FltMgt9 S1240_OBC_Connect_Time_out /end SUB_GROUP
 /begin REF_CHARACTERISTIC KDAG_ACChrgStFailActnMsk_enum KDAG_ACChrgStFailFailTm_s KDAG_ACDchaBMSPwrLoActnMsk_enum KDAG_ACDchaBMSPwrLoFailTm_s KDAG_ACDchaBMSPwrLo_A KDAG_ACDchaBMSSOCLoActnMsk_enum KDAG_ACDchaBMSSOCLoFailTm_s KDAG_ACDchaBMSSOCLo_pct KDAG_ACDchaOverPwrActnMsk_enum KDAG_ACDchaOverPwrFailTm_s KDAG_OBCChrgReqActnMsk_enum KDAG_OBCChrgReqFailTm_s KDAG_OBCConnectTmOutActnMsk_enum KDAG_OBCInletConnectActnMsk_enum KDAG_OBCInletConnectFailTm_s KDAG_OBCModeMsmtchActnMsk_enum KDAG_OBCModeMsmtchFailTm_s KDAG_OBCS2StatActnMsk_enum KDAG_OBCS2StatFailTm_s KDAG_OBCSysFailFailTm_s KDAG_OBCSysFailLvl4ActnMsk_enum /end REF_CHARACTERISTIC
/end GROUP
/begin GROUP S957_Model "AppSwcVcu/Vcu_20ms/FaultDiag/OtherECU_FaultDiag/Model"
 /begin SUB_GROUP S1302_FltMgt1 S1302_FltMgt10 S1302_FltMgt11 S1302_FltMgt12 S1302_FltMgt13 S1302_FltMgt14 S1302_FltMgt2 S1302_FltMgt3 S1302_FltMgt4 S1302_FltMgt5 S1302_FltMgt6 S1302_FltMgt7 S1302_FltMgt8 S1302_FltMgt9 S1302_Gear_P_Shft_Invld /end SUB_GROUP
 /begin REF_CHARACTERISTIC KDAG_EHBFltFailTm_s KDAG_EHBFltLvl2ActnMsk_enum KDAG_EHBFltLvl3ActnMsk_enum KDAG_EHBFltLvl4ActnMsk_enum KDAG_EHBFltLvl5ActnMsk_enum KDAG_ESCFltFailTm_s KDAG_ESCFltLvl2ActnMsk_enum KDAG_ESCFltLvl3ActnMsk_enum KDAG_ESCFltLvl4ActnMsk_enum KDAG_ESCFltLvl5ActnMsk_enum KDAG_ESCVehSpdInvldActnMsk_enum KDAG_ESCVehSpdInvldFailTm_s KDAG_SysPwrModeInvldFailTm_s KDAG_TMSFailLvl3ActnMsk_enum KDAG_TMSFailLvl3FailTm_s /end REF_CHARACTERISTIC
/end GROUP
/begin GROUP S1500_PreProcess "AppSwcVcu/Vcu_20ms/HvMgt/HighVoltageMgt/PreProcess" /begin REF_CHARACTERISTIC KDAG_HVAccAcptBMSVoltFac_c /end REF_CHARACTERISTIC /end GROUP
/begin GROUP S470_RetardingTqCalc "AppSwcVcu/Vcu_10ms/VSO/RoadSlopeEstmn/Model/RetardingTqCalc" /begin REF_CHARACTERISTIC KSYS_VehMass_kg /end REF_CHARACTERISTIC /end GROUP
/begin GROUP S519_TireForceCalc "AppSwcVcu/Vcu_10ms/VSO/VehMassEstmn/Model/TireForceCalc" /begin REF_CHARACTERISTIC KSYS_VehTransRto_c /end REF_CHARACTERISTIC /end GROUP
/begin GROUP S554_PostProcess "AppSwcVcu/Vcu_10ms/VTM/DAC/Model/PostProcess" /begin REF_CHARACTERISTIC KDAC_BrkTq2PresrCvrtCoeff_c /end REF_CHARACTERISTIC /end GROUP
/begin GROUP S682_ESPIntv "AppSwcVcu/Vcu_10ms/VTM/TQC/Model/ESPIntv" /begin REF_CHARACTERISTIC KSYS_VehTransRto_c KTQC_ESCTqIntvAllwdVal_Nm /end REF_CHARACTERISTIC /end GROUP
/begin GROUP S817_TqReqPrdt "AppSwcVcu/Vcu_10ms/VTM/TZX/Model/TqReqPrdt" /begin REF_CHARACTERISTIC KSYS_VehTransRto_c /end REF_CHARACTERISTIC /end GROUP
/begin GROUP S1240_AC_Discharge_Over_Power "AppSwcVcu/Vcu_20ms/FaultDiag/OBC_FaultDiag/Model/AC Discharge Over Power" /begin REF_CHARACTERISTIC KDAG_ACDchaOverPwrFailTm_s /end REF_CHARACTERISTIC /end GROUP
/begin GROUP S1504_ChrgTrans "AppSwcVcu/Vcu_20ms/HvMgt/HighVoltageMgt/TransCond/ChrgTrans" /begin REF_CHARACTERISTIC KDAG_DCSChrgReqFailTm_s /end REF_CHARACTERISTIC /end GROUP
/begin GROUP S759_TqRateLimCalDec "AppSwcVcu/Vcu_10ms/VTM/TQF/Model/FilterSlewRate/TqRateLimCalDec" /begin REF_CHARACTERISTIC KSYS_VehTransRto_c /end REF_CHARACTERISTIC /end GROUP
/begin GROUP S759_TqRateLimCalInc "AppSwcVcu/Vcu_10ms/VTM/TQF/Model/FilterSlewRate/TqRateLimCalInc" /begin REF_CHARACTERISTIC KSYS_VehTransRto_c /end REF_CHARACTERISTIC /end GROUP
/begin GROUP S761_TZXLimTq "AppSwcVcu/Vcu_10ms/VTM/TQF/Model/TorqueFilter/TZXLimTq" /begin REF_CHARACTERISTIC KSYS_VehTransRto_c /end REF_CHARACTERISTIC /end GROUP
/begin GROUP S736_ShiftRisk "AppSwcVcu/Vcu_10ms/VTM/TQD/Model/TorqueLimit/TorqZeroReq/ShiftRisk" /begin REF_CHARACTERISTIC KSYS_VehTransRto_c /end REF_CHARACTERISTIC /end GROUP
/begin GROUP S654_TqRampFilt "AppSwcVcu/Vcu_10ms/VTM/DAC/Model/HillDescentControl/HDCSpdCtrl/Active/TqRampFilt" /begin REF_CHARACTERISTIC KDAC_BrkTq2PresrCvrtCoeff_c /end REF_CHARACTERISTIC /end GROUP
/begin GROUP S716_RegenTqCalc "AppSwcVcu/Vcu_10ms/VTM/TQD/Model/DriverTqReqOriginal/RegenTq/CoastRegen/AdaptCoastRegen/RegenTqCalc" /begin REF_CHARACTERISTIC KSYS_VehMass_kg /end REF_CHARACTERISTIC /end GROUP
/begin GROUP S589_FF_Items "AppSwcVcu/Vcu_10ms/VTM/DAC/Model/CruiseControl/CruiseControl/CCSpdCtrl/CruzDsrdTq/Active/FF_Items" /begin REF_CHARACTERISTIC KSYS_VehMass_kg /end REF_CHARACTERISTIC /end GROUP
/end MODULE
/end PROJECT
/* (add any file trailer comments here) */ /* EOF AppSwcVcu.a2l */
