ASAP2_VERSION 1 31
/begin PROJECT ProjectName "Project Comment Goes Here"
/begin HEADER "Header Comments go here" /end HEADER
/begin MODULE ModuleName "Module Comment Goes Here"
/begin MOD_COMMON "Mod Common Comment Here" BYTE_ORDER MSB_LAST /end MOD_COMMON
/begin RECORD_LAYOUT Scalar_BOOLEAN FNC_VALUES 1 UBYTE COLUMN_DIR DIRECT /end RECORD_LAYOUT
/begin RECORD_LAYOUT Scalar_UBYTE FNC_VALUES 1 UBYTE COLUMN_DIR DIRECT /end RECORD_LAYOUT
/begin RECORD_LAYOUT Scalar_FLOAT32_IEEE FNC_VALUES 1 FLOAT32_IEEE COLUMN_DIR DIRECT /end RECORD_LAYOUT
/begin RECORD_LAYOUT Lookup1D_FLOAT32_IEEE FNC_VALUES 1 FLOAT32_IEEE COLUMN_DIR DIRECT /end RECORD_LAYOUT
/begin RECORD_LAYOUT Lookup1D_X_FLOAT32_IEEE AXIS_PTS_X 1 FLOAT32_IEEE INDEX_INCR DIRECT /end RECORD_LAYOUT
/begin RECORD_LAYOUT Lookup2D_UBYTE FNC_VALUES 1 UBYTE COLUMN_DIR DIRECT /end RECORD_LAYOUT
/begin RECORD_LAYOUT Lookup2D_X_UBYTE AXIS_PTS_X 1 UBYTE INDEX_INCR DIRECT /end RECORD_LAYOUT
/begin RECORD_LAYOUT Lookup2D_BYTE FNC_VALUES 1 SBYTE COLUMN_DIR DIRECT /end RECORD_LAYOUT
/begin RECORD_LAYOUT Lookup2D_X_BYTE AXIS_PTS_X 1 SBYTE INDEX_INCR DIRECT /end RECORD_LAYOUT
/begin RECORD_LAYOUT Lookup2D_X_UWORD AXIS_PTS_X 1 UWORD INDEX_INCR DIRECT /end RECORD_LAYOUT
/begin RECORD_LAYOUT Lookup2D_WORD FNC_VALUES 1 SWORD COLUMN_DIR DIRECT /end RECORD_LAYOUT
/begin RECORD_LAYOUT Lookup2D_X_WORD AXIS_PTS_X 1 SWORD INDEX_INCR DIRECT /end RECORD_LAYOUT
/begin RECORD_LAYOUT Lookup2D_ULONG FNC_VALUES 1 ULONG COLUMN_DIR DIRECT /end RECORD_LAYOUT
/begin RECORD_LAYOUT Lookup2D_X_ULONG AXIS_PTS_X 1 ULONG INDEX_INCR DIRECT /end RECORD_LAYOUT
/begin RECORD_LAYOUT Lookup2D_LONG FNC_VALUES 1 SLONG COLUMN_DIR DIRECT /end RECORD_LAYOUT
/begin RECORD_LAYOUT Lookup2D_X_LONG AXIS_PTS_X 1 SLONG INDEX_INCR DIRECT /end RECORD_LAYOUT
/begin RECORD_LAYOUT Lookup2D_FLOAT32_IEEE FNC_VALUES 1 FLOAT32_IEEE COLUMN_DIR DIRECT /end RECORD_LAYOUT
/begin RECORD_LAYOUT Lookup2D_X_FLOAT32_IEEE AXIS_PTS_X 1 FLOAT32_IEEE INDEX_INCR DIRECT /end RECORD_LAYOUT
/begin RECORD_LAYOUT Lookup2D_FLOAT64_IEEE FNC_VALUES 1 FLOAT64_IEEE COLUMN_DIR DIRECT /end RECORD_LAYOUT
/begin RECORD_LAYOUT Lookup2D_X_FLOAT64_IEEE AXIS_PTS_X 1 FLOAT64_IEEE INDEX_INCR DIRECT /end RECORD_LAYOUT
/begin CHARACTERISTIC MDSA_DeceltnIdxAvg_pct "" CURVE 0x0000 /* @ECU_Address@MDSA_DeceltnIdxAvg_pct@ */ Lookup1D_FLOAT32_IEEE 0 AppSwcVcu_CM_single_pct 0.0 100.0
 /begin AXIS_DESCR COM_AXIS VDSA_BrkPedPstnAvg_pct AppSwcVcu_CM_single_pct 10 0.0 100.0 AXIS_PTS_REF ADSA_DeceltnIdxAvg_X_pct /end AXIS_DESCR
/end CHARACTERISTIC
/begin AXIS_PTS ADSA_DeceltnIdxAvg_X_pct "" 0x0000 /* @ECU_Address@ADSA_DeceltnIdxAvg_X_pct@ */ VDSA_BrkPedPstnAvg_pct Lookup1D_X_FLOAT32_IEEE 0 AppSwcVcu_CM_single_pct 10 0.0 100.0 /end AXIS_PTS
/begin CHARACTERISTIC MEMS_ChrgPwrFbKi_c "充电功率闭环KI" CURVE 0x0000 /* @ECU_Address@MEMS_ChrgPwrFbKi_c@ */ Lookup1D_FLOAT32_IEEE 0 AppSwcVcu_CM_single_c -10000.0 10000.0
 /begin AXIS_DESCR COM_AXIS VEMS_ChrgOvrshtPwr_kW AppSwcVcu_CM_single_kW 15 -10000.0 10000.0 AXIS_PTS_REF AEMS_ChrgPwrFbKi_X_kW /end AXIS_DESCR
/end CHARACTERISTIC
/begin AXIS_PTS AEMS_ChrgPwrFbKi_X_kW "" 0x0000 /* @ECU_Address@AEMS_ChrgPwrFbKi_X_kW@ */ VEMS_ChrgOvrshtPwr_kW Lookup1D_X_FLOAT32_IEEE 0 AppSwcVcu_CM_single_kW 15 -10000.0 10000.0 /end AXIS_PTS
/begin CHARACTERISTIC MEMS_ChrgPwrFbKp_c "充电功率闭环KP" CURVE 0x0000 /* @ECU_Address@MEMS_ChrgPwrFbKp_c@ */ Lookup1D_FLOAT32_IEEE 0 AppSwcVcu_CM_single_c -10000.0 10000.0
 /begin AXIS_DESCR COM_AXIS NO_INPUT_QUANTITY AppSwcVcu_CM_single_kW 11 -10000.0 10000.0 AXIS_PTS_REF AEMS_ChrgPwrFbKp_X_kW /end AXIS_DESCR
/end CHARACTERISTIC
/begin AXIS_PTS AEMS_ChrgPwrFbKp_X_kW "" 0x0000 /* @ECU_Address@AEMS_ChrgPwrFbKp_X_kW@ */ NO_INPUT_QUANTITY Lookup1D_X_FLOAT32_IEEE 0 AppSwcVcu_CM_single_kW 11 -10000.0 10000.0 /end AXIS_PTS
/begin CHARACTERISTIC MEMS_DchaPwrFbKi_c "放电功率闭环KI" CURVE 0x0000 /* @ECU_Address@MEMS_DchaPwrFbKi_c@ */ Lookup1D_FLOAT32_IEEE 0 AppSwcVcu_CM_single_c -10000.0 10000.0
 /begin AXIS_DESCR COM_AXIS VEMS_DchaOvrshtPwr_kW AppSwcVcu_CM_single_kW 15 -10000.0 10000.0 AXIS_PTS_REF AEMS_DchaPwrFbKi_X_kW /end AXIS_DESCR
/end CHARACTERISTIC
/begin AXIS_PTS AEMS_DchaPwrFbKi_X_kW "" 0x0000 /* @ECU_Address@AEMS_DchaPwrFbKi_X_kW@ */ VEMS_DchaOvrshtPwr_kW Lookup1D_X_FLOAT32_IEEE 0 AppSwcVcu_CM_single_kW 15 -10000.0 10000.0 /end AXIS_PTS
/begin CHARACTERISTIC MEMS_DchaPwrFbKp_c "放电功率闭环KP" CURVE 0x0000 /* @ECU_Address@MEMS_DchaPwrFbKp_c@ */ Lookup1D_FLOAT32_IEEE 0 AppSwcVcu_CM_single_c -10000.0 10000.0
 /begin AXIS_DESCR COM_AXIS NO_INPUT_QUANTITY AppSwcVcu_CM_single_kW 11 -10000.0 10000.0 AXIS_PTS_REF AEMS_DchaPwrFbKp_X_kW /end AXIS_DESCR
/end CHARACTERISTIC
/begin AXIS_PTS AEMS_DchaPwrFbKp_X_kW "" 0x0000 /* @ECU_Address@AEMS_DchaPwrFbKp_X_kW@ */ NO_INPUT_QUANTITY Lookup1D_X_FLOAT32_IEEE 0 AppSwcVcu_CM_single_kW 11 -10000.0 10000.0 /end AXIS_PTS
/begin CHARACTERISTIC MEMS_CellTempMinFac_rat "电芯温度切换过渡系数" CURVE 0x0000 /* @ECU_Address@MEMS_CellTempMinFac_rat@ */ Lookup1D_FLOAT32_IEEE 0 AppSwcVcu_CM_single_rat 0.0 1.0
 /begin AXIS_DESCR COM_AXIS NO_INPUT_QUANTITY AppSwcVcu_CM_single_C 5 -100.0 200.0 AXIS_PTS_REF AEMS_CellTempMinFac_X_C /end AXIS_DESCR
/end CHARACTERISTIC
/begin AXIS_PTS AEMS_CellTempMinFac_X_C "" 0x0000 /* @ECU_Address@AEMS_CellTempMinFac_X_C@ */ NO_INPUT_QUANTITY Lookup1D_X_FLOAT32_IEEE 0 AppSwcVcu_CM_single_C 5 -100.0 200.0 /end AXIS_PTS
/begin CHARACTERISTIC MEMS_MaxInsChrgCurr_A "VCU限制Ins瞬时回收电流" MAP 0x0000 /* @ECU_Address@MEMS_MaxInsChrgCurr_A@ */ Lookup2D_FLOAT32_IEEE 0 AppSwcVcu_CM_single_A -10000.0 0.0
 /begin AXIS_DESCR COM_AXIS NO_INPUT_QUANTITY AppSwcVcu_CM_single_pct 10 0.0 100.0 AXIS_PTS_REF AEMS_MaxInsChrgCurr_Y_pct /end AXIS_DESCR
 /begin AXIS_DESCR COM_AXIS VEMS_CellTempSyn_C AppSwcVcu_CM_single_C 17 -100.0 200.0 AXIS_PTS_REF AEMS_MaxInsChrgCurr_X_C /end AXIS_DESCR
/end CHARACTERISTIC
/begin AXIS_PTS AEMS_MaxInsChrgCurr_X_C "" 0x0000 /* @ECU_Address@AEMS_MaxInsChrgCurr_X_C@ */ VEMS_CellTempSyn_C Lookup2D_X_FLOAT32_IEEE 0 AppSwcVcu_CM_single_C 17 -100.0 200.0 /end AXIS_PTS
/begin AXIS_PTS AEMS_MaxInsChrgCurr_Y_pct "" 0x0000 /* @ECU_Address@AEMS_MaxInsChrgCurr_Y_pct@ */ NO_INPUT_QUANTITY Lookup2D_X_FLOAT32_IEEE 0 AppSwcVcu_CM_single_pct 10 0.0 100.0 /end AXIS_PTS
/begin CHARACTERISTIC MEMS_MaxInsChrgCurrFac_c "VCU修正不同Pack类型回收系数" MAP 0x0000 /* @ECU_Address@MEMS_MaxInsChrgCurrFac_c@ */ Lookup2D_FLOAT32_IEEE 0 AppSwcVcu_CM_single_rat 0.0 100.0
 /begin AXIS_DESCR COM_AXIS NO_INPUT_QUANTITY AppSwcVcu_CM_single_pct 10 0.0 100.0 AXIS_PTS_REF AEMS_MaxInsChrgCurr_Y_pct /end AXIS_DESCR
 /begin AXIS_DESCR COM_AXIS NO_INPUT_QUANTITY AppSwcVcu_CM_uint8_Ah 10 0.0 255.0 AXIS_PTS_REF ASYS_HVBatPackTyp_X_Ah /end AXIS_DESCR
/end CHARACTERISTIC
/begin AXIS_PTS ASYS_HVBatPackTyp_X_Ah "" 0x0000 /* @ECU_Address@ASYS_HVBatPackTyp_X_Ah@ */ NO_INPUT_QUANTITY Lookup2D_X_UBYTE 0 AppSwcVcu_CM_uint8_Ah 10 0.0 255.0 /end AXIS_PTS
/begin CHARACTERISTIC MEMS_ChrgCurFbKp_c "过压闭环控制KP" CURVE 0x0000 /* @ECU_Address@MEMS_ChrgCurFbKp_c@ */ Lookup1D_FLOAT32_IEEE 0 AppSwcVcu_CM_single_c -10000.0 10000.0
 /begin AXIS_DESCR COM_AXIS NO_INPUT_QUANTITY AppSwcVcu_CM_single_mV 11 -10000.0 10000.0 AXIS_PTS_REF AEMS_ChrgCurFbKp_X_mV /end AXIS_DESCR
/end CHARACTERISTIC
/begin AXIS_PTS AEMS_ChrgCurFbKp_X_mV "" 0x0000 /* @ECU_Address@AEMS_ChrgCurFbKp_X_mV@ */ NO_INPUT_QUANTITY Lookup1D_X_FLOAT32_IEEE 0 AppSwcVcu_CM_single_mV 11 -10000.0 10000.0 /end AXIS_PTS
/begin CHARACTERISTIC MEMS_ChrgCurFbKi_c "过压闭环控制Ki" CURVE 0x0000 /* @ECU_Address@MEMS_ChrgCurFbKi_c@ */ Lookup1D_FLOAT32_IEEE 0 AppSwcVcu_CM_single_c -10000.0 10000.0
 /begin AXIS_DESCR COM_AXIS NO_INPUT_QUANTITY AppSwcVcu_CM_single_mV 15 -10000.0 10000.0 AXIS_PTS_REF AEMS_ChrgCurFbKi_X_mV /end AXIS_DESCR
/end CHARACTERISTIC
/begin AXIS_PTS AEMS_ChrgCurFbKi_X_mV "" 0x0000 /* @ECU_Address@AEMS_ChrgCurFbKi_X_mV@ */ NO_INPUT_QUANTITY Lookup1D_X_FLOAT32_IEEE 0 AppSwcVcu_CM_single_mV 15 -10000.0 10000.0 /end AXIS_PTS
/begin CHARACTERISTIC MEMS_MaxConChrgCurOfst_A "Con持续回收电流偏移" CURVE 0x0000 /* @ECU_Address@MEMS_MaxConChrgCurOfst_A@ */ Lookup1D_FLOAT32_IEEE 0 AppSwcVcu_CM_single_A -10000.0 0.0
 /begin AXIS_DESCR COM_AXIS NO_INPUT_QUANTITY AppSwcVcu_CM_single_A 8 -10000.0 0.0 AXIS_PTS_REF AEMS_MaxConChrgCurOfst_X_A /end AXIS_DESCR
/end CHARACTERISTIC
/begin AXIS_PTS AEMS_MaxConChrgCurOfst_X_A "" 0x0000 /* @ECU_Address@AEMS_MaxConChrgCurOfst_X_A@ */ NO_INPUT_QUANTITY Lookup1D_X_FLOAT32_IEEE 0 AppSwcVcu_CM_single_A 8 -10000.0 0.0 /end AXIS_PTS
/begin CHARACTERISTIC MEMS_MaxInsChrgCurOfst_A "Ins瞬时回收电流偏移" CURVE 0x0000 /* @ECU_Address@MEMS_MaxInsChrgCurOfst_A@ */ Lookup1D_FLOAT32_IEEE 0 AppSwcVcu_CM_single_A -10000.0 0.0
 /begin AXIS_DESCR COM_AXIS NO_INPUT_QUANTITY AppSwcVcu_CM_single_A 8 -10000.0 0.0 AXIS_PTS_REF AEMS_MaxInsChrgCurOfst_X_A /end AXIS_DESCR
/end CHARACTERISTIC
/begin AXIS_PTS AEMS_MaxInsChrgCurOfst_X_A "" 0x0000 /* @ECU_Address@AEMS_MaxInsChrgCurOfst_X_A@ */ NO_INPUT_QUANTITY Lookup1D_X_FLOAT32_IEEE 0 AppSwcVcu_CM_single_A 8 -10000.0 0.0 /end AXIS_PTS
/begin CHARACTERISTIC MEMS_HVBatMaxChrgPwrSOC_kW "充电SOC功率限制（目前暂未使用）" CURVE 0x0000 /* @ECU_Address@MEMS_HVBatMaxChrgPwrSOC_kW@ */ Lookup1D_FLOAT32_IEEE 0 AppSwcVcu_CM_single_kW -1000.0 0.0
 /begin AXIS_DESCR COM_AXIS NO_INPUT_QUANTITY AppSwcVcu_CM_single_pct 7 0.0 100.0 AXIS_PTS_REF AEMS_HVBatMaxChrgPwrSOC_X_pct /end AXIS_DESCR
/end CHARACTERISTIC
/begin AXIS_PTS AEMS_HVBatMaxChrgPwrSOC_X_pct "" 0x0000 /* @ECU_Address@AEMS_HVBatMaxChrgPwrSOC_X_pct@ */ NO_INPUT_QUANTITY Lookup1D_X_FLOAT32_IEEE 0 AppSwcVcu_CM_single_pct 7 0.0 100.0 /end AXIS_PTS
/begin CHARACTERISTIC MEMS_MaxInsDchaCurr_A "VCU限制Ins瞬时放电电流" MAP 0x0000 /* @ECU_Address@MEMS_MaxInsDchaCurr_A@ */ Lookup2D_FLOAT32_IEEE 0 AppSwcVcu_CM_single_A 0.0 10000.0
 /begin AXIS_DESCR COM_AXIS NO_INPUT_QUANTITY AppSwcVcu_CM_single_pct 10 0.0 100.0 AXIS_PTS_REF AEMS_MaxInsDchaCurr_Y_pct /end AXIS_DESCR
 /begin AXIS_DESCR COM_AXIS VEMS_CellTempSyn_C AppSwcVcu_CM_single_C 17 -100.0 200.0 AXIS_PTS_REF AEMS_MaxInsDchaCurr_X_C /end AXIS_DESCR
/end CHARACTERISTIC
/begin AXIS_PTS AEMS_MaxInsDchaCurr_X_C "" 0x0000 /* @ECU_Address@AEMS_MaxInsDchaCurr_X_C@ */ VEMS_CellTempSyn_C Lookup2D_X_FLOAT32_IEEE 0 AppSwcVcu_CM_single_C 17 -100.0 200.0 /end AXIS_PTS
/begin AXIS_PTS AEMS_MaxInsDchaCurr_Y_pct "" 0x0000 /* @ECU_Address@AEMS_MaxInsDchaCurr_Y_pct@ */ NO_INPUT_QUANTITY Lookup2D_X_FLOAT32_IEEE 0 AppSwcVcu_CM_single_pct 10 0.0 100.0 /end AXIS_PTS
/begin CHARACTERISTIC MEMS_MaxInsDchaCurrFac_c "VCU修正不同类型Pack放电系数" MAP 0x0000 /* @ECU_Address@MEMS_MaxInsDchaCurrFac_c@ */ Lookup2D_FLOAT32_IEEE 0 AppSwcVcu_CM_single_rat 0.0 100.0
 /begin AXIS_DESCR COM_AXIS NO_INPUT_QUANTITY AppSwcVcu_CM_single_pct 10 0.0 100.0 AXIS_PTS_REF AEMS_MaxInsDchaCurr_Y_pct /end AXIS_DESCR
 /begin AXIS_DESCR COM_AXIS NO_INPUT_QUANTITY AppSwcVcu_CM_uint8_Ah 10 0.0 255.0 AXIS_PTS_REF ASYS_HVBatPackTyp_X_Ah /end AXIS_DESCR
/end CHARACTERISTIC
/begin CHARACTERISTIC MEMS_DchaCurFbKp_c "欠压电压闭环KP" CURVE 0x0000 /* @ECU_Address@MEMS_DchaCurFbKp_c@ */ Lookup1D_FLOAT32_IEEE 0 AppSwcVcu_CM_single_c -10000.0 10000.0
 /begin AXIS_DESCR COM_AXIS NO_INPUT_QUANTITY AppSwcVcu_CM_single_mV 11 -10000.0 10000.0 AXIS_PTS_REF AEMS_DchaCurFbKp_X_mV /end AXIS_DESCR
/end CHARACTERISTIC
/begin AXIS_PTS AEMS_DchaCurFbKp_X_mV "" 0x0000 /* @ECU_Address@AEMS_DchaCurFbKp_X_mV@ */ NO_INPUT_QUANTITY Lookup1D_X_FLOAT32_IEEE 0 AppSwcVcu_CM_single_mV 11 -10000.0 10000.0 /end AXIS_PTS
/begin CHARACTERISTIC MEMS_DchaCurFbKi_c "欠压电压闭环KI" CURVE 0x0000 /* @ECU_Address@MEMS_DchaCurFbKi_c@ */ Lookup1D_FLOAT32_IEEE 0 AppSwcVcu_CM_single_c -10000.0 10000.0
 /begin AXIS_DESCR COM_AXIS NO_INPUT_QUANTITY AppSwcVcu_CM_single_mV 15 -10000.0 10000.0 AXIS_PTS_REF AEMS_DchaCurFbKi_X_mV /end AXIS_DESCR
/end CHARACTERISTIC
/begin AXIS_PTS AEMS_DchaCurFbKi_X_mV "" 0x0000 /* @ECU_Address@AEMS_DchaCurFbKi_X_mV@ */ NO_INPUT_QUANTITY Lookup1D_X_FLOAT32_IEEE 0 AppSwcVcu_CM_single_mV 15 -10000.0 10000.0 /end AXIS_PTS
/begin CHARACTERISTIC MEMS_MaxConDchaCurOfst_A "放电-持续电流偏移" CURVE 0x0000 /* @ECU_Address@MEMS_MaxConDchaCurOfst_A@ */ Lookup1D_FLOAT32_IEEE 0 AppSwcVcu_CM_single_A 0.0 10000.0
 /begin AXIS_DESCR COM_AXIS NO_INPUT_QUANTITY AppSwcVcu_CM_single_A 8 0.0 10000.0 AXIS_PTS_REF AEMS_MaxConDchaCurOfst_X_A /end AXIS_DESCR
/end CHARACTERISTIC
/begin AXIS_PTS AEMS_MaxConDchaCurOfst_X_A "" 0x0000 /* @ECU_Address@AEMS_MaxConDchaCurOfst_X_A@ */ NO_INPUT_QUANTITY Lookup1D_X_FLOAT32_IEEE 0 AppSwcVcu_CM_single_A 8 0.0 10000.0 /end AXIS_PTS
/begin CHARACTERISTIC MEMS_MaxInsDchaCurOfst_A "放电-瞬时电流偏移" CURVE 0x0000 /* @ECU_Address@MEMS_MaxInsDchaCurOfst_A@ */ Lookup1D_FLOAT32_IEEE 0 AppSwcVcu_CM_single_A 0.0 10000.0
 /begin AXIS_DESCR COM_AXIS NO_INPUT_QUANTITY AppSwcVcu_CM_single_A 8 0.0 10000.0 AXIS_PTS_REF AEMS_MaxInsDchaCurOfst_X_A /end AXIS_DESCR
/end CHARACTERISTIC
/begin AXIS_PTS AEMS_MaxInsDchaCurOfst_X_A "" 0x0000 /* @ECU_Address@AEMS_MaxInsDchaCurOfst_X_A@ */ NO_INPUT_QUANTITY Lookup1D_X_FLOAT32_IEEE 0 AppSwcVcu_CM_single_A 8 0.0 10000.0 /end AXIS_PTS
/begin CHARACTERISTIC MEMS_HVBatMaxDchaPwrSOC_kW "放电SOC限制功率(目前暂未使用)" CURVE 0x0000 /* @ECU_Address@MEMS_HVBatMaxDchaPwrSOC_kW@ */ Lookup1D_FLOAT32_IEEE 0 AppSwcVcu_CM_single_kW 0.0 1000.0
 /begin AXIS_DESCR COM_AXIS NO_INPUT_QUANTITY AppSwcVcu_CM_single_pct 7 0.0 100.0 AXIS_PTS_REF AEMS_HVBatMaxDchaPwrSOC_X_pct /end AXIS_DESCR
/end CHARACTERISTIC
/begin AXIS_PTS AEMS_HVBatMaxDchaPwrSOC_X_pct "" 0x0000 /* @ECU_Address@AEMS_HVBatMaxDchaPwrSOC_X_pct@ */ NO_INPUT_QUANTITY Lookup1D_X_FLOAT32_IEEE 0 AppSwcVcu_CM_single_pct 7 0.0 100.0 /end AXIS_PTS
/begin CHARACTERISTIC MIPC_AccPedBckLsh_pct "" CURVE 0x0000 /* @ECU_Address@MIPC_AccPedBckLsh_pct@ */ Lookup1D_FLOAT32_IEEE 0 AppSwcVcu_CM_single_pct 0.0 100.0
 /begin AXIS_DESCR COM_AXIS NO_INPUT_QUANTITY AppSwcVcu_CM_single_pct 12 0.0 100.0 AXIS_PTS_REF AIPC_AccPedBckLsh_X_pct /end AXIS_DESCR
/end CHARACTERISTIC
/begin AXIS_PTS AIPC_AccPedBckLsh_X_pct "" 0x0000 /* @ECU_Address@AIPC_AccPedBckLsh_X_pct@ */ NO_INPUT_QUANTITY Lookup1D_X_FLOAT32_IEEE 0 AppSwcVcu_CM_single_pct 12 0.0 100.0 /end AXIS_PTS
/begin CHARACTERISTIC MVTM_VehSpdFiltCoeff_rat "" CURVE 0x0000 /* @ECU_Address@MVTM_VehSpdFiltCoeff_rat@ */ Lookup1D_FLOAT32_IEEE 0 AppSwcVcu_CM_single_rat 0.0 1.0
 /begin AXIS_DESCR COM_AXIS NO_INPUT_QUANTITY AppSwcVcu_CM_single_kph 8 -300.0 300.0 AXIS_PTS_REF AVTM_VehSpdFiltCoeff_X_kph /end AXIS_DESCR
/end CHARACTERISTIC
/begin AXIS_PTS AVTM_VehSpdFiltCoeff_X_kph "" 0x0000 /* @ECU_Address@AVTM_VehSpdFiltCoeff_X_kph@ */ NO_INPUT_QUANTITY Lookup1D_X_FLOAT32_IEEE 0 AppSwcVcu_CM_single_kph 8 -300.0 300.0 /end AXIS_PTS
/begin CHARACTERISTIC MVTM_MotorSpdFiltCoeff_rat "" CURVE 0x0000 /* @ECU_Address@MVTM_MotorSpdFiltCoeff_rat@ */ Lookup1D_FLOAT32_IEEE 0 AppSwcVcu_CM_single_rat 0.0 1.0
 /begin AXIS_DESCR COM_AXIS NO_INPUT_QUANTITY AppSwcVcu_CM_single_rpm 8 -10000.0 10000.0 AXIS_PTS_REF AVTM_MotorSpdFiltCoeff_X_rpm /end AXIS_DESCR
/end CHARACTERISTIC
/begin AXIS_PTS AVTM_MotorSpdFiltCoeff_X_rpm "" 0x0000 /* @ECU_Address@AVTM_MotorSpdFiltCoeff_X_rpm@ */ NO_INPUT_QUANTITY Lookup1D_X_FLOAT32_IEEE 0 AppSwcVcu_CM_single_rpm 8 -10000.0 10000.0 /end AXIS_PTS
/begin CHARACTERISTIC MCPT_MotorSpdFiltCoeff_rat "" CURVE 0x0000 /* @ECU_Address@MCPT_MotorSpdFiltCoeff_rat@ */ Lookup1D_FLOAT32_IEEE 0 AppSwcVcu_CM_single_rat 0.0 1.0
 /begin AXIS_DESCR COM_AXIS NO_INPUT_QUANTITY AppSwcVcu_CM_single_rpm 8 -10000.0 10000.0 AXIS_PTS_REF ACPT_MotorSpdFiltCoeff_X_rpm /end AXIS_DESCR
/end CHARACTERISTIC
/begin AXIS_PTS ACPT_MotorSpdFiltCoeff_X_rpm "" 0x0000 /* @ECU_Address@ACPT_MotorSpdFiltCoeff_X_rpm@ */ NO_INPUT_QUANTITY Lookup1D_X_FLOAT32_IEEE 0 AppSwcVcu_CM_single_rpm 8 -10000.0 10000.0 /end AXIS_PTS
/begin CHARACTERISTIC MCPT_TqDrtFacIgbtTemp_c "" CURVE 0x0000 /* @ECU_Address@MCPT_TqDrtFacIgbtTemp_c@ */ Lookup1D_FLOAT32_IEEE 0 AppSwcVcu_CM_single_c 0.0 1.0
 /begin AXIS_DESCR COM_AXIS NO_INPUT_QUANTITY AppSwcVcu_CM_single_C 8 -1000.0 1000.0 AXIS_PTS_REF ACPT_TqDrtFacIgbtTemp_X_C /end AXIS_DESCR
/end CHARACTERISTIC
/begin AXIS_PTS ACPT_TqDrtFacIgbtTemp_X_C "" 0x0000 /* @ECU_Address@ACPT_TqDrtFacIgbtTemp_X_C@ */ NO_INPUT_QUANTITY Lookup1D_X_FLOAT32_IEEE 0 AppSwcVcu_CM_single_C 8 -1000.0 1000.0 /end AXIS_PTS
/begin CHARACTERISTIC MCPT_TqDrtFacMotorTemp_c "" CURVE 0x0000 /* @ECU_Address@MCPT_TqDrtFacMotorTemp_c@ */ Lookup1D_FLOAT32_IEEE 0 AppSwcVcu_CM_single_c 0.0 1.0
 /begin AXIS_DESCR COM_AXIS NO_INPUT_QUANTITY AppSwcVcu_CM_single_C 8 -1000.0 1000.0 AXIS_PTS_REF ACPT_TqDrtFacMotorTemp_X_C /end AXIS_DESCR
/end CHARACTERISTIC
/begin AXIS_PTS ACPT_TqDrtFacMotorTemp_X_C "" 0x0000 /* @ECU_Address@ACPT_TqDrtFacMotorTemp_X_C@ */ NO_INPUT_QUANTITY Lookup1D_X_FLOAT32_IEEE 0 AppSwcVcu_CM_single_C 8 -1000.0 1000.0 /end AXIS_PTS
/begin CHARACTERISTIC MCPT_MotorEffVoltFac_c "" CURVE 0x0000 /* @ECU_Address@MCPT_MotorEffVoltFac_c@ */ Lookup1D_FLOAT32_IEEE 0 AppSwcVcu_CM_single_c 0.0 10.0
 /begin AXIS_DESCR COM_AXIS NO_INPUT_QUANTITY AppSwcVcu_CM_single_V 9 0.0 1000.0 AXIS_PTS_REF ACPT_MotorEffVoltFac_X_V /end AXIS_DESCR
/end CHARACTERISTIC
/begin AXIS_PTS ACPT_MotorEffVoltFac_X_V "" 0x0000 /* @ECU_Address@ACPT_MotorEffVoltFac_X_V@ */ NO_INPUT_QUANTITY Lookup1D_X_FLOAT32_IEEE 0 AppSwcVcu_CM_single_V 9 0.0 1000.0 /end AXIS_PTS
/begin CHARACTERISTIC MCPT_Pwr2MotorTqGen_Nm "" MAP 0x0000 /* @ECU_Address@MCPT_Pwr2MotorTqGen_Nm@ */ Lookup2D_FLOAT32_IEEE 0 AppSwcVcu_CM_single_Nm -10000.0 10000.0
 /begin AXIS_DESCR COM_AXIS NO_INPUT_QUANTITY AppSwcVcu_CM_single_rpm 28 -100000.0 100000.0 AXIS_PTS_REF ACPT_Pwr2MotorTqGen_Y_rpm /end AXIS_DESCR
 /begin AXIS_DESCR COM_AXIS NO_INPUT_QUANTITY AppSwcVcu_CM_single_kW 22 -100000.0 100000.0 AXIS_PTS_REF ACPT_Pwr2MotorTqGen_X_kW /end AXIS_DESCR
/end CHARACTERISTIC
/begin AXIS_PTS ACPT_Pwr2MotorTqGen_X_kW "" 0x0000 /* @ECU_Address@ACPT_Pwr2MotorTqGen_X_kW@ */ NO_INPUT_QUANTITY Lookup2D_X_FLOAT32_IEEE 0 AppSwcVcu_CM_single_kW 22 -100000.0 100000.0 /end AXIS_PTS
/begin AXIS_PTS ACPT_Pwr2MotorTqGen_Y_rpm "" 0x0000 /* @ECU_Address@ACPT_Pwr2MotorTqGen_Y_rpm@ */ NO_INPUT_QUANTITY Lookup2D_X_FLOAT32_IEEE 0 AppSwcVcu_CM_single_rpm 28 -100000.0 100000.0 /end AXIS_PTS
/begin CHARACTERISTIC MCPT_Pwr2MotorTqMot_Nm "" MAP 0x0000 /* @ECU_Address@MCPT_Pwr2MotorTqMot_Nm@ */ Lookup2D_FLOAT32_IEEE 0 AppSwcVcu_CM_single_Nm -10000.0 10000.0
 /begin AXIS_DESCR COM_AXIS NO_INPUT_QUANTITY AppSwcVcu_CM_single_rpm 28 -100000.0 100000.0 AXIS_PTS_REF ACPT_Pwr2MotorTqMot_Y_rpm /end AXIS_DESCR
 /begin AXIS_DESCR COM_AXIS NO_INPUT_QUANTITY AppSwcVcu_CM_single_kW 21 -100000.0 100000.0 AXIS_PTS_REF ACPT_Pwr2MotorTqMot_X_kW /end AXIS_DESCR
/end CHARACTERISTIC
/begin AXIS_PTS ACPT_Pwr2MotorTqMot_X_kW "" 0x0000 /* @ECU_Address@ACPT_Pwr2MotorTqMot_X_kW@ */ NO_INPUT_QUANTITY Lookup2D_X_FLOAT32_IEEE 0 AppSwcVcu_CM_single_kW 21 -100000.0 100000.0 /end AXIS_PTS
/begin AXIS_PTS ACPT_Pwr2MotorTqMot_Y_rpm "" 0x0000 /* @ECU_Address@ACPT_Pwr2MotorTqMot_Y_rpm@ */ NO_INPUT_QUANTITY Lookup2D_X_FLOAT32_IEEE 0 AppSwcVcu_CM_single_rpm 28 -100000.0 100000.0 /end AXIS_PTS
/begin CHARACTERISTIC MDAC_CCDsrdAcceltnInc_mps3 "" CURVE 0x0000 /* @ECU_Address@MDAC_CCDsrdAcceltnInc_mps3@ */ Lookup1D_FLOAT32_IEEE 0 AppSwcVcu_CM_single_mps3 0.0 1000.0
 /begin AXIS_DESCR COM_AXIS NO_INPUT_QUANTITY AppSwcVcu_CM_single_mps2 12 -20.0 20.0 AXIS_PTS_REF ADAC_CCDsrdAcceltnInc_X_mps2 /end AXIS_DESCR
/end CHARACTERISTIC
/begin AXIS_PTS ADAC_CCDsrdAcceltnInc_X_mps2 "" 0x0000 /* @ECU_Address@ADAC_CCDsrdAcceltnInc_X_mps2@ */ NO_INPUT_QUANTITY Lookup1D_X_FLOAT32_IEEE 0 AppSwcVcu_CM_single_mps2 12 -20.0 20.0 /end AXIS_PTS
/begin CHARACTERISTIC MDAC_CCDsrdAcceltnDec_mps3 "" CURVE 0x0000 /* @ECU_Address@MDAC_CCDsrdAcceltnDec_mps3@ */ Lookup1D_FLOAT32_IEEE 0 AppSwcVcu_CM_single_mps3 -1000.0 0.0
 /begin AXIS_DESCR COM_AXIS NO_INPUT_QUANTITY AppSwcVcu_CM_single_mps2 12 -20.0 20.0 AXIS_PTS_REF ADAC_CCDsrdAcceltnDec_X_mps2 /end AXIS_DESCR
/end CHARACTERISTIC
/begin AXIS_PTS ADAC_CCDsrdAcceltnDec_X_mps2 "" 0x0000 /* @ECU_Address@ADAC_CCDsrdAcceltnDec_X_mps2@ */ NO_INPUT_QUANTITY Lookup1D_X_FLOAT32_IEEE 0 AppSwcVcu_CM_single_mps2 12 -20.0 20.0 /end AXIS_PTS
/begin CHARACTERISTIC MDAC_NonDrvnSpdFiltCoeff_rat "" CURVE 0x0000 /* @ECU_Address@MDAC_NonDrvnSpdFiltCoeff_rat@ */ Lookup1D_FLOAT32_IEEE 0 AppSwcVcu_CM_single_rat 0.0 1.0
 /begin AXIS_DESCR COM_AXIS NO_INPUT_QUANTITY AppSwcVcu_CM_single_kph 7 0.0 300.0 AXIS_PTS_REF ADAC_NonDrvnSpdFiltCoeff_X_kph /end AXIS_DESCR
/end CHARACTERISTIC
/begin AXIS_PTS ADAC_NonDrvnSpdFiltCoeff_X_kph "" 0x0000 /* @ECU_Address@ADAC_NonDrvnSpdFiltCoeff_X_kph@ */ NO_INPUT_QUANTITY Lookup1D_X_FLOAT32_IEEE 0 AppSwcVcu_CM_single_kph 7 0.0 300.0 /end AXIS_PTS
/begin CHARACTERISTIC MDAC_FullPedDrvTqWhl_Nm "" CURVE 0x0000 /* @ECU_Address@MDAC_FullPedDrvTqWhl_Nm@ */ Lookup1D_FLOAT32_IEEE 0 AppSwcVcu_CM_single_Nm -10000.0 10000.0
 /begin AXIS_DESCR COM_AXIS VVTM_VehSpd_kph AppSwcVcu_CM_single_kph 23 -300.0 300.0 AXIS_PTS_REF ADAC_FullPedDrvTqWhl_X_kph /end AXIS_DESCR
/end CHARACTERISTIC
/begin AXIS_PTS ADAC_FullPedDrvTqWhl_X_kph "" 0x0000 /* @ECU_Address@ADAC_FullPedDrvTqWhl_X_kph@ */ VVTM_VehSpd_kph Lookup1D_X_FLOAT32_IEEE 0 AppSwcVcu_CM_single_kph 23 -300.0 300.0 /end AXIS_PTS
/begin CHARACTERISTIC MTQD_CrpTqReqWhlD_Nm "" CURVE 0x0000 /* @ECU_Address@MTQD_CrpTqReqWhlD_Nm@ */ Lookup1D_FLOAT32_IEEE 0 AppSwcVcu_CM_single_Nm -1000.0 1000.0
 /begin AXIS_DESCR COM_AXIS VVTM_VehSpd_kph AppSwcVcu_CM_single_kph 10 -300.0 300.0 AXIS_PTS_REF ATQD_CrpTqReqWhlD_X_kph /end AXIS_DESCR
/end CHARACTERISTIC
/begin AXIS_PTS ATQD_CrpTqReqWhlD_X_kph "" 0x0000 /* @ECU_Address@ATQD_CrpTqReqWhlD_X_kph@ */ VVTM_VehSpd_kph Lookup1D_X_FLOAT32_IEEE 0 AppSwcVcu_CM_single_kph 10 -300.0 300.0 /end AXIS_PTS
/begin CHARACTERISTIC MTQD_CrpTqReqWhlR_Nm "" CURVE 0x0000 /* @ECU_Address@MTQD_CrpTqReqWhlR_Nm@ */ Lookup1D_FLOAT32_IEEE 0 AppSwcVcu_CM_single_Nm -1000.0 1000.0
 /begin AXIS_DESCR COM_AXIS VVTM_VehSpd_kph AppSwcVcu_CM_single_kph 10 -300.0 300.0 AXIS_PTS_REF ATQD_CrpTqReqWhlR_X_kph /end AXIS_DESCR
/end CHARACTERISTIC
/begin AXIS_PTS ATQD_CrpTqReqWhlR_X_kph "" 0x0000 /* @ECU_Address@ATQD_CrpTqReqWhlR_X_kph@ */ VVTM_VehSpd_kph Lookup1D_X_FLOAT32_IEEE 0 AppSwcVcu_CM_single_kph 10 -300.0 300.0 /end AXIS_PTS
/begin CHARACTERISTIC MTQD_FwdFullPedDrvTqWhlSprt_Nm "" CURVE 0x0000 /* @ECU_Address@MTQD_FwdFullPedDrvTqWhlSprt_Nm@ */ Lookup1D_FLOAT32_IEEE 0 AppSwcVcu_CM_single_Nm -10000.0 10000.0
 /begin AXIS_DESCR COM_AXIS VVTM_VehSpd_kph AppSwcVcu_CM_single_kph 19 -300.0 300.0 AXIS_PTS_REF ATQD_FwdFullPedDrvTqWhl_X_kph /end AXIS_DESCR
/end CHARACTERISTIC
/begin AXIS_PTS ATQD_FwdFullPedDrvTqWhl_X_kph "" 0x0000 /* @ECU_Address@ATQD_FwdFullPedDrvTqWhl_X_kph@ */ VVTM_VehSpd_kph Lookup1D_X_FLOAT32_IEEE 0 AppSwcVcu_CM_single_kph 19 -300.0 300.0 /end AXIS_PTS
/begin CHARACTERISTIC MTQD_FwdFullPedDrvTqWhl_Nm "" CURVE 0x0000 /* @ECU_Address@MTQD_FwdFullPedDrvTqWhl_Nm@ */ Lookup1D_FLOAT32_IEEE 0 AppSwcVcu_CM_single_Nm -10000.0 10000.0
 /begin AXIS_DESCR COM_AXIS VVTM_VehSpd_kph AppSwcVcu_CM_single_kph 19 -300.0 300.0 AXIS_PTS_REF ATQD_FwdFullPedDrvTqWhl_X_kph /end AXIS_DESCR
/end CHARACTERISTIC
/begin CHARACTERISTIC MTQD_FwdPedMapSnow_pct "" MAP 0x0000 /* @ECU_Address@MTQD_FwdPedMapSnow_pct@ */ Lookup2D_FLOAT32_IEEE 0 AppSwcVcu_CM_single_pct -100.0 200.0
 /begin AXIS_DESCR COM_AXIS VTQD_AccelPedPstnRescl_pct AppSwcVcu_CM_single_pct 21 -100.0 200.0 AXIS_PTS_REF ATQD_FwdPedMapSnow_Y_pct /end AXIS_DESCR
 /begin AXIS_DESCR COM_AXIS VVTM_VehSpd_kph AppSwcVcu_CM_single_kph 18 -300.0 300.0 AXIS_PTS_REF ATQD_FwdPedMapSnow_X_kph /end AXIS_DESCR
/end CHARACTERISTIC
/begin AXIS_PTS ATQD_FwdPedMapSnow_X_kph "" 0x0000 /* @ECU_Address@ATQD_FwdPedMapSnow_X_kph@ */ VVTM_VehSpd_kph Lookup2D_X_FLOAT32_IEEE 0 AppSwcVcu_CM_single_kph 18 -300.0 300.0 /end AXIS_PTS
/begin AXIS_PTS ATQD_FwdPedMapSnow_Y_pct "" 0x0000 /* @ECU_Address@ATQD_FwdPedMapSnow_Y_pct@ */ VTQD_AccelPedPstnRescl_pct Lookup2D_X_FLOAT32_IEEE 0 AppSwcVcu_CM_single_pct 21 -100.0 200.0 /end AXIS_PTS
/begin CHARACTERISTIC MTQD_FwdPedMapNorm_pct "" MAP 0x0000 /* @ECU_Address@MTQD_FwdPedMapNorm_pct@ */ Lookup2D_FLOAT32_IEEE 0 AppSwcVcu_CM_single_pct -100.0 200.0
 /begin AXIS_DESCR COM_AXIS VTQD_AccelPedPstnRescl_pct AppSwcVcu_CM_single_pct 21 -100.0 200.0 AXIS_PTS_REF ATQD_FwdPedMapNorm_Y_pct /end AXIS_DESCR
 /begin AXIS_DESCR COM_AXIS VVTM_VehSpd_kph AppSwcVcu_CM_single_kph 18 -300.0 300.0 AXIS_PTS_REF ATQD_FwdPedMapNorm_X_kph /end AXIS_DESCR
/end CHARACTERISTIC
/begin AXIS_PTS ATQD_FwdPedMapNorm_X_kph "" 0x0000 /* @ECU_Address@ATQD_FwdPedMapNorm_X_kph@ */ VVTM_VehSpd_kph Lookup2D_X_FLOAT32_IEEE 0 AppSwcVcu_CM_single_kph 18 -300.0 300.0 /end AXIS_PTS
/begin AXIS_PTS ATQD_FwdPedMapNorm_Y_pct "" 0x0000 /* @ECU_Address@ATQD_FwdPedMapNorm_Y_pct@ */ VTQD_AccelPedPstnRescl_pct Lookup2D_X_FLOAT32_IEEE 0 AppSwcVcu_CM_single_pct 21 -100.0 200.0 /end AXIS_PTS
/begin CHARACTERISTIC MTQD_FwdPedMapEco_pct "" MAP 0x0000 /* @ECU_Address@MTQD_FwdPedMapEco_pct@ */ Lookup2D_FLOAT32_IEEE 0 AppSwcVcu_CM_single_pct -100.0 200.0
 /begin AXIS_DESCR COM_AXIS VTQD_AccelPedPstnRescl_pct AppSwcVcu_CM_single_pct 21 -100.0 200.0 AXIS_PTS_REF ATQD_FwdPedMapEco_Y_pct /end AXIS_DESCR
 /begin AXIS_DESCR COM_AXIS VVTM_VehSpd_kph AppSwcVcu_CM_single_kph 18 -300.0 300.0 AXIS_PTS_REF ATQD_FwdPedMapEco_X_kph /end AXIS_DESCR
/end CHARACTERISTIC
/begin AXIS_PTS ATQD_FwdPedMapEco_X_kph "" 0x0000 /* @ECU_Address@ATQD_FwdPedMapEco_X_kph@ */ VVTM_VehSpd_kph Lookup2D_X_FLOAT32_IEEE 0 AppSwcVcu_CM_single_kph 18 -300.0 300.0 /end AXIS_PTS
/begin AXIS_PTS ATQD_FwdPedMapEco_Y_pct "" 0x0000 /* @ECU_Address@ATQD_FwdPedMapEco_Y_pct@ */ VTQD_AccelPedPstnRescl_pct Lookup2D_X_FLOAT32_IEEE 0 AppSwcVcu_CM_single_pct 21 -100.0 200.0 /end AXIS_PTS
/begin CHARACTERISTIC MTQD_FwdPedMapSpt_pct "" MAP 0x0000 /* @ECU_Address@MTQD_FwdPedMapSpt_pct@ */ Lookup2D_FLOAT32_IEEE 0 AppSwcVcu_CM_single_pct -100.0 200.0
 /begin AXIS_DESCR COM_AXIS VTQD_AccelPedPstnRescl_pct AppSwcVcu_CM_single_pct 21 -100.0 200.0 AXIS_PTS_REF ATQD_FwdPedMapSpt_Y_pct /end AXIS_DESCR
 /begin AXIS_DESCR COM_AXIS VVTM_VehSpd_kph AppSwcVcu_CM_single_kph 18 -300.0 300.0 AXIS_PTS_REF ATQD_FwdPedMapSpt_X_kph /end AXIS_DESCR
/end CHARACTERISTIC
/begin AXIS_PTS ATQD_FwdPedMapSpt_X_kph "" 0x0000 /* @ECU_Address@ATQD_FwdPedMapSpt_X_kph@ */ VVTM_VehSpd_kph Lookup2D_X_FLOAT32_IEEE 0 AppSwcVcu_CM_single_kph 18 -300.0 300.0 /end AXIS_PTS
/begin AXIS_PTS ATQD_FwdPedMapSpt_Y_pct "" 0x0000 /* @ECU_Address@ATQD_FwdPedMapSpt_Y_pct@ */ VTQD_AccelPedPstnRescl_pct Lookup2D_X_FLOAT32_IEEE 0 AppSwcVcu_CM_single_pct 21 -100.0 200.0 /end AXIS_PTS
/begin CHARACTERISTIC MTQD_RevFullPedDrvTqWhl_Nm "" CURVE 0x0000 /* @ECU_Address@MTQD_RevFullPedDrvTqWhl_Nm@ */ Lookup1D_FLOAT32_IEEE 0 AppSwcVcu_CM_single_Nm -10000.0 10000.0
 /begin AXIS_DESCR COM_AXIS VVTM_VehSpd_kph AppSwcVcu_CM_single_kph 19 -300.0 300.0 AXIS_PTS_REF ATQD_RevFullPedDrvTqWhl_X_kph /end AXIS_DESCR
/end CHARACTERISTIC
/begin AXIS_PTS ATQD_RevFullPedDrvTqWhl_X_kph "" 0x0000 /* @ECU_Address@ATQD_RevFullPedDrvTqWhl_X_kph@ */ VVTM_VehSpd_kph Lookup1D_X_FLOAT32_IEEE 0 AppSwcVcu_CM_single_kph 19 -300.0 300.0 /end AXIS_PTS
/begin CHARACTERISTIC MTQD_RevPedMap_pct "" MAP 0x0000 /* @ECU_Address@MTQD_RevPedMap_pct@ */ Lookup2D_FLOAT32_IEEE 0 AppSwcVcu_CM_single_pct -100.0 200.0
 /begin AXIS_DESCR COM_AXIS VTQD_AccelPedPstnRescl_pct AppSwcVcu_CM_single_pct 21 -100.0 200.0 AXIS_PTS_REF ATQD_RevPedMap_Y_pct /end AXIS_DESCR
 /begin AXIS_DESCR COM_AXIS VVTM_VehSpd_kph AppSwcVcu_CM_single_kph 11 -300.0 300.0 AXIS_PTS_REF ATQD_RevPedMap_X_kph /end AXIS_DESCR
/end CHARACTERISTIC
/begin AXIS_PTS ATQD_RevPedMap_X_kph "" 0x0000 /* @ECU_Address@ATQD_RevPedMap_X_kph@ */ VVTM_VehSpd_kph Lookup2D_X_FLOAT32_IEEE 0 AppSwcVcu_CM_single_kph 11 -300.0 300.0 /end AXIS_PTS
/begin AXIS_PTS ATQD_RevPedMap_Y_pct "" 0x0000 /* @ECU_Address@ATQD_RevPedMap_Y_pct@ */ VTQD_AccelPedPstnRescl_pct Lookup2D_X_FLOAT32_IEEE 0 AppSwcVcu_CM_single_pct 21 -100.0 200.0 /end AXIS_PTS
/begin CHARACTERISTIC MTQD_CstRegenTqReqWhlOff_Nm "" MAP 0x0000 /* @ECU_Address@MTQD_CstRegenTqReqWhlOff_Nm@ */ Lookup2D_FLOAT32_IEEE 0 AppSwcVcu_CM_single_Nm -10000.0 10000.0
 /begin AXIS_DESCR COM_AXIS VVTM_VehSpd_kph AppSwcVcu_CM_single_kph 14 -300.0 300.0 AXIS_PTS_REF ATQD_CstRegenTqReqWhlOff_Y_kph /end AXIS_DESCR
 /begin AXIS_DESCR COM_AXIS NO_INPUT_QUANTITY AppSwcVcu_CM_single_pct 5 -100.0 200.0 AXIS_PTS_REF ATQD_CstRegenTqReqWhlOff_X_pct /end AXIS_DESCR
/end CHARACTERISTIC
/begin AXIS_PTS ATQD_CstRegenTqReqWhlOff_X_pct "" 0x0000 /* @ECU_Address@ATQD_CstRegenTqReqWhlOff_X_pct@ */ NO_INPUT_QUANTITY Lookup2D_X_FLOAT32_IEEE 0 AppSwcVcu_CM_single_pct 5 -100.0 200.0 /end AXIS_PTS
/begin AXIS_PTS ATQD_CstRegenTqReqWhlOff_Y_kph "" 0x0000 /* @ECU_Address@ATQD_CstRegenTqReqWhlOff_Y_kph@ */ VVTM_VehSpd_kph Lookup2D_X_FLOAT32_IEEE 0 AppSwcVcu_CM_single_kph 14 -300.0 300.0 /end AXIS_PTS
/begin CHARACTERISTIC MTQD_TqDrtFacBrkPedAccOn_c "" MAP 0x0000 /* @ECU_Address@MTQD_TqDrtFacBrkPedAccOn_c@ */ Lookup2D_FLOAT32_IEEE 0 AppSwcVcu_CM_single_c 0.0 1.0
 /begin AXIS_DESCR COM_AXIS NO_INPUT_QUANTITY AppSwcVcu_CM_single_kph 5 -300.0 300.0 AXIS_PTS_REF ATQD_TqDrtFacBrkPedAccOn_Y_kph /end AXIS_DESCR
 /begin AXIS_DESCR COM_AXIS NO_INPUT_QUANTITY AppSwcVcu_CM_single_pct 9 -100.0 200.0 AXIS_PTS_REF ATQD_TqDrtFacBrkPedAccOn_X_pct /end AXIS_DESCR
/end CHARACTERISTIC
/begin AXIS_PTS ATQD_TqDrtFacBrkPedAccOn_X_pct "" 0x0000 /* @ECU_Address@ATQD_TqDrtFacBrkPedAccOn_X_pct@ */ NO_INPUT_QUANTITY Lookup2D_X_FLOAT32_IEEE 0 AppSwcVcu_CM_single_pct 9 -100.0 200.0 /end AXIS_PTS
/begin AXIS_PTS ATQD_TqDrtFacBrkPedAccOn_Y_kph "" 0x0000 /* @ECU_Address@ATQD_TqDrtFacBrkPedAccOn_Y_kph@ */ NO_INPUT_QUANTITY Lookup2D_X_FLOAT32_IEEE 0 AppSwcVcu_CM_single_kph 5 -300.0 300.0 /end AXIS_PTS
/begin CHARACTERISTIC MTQD_TqDrtFacBrkPedAccOff_c "" CURVE 0x0000 /* @ECU_Address@MTQD_TqDrtFacBrkPedAccOff_c@ */ Lookup1D_FLOAT32_IEEE 0 AppSwcVcu_CM_single_c 0.0 1.0
 /begin AXIS_DESCR COM_AXIS NO_INPUT_QUANTITY AppSwcVcu_CM_single_pct 9 -100.0 200.0 AXIS_PTS_REF ATQD_TqDrtFacBrkPedAccOff_X_pct /end AXIS_DESCR
/end CHARACTERISTIC
/begin AXIS_PTS ATQD_TqDrtFacBrkPedAccOff_X_pct "" 0x0000 /* @ECU_Address@ATQD_TqDrtFacBrkPedAccOff_X_pct@ */ NO_INPUT_QUANTITY Lookup1D_X_FLOAT32_IEEE 0 AppSwcVcu_CM_single_pct 9 -100.0 200.0 /end AXIS_PTS
/begin CHARACTERISTIC MTQD_TqDrtFacLmtPerfmn_c "" CURVE 0x0000 /* @ECU_Address@MTQD_TqDrtFacLmtPerfmn_c@ */ Lookup1D_FLOAT32_IEEE 0 AppSwcVcu_CM_single_c 0.0 1.0
 /begin AXIS_DESCR COM_AXIS VVTM_VehSpd_kph AppSwcVcu_CM_single_kph 8 -300.0 300.0 AXIS_PTS_REF ATQD_TqDrtFacLmtPerfmn_X_kph /end AXIS_DESCR
/end CHARACTERISTIC
/begin AXIS_PTS ATQD_TqDrtFacLmtPerfmn_X_kph "" 0x0000 /* @ECU_Address@ATQD_TqDrtFacLmtPerfmn_X_kph@ */ VVTM_VehSpd_kph Lookup1D_X_FLOAT32_IEEE 0 AppSwcVcu_CM_single_kph 8 -300.0 300.0 /end AXIS_PTS
/begin CHARACTERISTIC MTQD_TqDrtFacLimpHome_c "" CURVE 0x0000 /* @ECU_Address@MTQD_TqDrtFacLimpHome_c@ */ Lookup1D_FLOAT32_IEEE 0 AppSwcVcu_CM_single_c 0.0 1.0
 /begin AXIS_DESCR COM_AXIS VVTM_VehSpd_kph AppSwcVcu_CM_single_kph 7 -300.0 300.0 AXIS_PTS_REF ATQD_TqDrtFacLimpHome_X_kph /end AXIS_DESCR
/end CHARACTERISTIC
/begin AXIS_PTS ATQD_TqDrtFacLimpHome_X_kph "" 0x0000 /* @ECU_Address@ATQD_TqDrtFacLimpHome_X_kph@ */ VVTM_VehSpd_kph Lookup1D_X_FLOAT32_IEEE 0 AppSwcVcu_CM_single_kph 7 -300.0 300.0 /end AXIS_PTS
/begin CHARACTERISTIC MTQD_TqDrtFacHiddenLmtPwr_c "" CURVE 0x0000 /* @ECU_Address@MTQD_TqDrtFacHiddenLmtPwr_c@ */ Lookup1D_FLOAT32_IEEE 0 AppSwcVcu_CM_single_c 0.0 1.0
 /begin AXIS_DESCR COM_AXIS VVTM_VehSpd_kph AppSwcVcu_CM_single_kph 7 -300.0 300.0 AXIS_PTS_REF ATQD_TqDrtFacHiddenLmtPwr_X_kph /end AXIS_DESCR
/end CHARACTERISTIC
/begin AXIS_PTS ATQD_TqDrtFacHiddenLmtPwr_X_kph "" 0x0000 /* @ECU_Address@ATQD_TqDrtFacHiddenLmtPwr_X_kph@ */ VVTM_VehSpd_kph Lookup1D_X_FLOAT32_IEEE 0 AppSwcVcu_CM_single_kph 7 -300.0 300.0 /end AXIS_PTS
/begin CHARACTERISTIC MTQD_TqDrtFacVehSpdSnow_c "" CURVE 0x0000 /* @ECU_Address@MTQD_TqDrtFacVehSpdSnow_c@ */ Lookup1D_FLOAT32_IEEE 0 AppSwcVcu_CM_single_c 0.0 1.0
 /begin AXIS_DESCR COM_AXIS VVTM_VehSpd_kph AppSwcVcu_CM_single_kph 6 -300.0 300.0 AXIS_PTS_REF ATQD_TqDrtFacVehSpdSnow_X_kph /end AXIS_DESCR
/end CHARACTERISTIC
/begin AXIS_PTS ATQD_TqDrtFacVehSpdSnow_X_kph "" 0x0000 /* @ECU_Address@ATQD_TqDrtFacVehSpdSnow_X_kph@ */ VVTM_VehSpd_kph Lookup1D_X_FLOAT32_IEEE 0 AppSwcVcu_CM_single_kph 6 -300.0 300.0 /end AXIS_PTS
/begin CHARACTERISTIC MTQD_TqDrtFacVehSpdEco_c "" CURVE 0x0000 /* @ECU_Address@MTQD_TqDrtFacVehSpdEco_c@ */ Lookup1D_FLOAT32_IEEE 0 AppSwcVcu_CM_single_c 0.0 1.0
 /begin AXIS_DESCR COM_AXIS VVTM_VehSpd_kph AppSwcVcu_CM_single_kph 6 -300.0 300.0 AXIS_PTS_REF ATQD_TqDrtFacVehSpdEco_X_kph /end AXIS_DESCR
/end CHARACTERISTIC
/begin AXIS_PTS ATQD_TqDrtFacVehSpdEco_X_kph "" 0x0000 /* @ECU_Address@ATQD_TqDrtFacVehSpdEco_X_kph@ */ VVTM_VehSpd_kph Lookup1D_X_FLOAT32_IEEE 0 AppSwcVcu_CM_single_kph 6 -300.0 300.0 /end AXIS_PTS
/begin CHARACTERISTIC MTQD_TqDrtFacVehSpdSpt_c "" CURVE 0x0000 /* @ECU_Address@MTQD_TqDrtFacVehSpdSpt_c@ */ Lookup1D_FLOAT32_IEEE 0 AppSwcVcu_CM_single_c 0.0 1.0
 /begin AXIS_DESCR COM_AXIS VVTM_VehSpd_kph AppSwcVcu_CM_single_kph 6 -300.0 300.0 AXIS_PTS_REF ATQD_TqDrtFacVehSpdSpt_X_kph /end AXIS_DESCR
/end CHARACTERISTIC
/begin AXIS_PTS ATQD_TqDrtFacVehSpdSpt_X_kph "" 0x0000 /* @ECU_Address@ATQD_TqDrtFacVehSpdSpt_X_kph@ */ VVTM_VehSpd_kph Lookup1D_X_FLOAT32_IEEE 0 AppSwcVcu_CM_single_kph 6 -300.0 300.0 /end AXIS_PTS
/begin CHARACTERISTIC MTQD_TqDrtFacVehSpdNorm_c "" CURVE 0x0000 /* @ECU_Address@MTQD_TqDrtFacVehSpdNorm_c@ */ Lookup1D_FLOAT32_IEEE 0 AppSwcVcu_CM_single_c 0.0 1.0
 /begin AXIS_DESCR COM_AXIS VVTM_VehSpd_kph AppSwcVcu_CM_single_kph 6 -300.0 300.0 AXIS_PTS_REF ATQD_TqDrtFacVehSpdNorm_X_kph /end AXIS_DESCR
/end CHARACTERISTIC
/begin AXIS_PTS ATQD_TqDrtFacVehSpdNorm_X_kph "" 0x0000 /* @ECU_Address@ATQD_TqDrtFacVehSpdNorm_X_kph@ */ VVTM_VehSpd_kph Lookup1D_X_FLOAT32_IEEE 0 AppSwcVcu_CM_single_kph 6 -300.0 300.0 /end AXIS_PTS
/begin CHARACTERISTIC MTQD_TqDrtFacVehSpdRev_c "" CURVE 0x0000 /* @ECU_Address@MTQD_TqDrtFacVehSpdRev_c@ */ Lookup1D_FLOAT32_IEEE 0 AppSwcVcu_CM_single_c 0.0 1.0
 /begin AXIS_DESCR COM_AXIS VVTM_VehSpd_kph AppSwcVcu_CM_single_kph 6 -300.0 300.0 AXIS_PTS_REF ATQD_TqDrtFacVehSpdRev_X_kph /end AXIS_DESCR
/end CHARACTERISTIC
/begin AXIS_PTS ATQD_TqDrtFacVehSpdRev_X_kph "" 0x0000 /* @ECU_Address@ATQD_TqDrtFacVehSpdRev_X_kph@ */ VVTM_VehSpd_kph Lookup1D_X_FLOAT32_IEEE 0 AppSwcVcu_CM_single_kph 6 -300.0 300.0 /end AXIS_PTS
/begin CHARACTERISTIC MTQD_TqDrtFacMotorSpd_c "" CURVE 0x0000 /* @ECU_Address@MTQD_TqDrtFacMotorSpd_c@ */ Lookup1D_FLOAT32_IEEE 0 AppSwcVcu_CM_single_c 0.0 1.0
 /begin AXIS_DESCR COM_AXIS NO_INPUT_QUANTITY AppSwcVcu_CM_single_rpm 5 -100000.0 100000.0 AXIS_PTS_REF ATQD_TqDrtFacMotorSpd_X_rpm /end AXIS_DESCR
/end CHARACTERISTIC
/begin AXIS_PTS ATQD_TqDrtFacMotorSpd_X_rpm "" 0x0000 /* @ECU_Address@ATQD_TqDrtFacMotorSpd_X_rpm@ */ NO_INPUT_QUANTITY Lookup1D_X_FLOAT32_IEEE 0 AppSwcVcu_CM_single_rpm 5 -100000.0 100000.0 /end AXIS_PTS
/begin CHARACTERISTIC MTQF_TqRateDecMaxACC_Nmps "Max torque decreasing change rate in ACC" CURVE 0x0000 /* @ECU_Address@MTQF_TqRateDecMaxACC_Nmps@ */ Lookup1D_FLOAT32_IEEE 0 AppSwcVcu_CM_single_Nmps -100000.0 100000.0
 /begin AXIS_DESCR COM_AXIS NO_INPUT_QUANTITY AppSwcVcu_CM_single_Nm 8 -10000.0 10000.0 AXIS_PTS_REF ATQF_TqRateDecMaxACC_X_Nm /end AXIS_DESCR
/end CHARACTERISTIC
/begin AXIS_PTS ATQF_TqRateDecMaxACC_X_Nm "" 0x0000 /* @ECU_Address@ATQF_TqRateDecMaxACC_X_Nm@ */ NO_INPUT_QUANTITY Lookup1D_X_FLOAT32_IEEE 0 AppSwcVcu_CM_single_Nm 8 -10000.0 10000.0 /end AXIS_PTS
/begin CHARACTERISTIC MTQF_TqRateIncMaxACC_Nmps "Max torque increasing change rate in ACC" CURVE 0x0000 /* @ECU_Address@MTQF_TqRateIncMaxACC_Nmps@ */ Lookup1D_FLOAT32_IEEE 0 AppSwcVcu_CM_single_Nmps -100000.0 100000.0
 /begin AXIS_DESCR COM_AXIS NO_INPUT_QUANTITY AppSwcVcu_CM_single_Nm 8 -10000.0 10000.0 AXIS_PTS_REF ATQF_TqRateIncMaxACC_X_Nm /end AXIS_DESCR
/end CHARACTERISTIC
/begin AXIS_PTS ATQF_TqRateIncMaxACC_X_Nm "" 0x0000 /* @ECU_Address@ATQF_TqRateIncMaxACC_X_Nm@ */ NO_INPUT_QUANTITY Lookup1D_X_FLOAT32_IEEE 0 AppSwcVcu_CM_single_Nm 8 -10000.0 10000.0 /end AXIS_PTS
/begin CHARACTERISTIC MTZX_ZeroTqOfstIncACC_Nm "" CURVE 0x0000 /* @ECU_Address@MTZX_ZeroTqOfstIncACC_Nm@ */ Lookup1D_FLOAT32_IEEE 0 AppSwcVcu_CM_single_Nm -1000.0 1000.0
 /begin AXIS_DESCR COM_AXIS VVTM_VehSpd_kph AppSwcVcu_CM_single_kph 12 -300.0 300.0 AXIS_PTS_REF ATZX_ZeroTqOfstIncACC_X_kph /end AXIS_DESCR
/end CHARACTERISTIC
/begin AXIS_PTS ATZX_ZeroTqOfstIncACC_X_kph "" 0x0000 /* @ECU_Address@ATZX_ZeroTqOfstIncACC_X_kph@ */ VVTM_VehSpd_kph Lookup1D_X_FLOAT32_IEEE 0 AppSwcVcu_CM_single_kph 12 -300.0 300.0 /end AXIS_PTS
/begin CHARACTERISTIC MTZX_ZeroTqOfstDecACC_Nm "" CURVE 0x0000 /* @ECU_Address@MTZX_ZeroTqOfstDecACC_Nm@ */ Lookup1D_FLOAT32_IEEE 0 AppSwcVcu_CM_single_Nm -1000.0 1000.0
 /begin AXIS_DESCR COM_AXIS VVTM_VehSpd_kph AppSwcVcu_CM_single_kph 12 -300.0 300.0 AXIS_PTS_REF ATZX_ZeroTqOfstDecACC_X_kph /end AXIS_DESCR
/end CHARACTERISTIC
/begin AXIS_PTS ATZX_ZeroTqOfstDecACC_X_kph "" 0x0000 /* @ECU_Address@ATZX_ZeroTqOfstDecACC_X_kph@ */ VVTM_VehSpd_kph Lookup1D_X_FLOAT32_IEEE 0 AppSwcVcu_CM_single_kph 12 -300.0 300.0 /end AXIS_PTS
/begin CHARACTERISTIC MTZX_ZeroXTmACC_s "" CURVE 0x0000 /* @ECU_Address@MTZX_ZeroXTmACC_s@ */ Lookup1D_FLOAT32_IEEE 0 AppSwcVcu_CM_single_s 0.0 60.0
 /begin AXIS_DESCR COM_AXIS VVTM_VehSpd_kph AppSwcVcu_CM_single_kph 10 -300.0 300.0 AXIS_PTS_REF ATZX_ZeroXTmACC_X_kph /end AXIS_DESCR
/end CHARACTERISTIC
/begin AXIS_PTS ATZX_ZeroXTmACC_X_kph "" 0x0000 /* @ECU_Address@ATZX_ZeroXTmACC_X_kph@ */ VVTM_VehSpd_kph Lookup1D_X_FLOAT32_IEEE 0 AppSwcVcu_CM_single_kph 10 -300.0 300.0 /end AXIS_PTS
/begin CHARACTERISTIC MTZX_AZRngInc_Nm "" CURVE 0x0000 /* @ECU_Address@MTZX_AZRngInc_Nm@ */ Lookup1D_FLOAT32_IEEE 0 AppSwcVcu_CM_single_Nm -1000.0 1000.0
 /begin AXIS_DESCR COM_AXIS VVTM_VehSpd_kph AppSwcVcu_CM_single_kph 12 -300.0 300.0 AXIS_PTS_REF ATZX_AZRngInc_X_kph /end AXIS_DESCR
/end CHARACTERISTIC
/begin AXIS_PTS ATZX_AZRngInc_X_kph "" 0x0000 /* @ECU_Address@ATZX_AZRngInc_X_kph@ */ VVTM_VehSpd_kph Lookup1D_X_FLOAT32_IEEE 0 AppSwcVcu_CM_single_kph 12 -300.0 300.0 /end AXIS_PTS
/begin CHARACTERISTIC MTZX_AZRngDec_Nm "" CURVE 0x0000 /* @ECU_Address@MTZX_AZRngDec_Nm@ */ Lookup1D_FLOAT32_IEEE 0 AppSwcVcu_CM_single_Nm -1000.0 1000.0
 /begin AXIS_DESCR COM_AXIS VVTM_VehSpd_kph AppSwcVcu_CM_single_kph 12 -300.0 300.0 AXIS_PTS_REF ATZX_AZRngDec_X_kph /end AXIS_DESCR
/end CHARACTERISTIC
/begin AXIS_PTS ATZX_AZRngDec_X_kph "" 0x0000 /* @ECU_Address@ATZX_AZRngDec_X_kph@ */ VVTM_VehSpd_kph Lookup1D_X_FLOAT32_IEEE 0 AppSwcVcu_CM_single_kph 12 -300.0 300.0 /end AXIS_PTS
/begin CHARACTERISTIC MTZX_BZRngInc_Nm "" CURVE 0x0000 /* @ECU_Address@MTZX_BZRngInc_Nm@ */ Lookup1D_FLOAT32_IEEE 0 AppSwcVcu_CM_single_Nm -1000.0 1000.0
 /begin AXIS_DESCR COM_AXIS VVTM_VehSpd_kph AppSwcVcu_CM_single_kph 12 -300.0 300.0 AXIS_PTS_REF ATZX_BZRngInc_X_kph /end AXIS_DESCR
/end CHARACTERISTIC
/begin AXIS_PTS ATZX_BZRngInc_X_kph "" 0x0000 /* @ECU_Address@ATZX_BZRngInc_X_kph@ */ VVTM_VehSpd_kph Lookup1D_X_FLOAT32_IEEE 0 AppSwcVcu_CM_single_kph 12 -300.0 300.0 /end AXIS_PTS
/begin CHARACTERISTIC MTZX_BZRngDec_Nm "" CURVE 0x0000 /* @ECU_Address@MTZX_BZRngDec_Nm@ */ Lookup1D_FLOAT32_IEEE 0 AppSwcVcu_CM_single_Nm -1000.0 1000.0
 /begin AXIS_DESCR COM_AXIS VVTM_VehSpd_kph AppSwcVcu_CM_single_kph 12 -300.0 300.0 AXIS_PTS_REF ATZX_BZRngDec_X_kph /end AXIS_DESCR
/end CHARACTERISTIC
/begin AXIS_PTS ATZX_BZRngDec_X_kph "" 0x0000 /* @ECU_Address@ATZX_BZRngDec_X_kph@ */ VVTM_VehSpd_kph Lookup1D_X_FLOAT32_IEEE 0 AppSwcVcu_CM_single_kph 12 -300.0 300.0 /end AXIS_PTS
/begin CHARACTERISTIC MVTM_ActPwrBacklash_kW "" CURVE 0x0000 /* @ECU_Address@MVTM_ActPwrBacklash_kW@ */ Lookup1D_FLOAT32_IEEE 0 AppSwcVcu_CM_single_kW -10000.0 10000.0
 /begin AXIS_DESCR COM_AXIS NO_INPUT_QUANTITY AppSwcVcu_CM_single_kW 8 -10000.0 10000.0 AXIS_PTS_REF AVTM_ActPwrBacklash_X_kW /end AXIS_DESCR
/end CHARACTERISTIC
/begin AXIS_PTS AVTM_ActPwrBacklash_X_kW "" 0x0000 /* @ECU_Address@AVTM_ActPwrBacklash_X_kW@ */ NO_INPUT_QUANTITY Lookup1D_X_FLOAT32_IEEE 0 AppSwcVcu_CM_single_kW 8 -10000.0 10000.0 /end AXIS_PTS
/begin CHARACTERISTIC MVTM_MotorMaxDrvTqWT_Nm "" CURVE 0x0000 /* @ECU_Address@MVTM_MotorMaxDrvTqWT_Nm@ */ Lookup1D_FLOAT32_IEEE 0 AppSwcVcu_CM_single_Nm -1000.0 1000.0
 /begin AXIS_DESCR COM_AXIS NO_INPUT_QUANTITY AppSwcVcu_CM_single_rpm 23 -100000.0 100000.0 AXIS_PTS_REF AVTM_MotorMaxDrvTqWT_X_rpm /end AXIS_DESCR
/end CHARACTERISTIC
/begin AXIS_PTS AVTM_MotorMaxDrvTqWT_X_rpm "" 0x0000 /* @ECU_Address@AVTM_MotorMaxDrvTqWT_X_rpm@ */ NO_INPUT_QUANTITY Lookup1D_X_FLOAT32_IEEE 0 AppSwcVcu_CM_single_rpm 23 -100000.0 100000.0 /end AXIS_PTS
/begin CHARACTERISTIC MDAC_OPDOvrdAccPedPstn_pct "" CURVE 0x0000 /* @ECU_Address@MDAC_OPDOvrdAccPedPstn_pct@ */ Lookup1D_FLOAT32_IEEE 0 AppSwcVcu_CM_single_pct 0.0 100.0
 /begin AXIS_DESCR COM_AXIS NO_INPUT_QUANTITY AppSwcVcu_CM_single_Nm 11 -10000.0 10000.0 AXIS_PTS_REF ADAC_OPDOvrdAccPedPstn_X_Nm /end AXIS_DESCR
/end CHARACTERISTIC
/begin AXIS_PTS ADAC_OPDOvrdAccPedPstn_X_Nm "" 0x0000 /* @ECU_Address@ADAC_OPDOvrdAccPedPstn_X_Nm@ */ NO_INPUT_QUANTITY Lookup1D_X_FLOAT32_IEEE 0 AppSwcVcu_CM_single_Nm 11 -10000.0 10000.0 /end AXIS_PTS
/begin CHARACTERISTIC MTQF_DecEndRateFiltTmSMode_s "" CURVE 0x0000 /* @ECU_Address@MTQF_DecEndRateFiltTmSMode_s@ */ Lookup1D_FLOAT32_IEEE 0 AppSwcVcu_CM_single_s 0.0 60.0
 /begin AXIS_DESCR COM_AXIS VTQF_TqOutChgRate_Nmps AppSwcVcu_CM_single_Nmps 12 -100000.0 100000.0 AXIS_PTS_REF ATQF_DecRateFiltTm_X_Nmps /end AXIS_DESCR
/end CHARACTERISTIC
/begin AXIS_PTS ATQF_DecRateFiltTm_X_Nmps "torque decrease rate filter time in starting phase, x axle" 0x0000 /* @ECU_Address@ATQF_DecRateFiltTm_X_Nmps@ */ VTQF_TqOutChgRate_Nmps Lookup1D_X_FLOAT32_IEEE 0 AppSwcVcu_CM_single_Nmps 12 -100000.0 100000.0 /end AXIS_PTS
/begin CHARACTERISTIC MTQF_DecEndRateFiltTm_s "torque decrease rate filter time in ending phase" CURVE 0x0000 /* @ECU_Address@MTQF_DecEndRateFiltTm_s@ */ Lookup1D_FLOAT32_IEEE 0 AppSwcVcu_CM_single_s 0.0 60.0
 /begin AXIS_DESCR COM_AXIS VTQF_TqOutChgRate_Nmps AppSwcVcu_CM_single_Nmps 12 -100000.0 100000.0 AXIS_PTS_REF ATQF_DecRateFiltTm_X_Nmps /end AXIS_DESCR
/end CHARACTERISTIC
/begin CHARACTERISTIC MTQF_DecStartRateFiltTmACC_s "" CURVE 0x0000 /* @ECU_Address@MTQF_DecStartRateFiltTmACC_s@ */ Lookup1D_FLOAT32_IEEE 0 AppSwcVcu_CM_single_s 0.0 60.0
 /begin AXIS_DESCR COM_AXIS VTQF_TqOutChgRate_Nmps AppSwcVcu_CM_single_Nmps 12 -100000.0 100000.0 AXIS_PTS_REF ATQF_DecRateFiltTm_X_Nmps /end AXIS_DESCR
/end CHARACTERISTIC
/begin CHARACTERISTIC MTQF_DecStartRateFiltTmSMode_s "" CURVE 0x0000 /* @ECU_Address@MTQF_DecStartRateFiltTmSMode_s@ */ Lookup1D_FLOAT32_IEEE 0 AppSwcVcu_CM_single_s 0.0 60.0
 /begin AXIS_DESCR COM_AXIS VTQF_TqOutChgRate_Nmps AppSwcVcu_CM_single_Nmps 12 -100000.0 100000.0 AXIS_PTS_REF ATQF_DecRateFiltTm_X_Nmps /end AXIS_DESCR
/end CHARACTERISTIC
/begin CHARACTERISTIC MTQF_DecStartRateFiltTm_s "torque decrease rate filter time in starting phase" CURVE 0x0000 /* @ECU_Address@MTQF_DecStartRateFiltTm_s@ */ Lookup1D_FLOAT32_IEEE 0 AppSwcVcu_CM_single_s 0.0 60.0
 /begin AXIS_DESCR COM_AXIS VTQF_TqOutChgRate_Nmps AppSwcVcu_CM_single_Nmps 12 -100000.0 100000.0 AXIS_PTS_REF ATQF_DecRateFiltTm_X_Nmps /end AXIS_DESCR
/end CHARACTERISTIC
/begin CHARACTERISTIC MTQF_TqRateDecMaxE_Nmps "Max torque decreasing change rate in Eco" MAP 0x0000 /* @ECU_Address@MTQF_TqRateDecMaxE_Nmps@ */ Lookup2D_FLOAT32_IEEE 0 AppSwcVcu_CM_single_Nmps -100000.0 100000.0
 /begin AXIS_DESCR COM_AXIS VVTM_VehSpd_kph AppSwcVcu_CM_single_kph 13 -300.0 300.0 AXIS_PTS_REF ATQF_TqRateDecMax_Y_kph /end AXIS_DESCR
 /begin AXIS_DESCR COM_AXIS VDAC_VirtPedPstn_pct AppSwcVcu_CM_single_pct 12 -100.0 200.0 AXIS_PTS_REF ATQF_TqRateDecMax_X_pct /end AXIS_DESCR
/end CHARACTERISTIC
/begin AXIS_PTS ATQF_TqRateDecMax_X_pct "X axis of max torque decreasing change rate" 0x0000 /* @ECU_Address@ATQF_TqRateDecMax_X_pct@ */ VDAC_VirtPedPstn_pct Lookup2D_X_FLOAT32_IEEE 0 AppSwcVcu_CM_single_pct 12 -100.0 200.0 /end AXIS_PTS
/begin AXIS_PTS ATQF_TqRateDecMax_Y_kph "Y axis of max torque decreasing change rate" 0x0000 /* @ECU_Address@ATQF_TqRateDecMax_Y_kph@ */ VVTM_VehSpd_kph Lookup2D_X_FLOAT32_IEEE 0 AppSwcVcu_CM_single_kph 13 -300.0 300.0 /end AXIS_PTS
/begin CHARACTERISTIC MTQF_TqRateDecMaxS_Nmps "Max torque decreasing change rate in Sport" MAP 0x0000 /* @ECU_Address@MTQF_TqRateDecMaxS_Nmps@ */ Lookup2D_FLOAT32_IEEE 0 AppSwcVcu_CM_single_Nmps -100000.0 100000.0
 /begin AXIS_DESCR COM_AXIS VVTM_VehSpd_kph AppSwcVcu_CM_single_kph 13 -300.0 300.0 AXIS_PTS_REF ATQF_TqRateDecMax_Y_kph /end AXIS_DESCR
 /begin AXIS_DESCR COM_AXIS VDAC_VirtPedPstn_pct AppSwcVcu_CM_single_pct 12 -100.0 200.0 AXIS_PTS_REF ATQF_TqRateDecMax_X_pct /end AXIS_DESCR
/end CHARACTERISTIC
/begin CHARACTERISTIC MTQF_TqRateDecMaxN_Nmps "Max torque decreasing change rate in Normal" MAP 0x0000 /* @ECU_Address@MTQF_TqRateDecMaxN_Nmps@ */ Lookup2D_FLOAT32_IEEE 0 AppSwcVcu_CM_single_Nmps -100000.0 100000.0
 /begin AXIS_DESCR COM_AXIS VVTM_VehSpd_kph AppSwcVcu_CM_single_kph 13 -300.0 300.0 AXIS_PTS_REF ATQF_TqRateDecMax_Y_kph /end AXIS_DESCR
 /begin AXIS_DESCR COM_AXIS VDAC_VirtPedPstn_pct AppSwcVcu_CM_single_pct 12 -100.0 200.0 AXIS_PTS_REF ATQF_TqRateDecMax_X_pct /end AXIS_DESCR
/end CHARACTERISTIC
/begin CHARACTERISTIC MTQF_TqRateDecMaxRegenE_Nmps "" MAP 0x0000 /* @ECU_Address@MTQF_TqRateDecMaxRegenE_Nmps@ */ Lookup2D_FLOAT32_IEEE 0 AppSwcVcu_CM_single_Nmps -100000.0 100000.0
 /begin AXIS_DESCR COM_AXIS VVTM_VehSpd_kph AppSwcVcu_CM_single_kph 13 -300.0 300.0 AXIS_PTS_REF ATQF_TqRateDecMaxRegen_Y_kph /end AXIS_DESCR
 /begin AXIS_DESCR COM_AXIS VDAC_VirtPedPstn_pct AppSwcVcu_CM_single_pct 7 -100.0 200.0 AXIS_PTS_REF ATQF_TqRateDecMaxRegen_X_pct /end AXIS_DESCR
/end CHARACTERISTIC
/begin AXIS_PTS ATQF_TqRateDecMaxRegen_X_pct "" 0x0000 /* @ECU_Address@ATQF_TqRateDecMaxRegen_X_pct@ */ VDAC_VirtPedPstn_pct Lookup2D_X_FLOAT32_IEEE 0 AppSwcVcu_CM_single_pct 7 -100.0 200.0 /end AXIS_PTS
/begin AXIS_PTS ATQF_TqRateDecMaxRegen_Y_kph "" 0x0000 /* @ECU_Address@ATQF_TqRateDecMaxRegen_Y_kph@ */ VVTM_VehSpd_kph Lookup2D_X_FLOAT32_IEEE 0 AppSwcVcu_CM_single_kph 13 -300.0 300.0 /end AXIS_PTS
/begin CHARACTERISTIC MTQF_TqRateDecMaxRegenS_Nmps "" MAP 0x0000 /* @ECU_Address@MTQF_TqRateDecMaxRegenS_Nmps@ */ Lookup2D_FLOAT32_IEEE 0 AppSwcVcu_CM_single_Nmps -100000.0 100000.0
 /begin AXIS_DESCR COM_AXIS VVTM_VehSpd_kph AppSwcVcu_CM_single_kph 13 -300.0 300.0 AXIS_PTS_REF ATQF_TqRateDecMaxRegen_Y_kph /end AXIS_DESCR
 /begin AXIS_DESCR COM_AXIS VDAC_VirtPedPstn_pct AppSwcVcu_CM_single_pct 7 -100.0 200.0 AXIS_PTS_REF ATQF_TqRateDecMaxRegen_X_pct /end AXIS_DESCR
/end CHARACTERISTIC
/begin CHARACTERISTIC MTQF_TqRateDecMaxRegenN_Nmps "" MAP 0x0000 /* @ECU_Address@MTQF_TqRateDecMaxRegenN_Nmps@ */ Lookup2D_FLOAT32_IEEE 0 AppSwcVcu_CM_single_Nmps -100000.0 100000.0
 /begin AXIS_DESCR COM_AXIS VVTM_VehSpd_kph AppSwcVcu_CM_single_kph 13 -300.0 300.0 AXIS_PTS_REF ATQF_TqRateDecMaxRegen_Y_kph /end AXIS_DESCR
 /begin AXIS_DESCR COM_AXIS VDAC_VirtPedPstn_pct AppSwcVcu_CM_single_pct 7 -100.0 200.0 AXIS_PTS_REF ATQF_TqRateDecMaxRegen_X_pct /end AXIS_DESCR
/end CHARACTERISTIC
/begin CHARACTERISTIC MTQF_TipOutTqDecRateCoeff_rat "" CURVE 0x0000 /* @ECU_Address@MTQF_TipOutTqDecRateCoeff_rat@ */ Lookup1D_FLOAT32_IEEE 0 AppSwcVcu_CM_single_rat 0.0 100.0
 /begin AXIS_DESCR COM_AXIS NO_INPUT_QUANTITY AppSwcVcu_CM_single_Nm 8 -10000.0 10000.0 AXIS_PTS_REF ATQF_TipOutTqDecRateCoeff_Nm /end AXIS_DESCR
/end CHARACTERISTIC
/begin AXIS_PTS ATQF_TipOutTqDecRateCoeff_Nm "" 0x0000 /* @ECU_Address@ATQF_TipOutTqDecRateCoeff_Nm@ */ NO_INPUT_QUANTITY Lookup1D_X_FLOAT32_IEEE 0 AppSwcVcu_CM_single_Nm 8 -10000.0 10000.0 /end AXIS_PTS
/begin CHARACTERISTIC MTQF_IncEndRateFiltTmSMode_s "" CURVE 0x0000 /* @ECU_Address@MTQF_IncEndRateFiltTmSMode_s@ */ Lookup1D_FLOAT32_IEEE 0 AppSwcVcu_CM_single_s 0.0 60.0
 /begin AXIS_DESCR COM_AXIS VTQF_TqOutChgRate_Nmps AppSwcVcu_CM_single_Nmps 12 -100000.0 100000.0 AXIS_PTS_REF ATQF_IncRateFiltTm_X_Nmps /end AXIS_DESCR
/end CHARACTERISTIC
/begin AXIS_PTS ATQF_IncRateFiltTm_X_Nmps "torque increase rate filter time in starting phase, x axle" 0x0000 /* @ECU_Address@ATQF_IncRateFiltTm_X_Nmps@ */ VTQF_TqOutChgRate_Nmps Lookup1D_X_FLOAT32_IEEE 0 AppSwcVcu_CM_single_Nmps 12 -100000.0 100000.0 /end AXIS_PTS
/begin CHARACTERISTIC MTQF_IncEndRateFiltTm_s "torque increase rate filter time in ending phase" CURVE 0x0000 /* @ECU_Address@MTQF_IncEndRateFiltTm_s@ */ Lookup1D_FLOAT32_IEEE 0 AppSwcVcu_CM_single_s 0.0 60.0
 /begin AXIS_DESCR COM_AXIS VTQF_TqOutChgRate_Nmps AppSwcVcu_CM_single_Nmps 12 -100000.0 100000.0 AXIS_PTS_REF ATQF_IncRateFiltTm_X_Nmps /end AXIS_DESCR
/end CHARACTERISTIC
/begin CHARACTERISTIC MTQF_IncStartRateFiltTmACC_s "" CURVE 0x0000 /* @ECU_Address@MTQF_IncStartRateFiltTmACC_s@ */ Lookup1D_FLOAT32_IEEE 0 AppSwcVcu_CM_single_s 0.0 60.0
 /begin AXIS_DESCR COM_AXIS VTQF_TqOutChgRate_Nmps AppSwcVcu_CM_single_Nmps 12 -100000.0 100000.0 AXIS_PTS_REF ATQF_IncRateFiltTm_X_Nmps /end AXIS_DESCR
/end CHARACTERISTIC
/begin CHARACTERISTIC MTQF_IncStartRateFiltTmSMode_s "" CURVE 0x0000 /* @ECU_Address@MTQF_IncStartRateFiltTmSMode_s@ */ Lookup1D_FLOAT32_IEEE 0 AppSwcVcu_CM_single_s 0.0 60.0
 /begin AXIS_DESCR COM_AXIS VTQF_TqOutChgRate_Nmps AppSwcVcu_CM_single_Nmps 12 -100000.0 100000.0 AXIS_PTS_REF ATQF_IncRateFiltTm_X_Nmps /end AXIS_DESCR
/end CHARACTERISTIC
/begin CHARACTERISTIC MTQF_IncStartRateFiltTm_s "torque increase rate filter time in starting phase" CURVE 0x0000 /* @ECU_Address@MTQF_IncStartRateFiltTm_s@ */ Lookup1D_FLOAT32_IEEE 0 AppSwcVcu_CM_single_s 0.0 60.0
 /begin AXIS_DESCR COM_AXIS VTQF_TqOutChgRate_Nmps AppSwcVcu_CM_single_Nmps 12 -100000.0 100000.0 AXIS_PTS_REF ATQF_IncRateFiltTm_X_Nmps /end AXIS_DESCR
/end CHARACTERISTIC
/begin CHARACTERISTIC MTQF_TqRateIncMaxE_Nmps "Max torque increasing change rate in Eco" MAP 0x0000 /* @ECU_Address@MTQF_TqRateIncMaxE_Nmps@ */ Lookup2D_FLOAT32_IEEE 0 AppSwcVcu_CM_single_Nmps -100000.0 100000.0
 /begin AXIS_DESCR COM_AXIS VVTM_VehSpd_kph AppSwcVcu_CM_single_kph 13 -300.0 300.0 AXIS_PTS_REF ATQF_TqRateIncMax_Y_kph /end AXIS_DESCR
 /begin AXIS_DESCR COM_AXIS VDAC_VirtPedPstn_pct AppSwcVcu_CM_single_pct 12 -100.0 200.0 AXIS_PTS_REF ATQF_TqRateIncMax_X_pct /end AXIS_DESCR
/end CHARACTERISTIC
/begin AXIS_PTS ATQF_TqRateIncMax_X_pct "X axis of max torque increasing change rate" 0x0000 /* @ECU_Address@ATQF_TqRateIncMax_X_pct@ */ VDAC_VirtPedPstn_pct Lookup2D_X_FLOAT32_IEEE 0 AppSwcVcu_CM_single_pct 12 -100.0 200.0 /end AXIS_PTS
/begin AXIS_PTS ATQF_TqRateIncMax_Y_kph "Y axis of max torque increasing change rate" 0x0000 /* @ECU_Address@ATQF_TqRateIncMax_Y_kph@ */ VVTM_VehSpd_kph Lookup2D_X_FLOAT32_IEEE 0 AppSwcVcu_CM_single_kph 13 -300.0 300.0 /end AXIS_PTS
/begin CHARACTERISTIC MTQF_TqRateIncMaxS_Nmps "Max torque increasing change rate in Sport" MAP 0x0000 /* @ECU_Address@MTQF_TqRateIncMaxS_Nmps@ */ Lookup2D_FLOAT32_IEEE 0 AppSwcVcu_CM_single_Nmps -100000.0 100000.0
 /begin AXIS_DESCR COM_AXIS VVTM_VehSpd_kph AppSwcVcu_CM_single_kph 13 -300.0 300.0 AXIS_PTS_REF ATQF_TqRateIncMax_Y_kph /end AXIS_DESCR
 /begin AXIS_DESCR COM_AXIS VDAC_VirtPedPstn_pct AppSwcVcu_CM_single_pct 12 -100.0 200.0 AXIS_PTS_REF ATQF_TqRateIncMax_X_pct /end AXIS_DESCR
/end CHARACTERISTIC
/begin CHARACTERISTIC MTQF_TqRateIncMaxN_Nmps "Max torque increasing change rate in Normal" MAP 0x0000 /* @ECU_Address@MTQF_TqRateIncMaxN_Nmps@ */ Lookup2D_FLOAT32_IEEE 0 AppSwcVcu_CM_single_Nmps -100000.0 100000.0
 /begin AXIS_DESCR COM_AXIS VVTM_VehSpd_kph AppSwcVcu_CM_single_kph 13 -300.0 300.0 AXIS_PTS_REF ATQF_TqRateIncMax_Y_kph /end AXIS_DESCR
 /begin AXIS_DESCR COM_AXIS VDAC_VirtPedPstn_pct AppSwcVcu_CM_single_pct 12 -100.0 200.0 AXIS_PTS_REF ATQF_TqRateIncMax_X_pct /end AXIS_DESCR
/end CHARACTERISTIC
/begin CHARACTERISTIC MTQR_ASDSpdFiltHi_s "" CURVE 0x0000 /* @ECU_Address@MTQR_ASDSpdFiltHi_s@ */ Lookup1D_FLOAT32_IEEE 0 AppSwcVcu_CM_single_s 0.0 1000.0
 /begin AXIS_DESCR COM_AXIS NO_INPUT_QUANTITY AppSwcVcu_CM_single_rpm 8 0.0 100000.0 AXIS_PTS_REF ATQR_ASDSpdFiltHi_X_rpm /end AXIS_DESCR
/end CHARACTERISTIC
/begin AXIS_PTS ATQR_ASDSpdFiltHi_X_rpm "" 0x0000 /* @ECU_Address@ATQR_ASDSpdFiltHi_X_rpm@ */ NO_INPUT_QUANTITY Lookup1D_X_FLOAT32_IEEE 0 AppSwcVcu_CM_single_rpm 8 0.0 100000.0 /end AXIS_PTS
/begin CHARACTERISTIC MTQR_ASDTqGain_c "" CURVE 0x0000 /* @ECU_Address@MTQR_ASDTqGain_c@ */ Lookup1D_FLOAT32_IEEE 0 AppSwcVcu_CM_single_c -1.0E+6 0.0
 /begin AXIS_DESCR COM_AXIS NO_INPUT_QUANTITY AppSwcVcu_CM_single_kph 8 0.0 100.0 AXIS_PTS_REF ATQR_ASDTqGain_X_kph /end AXIS_DESCR
/end CHARACTERISTIC
/begin AXIS_PTS ATQR_ASDTqGain_X_kph "" 0x0000 /* @ECU_Address@ATQR_ASDTqGain_X_kph@ */ NO_INPUT_QUANTITY Lookup1D_X_FLOAT32_IEEE 0 AppSwcVcu_CM_single_kph 8 0.0 100.0 /end AXIS_PTS
/begin CHARACTERISTIC MDAC_ACCOvrdTqOn_Nm "" CURVE 0x0000 /* @ECU_Address@MDAC_ACCOvrdTqOn_Nm@ */ Lookup1D_FLOAT32_IEEE 0 AppSwcVcu_CM_single_Nm -10000.0 10000.0
 /begin AXIS_DESCR COM_AXIS VVTM_VehSpd_kph AppSwcVcu_CM_single_kph 7 -300.0 300.0 AXIS_PTS_REF ADAC_ACCOvrdTq_X_kph /end AXIS_DESCR
/end CHARACTERISTIC
/begin AXIS_PTS ADAC_ACCOvrdTq_X_kph "" 0x0000 /* @ECU_Address@ADAC_ACCOvrdTq_X_kph@ */ VVTM_VehSpd_kph Lookup1D_X_FLOAT32_IEEE 0 AppSwcVcu_CM_single_kph 7 -300.0 300.0 /end AXIS_PTS
/begin CHARACTERISTIC MDAC_ACCOvrdTqOff_Nm "" CURVE 0x0000 /* @ECU_Address@MDAC_ACCOvrdTqOff_Nm@ */ Lookup1D_FLOAT32_IEEE 0 AppSwcVcu_CM_single_Nm -10000.0 10000.0
 /begin AXIS_DESCR COM_AXIS VVTM_VehSpd_kph AppSwcVcu_CM_single_kph 7 -300.0 300.0 AXIS_PTS_REF ADAC_ACCOvrdTq_X_kph /end AXIS_DESCR
/end CHARACTERISTIC
/begin CHARACTERISTIC MDAC_OPDTgtAcceltn_mps2 "" MAP 0x0000 /* @ECU_Address@MDAC_OPDTgtAcceltn_mps2@ */ Lookup2D_FLOAT32_IEEE 0 AppSwcVcu_CM_single_mps2 -20.0 20.0
 /begin AXIS_DESCR COM_AXIS NO_INPUT_QUANTITY AppSwcVcu_CM_single_kph 16 -300.0 300.0 AXIS_PTS_REF ADAC_OPDTgtAcceltnDeltaSpd_Y_kph /end AXIS_DESCR
 /begin AXIS_DESCR COM_AXIS NO_INPUT_QUANTITY AppSwcVcu_CM_single_kph 7 0.0 100.0 AXIS_PTS_REF ADAC_OPDTgtAcceltnTgtSpd_X_kph /end AXIS_DESCR
/end CHARACTERISTIC
/begin AXIS_PTS ADAC_OPDTgtAcceltnTgtSpd_X_kph "" 0x0000 /* @ECU_Address@ADAC_OPDTgtAcceltnTgtSpd_X_kph@ */ NO_INPUT_QUANTITY Lookup2D_X_FLOAT32_IEEE 0 AppSwcVcu_CM_single_kph 7 0.0 100.0 /end AXIS_PTS
/begin AXIS_PTS ADAC_OPDTgtAcceltnDeltaSpd_Y_kph "" 0x0000 /* @ECU_Address@ADAC_OPDTgtAcceltnDeltaSpd_Y_kph@ */ NO_INPUT_QUANTITY Lookup2D_X_FLOAT32_IEEE 0 AppSwcVcu_CM_single_kph 16 -300.0 300.0 /end AXIS_PTS
/begin CHARACTERISTIC MDAC_OPDTgtSpdChgRate_kphps "" CURVE 0x0000 /* @ECU_Address@MDAC_OPDTgtSpdChgRate_kphps@ */ Lookup1D_FLOAT32_IEEE 0 AppSwcVcu_CM_single_kphps 0.0 300.0
 /begin AXIS_DESCR COM_AXIS NO_INPUT_QUANTITY AppSwcVcu_CM_single_kph 11 -300.0 300.0 AXIS_PTS_REF ADAC_OPDTgtSpdChgRate_X_kph /end AXIS_DESCR
/end CHARACTERISTIC
/begin AXIS_PTS ADAC_OPDTgtSpdChgRate_X_kph "" 0x0000 /* @ECU_Address@ADAC_OPDTgtSpdChgRate_X_kph@ */ NO_INPUT_QUANTITY Lookup1D_X_FLOAT32_IEEE 0 AppSwcVcu_CM_single_kph 11 -300.0 300.0 /end AXIS_PTS
/begin CHARACTERISTIC MDAC_OPDTgtAcceltnFiltCoeff_rat "" CURVE 0x0000 /* @ECU_Address@MDAC_OPDTgtAcceltnFiltCoeff_rat@ */ Lookup1D_FLOAT32_IEEE 0 AppSwcVcu_CM_single_rat 0.0 1.0
 /begin AXIS_DESCR COM_AXIS NO_INPUT_QUANTITY AppSwcVcu_CM_single_mps2 11 -20.0 20.0 AXIS_PTS_REF ADAC_OPDTgtAcceltnFiltCoeff_X_mps2 /end AXIS_DESCR
/end CHARACTERISTIC
/begin AXIS_PTS ADAC_OPDTgtAcceltnFiltCoeff_X_mps2 "" 0x0000 /* @ECU_Address@ADAC_OPDTgtAcceltnFiltCoeff_X_mps2@ */ NO_INPUT_QUANTITY Lookup1D_X_FLOAT32_IEEE 0 AppSwcVcu_CM_single_mps2 11 -20.0 20.0 /end AXIS_PTS
/begin CHARACTERISTIC MDAC_OPDTgtAcceltnFiltCoeffInit_rat "" CURVE 0x0000 /* @ECU_Address@MDAC_OPDTgtAcceltnFiltCoeffInit_rat@ */ Lookup1D_FLOAT32_IEEE 0 AppSwcVcu_CM_single_rat 0.0 1.0
 /begin AXIS_DESCR COM_AXIS VDAC_OPDVehSpd_kph AppSwcVcu_CM_single_kph 6 -300.0 300.0 AXIS_PTS_REF ADAC_OPDTgtAcceltnFiltCoeffInit_X_kph /end AXIS_DESCR
/end CHARACTERISTIC
/begin AXIS_PTS ADAC_OPDTgtAcceltnFiltCoeffInit_X_kph "" 0x0000 /* @ECU_Address@ADAC_OPDTgtAcceltnFiltCoeffInit_X_kph@ */ VDAC_OPDVehSpd_kph Lookup1D_X_FLOAT32_IEEE 0 AppSwcVcu_CM_single_kph 6 -300.0 300.0 /end AXIS_PTS
/begin CHARACTERISTIC MDAC_OPDTgtSpd_kph "" MAP 0x0000 /* @ECU_Address@MDAC_OPDTgtSpd_kph@ */ Lookup2D_FLOAT32_IEEE 0 AppSwcVcu_CM_single_kph -100.0 300.0
 /begin AXIS_DESCR COM_AXIS NO_INPUT_QUANTITY AppSwcVcu_CM_single_pct 15 -100.0 100.0 AXIS_PTS_REF ADAC_OPDTgtSpd_Y_pct /end AXIS_DESCR
 /begin AXIS_DESCR COM_AXIS NO_INPUT_QUANTITY AppSwcVcu_CM_single_Nm 11 -10000.0 10000.0 AXIS_PTS_REF ADAC_OPDTgtSpd_X_Nm /end AXIS_DESCR
/end CHARACTERISTIC
/begin AXIS_PTS ADAC_OPDTgtSpd_X_Nm "" 0x0000 /* @ECU_Address@ADAC_OPDTgtSpd_X_Nm@ */ NO_INPUT_QUANTITY Lookup2D_X_FLOAT32_IEEE 0 AppSwcVcu_CM_single_Nm 11 -10000.0 10000.0 /end AXIS_PTS
/begin AXIS_PTS ADAC_OPDTgtSpd_Y_pct "" 0x0000 /* @ECU_Address@ADAC_OPDTgtSpd_Y_pct@ */ NO_INPUT_QUANTITY Lookup2D_X_FLOAT32_IEEE 0 AppSwcVcu_CM_single_pct 15 -100.0 100.0 /end AXIS_PTS
/begin CHARACTERISTIC MTQD_FwdPedMapNoCrpSnow_pct "" MAP 0x0000 /* @ECU_Address@MTQD_FwdPedMapNoCrpSnow_pct@ */ Lookup2D_FLOAT32_IEEE 0 AppSwcVcu_CM_single_pct -100.0 200.0
 /begin AXIS_DESCR COM_AXIS VTQD_AccelPedPstnRescl_pct AppSwcVcu_CM_single_pct 21 -100.0 200.0 AXIS_PTS_REF ATQD_FwdPedMapSnow_Y_pct /end AXIS_DESCR
 /begin AXIS_DESCR COM_AXIS VVTM_VehSpd_kph AppSwcVcu_CM_single_kph 2 -300.0 300.0 AXIS_PTS_REF ATQD_FwdPedMapNoCrpSnow_X_kph /end AXIS_DESCR
/end CHARACTERISTIC
/begin AXIS_PTS ATQD_FwdPedMapNoCrpSnow_X_kph "" 0x0000 /* @ECU_Address@ATQD_FwdPedMapNoCrpSnow_X_kph@ */ VVTM_VehSpd_kph Lookup2D_X_FLOAT32_IEEE 0 AppSwcVcu_CM_single_kph 2 -300.0 300.0 /end AXIS_PTS
/begin CHARACTERISTIC MTQD_FwdPedMapNoCrpEco_pct "" MAP 0x0000 /* @ECU_Address@MTQD_FwdPedMapNoCrpEco_pct@ */ Lookup2D_FLOAT32_IEEE 0 AppSwcVcu_CM_single_pct -100.0 200.0
 /begin AXIS_DESCR COM_AXIS VTQD_AccelPedPstnRescl_pct AppSwcVcu_CM_single_pct 21 -100.0 200.0 AXIS_PTS_REF ATQD_FwdPedMapEco_Y_pct /end AXIS_DESCR
 /begin AXIS_DESCR COM_AXIS VVTM_VehSpd_kph AppSwcVcu_CM_single_kph 2 -300.0 300.0 AXIS_PTS_REF ATQD_FwdPedMapNoCrpEco_X_kph /end AXIS_DESCR
/end CHARACTERISTIC
/begin AXIS_PTS ATQD_FwdPedMapNoCrpEco_X_kph "" 0x0000 /* @ECU_Address@ATQD_FwdPedMapNoCrpEco_X_kph@ */ VVTM_VehSpd_kph Lookup2D_X_FLOAT32_IEEE 0 AppSwcVcu_CM_single_kph 2 -300.0 300.0 /end AXIS_PTS
/begin CHARACTERISTIC MTQD_FwdPedMapNoCrpSpt_pct "" MAP 0x0000 /* @ECU_Address@MTQD_FwdPedMapNoCrpSpt_pct@ */ Lookup2D_FLOAT32_IEEE 0 AppSwcVcu_CM_single_pct -100.0 200.0
 /begin AXIS_DESCR COM_AXIS VTQD_AccelPedPstnRescl_pct AppSwcVcu_CM_single_pct 21 -100.0 200.0 AXIS_PTS_REF ATQD_FwdPedMapSpt_Y_pct /end AXIS_DESCR
 /begin AXIS_DESCR COM_AXIS VVTM_VehSpd_kph AppSwcVcu_CM_single_kph 2 -300.0 300.0 AXIS_PTS_REF ATQD_FwdPedMapNoCrpSpt_X_kph /end AXIS_DESCR
/end CHARACTERISTIC
/begin AXIS_PTS ATQD_FwdPedMapNoCrpSpt_X_kph "" 0x0000 /* @ECU_Address@ATQD_FwdPedMapNoCrpSpt_X_kph@ */ VVTM_VehSpd_kph Lookup2D_X_FLOAT32_IEEE 0 AppSwcVcu_CM_single_kph 2 -300.0 300.0 /end AXIS_PTS
/begin CHARACTERISTIC MTQD_FwdPedMapNoCrpNorm_pct "" MAP 0x0000 /* @ECU_Address@MTQD_FwdPedMapNoCrpNorm_pct@ */ Lookup2D_FLOAT32_IEEE 0 AppSwcVcu_CM_single_pct -100.0 200.0
 /begin AXIS_DESCR COM_AXIS VTQD_AccelPedPstnRescl_pct AppSwcVcu_CM_single_pct 21 -100.0 200.0 AXIS_PTS_REF ATQD_FwdPedMapNorm_Y_pct /end AXIS_DESCR
 /begin AXIS_DESCR COM_AXIS VVTM_VehSpd_kph AppSwcVcu_CM_single_kph 2 -300.0 300.0 AXIS_PTS_REF ATQD_FwdPedMapNoCrpNorm_X_kph /end AXIS_DESCR
/end CHARACTERISTIC
/begin AXIS_PTS ATQD_FwdPedMapNoCrpNorm_X_kph "" 0x0000 /* @ECU_Address@ATQD_FwdPedMapNoCrpNorm_X_kph@ */ VVTM_VehSpd_kph Lookup2D_X_FLOAT32_IEEE 0 AppSwcVcu_CM_single_kph 2 -300.0 300.0 /end AXIS_PTS
/begin CHARACTERISTIC MTQD_CstRegenTqReqWhlS_Nm "" CURVE 0x0000 /* @ECU_Address@MTQD_CstRegenTqReqWhlS_Nm@ */ Lookup1D_FLOAT32_IEEE 0 AppSwcVcu_CM_single_Nm -10000.0 10000.0
 /begin AXIS_DESCR COM_AXIS VVTM_VehSpd_kph AppSwcVcu_CM_single_kph 14 -300.0 300.0 AXIS_PTS_REF ATQD_CstRegenTqReqWhlD_X_kph /end AXIS_DESCR
/end CHARACTERISTIC
/begin AXIS_PTS ATQD_CstRegenTqReqWhlD_X_kph "" 0x0000 /* @ECU_Address@ATQD_CstRegenTqReqWhlD_X_kph@ */ VVTM_VehSpd_kph Lookup1D_X_FLOAT32_IEEE 0 AppSwcVcu_CM_single_kph 14 -300.0 300.0 /end AXIS_PTS
/begin CHARACTERISTIC MTQD_CstRegenTqReqWhlW_Nm "" CURVE 0x0000 /* @ECU_Address@MTQD_CstRegenTqReqWhlW_Nm@ */ Lookup1D_FLOAT32_IEEE 0 AppSwcVcu_CM_single_Nm -10000.0 10000.0
 /begin AXIS_DESCR COM_AXIS VVTM_VehSpd_kph AppSwcVcu_CM_single_kph 14 -300.0 300.0 AXIS_PTS_REF ATQD_CstRegenTqReqWhlD_X_kph /end AXIS_DESCR
/end CHARACTERISTIC
/begin CHARACTERISTIC MTQD_CstRegenTqReqWhlV_Nm "" CURVE 0x0000 /* @ECU_Address@MTQD_CstRegenTqReqWhlV_Nm@ */ Lookup1D_FLOAT32_IEEE 0 AppSwcVcu_CM_single_Nm -10000.0 10000.0
 /begin AXIS_DESCR COM_AXIS VVTM_VehSpd_kph AppSwcVcu_CM_single_kph 14 -300.0 300.0 AXIS_PTS_REF ATQD_CstRegenTqReqWhlV_X_kph /end AXIS_DESCR
/end CHARACTERISTIC
/begin AXIS_PTS ATQD_CstRegenTqReqWhlV_X_kph "" 0x0000 /* @ECU_Address@ATQD_CstRegenTqReqWhlV_X_kph@ */ VVTM_VehSpd_kph Lookup1D_X_FLOAT32_IEEE 0 AppSwcVcu_CM_single_kph 14 -300.0 300.0 /end AXIS_PTS
/begin CHARACTERISTIC MTQD_CstRegenTqReqWhlR_Nm "" CURVE 0x0000 /* @ECU_Address@MTQD_CstRegenTqReqWhlR_Nm@ */ Lookup1D_FLOAT32_IEEE 0 AppSwcVcu_CM_single_Nm -10000.0 10000.0
 /begin AXIS_DESCR COM_AXIS VVTM_VehSpd_kph AppSwcVcu_CM_single_kph 12 -300.0 300.0 AXIS_PTS_REF ATQD_CstRegenTqReqWhlR_X_kph /end AXIS_DESCR
/end CHARACTERISTIC
/begin AXIS_PTS ATQD_CstRegenTqReqWhlR_X_kph "" 0x0000 /* @ECU_Address@ATQD_CstRegenTqReqWhlR_X_kph@ */ VVTM_VehSpd_kph Lookup1D_X_FLOAT32_IEEE 0 AppSwcVcu_CM_single_kph 12 -300.0 300.0 /end AXIS_PTS
/begin CHARACTERISTIC MTQD_CstRegenEndPstnA_pct "" CURVE 0x0000 /* @ECU_Address@MTQD_CstRegenEndPstnA_pct@ */ Lookup1D_FLOAT32_IEEE 0 AppSwcVcu_CM_single_pct -100.0 200.0
 /begin AXIS_DESCR COM_AXIS VVTM_VehSpd_kph AppSwcVcu_CM_single_kph 15 -300.0 300.0 AXIS_PTS_REF ATQD_CstRegenEndPstn_X_kph /end AXIS_DESCR
/end CHARACTERISTIC
/begin AXIS_PTS ATQD_CstRegenEndPstn_X_kph "" 0x0000 /* @ECU_Address@ATQD_CstRegenEndPstn_X_kph@ */ VVTM_VehSpd_kph Lookup1D_X_FLOAT32_IEEE 0 AppSwcVcu_CM_single_kph 15 -300.0 300.0 /end AXIS_PTS
/begin CHARACTERISTIC MTQD_CstRegenEndPstnS_pct "" CURVE 0x0000 /* @ECU_Address@MTQD_CstRegenEndPstnS_pct@ */ Lookup1D_FLOAT32_IEEE 0 AppSwcVcu_CM_single_pct -100.0 200.0
 /begin AXIS_DESCR COM_AXIS VVTM_VehSpd_kph AppSwcVcu_CM_single_kph 15 -300.0 300.0 AXIS_PTS_REF ATQD_CstRegenEndPstn_X_kph /end AXIS_DESCR
/end CHARACTERISTIC
/begin CHARACTERISTIC MTQD_CstRegenEndPstnW_pct "" CURVE 0x0000 /* @ECU_Address@MTQD_CstRegenEndPstnW_pct@ */ Lookup1D_FLOAT32_IEEE 0 AppSwcVcu_CM_single_pct -100.0 200.0
 /begin AXIS_DESCR COM_AXIS VVTM_VehSpd_kph AppSwcVcu_CM_single_kph 15 -300.0 300.0 AXIS_PTS_REF ATQD_CstRegenEndPstn_X_kph /end AXIS_DESCR
/end CHARACTERISTIC
/begin CHARACTERISTIC MTQD_CstRegenEndPstnV_pct "" CURVE 0x0000 /* @ECU_Address@MTQD_CstRegenEndPstnV_pct@ */ Lookup1D_FLOAT32_IEEE 0 AppSwcVcu_CM_single_pct -100.0 200.0
 /begin AXIS_DESCR COM_AXIS VVTM_VehSpd_kph AppSwcVcu_CM_single_kph 14 -300.0 300.0 AXIS_PTS_REF ATQD_CstRegenEndPstnV_X_kph /end AXIS_DESCR
/end CHARACTERISTIC
/begin AXIS_PTS ATQD_CstRegenEndPstnV_X_kph "" 0x0000 /* @ECU_Address@ATQD_CstRegenEndPstnV_X_kph@ */ VVTM_VehSpd_kph Lookup1D_X_FLOAT32_IEEE 0 AppSwcVcu_CM_single_kph 14 -300.0 300.0 /end AXIS_PTS
/begin CHARACTERISTIC MDAC_ACCDsrdTqKi_c "" MAP 0x0000 /* @ECU_Address@MDAC_ACCDsrdTqKi_c@ */ Lookup2D_FLOAT32_IEEE 0 AppSwcVcu_CM_single_c 0.0 100000.0
 /begin AXIS_DESCR COM_AXIS VDAC_ACCDeltaAcceltn_mps2 AppSwcVcu_CM_single_mps2 15 -20.0 20.0 AXIS_PTS_REF ADAC_ACCDsrdTqKi_Y_mps2 /end AXIS_DESCR
 /begin AXIS_DESCR COM_AXIS NO_INPUT_QUANTITY AppSwcVcu_CM_single_N 15 -100000.0 100000.0 AXIS_PTS_REF ADAC_ACCDsrdTqKi_X_N /end AXIS_DESCR
/end CHARACTERISTIC
/begin AXIS_PTS ADAC_ACCDsrdTqKi_X_N "" 0x0000 /* @ECU_Address@ADAC_ACCDsrdTqKi_X_N@ */ NO_INPUT_QUANTITY Lookup2D_X_FLOAT32_IEEE 0 AppSwcVcu_CM_single_N 15 -100000.0 100000.0 /end AXIS_PTS
/begin AXIS_PTS ADAC_ACCDsrdTqKi_Y_mps2 "" 0x0000 /* @ECU_Address@ADAC_ACCDsrdTqKi_Y_mps2@ */ VDAC_ACCDeltaAcceltn_mps2 Lookup2D_X_FLOAT32_IEEE 0 AppSwcVcu_CM_single_mps2 15 -20.0 20.0 /end AXIS_PTS
/begin CHARACTERISTIC MDAC_ACCDsrdTqKp_c "" CURVE 0x0000 /* @ECU_Address@MDAC_ACCDsrdTqKp_c@ */ Lookup1D_FLOAT32_IEEE 0 AppSwcVcu_CM_single_c 0.0 100000.0
 /begin AXIS_DESCR COM_AXIS VDAC_ACCDeltaAcceltn_mps2 AppSwcVcu_CM_single_mps2 15 -20.0 20.0 AXIS_PTS_REF ADAC_ACCDsrdTqKp_X_mps2 /end AXIS_DESCR
/end CHARACTERISTIC
/begin AXIS_PTS ADAC_ACCDsrdTqKp_X_mps2 "" 0x0000 /* @ECU_Address@ADAC_ACCDsrdTqKp_X_mps2@ */ VDAC_ACCDeltaAcceltn_mps2 Lookup1D_X_FLOAT32_IEEE 0 AppSwcVcu_CM_single_mps2 15 -20.0 20.0 /end AXIS_PTS
/begin CHARACTERISTIC MDAC_HDCTgtAcceltn_mps2 "" CURVE 0x0000 /* @ECU_Address@MDAC_HDCTgtAcceltn_mps2@ */ Lookup1D_FLOAT32_IEEE 0 AppSwcVcu_CM_single_mps2 -20.0 20.0
 /begin AXIS_DESCR COM_AXIS NO_INPUT_QUANTITY AppSwcVcu_CM_single_kph 16 -300.0 300.0 AXIS_PTS_REF ADAC_HDCTgtAcceltnDeltaSpd_X_kph /end AXIS_DESCR
/end CHARACTERISTIC
/begin AXIS_PTS ADAC_HDCTgtAcceltnDeltaSpd_X_kph "" 0x0000 /* @ECU_Address@ADAC_HDCTgtAcceltnDeltaSpd_X_kph@ */ NO_INPUT_QUANTITY Lookup1D_X_FLOAT32_IEEE 0 AppSwcVcu_CM_single_kph 16 -300.0 300.0 /end AXIS_PTS
/begin CHARACTERISTIC MDAC_HDCDsrdTqKi_c "" MAP 0x0000 /* @ECU_Address@MDAC_HDCDsrdTqKi_c@ */ Lookup2D_FLOAT32_IEEE 0 AppSwcVcu_CM_single_c 0.0 100000.0
 /begin AXIS_DESCR COM_AXIS VDAC_HDCDeltaAcceltn_mps2 AppSwcVcu_CM_single_mps2 15 -20.0 20.0 AXIS_PTS_REF ADAC_HDCDsrdTqKi_Y_mps2 /end AXIS_DESCR
 /begin AXIS_DESCR COM_AXIS NO_INPUT_QUANTITY AppSwcVcu_CM_single_N 15 -100000.0 100000.0 AXIS_PTS_REF ADAC_HDCDsrdTqKi_X_N /end AXIS_DESCR
/end CHARACTERISTIC
/begin AXIS_PTS ADAC_HDCDsrdTqKi_X_N "" 0x0000 /* @ECU_Address@ADAC_HDCDsrdTqKi_X_N@ */ NO_INPUT_QUANTITY Lookup2D_X_FLOAT32_IEEE 0 AppSwcVcu_CM_single_N 15 -100000.0 100000.0 /end AXIS_PTS
/begin AXIS_PTS ADAC_HDCDsrdTqKi_Y_mps2 "" 0x0000 /* @ECU_Address@ADAC_HDCDsrdTqKi_Y_mps2@ */ VDAC_HDCDeltaAcceltn_mps2 Lookup2D_X_FLOAT32_IEEE 0 AppSwcVcu_CM_single_mps2 15 -20.0 20.0 /end AXIS_PTS
/begin CHARACTERISTIC MDAC_HDCDsrdTqKp_c "" CURVE 0x0000 /* @ECU_Address@MDAC_HDCDsrdTqKp_c@ */ Lookup1D_FLOAT32_IEEE 0 AppSwcVcu_CM_single_c 0.0 100000.0
 /begin AXIS_DESCR COM_AXIS VDAC_HDCDeltaAcceltn_mps2 AppSwcVcu_CM_single_mps2 15 -20.0 20.0 AXIS_PTS_REF ADAC_HDCDsrdTqKp_X_mps2 /end AXIS_DESCR
/end CHARACTERISTIC
/begin AXIS_PTS ADAC_HDCDsrdTqKp_X_mps2 "" 0x0000 /* @ECU_Address@ADAC_HDCDsrdTqKp_X_mps2@ */ VDAC_HDCDeltaAcceltn_mps2 Lookup1D_X_FLOAT32_IEEE 0 AppSwcVcu_CM_single_mps2 15 -20.0 20.0 /end AXIS_PTS
/begin CHARACTERISTIC MDAC_OPDDsrdTqKi_c "" MAP 0x0000 /* @ECU_Address@MDAC_OPDDsrdTqKi_c@ */ Lookup2D_FLOAT32_IEEE 0 AppSwcVcu_CM_single_c 0.0 100000.0
 /begin AXIS_DESCR COM_AXIS VDAC_OPDDeltaAcceltn_mps2 AppSwcVcu_CM_single_mps2 15 -20.0 20.0 AXIS_PTS_REF ADAC_OPDDsrdTqKi_Y_mps2 /end AXIS_DESCR
 /begin AXIS_DESCR COM_AXIS NO_INPUT_QUANTITY AppSwcVcu_CM_single_N 15 -100000.0 100000.0 AXIS_PTS_REF ADAC_OPDDsrdTqKi_X_N /end AXIS_DESCR
/end CHARACTERISTIC
/begin AXIS_PTS ADAC_OPDDsrdTqKi_X_N "" 0x0000 /* @ECU_Address@ADAC_OPDDsrdTqKi_X_N@ */ NO_INPUT_QUANTITY Lookup2D_X_FLOAT32_IEEE 0 AppSwcVcu_CM_single_N 15 -100000.0 100000.0 /end AXIS_PTS
/begin AXIS_PTS ADAC_OPDDsrdTqKi_Y_mps2 "" 0x0000 /* @ECU_Address@ADAC_OPDDsrdTqKi_Y_mps2@ */ VDAC_OPDDeltaAcceltn_mps2 Lookup2D_X_FLOAT32_IEEE 0 AppSwcVcu_CM_single_mps2 15 -20.0 20.0 /end AXIS_PTS
/begin CHARACTERISTIC MDAC_OPDDsrdTqKi2_c "" MAP 0x0000 /* @ECU_Address@MDAC_OPDDsrdTqKi2_c@ */ Lookup2D_FLOAT32_IEEE 0 AppSwcVcu_CM_single_c 0.0 100000.0
 /begin AXIS_DESCR COM_AXIS VDAC_OPDDeltaSpd_kph AppSwcVcu_CM_single_kph 12 -300.0 300.0 AXIS_PTS_REF ADAC_OPDDsrdTqKi2_Y_kph /end AXIS_DESCR
 /begin AXIS_DESCR COM_AXIS NO_INPUT_QUANTITY AppSwcVcu_CM_single_N 9 -100000.0 100000.0 AXIS_PTS_REF ADAC_OPDDsrdTqKi2_X_N /end AXIS_DESCR
/end CHARACTERISTIC
/begin AXIS_PTS ADAC_OPDDsrdTqKi2_X_N "" 0x0000 /* @ECU_Address@ADAC_OPDDsrdTqKi2_X_N@ */ NO_INPUT_QUANTITY Lookup2D_X_FLOAT32_IEEE 0 AppSwcVcu_CM_single_N 9 -100000.0 100000.0 /end AXIS_PTS
/begin AXIS_PTS ADAC_OPDDsrdTqKi2_Y_kph "" 0x0000 /* @ECU_Address@ADAC_OPDDsrdTqKi2_Y_kph@ */ VDAC_OPDDeltaSpd_kph Lookup2D_X_FLOAT32_IEEE 0 AppSwcVcu_CM_single_kph 12 -300.0 300.0 /end AXIS_PTS
/begin CHARACTERISTIC MDAC_OPDDsrdTqKp_c "" CURVE 0x0000 /* @ECU_Address@MDAC_OPDDsrdTqKp_c@ */ Lookup1D_FLOAT32_IEEE 0 AppSwcVcu_CM_single_c 0.0 100000.0
 /begin AXIS_DESCR COM_AXIS VDAC_OPDDeltaAcceltn_mps2 AppSwcVcu_CM_single_mps2 15 -20.0 20.0 AXIS_PTS_REF ADAC_OPDDsrdTqKp_X_mps2 /end AXIS_DESCR
/end CHARACTERISTIC
/begin AXIS_PTS ADAC_OPDDsrdTqKp_X_mps2 "" 0x0000 /* @ECU_Address@ADAC_OPDDsrdTqKp_X_mps2@ */ VDAC_OPDDeltaAcceltn_mps2 Lookup1D_X_FLOAT32_IEEE 0 AppSwcVcu_CM_single_mps2 15 -20.0 20.0 /end AXIS_PTS
/begin CHARACTERISTIC MDAC_OPDDsrdTqKp2_c "" CURVE 0x0000 /* @ECU_Address@MDAC_OPDDsrdTqKp2_c@ */ Lookup1D_FLOAT32_IEEE 0 AppSwcVcu_CM_single_c 0.0 100000.0
 /begin AXIS_DESCR COM_AXIS VDAC_OPDDeltaSpd_kph AppSwcVcu_CM_single_kph 12 -300.0 300.0 AXIS_PTS_REF ADAC_OPDDsrdTqKp2_X_kph /end AXIS_DESCR
/end CHARACTERISTIC
/begin AXIS_PTS ADAC_OPDDsrdTqKp2_X_kph "" 0x0000 /* @ECU_Address@ADAC_OPDDsrdTqKp2_X_kph@ */ VDAC_OPDDeltaSpd_kph Lookup1D_X_FLOAT32_IEEE 0 AppSwcVcu_CM_single_kph 12 -300.0 300.0 /end AXIS_PTS
/begin CHARACTERISTIC MDAC_OPDDsrdTqKd_c "" CURVE 0x0000 /* @ECU_Address@MDAC_OPDDsrdTqKd_c@ */ Lookup1D_FLOAT32_IEEE 0 AppSwcVcu_CM_single_c 0.0 100000.0
 /begin AXIS_DESCR COM_AXIS NO_INPUT_QUANTITY AppSwcVcu_CM_single_mps2 12 -20.0 20.0 AXIS_PTS_REF ADAC_OPDDsrdTqKd_X_mps2 /end AXIS_DESCR
/end CHARACTERISTIC
/begin AXIS_PTS ADAC_OPDDsrdTqKd_X_mps2 "" 0x0000 /* @ECU_Address@ADAC_OPDDsrdTqKd_X_mps2@ */ NO_INPUT_QUANTITY Lookup1D_X_FLOAT32_IEEE 0 AppSwcVcu_CM_single_mps2 12 -20.0 20.0 /end AXIS_PTS
/begin CHARACTERISTIC MDAC_OPDTqReqWhlRate_Nmps "" CURVE 0x0000 /* @ECU_Address@MDAC_OPDTqReqWhlRate_Nmps@ */ Lookup1D_FLOAT32_IEEE 0 AppSwcVcu_CM_single_Nmps 0.0 100000.0
 /begin AXIS_DESCR COM_AXIS NO_INPUT_QUANTITY AppSwcVcu_CM_single_Nm 11 -10000.0 10000.0 AXIS_PTS_REF ADAC_OPDTqReqWhlRate_X_Nm /end AXIS_DESCR
/end CHARACTERISTIC
/begin AXIS_PTS ADAC_OPDTqReqWhlRate_X_Nm "" 0x0000 /* @ECU_Address@ADAC_OPDTqReqWhlRate_X_Nm@ */ NO_INPUT_QUANTITY Lookup1D_X_FLOAT32_IEEE 0 AppSwcVcu_CM_single_Nm 11 -10000.0 10000.0 /end AXIS_PTS
/begin CHARACTERISTIC MTQD_AdaptCstMinTqWhl_Nm "" CURVE 0x0000 /* @ECU_Address@MTQD_AdaptCstMinTqWhl_Nm@ */ Lookup1D_FLOAT32_IEEE 0 AppSwcVcu_CM_single_Nm -10000.0 10000.0
 /begin AXIS_DESCR COM_AXIS VVTM_VehSpd_kph AppSwcVcu_CM_single_kph 14 -300.0 300.0 AXIS_PTS_REF ATQD_AdaptCstVehSpd_X_kph /end AXIS_DESCR
/end CHARACTERISTIC
/begin AXIS_PTS ATQD_AdaptCstVehSpd_X_kph "" 0x0000 /* @ECU_Address@ATQD_AdaptCstVehSpd_X_kph@ */ VVTM_VehSpd_kph Lookup1D_X_FLOAT32_IEEE 0 AppSwcVcu_CM_single_kph 14 -300.0 300.0 /end AXIS_PTS
/begin CHARACTERISTIC MTQD_AdaptCstMaxTqWhl_Nm "" CURVE 0x0000 /* @ECU_Address@MTQD_AdaptCstMaxTqWhl_Nm@ */ Lookup1D_FLOAT32_IEEE 0 AppSwcVcu_CM_single_Nm -10000.0 10000.0
 /begin AXIS_DESCR COM_AXIS VVTM_VehSpd_kph AppSwcVcu_CM_single_kph 14 -300.0 300.0 AXIS_PTS_REF ATQD_AdaptCstVehSpd_X_kph /end AXIS_DESCR
/end CHARACTERISTIC
/begin CHARACTERISTIC MTQD_CstRegenTqReqWhlInc_Nmps "" CURVE 0x0000 /* @ECU_Address@MTQD_CstRegenTqReqWhlInc_Nmps@ */ Lookup1D_FLOAT32_IEEE 0 AppSwcVcu_CM_single_Nmps 0.0 100000.0
 /begin AXIS_DESCR COM_AXIS NO_INPUT_QUANTITY AppSwcVcu_CM_single_pct 8 -100.0 100.0 AXIS_PTS_REF ATQD_CstRegenRateAccPed_X_pct /end AXIS_DESCR
/end CHARACTERISTIC
/begin AXIS_PTS ATQD_CstRegenRateAccPed_X_pct "" 0x0000 /* @ECU_Address@ATQD_CstRegenRateAccPed_X_pct@ */ NO_INPUT_QUANTITY Lookup1D_X_FLOAT32_IEEE 0 AppSwcVcu_CM_single_pct 8 -100.0 100.0 /end AXIS_PTS
/begin CHARACTERISTIC MDAC_CCDsrdAcceltn_mps2 "" MAP 0x0000 /* @ECU_Address@MDAC_CCDsrdAcceltn_mps2@ */ Lookup2D_FLOAT32_IEEE 0 AppSwcVcu_CM_single_mps2 -10.0 10.0
 /begin AXIS_DESCR COM_AXIS NO_INPUT_QUANTITY AppSwcVcu_CM_single_kph 21 -300.0 300.0 AXIS_PTS_REF ADAC_CCDsrdAcceltnDeltaSpd_X_kph /end AXIS_DESCR
 /begin AXIS_DESCR COM_AXIS VVTM_VehSpd_kph AppSwcVcu_CM_single_kph 6 -300.0 300.0 AXIS_PTS_REF ADAC_CCDsrdAcceltnSpd_X_kph /end AXIS_DESCR
/end CHARACTERISTIC
/begin AXIS_PTS ADAC_CCDsrdAcceltnSpd_X_kph "" 0x0000 /* @ECU_Address@ADAC_CCDsrdAcceltnSpd_X_kph@ */ VVTM_VehSpd_kph Lookup2D_X_FLOAT32_IEEE 0 AppSwcVcu_CM_single_kph 6 -300.0 300.0 /end AXIS_PTS
/begin AXIS_PTS ADAC_CCDsrdAcceltnDeltaSpd_X_kph "" 0x0000 /* @ECU_Address@ADAC_CCDsrdAcceltnDeltaSpd_X_kph@ */ NO_INPUT_QUANTITY Lookup2D_X_FLOAT32_IEEE 0 AppSwcVcu_CM_single_kph 21 -300.0 300.0 /end AXIS_PTS
/begin CHARACTERISTIC MDAC_CCSpdStabUpprOfst_kph "" CURVE 0x0000 /* @ECU_Address@MDAC_CCSpdStabUpprOfst_kph@ */ Lookup1D_FLOAT32_IEEE 0 AppSwcVcu_CM_single_kph 0.0 300.0
 /begin AXIS_DESCR COM_AXIS NO_INPUT_QUANTITY AppSwcVcu_CM_single_kph 8 -300.0 300.0 AXIS_PTS_REF ADAC_CCSpdStabOfst_X_kph /end AXIS_DESCR
/end CHARACTERISTIC
/begin AXIS_PTS ADAC_CCSpdStabOfst_X_kph "" 0x0000 /* @ECU_Address@ADAC_CCSpdStabOfst_X_kph@ */ NO_INPUT_QUANTITY Lookup1D_X_FLOAT32_IEEE 0 AppSwcVcu_CM_single_kph 8 -300.0 300.0 /end AXIS_PTS
/begin CHARACTERISTIC MDAC_CCSpdStabLowerOfst_kph "" CURVE 0x0000 /* @ECU_Address@MDAC_CCSpdStabLowerOfst_kph@ */ Lookup1D_FLOAT32_IEEE 0 AppSwcVcu_CM_single_kph 0.0 300.0
 /begin AXIS_DESCR COM_AXIS NO_INPUT_QUANTITY AppSwcVcu_CM_single_kph 8 -300.0 300.0 AXIS_PTS_REF ADAC_CCSpdStabOfst_X_kph /end AXIS_DESCR
/end CHARACTERISTIC
/begin CHARACTERISTIC MDAC_OPDMaxDrvTqWhl_Nm "" CURVE 0x0000 /* @ECU_Address@MDAC_OPDMaxDrvTqWhl_Nm@ */ Lookup1D_FLOAT32_IEEE 0 AppSwcVcu_CM_single_Nm 0.0 10000.0
 /begin AXIS_DESCR COM_AXIS VDAC_OPDVehSpd_kph AppSwcVcu_CM_single_kph 7 -300.0 300.0 AXIS_PTS_REF ADAC_OPDMaxDrvTqWhl_X_kph /end AXIS_DESCR
/end CHARACTERISTIC
/begin AXIS_PTS ADAC_OPDMaxDrvTqWhl_X_kph "" 0x0000 /* @ECU_Address@ADAC_OPDMaxDrvTqWhl_X_kph@ */ VDAC_OPDVehSpd_kph Lookup1D_X_FLOAT32_IEEE 0 AppSwcVcu_CM_single_kph 7 -300.0 300.0 /end AXIS_PTS
/begin CHARACTERISTIC MDAC_OPDMaxDrgTqWhl_Nm "" CURVE 0x0000 /* @ECU_Address@MDAC_OPDMaxDrgTqWhl_Nm@ */ Lookup1D_FLOAT32_IEEE 0 AppSwcVcu_CM_single_Nm -10000.0 0.0
 /begin AXIS_DESCR COM_AXIS VDAC_OPDVehSpd_kph AppSwcVcu_CM_single_kph 7 -300.0 300.0 AXIS_PTS_REF ADAC_OPDMaxDrvTqWhl_X_kph /end AXIS_DESCR
/end CHARACTERISTIC
/begin CHARACTERISTIC MDAC_OPDDsrdTqFastIAcc_mps2 "" CURVE 0x0000 /* @ECU_Address@MDAC_OPDDsrdTqFastIAcc_mps2@ */ Lookup1D_FLOAT32_IEEE 0 AppSwcVcu_CM_single_mps2 -20.0 20.0
 /begin AXIS_DESCR COM_AXIS VDAC_OPDVehSpd_kph AppSwcVcu_CM_single_kph 6 -100.0 300.0 AXIS_PTS_REF ADAC_OPDDsrdTqFastIAcc_X_kph /end AXIS_DESCR
/end CHARACTERISTIC
/begin AXIS_PTS ADAC_OPDDsrdTqFastIAcc_X_kph "" 0x0000 /* @ECU_Address@ADAC_OPDDsrdTqFastIAcc_X_kph@ */ VDAC_OPDVehSpd_kph Lookup1D_X_FLOAT32_IEEE 0 AppSwcVcu_CM_single_kph 6 -100.0 300.0 /end AXIS_PTS
/begin CHARACTERISTIC MTQD_AdaptCstDsrdTqKi_c "" MAP 0x0000 /* @ECU_Address@MTQD_AdaptCstDsrdTqKi_c@ */ Lookup2D_FLOAT32_IEEE 0 AppSwcVcu_CM_single_c 0.0 100000.0
 /begin AXIS_DESCR COM_AXIS VTQD_AdaptCstDeltaAcceltn_mps2 AppSwcVcu_CM_single_mps2 15 -20.0 20.0 AXIS_PTS_REF ATQD_AdaptCstDsrdTqKi_Y_mps2 /end AXIS_DESCR
 /begin AXIS_DESCR COM_AXIS NO_INPUT_QUANTITY AppSwcVcu_CM_single_N 15 -100000.0 100000.0 AXIS_PTS_REF ATQD_AdaptCstDsrdTqKi_X_N /end AXIS_DESCR
/end CHARACTERISTIC
/begin AXIS_PTS ATQD_AdaptCstDsrdTqKi_X_N "" 0x0000 /* @ECU_Address@ATQD_AdaptCstDsrdTqKi_X_N@ */ NO_INPUT_QUANTITY Lookup2D_X_FLOAT32_IEEE 0 AppSwcVcu_CM_single_N 15 -100000.0 100000.0 /end AXIS_PTS
/begin AXIS_PTS ATQD_AdaptCstDsrdTqKi_Y_mps2 "" 0x0000 /* @ECU_Address@ATQD_AdaptCstDsrdTqKi_Y_mps2@ */ VTQD_AdaptCstDeltaAcceltn_mps2 Lookup2D_X_FLOAT32_IEEE 0 AppSwcVcu_CM_single_mps2 15 -20.0 20.0 /end AXIS_PTS
/begin CHARACTERISTIC MTQD_AdaptCstDsrdTqKp_c "" CURVE 0x0000 /* @ECU_Address@MTQD_AdaptCstDsrdTqKp_c@ */ Lookup1D_FLOAT32_IEEE 0 AppSwcVcu_CM_single_c 0.0 100000.0
 /begin AXIS_DESCR COM_AXIS VTQD_AdaptCstDeltaAcceltn_mps2 AppSwcVcu_CM_single_mps2 15 -20.0 20.0 AXIS_PTS_REF ATQD_AdaptCstDsrdTqKp_X_mps2 /end AXIS_DESCR
/end CHARACTERISTIC
/begin AXIS_PTS ATQD_AdaptCstDsrdTqKp_X_mps2 "" 0x0000 /* @ECU_Address@ATQD_AdaptCstDsrdTqKp_X_mps2@ */ VTQD_AdaptCstDeltaAcceltn_mps2 Lookup1D_X_FLOAT32_IEEE 0 AppSwcVcu_CM_single_mps2 15 -20.0 20.0 /end AXIS_PTS
/begin CHARACTERISTIC MTQD_AdaptCstAcceltnReqWhlS_mps2 "" CURVE 0x0000 /* @ECU_Address@MTQD_AdaptCstAcceltnReqWhlS_mps2@ */ Lookup1D_FLOAT32_IEEE 0 AppSwcVcu_CM_single_mps2 -20.0 20.0
 /begin AXIS_DESCR COM_AXIS VVTM_VehSpd_kph AppSwcVcu_CM_single_kph 14 -300.0 300.0 AXIS_PTS_REF ATQD_AdaptCstVehSpd_X_kph /end AXIS_DESCR
/end CHARACTERISTIC
/begin CHARACTERISTIC MTQD_AdaptCstAcceltnReqWhlW_mps2 "" CURVE 0x0000 /* @ECU_Address@MTQD_AdaptCstAcceltnReqWhlW_mps2@ */ Lookup1D_FLOAT32_IEEE 0 AppSwcVcu_CM_single_mps2 -20.0 20.0
 /begin AXIS_DESCR COM_AXIS VVTM_VehSpd_kph AppSwcVcu_CM_single_kph 14 -300.0 300.0 AXIS_PTS_REF ATQD_AdaptCstVehSpd_X_kph /end AXIS_DESCR
/end CHARACTERISTIC
/begin CHARACTERISTIC MTQD_AdaptCstAcceltnReqWhlEndPstn_mps2 "" CURVE 0x0000 /* @ECU_Address@MTQD_AdaptCstAcceltnReqWhlEndPstn_mps2@ */ Lookup1D_FLOAT32_IEEE 0 AppSwcVcu_CM_single_mps2 -20.0 20.0
 /begin AXIS_DESCR COM_AXIS VVTM_VehSpd_kph AppSwcVcu_CM_single_kph 14 -300.0 300.0 AXIS_PTS_REF ATQD_AdaptCstVehSpd_X_kph /end AXIS_DESCR
/end CHARACTERISTIC
/begin CHARACTERISTIC MDAC_CCDsrdTqKi_c "" MAP 0x0000 /* @ECU_Address@MDAC_CCDsrdTqKi_c@ */ Lookup2D_FLOAT32_IEEE 0 AppSwcVcu_CM_single_c 0.0 100000.0
 /begin AXIS_DESCR COM_AXIS VDAC_CCDeltaAcceltn_mps2 AppSwcVcu_CM_single_mps2 15 -20.0 20.0 AXIS_PTS_REF ADAC_CCDsrdTqKi_Y_mps2 /end AXIS_DESCR
 /begin AXIS_DESCR COM_AXIS NO_INPUT_QUANTITY AppSwcVcu_CM_single_N 15 -100000.0 100000.0 AXIS_PTS_REF ADAC_CCDsrdTqKi_X_N /end AXIS_DESCR
/end CHARACTERISTIC
/begin AXIS_PTS ADAC_CCDsrdTqKi_X_N "" 0x0000 /* @ECU_Address@ADAC_CCDsrdTqKi_X_N@ */ NO_INPUT_QUANTITY Lookup2D_X_FLOAT32_IEEE 0 AppSwcVcu_CM_single_N 15 -100000.0 100000.0 /end AXIS_PTS
/begin AXIS_PTS ADAC_CCDsrdTqKi_Y_mps2 "" 0x0000 /* @ECU_Address@ADAC_CCDsrdTqKi_Y_mps2@ */ VDAC_CCDeltaAcceltn_mps2 Lookup2D_X_FLOAT32_IEEE 0 AppSwcVcu_CM_single_mps2 15 -20.0 20.0 /end AXIS_PTS
/begin CHARACTERISTIC MDAC_CCDsrdTqKp_c "" CURVE 0x0000 /* @ECU_Address@MDAC_CCDsrdTqKp_c@ */ Lookup1D_FLOAT32_IEEE 0 AppSwcVcu_CM_single_c 0.0 100000.0
 /begin AXIS_DESCR COM_AXIS VDAC_CCDeltaAcceltn_mps2 AppSwcVcu_CM_single_mps2 15 -20.0 20.0 AXIS_PTS_REF ADAC_CCDsrdTqKp_X_mps2 /end AXIS_DESCR
/end CHARACTERISTIC
/begin AXIS_PTS ADAC_CCDsrdTqKp_X_mps2 "" 0x0000 /* @ECU_Address@ADAC_CCDsrdTqKp_X_mps2@ */ VDAC_CCDeltaAcceltn_mps2 Lookup1D_X_FLOAT32_IEEE 0 AppSwcVcu_CM_single_mps2 15 -20.0 20.0 /end AXIS_PTS
/begin CHARACTERISTIC MDAC_CCMaxDrgTqWhl_Nm "" CURVE 0x0000 /* @ECU_Address@MDAC_CCMaxDrgTqWhl_Nm@ */ Lookup1D_FLOAT32_IEEE 0 AppSwcVcu_CM_single_Nm -10000.0 0.0
 /begin AXIS_DESCR COM_AXIS VVTM_VehSpd_kph AppSwcVcu_CM_single_kph 14 -300.0 300.0 AXIS_PTS_REF ADAC_CCMaxDrgTqWhl_X_kph /end AXIS_DESCR
/end CHARACTERISTIC
/begin AXIS_PTS ADAC_CCMaxDrgTqWhl_X_kph "" 0x0000 /* @ECU_Address@ADAC_CCMaxDrgTqWhl_X_kph@ */ VVTM_VehSpd_kph Lookup1D_X_FLOAT32_IEEE 0 AppSwcVcu_CM_single_kph 14 -300.0 300.0 /end AXIS_PTS
/begin CHARACTERISTIC KDAC_ABSActvDlyTm4CC_s "" VALUE 0x0000 /* @ECU_Address@KDAC_ABSActvDlyTm4CC_s@ */ Scalar_FLOAT32_IEEE 0 AppSwcVcu_CM_single_s 0.0 600.0 /end CHARACTERISTIC
/begin CHARACTERISTIC KDAC_ACCDsrdTqIMax_N "" VALUE 0x0000 /* @ECU_Address@KDAC_ACCDsrdTqIMax_N@ */ Scalar_FLOAT32_IEEE 0 AppSwcVcu_CM_single_N 0.0 100000.0 /end CHARACTERISTIC
/begin CHARACTERISTIC KDAC_ACCDsrdTqIMin_N "" VALUE 0x0000 /* @ECU_Address@KDAC_ACCDsrdTqIMin_N@ */ Scalar_FLOAT32_IEEE 0 AppSwcVcu_CM_single_N -100000.0 0.0 /end CHARACTERISTIC
/begin CHARACTERISTIC KDAC_AccReqStopAllwdSpd_kph "" VALUE 0x0000 /* @ECU_Address@KDAC_AccReqStopAllwdSpd_kph@ */ Scalar_FLOAT32_IEEE 0 AppSwcVcu_CM_single_kph -300.0 300.0 /end CHARACTERISTIC
/begin CHARACTERISTIC KDAC_AutoHoldIntvDlyTm_s "" VALUE 0x0000 /* @ECU_Address@KDAC_AutoHoldIntvDlyTm_s@ */ Scalar_FLOAT32_IEEE 0 AppSwcVcu_CM_single_s 0.0 3600.0 /end CHARACTERISTIC
/begin CHARACTERISTIC KDAC_CCAccelPedPrsdOff_pct "" VALUE 0x0000 /* @ECU_Address@KDAC_CCAccelPedPrsdOff_pct@ */ Scalar_FLOAT32_IEEE 0 AppSwcVcu_CM_single_pct -100.0 200.0 /end CHARACTERISTIC
/begin CHARACTERISTIC KDAC_CCAccelPedPrsdOn_pct "" VALUE 0x0000 /* @ECU_Address@KDAC_CCAccelPedPrsdOn_pct@ */ Scalar_FLOAT32_IEEE 0 AppSwcVcu_CM_single_pct -100.0 200.0 /end CHARACTERISTIC
/begin CHARACTERISTIC KDAC_CCDsrdAcceltnMax_mps2 "" VALUE 0x0000 /* @ECU_Address@KDAC_CCDsrdAcceltnMax_mps2@ */ Scalar_FLOAT32_IEEE 0 AppSwcVcu_CM_single_mps2 0.0 20.0 /end CHARACTERISTIC
/begin CHARACTERISTIC KDAC_CCDsrdAcceltnMin_mps2 "" VALUE 0x0000 /* @ECU_Address@KDAC_CCDsrdAcceltnMin_mps2@ */ Scalar_FLOAT32_IEEE 0 AppSwcVcu_CM_single_mps2 -20.0 0.0 /end CHARACTERISTIC
/begin CHARACTERISTIC KDAC_CCDsrdTqDecIDlyTm_s "" VALUE 0x0000 /* @ECU_Address@KDAC_CCDsrdTqDecIDlyTm_s@ */ Scalar_FLOAT32_IEEE 0 AppSwcVcu_CM_single_s 0.0 36000.0 /end CHARACTERISTIC
/begin CHARACTERISTIC KDAC_CCDsrdTqIMax_N "" VALUE 0x0000 /* @ECU_Address@KDAC_CCDsrdTqIMax_N@ */ Scalar_FLOAT32_IEEE 0 AppSwcVcu_CM_single_N 0.0 100000.0 /end CHARACTERISTIC
/begin CHARACTERISTIC KDAC_CCDsrdTqIMin_N "" VALUE 0x0000 /* @ECU_Address@KDAC_CCDsrdTqIMin_N@ */ Scalar_FLOAT32_IEEE 0 AppSwcVcu_CM_single_N -100000.0 0.0 /end CHARACTERISTIC
/begin CHARACTERISTIC KDAC_CCDsrdTqIncIDlyTm_s "" VALUE 0x0000 /* @ECU_Address@KDAC_CCDsrdTqIncIDlyTm_s@ */ Scalar_FLOAT32_IEEE 0 AppSwcVcu_CM_single_s 0.0 36000.0 /end CHARACTERISTIC
/begin CHARACTERISTIC KDAC_CCHldISpdOverOff_kph "" VALUE 0x0000 /* @ECU_Address@KDAC_CCHldISpdOverOff_kph@ */ Scalar_FLOAT32_IEEE 0 AppSwcVcu_CM_single_kph -300.0 300.0 /end CHARACTERISTIC
/begin CHARACTERISTIC KDAC_CCHldISpdOverOn_kph "" VALUE 0x0000 /* @ECU_Address@KDAC_CCHldISpdOverOn_kph@ */ Scalar_FLOAT32_IEEE 0 AppSwcVcu_CM_single_kph -300.0 300.0 /end CHARACTERISTIC
/begin CHARACTERISTIC KDAC_CCMaxSpdOfst_kph "" VALUE 0x0000 /* @ECU_Address@KDAC_CCMaxSpdOfst_kph@ */ Scalar_FLOAT32_IEEE 0 AppSwcVcu_CM_single_kph 0.0 300.0 /end CHARACTERISTIC
/begin CHARACTERISTIC KDAC_CCMinSpdOfst_kph "" VALUE 0x0000 /* @ECU_Address@KDAC_CCMinSpdOfst_kph@ */ Scalar_FLOAT32_IEEE 0 AppSwcVcu_CM_single_kph 0.0 300.0 /end CHARACTERISTIC
/begin CHARACTERISTIC KDAC_CCOvrdTqOff_Nm "" VALUE 0x0000 /* @ECU_Address@KDAC_CCOvrdTqOff_Nm@ */ Scalar_FLOAT32_IEEE 0 AppSwcVcu_CM_single_Nm -10000.0 10000.0 /end CHARACTERISTIC
/begin CHARACTERISTIC KDAC_CCOvrdTqOn_Nm "" VALUE 0x0000 /* @ECU_Address@KDAC_CCOvrdTqOn_Nm@ */ Scalar_FLOAT32_IEEE 0 AppSwcVcu_CM_single_Nm -10000.0 10000.0 /end CHARACTERISTIC
/begin CHARACTERISTIC KDAC_CCTgtSpdChgRate_kphps "" VALUE 0x0000 /* @ECU_Address@KDAC_CCTgtSpdChgRate_kphps@ */ Scalar_FLOAT32_IEEE 0 AppSwcVcu_CM_single_kphps 1.0 100000.0 /end CHARACTERISTIC
/begin CHARACTERISTIC KDAC_CCTqReqWhlAchvd_Nm "" VALUE 0x0000 /* @ECU_Address@KDAC_CCTqReqWhlAchvd_Nm@ */ Scalar_FLOAT32_IEEE 0 AppSwcVcu_CM_single_Nm 0.0 100000.0 /end CHARACTERISTIC
/begin CHARACTERISTIC KDAC_CCTqReqWhlDec_Nmps "" VALUE 0x0000 /* @ECU_Address@KDAC_CCTqReqWhlDec_Nmps@ */ Scalar_FLOAT32_IEEE 0 AppSwcVcu_CM_single_Nm -100000.0 0.0 /end CHARACTERISTIC
/begin CHARACTERISTIC KDAC_CCTqReqWhlInc_Nmps "" VALUE 0x0000 /* @ECU_Address@KDAC_CCTqReqWhlInc_Nmps@ */ Scalar_FLOAT32_IEEE 0 AppSwcVcu_CM_single_Nm 0.0 100000.0 /end CHARACTERISTIC
/begin CHARACTERISTIC KDAC_CruzSetSwOpTm_s "" VALUE 0x0000 /* @ECU_Address@KDAC_CruzSetSwOpTm_s@ */ Scalar_FLOAT32_IEEE 0 AppSwcVcu_CM_single_s 0.0 3600.0 /end CHARACTERISTIC
/begin CHARACTERISTIC KDAC_ESCIntvDlyTm4CC_s "" VALUE 0x0000 /* @ECU_Address@KDAC_ESCIntvDlyTm4CC_s@ */ Scalar_FLOAT32_IEEE 0 AppSwcVcu_CM_single_s 0.0 600.0 /end CHARACTERISTIC
/begin CHARACTERISTIC KDAC_ESPActvDlyTm4CC_s "" VALUE 0x0000 /* @ECU_Address@KDAC_ESPActvDlyTm4CC_s@ */ Scalar_FLOAT32_IEEE 0 AppSwcVcu_CM_single_s 0.0 600.0 /end CHARACTERISTIC
/begin CHARACTERISTIC KDAC_HDCActvSlopOff_pct "" VALUE 0x0000 /* @ECU_Address@KDAC_HDCActvSlopOff_pct@ */ Scalar_FLOAT32_IEEE 0 AppSwcVcu_CM_single_pct -100.0 100.0 /end CHARACTERISTIC
/begin CHARACTERISTIC KDAC_HDCActvSlopOn_pct "" VALUE 0x0000 /* @ECU_Address@KDAC_HDCActvSlopOn_pct@ */ Scalar_FLOAT32_IEEE 0 AppSwcVcu_CM_single_pct -100.0 100.0 /end CHARACTERISTIC
/begin CHARACTERISTIC KDAC_HDCDsrdTqIMax_N "" VALUE 0x0000 /* @ECU_Address@KDAC_HDCDsrdTqIMax_N@ */ Scalar_FLOAT32_IEEE 0 AppSwcVcu_CM_single_N -100000.0 100000.0 /end CHARACTERISTIC
/begin CHARACTERISTIC KDAC_HDCDsrdTqIMin_N "" VALUE 0x0000 /* @ECU_Address@KDAC_HDCDsrdTqIMin_N@ */ Scalar_FLOAT32_IEEE 0 AppSwcVcu_CM_single_N -100000.0 100000.0 /end CHARACTERISTIC
/begin CHARACTERISTIC KDAC_HDCTgtAcceltnFiltCoeff_rat "" VALUE 0x0000 /* @ECU_Address@KDAC_HDCTgtAcceltnFiltCoeff_rat@ */ Scalar_FLOAT32_IEEE 0 AppSwcVcu_CM_single_rat 0.0 1.0 /end CHARACTERISTIC
/begin CHARACTERISTIC KDAC_MstrCylPresDecCfmTm_s "" VALUE 0x0000 /* @ECU_Address@KDAC_MstrCylPresDecCfmTm_s@ */ Scalar_FLOAT32_IEEE 0 AppSwcVcu_CM_single_s 0.0 3600.0 /end CHARACTERISTIC
/begin CHARACTERISTIC KDAC_MstrCylPresDecRecTm_s "" VALUE 0x0000 /* @ECU_Address@KDAC_MstrCylPresDecRecTm_s@ */ Scalar_FLOAT32_IEEE 0 AppSwcVcu_CM_single_s 0.0 3600.0 /end CHARACTERISTIC
/begin CHARACTERISTIC KDAC_OPDAutoBrkDlyTmLong_s "" VALUE 0x0000 /* @ECU_Address@KDAC_OPDAutoBrkDlyTmLong_s@ */ Scalar_FLOAT32_IEEE 0 AppSwcVcu_CM_single_s 0.0 3600.0 /end CHARACTERISTIC
/begin CHARACTERISTIC KDAC_OPDAutoBrkDlyTm_s "" VALUE 0x0000 /* @ECU_Address@KDAC_OPDAutoBrkDlyTm_s@ */ Scalar_FLOAT32_IEEE 0 AppSwcVcu_CM_single_s 0.0 3600.0 /end CHARACTERISTIC
/begin CHARACTERISTIC KDAC_OPDAvailBMSChrgCur_A "" VALUE 0x0000 /* @ECU_Address@KDAC_OPDAvailBMSChrgCur_A@ */ Scalar_FLOAT32_IEEE 0 AppSwcVcu_CM_single_A -10000.0 0.0 /end CHARACTERISTIC
/begin CHARACTERISTIC KDAC_OPDAvailBMSDchaCur_A "" VALUE 0x0000 /* @ECU_Address@KDAC_OPDAvailBMSDchaCur_A@ */ Scalar_FLOAT32_IEEE 0 AppSwcVcu_CM_single_A 0.0 10000.0 /end CHARACTERISTIC
/begin CHARACTERISTIC KDAC_OPDAvailCapLoDlyTm_s "" VALUE 0x0000 /* @ECU_Address@KDAC_OPDAvailCapLoDlyTm_s@ */ Scalar_FLOAT32_IEEE 0 AppSwcVcu_CM_single_s 0.0 36000.0 /end CHARACTERISTIC
/begin CHARACTERISTIC KDAC_OPDAvailMotorDrvTq_Nm "" VALUE 0x0000 /* @ECU_Address@KDAC_OPDAvailMotorDrvTq_Nm@ */ Scalar_FLOAT32_IEEE 0 AppSwcVcu_CM_single_Nm 0.0 10000.0 /end CHARACTERISTIC
/begin CHARACTERISTIC KDAC_OPDAvailMotorRegenTq_Nm "" VALUE 0x0000 /* @ECU_Address@KDAC_OPDAvailMotorRegenTq_Nm@ */ Scalar_FLOAT32_IEEE 0 AppSwcVcu_CM_single_Nm -10000.0 0.0 /end CHARACTERISTIC
/begin CHARACTERISTIC KDAC_OPDDsblSpd_kph "" VALUE 0x0000 /* @ECU_Address@KDAC_OPDDsblSpd_kph@ */ Scalar_FLOAT32_IEEE 0 AppSwcVcu_CM_single_kph -300.0 300.0 /end CHARACTERISTIC
/begin CHARACTERISTIC KDAC_OPDDsrdTqFastIAccErr_mps2 "" VALUE 0x0000 /* @ECU_Address@KDAC_OPDDsrdTqFastIAccErr_mps2@ */ Scalar_FLOAT32_IEEE 0 AppSwcVcu_CM_single_mps2 -20.0 20.0 /end CHARACTERISTIC
/begin CHARACTERISTIC KDAC_OPDDsrdTqFastIFac_c "" VALUE 0x0000 /* @ECU_Address@KDAC_OPDDsrdTqFastIFac_c@ */ Scalar_FLOAT32_IEEE 0 AppSwcVcu_CM_single_c 0.0 100000.0 /end CHARACTERISTIC
/begin CHARACTERISTIC KDAC_OPDDsrdTqFastISpd_kph "" VALUE 0x0000 /* @ECU_Address@KDAC_OPDDsrdTqFastISpd_kph@ */ Scalar_FLOAT32_IEEE 0 AppSwcVcu_CM_single_kph -100.0 300.0 /end CHARACTERISTIC
/begin CHARACTERISTIC KDAC_OPDDsrdTqFastITqErrOff_Nm "" VALUE 0x0000 /* @ECU_Address@KDAC_OPDDsrdTqFastITqErrOff_Nm@ */ Scalar_FLOAT32_IEEE 0 AppSwcVcu_CM_single_Nm 0.0 10000.0 /end CHARACTERISTIC
/begin CHARACTERISTIC KDAC_OPDDsrdTqFastITqErrOn_Nm "" VALUE 0x0000 /* @ECU_Address@KDAC_OPDDsrdTqFastITqErrOn_Nm@ */ Scalar_FLOAT32_IEEE 0 AppSwcVcu_CM_single_Nm 0.0 10000.0 /end CHARACTERISTIC
/begin CHARACTERISTIC KDAC_OPDDsrdTqIMax_N "" VALUE 0x0000 /* @ECU_Address@KDAC_OPDDsrdTqIMax_N@ */ Scalar_FLOAT32_IEEE 0 AppSwcVcu_CM_single_N -100000.0 100000.0 /end CHARACTERISTIC
/begin CHARACTERISTIC KDAC_OPDDsrdTqIMin_N "" VALUE 0x0000 /* @ECU_Address@KDAC_OPDDsrdTqIMin_N@ */ Scalar_FLOAT32_IEEE 0 AppSwcVcu_CM_single_N -100000.0 100000.0 /end CHARACTERISTIC
/begin CHARACTERISTIC KDAC_OPDDsrdTqPAchvd_N "" VALUE 0x0000 /* @ECU_Address@KDAC_OPDDsrdTqPAchvd_N@ */ Scalar_FLOAT32_IEEE 0 AppSwcVcu_CM_single_N 0.0 100000.0 /end CHARACTERISTIC
/begin CHARACTERISTIC KDAC_OPDDsrdTqPBckLsh_N "" VALUE 0x0000 /* @ECU_Address@KDAC_OPDDsrdTqPBckLsh_N@ */ Scalar_FLOAT32_IEEE 0 AppSwcVcu_CM_single_N 0.0 10000.0 /end CHARACTERISTIC
/begin CHARACTERISTIC KDAC_OPDDsrdTqPFiltCoeff_c "" VALUE 0x0000 /* @ECU_Address@KDAC_OPDDsrdTqPFiltCoeff_c@ */ Scalar_FLOAT32_IEEE 0 AppSwcVcu_CM_single_rat 0.0 1.0 /end CHARACTERISTIC
/begin CHARACTERISTIC KDAC_OPDEnblSpd_kph "" VALUE 0x0000 /* @ECU_Address@KDAC_OPDEnblSpd_kph@ */ Scalar_FLOAT32_IEEE 0 AppSwcVcu_CM_single_kph -300.0 300.0 /end CHARACTERISTIC
/begin CHARACTERISTIC KDAC_OPDExitAccPedPstn_pct "" VALUE 0x0000 /* @ECU_Address@KDAC_OPDExitAccPedPstn_pct@ */ Scalar_FLOAT32_IEEE 0 AppSwcVcu_CM_single_pct 0.0 200.0 /end CHARACTERISTIC
/begin CHARACTERISTIC KDAC_OPDExitBrkPedPstn_pct "" VALUE 0x0000 /* @ECU_Address@KDAC_OPDExitBrkPedPstn_pct@ */ Scalar_FLOAT32_IEEE 0 AppSwcVcu_CM_single_pct 0.0 200.0 /end CHARACTERISTIC
/begin CHARACTERISTIC KDAC_OPDExitVehSpd_kph "" VALUE 0x0000 /* @ECU_Address@KDAC_OPDExitVehSpd_kph@ */ Scalar_FLOAT32_IEEE 0 AppSwcVcu_CM_single_kph 0.0 300.0 /end CHARACTERISTIC
/begin CHARACTERISTIC KDAC_OPDOvrdTqOff_Nm "" VALUE 0x0000 /* @ECU_Address@KDAC_OPDOvrdTqOff_Nm@ */ Scalar_FLOAT32_IEEE 0 AppSwcVcu_CM_single_Nm -10000.0 10000.0 /end CHARACTERISTIC
/begin CHARACTERISTIC KDAC_OPDOvrdTqOn_Nm "" VALUE 0x0000 /* @ECU_Address@KDAC_OPDOvrdTqOn_Nm@ */ Scalar_FLOAT32_IEEE 0 AppSwcVcu_CM_single_Nm -10000.0 10000.0 /end CHARACTERISTIC
/begin CHARACTERISTIC KDAC_OPDSpdClsLoopOff_kph "" VALUE 0x0000 /* @ECU_Address@KDAC_OPDSpdClsLoopOff_kph@ */ Scalar_FLOAT32_IEEE 0 AppSwcVcu_CM_single_kph -100.0 300.0 /end CHARACTERISTIC
/begin CHARACTERISTIC KDAC_OPDSpdClsLoopOn_kph "" VALUE 0x0000 /* @ECU_Address@KDAC_OPDSpdClsLoopOn_kph@ */ Scalar_FLOAT32_IEEE 0 AppSwcVcu_CM_single_kph -100.0 300.0 /end CHARACTERISTIC
/begin CHARACTERISTIC KDAC_OPDTqReqUnloadRmn_Nm "" VALUE 0x0000 /* @ECU_Address@KDAC_OPDTqReqUnloadRmn_Nm@ */ Scalar_FLOAT32_IEEE 0 AppSwcVcu_CM_single_Nm 0.0 100000.0 /end CHARACTERISTIC
/begin CHARACTERISTIC KDAC_OPDTqReqWhlAchvd_Nm "" VALUE 0x0000 /* @ECU_Address@KDAC_OPDTqReqWhlAchvd_Nm@ */ Scalar_FLOAT32_IEEE 0 AppSwcVcu_CM_single_Nm 0.0 100000.0 /end CHARACTERISTIC
/begin CHARACTERISTIC KDAC_OPDTqReqWhlLmtPosOff_Nm "" VALUE 0x0000 /* @ECU_Address@KDAC_OPDTqReqWhlLmtPosOff_Nm@ */ Scalar_FLOAT32_IEEE 0 AppSwcVcu_CM_single_Nm -10000.0 10000.0 /end CHARACTERISTIC
/begin CHARACTERISTIC KDAC_OPDTqReqWhlLmtPosOn_Nm "" VALUE 0x0000 /* @ECU_Address@KDAC_OPDTqReqWhlLmtPosOn_Nm@ */ Scalar_FLOAT32_IEEE 0 AppSwcVcu_CM_single_Nm -10000.0 10000.0 /end CHARACTERISTIC
/begin CHARACTERISTIC KDAC_OPDTqReqWhlLmtPos_Nm "" VALUE 0x0000 /* @ECU_Address@KDAC_OPDTqReqWhlLmtPos_Nm@ */ Scalar_FLOAT32_IEEE 0 AppSwcVcu_CM_single_Nm -10000.0 10000.0 /end CHARACTERISTIC
/begin CHARACTERISTIC KDAC_OPDTqReqWhlLmtRateFst_Nmps "" VALUE 0x0000 /* @ECU_Address@KDAC_OPDTqReqWhlLmtRateFst_Nmps@ */ Scalar_FLOAT32_IEEE 0 AppSwcVcu_CM_single_Nmps 0.0 100000.0 /end CHARACTERISTIC
/begin CHARACTERISTIC KDAC_OPDTqReqWhlLmtRate_Nmps "" VALUE 0x0000 /* @ECU_Address@KDAC_OPDTqReqWhlLmtRate_Nmps@ */ Scalar_FLOAT32_IEEE 0 AppSwcVcu_CM_single_Nmps 0.0 100000.0 /end CHARACTERISTIC
/begin CHARACTERISTIC KDAC_OPDTqReqWhlLoadAchvd_Nm "" VALUE 0x0000 /* @ECU_Address@KDAC_OPDTqReqWhlLoadAchvd_Nm@ */ Scalar_FLOAT32_IEEE 0 AppSwcVcu_CM_single_Nm 0.0 100000.0 /end CHARACTERISTIC
/begin CHARACTERISTIC KDAC_OPDTqReqWhlLoadFstRate_Nmps "" VALUE 0x0000 /* @ECU_Address@KDAC_OPDTqReqWhlLoadFstRate_Nmps@ */ Scalar_FLOAT32_IEEE 0 AppSwcVcu_CM_single_Nmps -100000.0 100000.0 /end CHARACTERISTIC
/begin CHARACTERISTIC KDAC_OPDTqReqWhlLoadRate_Nmps "" VALUE 0x0000 /* @ECU_Address@KDAC_OPDTqReqWhlLoadRate_Nmps@ */ Scalar_FLOAT32_IEEE 0 AppSwcVcu_CM_single_Nmps -100000.0 100000.0 /end CHARACTERISTIC
/begin CHARACTERISTIC KDAC_OPDTqReqWhlUnloadRate_Nmps "" VALUE 0x0000 /* @ECU_Address@KDAC_OPDTqReqWhlUnloadRate_Nmps@ */ Scalar_FLOAT32_IEEE 0 AppSwcVcu_CM_single_Nmps -100000.0 100000.0 /end CHARACTERISTIC
/begin CHARACTERISTIC KDAC_OPDVehAcceltnFilt2_rat "" VALUE 0x0000 /* @ECU_Address@KDAC_OPDVehAcceltnFilt2_rat@ */ Scalar_FLOAT32_IEEE 0 AppSwcVcu_CM_single_rat 0.0 1.0 /end CHARACTERISTIC
/begin CHARACTERISTIC KDAC_OPDVehAcceltnMax_mps2 "" VALUE 0x0000 /* @ECU_Address@KDAC_OPDVehAcceltnMax_mps2@ */ Scalar_FLOAT32_IEEE 0 AppSwcVcu_CM_single_mps2 0.0 20.0 /end CHARACTERISTIC
/begin CHARACTERISTIC KDAC_OPDVehAcceltnMin_mps2 "" VALUE 0x0000 /* @ECU_Address@KDAC_OPDVehAcceltnMin_mps2@ */ Scalar_FLOAT32_IEEE 0 AppSwcVcu_CM_single_mps2 -20.0 0.0 /end CHARACTERISTIC
/begin CHARACTERISTIC KDAC_OPDVehLnhSpd_kph "" VALUE 0x0000 /* @ECU_Address@KDAC_OPDVehLnhSpd_kph@ */ Scalar_FLOAT32_IEEE 0 AppSwcVcu_CM_single_kph -10.0 300.0 /end CHARACTERISTIC
/begin CHARACTERISTIC KDAC_OPDVehResistTqAchvd_Nm "" VALUE 0x0000 /* @ECU_Address@KDAC_OPDVehResistTqAchvd_Nm@ */ Scalar_FLOAT32_IEEE 0 AppSwcVcu_CM_single_Nm 0.0 10000.0 /end CHARACTERISTIC
/begin CHARACTERISTIC KDAC_OPDVehResistTqDrtOff_kph "" VALUE 0x0000 /* @ECU_Address@KDAC_OPDVehResistTqDrtOff_kph@ */ Scalar_FLOAT32_IEEE 0 AppSwcVcu_CM_single_kph -300.0 300.0 /end CHARACTERISTIC
/begin CHARACTERISTIC KDAC_OPDVehResistTqDrtOn_kph "" VALUE 0x0000 /* @ECU_Address@KDAC_OPDVehResistTqDrtOn_kph@ */ Scalar_FLOAT32_IEEE 0 AppSwcVcu_CM_single_kph -300.0 300.0 /end CHARACTERISTIC
/begin CHARACTERISTIC KDAC_OPDVehResistTqDrt_rat "" VALUE 0x0000 /* @ECU_Address@KDAC_OPDVehResistTqDrt_rat@ */ Scalar_FLOAT32_IEEE 0 AppSwcVcu_CM_single_rat 0.0 1.0 /end CHARACTERISTIC
/begin CHARACTERISTIC KDAC_OPDVehResistTqFiltCoeff_c "" VALUE 0x0000 /* @ECU_Address@KDAC_OPDVehResistTqFiltCoeff_c@ */ Scalar_FLOAT32_IEEE 0 AppSwcVcu_CM_single_rat 0.0 1.0 /end CHARACTERISTIC
/begin CHARACTERISTIC KDAC_OPDVehSpdMotorFacFilt_s "" VALUE 0x0000 /* @ECU_Address@KDAC_OPDVehSpdMotorFacFilt_s@ */ Scalar_FLOAT32_IEEE 0 AppSwcVcu_CM_single_s 0.0 10.0 /end CHARACTERISTIC
/begin CHARACTERISTIC KDAC_OPDVehSpdUseMotorTgt_kph "" VALUE 0x0000 /* @ECU_Address@KDAC_OPDVehSpdUseMotorTgt_kph@ */ Scalar_FLOAT32_IEEE 0 AppSwcVcu_CM_single_kph -100.0 300.0 /end CHARACTERISTIC
/begin CHARACTERISTIC KDAC_OPDVehSpdUseMotorTm_s "" VALUE 0x0000 /* @ECU_Address@KDAC_OPDVehSpdUseMotorTm_s@ */ Scalar_FLOAT32_IEEE 0 AppSwcVcu_CM_single_s 0.0 10.0 /end CHARACTERISTIC
/begin CHARACTERISTIC KDAC_OPDVehStopSpd_kph "" VALUE 0x0000 /* @ECU_Address@KDAC_OPDVehStopSpd_kph@ */ Scalar_FLOAT32_IEEE 0 AppSwcVcu_CM_single_kph -10.0 10.0 /end CHARACTERISTIC
/begin CHARACTERISTIC KDAC_SpdOutRngDlyTm4CC_s "" VALUE 0x0000 /* @ECU_Address@KDAC_SpdOutRngDlyTm4CC_s@ */ Scalar_FLOAT32_IEEE 0 AppSwcVcu_CM_single_s 0.0 600.0 /end CHARACTERISTIC
/begin CHARACTERISTIC KDAC_SpdStabDlyTm4CC_s "" VALUE 0x0000 /* @ECU_Address@KDAC_SpdStabDlyTm4CC_s@ */ Scalar_FLOAT32_IEEE 0 AppSwcVcu_CM_single_s 0.0 36000.0 /end CHARACTERISTIC
/begin CHARACTERISTIC KDAC_SpdUnstabDlyTm4CC_s "" VALUE 0x0000 /* @ECU_Address@KDAC_SpdUnstabDlyTm4CC_s@ */ Scalar_FLOAT32_IEEE 0 AppSwcVcu_CM_single_s 0.0 36000.0 /end CHARACTERISTIC
/begin CHARACTERISTIC KDAC_TCSActvDlyTm4CC_s "" VALUE 0x0000 /* @ECU_Address@KDAC_TCSActvDlyTm4CC_s@ */ Scalar_FLOAT32_IEEE 0 AppSwcVcu_CM_single_s 0.0 600.0 /end CHARACTERISTIC
/begin CHARACTERISTIC KDAC_TapDwnTmOut_s "" VALUE 0x0000 /* @ECU_Address@KDAC_TapDwnTmOut_s@ */ Scalar_FLOAT32_IEEE 0 AppSwcVcu_CM_single_s 0.0 600.0 /end CHARACTERISTIC
/begin CHARACTERISTIC KDAC_TapUpTmOut_s "" VALUE 0x0000 /* @ECU_Address@KDAC_TapUpTmOut_s@ */ Scalar_FLOAT32_IEEE 0 AppSwcVcu_CM_single_s 0.0 600.0 /end CHARACTERISTIC
/begin CHARACTERISTIC KDAC_WhlSlipDiffSpd4CC_kph "" VALUE 0x0000 /* @ECU_Address@KDAC_WhlSlipDiffSpd4CC_kph@ */ Scalar_FLOAT32_IEEE 0 AppSwcVcu_CM_single_kph 0.0 300.0 /end CHARACTERISTIC
/begin CHARACTERISTIC KDAC_WhlSlipDiffSpdOfst4CC_kph "" VALUE 0x0000 /* @ECU_Address@KDAC_WhlSlipDiffSpdOfst4CC_kph@ */ Scalar_FLOAT32_IEEE 0 AppSwcVcu_CM_single_kph 0.0 300.0 /end CHARACTERISTIC
/begin CHARACTERISTIC KDAC_WhlSlipDlyTm4CC_s "" VALUE 0x0000 /* @ECU_Address@KDAC_WhlSlipDlyTm4CC_s@ */ Scalar_FLOAT32_IEEE 0 AppSwcVcu_CM_single_s 0.0 600.0 /end CHARACTERISTIC
/begin CHARACTERISTIC KGSM_EPBApld2PDlyTm_s "规范：EPB拉起入P需求判断时间阈值" VALUE 0x0000 /* @ECU_Address@KGSM_EPBApld2PDlyTm_s@ */ Scalar_FLOAT32_IEEE 0 AppSwcVcu_CM_single_s 0.0 1000.0 /end CHARACTERISTIC
/begin CHARACTERISTIC KGSM_EPBReld2NDlyTm_s "规范：EPB释放入N需求判断时间阈值" VALUE 0x0000 /* @ECU_Address@KGSM_EPBReld2NDlyTm_s@ */ Scalar_FLOAT32_IEEE 0 AppSwcVcu_CM_single_s 0.0 1000.0 /end CHARACTERISTIC
/begin CHARACTERISTIC KGSM_GrShftF1R1HldTm_s "规范：换挡杆入N需求判断时间阈值" VALUE 0x0000 /* @ECU_Address@KGSM_GrShftF1R1HldTm_s@ */ Scalar_FLOAT32_IEEE 0 AppSwcVcu_CM_single_s 0.0 1000.0 /end CHARACTERISTIC
/begin CHARACTERISTIC KGSM_GrShftF2R2HldTm_s "规范：换挡杆入D需求判断时间阈值/换挡杆入R需求判断时间阈值" VALUE 0x0000 /* @ECU_Address@KGSM_GrShftF2R2HldTm_s@ */ Scalar_FLOAT32_IEEE 0 AppSwcVcu_CM_single_s 0.0 1000.0 /end CHARACTERISTIC
/begin CHARACTERISTIC KGSM_GrShftHwPHldTm_s "规范：换挡杆入P按键时间阈值" VALUE 0x0000 /* @ECU_Address@KGSM_GrShftHwPHldTm_s@ */ Scalar_FLOAT32_IEEE 0 AppSwcVcu_CM_single_s 0.0 1000.0 /end CHARACTERISTIC
/begin CHARACTERISTIC KGSM_TgtGrReqWatTm_s "规范：换挡请求持续时间阈值" VALUE 0x0000 /* @ECU_Address@KGSM_TgtGrReqWatTm_s@ */ Scalar_FLOAT32_IEEE 0 AppSwcVcu_CM_single_s 0.0 1000.0 /end CHARACTERISTIC
/begin CHARACTERISTIC KTQD_AccelPedPrsdOff_pct "" VALUE 0x0000 /* @ECU_Address@KTQD_AccelPedPrsdOff_pct@ */ Scalar_FLOAT32_IEEE 0 AppSwcVcu_CM_single_pct -100.0 200.0 /end CHARACTERISTIC
/begin CHARACTERISTIC KTQD_AccelPedPrsdOn_pct "" VALUE 0x0000 /* @ECU_Address@KTQD_AccelPedPrsdOn_pct@ */ Scalar_FLOAT32_IEEE 0 AppSwcVcu_CM_single_pct -100.0 200.0 /end CHARACTERISTIC
/begin CHARACTERISTIC KTQD_AdaptCstDsrdTqIMax_N "" VALUE 0x0000 /* @ECU_Address@KTQD_AdaptCstDsrdTqIMax_N@ */ Scalar_FLOAT32_IEEE 0 AppSwcVcu_CM_single_N -10000.0 10000.0 /end CHARACTERISTIC
/begin CHARACTERISTIC KTQD_AdaptCstDsrdTqIMin_N "" VALUE 0x0000 /* @ECU_Address@KTQD_AdaptCstDsrdTqIMin_N@ */ Scalar_FLOAT32_IEEE 0 AppSwcVcu_CM_single_N -10000.0 10000.0 /end CHARACTERISTIC
/begin CHARACTERISTIC KTQD_AdaptCstTgtAcceltnFiltTm_s "" VALUE 0x0000 /* @ECU_Address@KTQD_AdaptCstTgtAcceltnFiltTm_s@ */ Scalar_FLOAT32_IEEE 0 AppSwcVcu_CM_single_s 0.0 100.0 /end CHARACTERISTIC
/begin CHARACTERISTIC KTQD_AdaptCstVehSpdOff_kph "" VALUE 0x0000 /* @ECU_Address@KTQD_AdaptCstVehSpdOff_kph@ */ Scalar_FLOAT32_IEEE 0 AppSwcVcu_CM_single_kph -300.0 300.0 /end CHARACTERISTIC
/begin CHARACTERISTIC KTQD_AdaptCstVehSpdOn_kph "" VALUE 0x0000 /* @ECU_Address@KTQD_AdaptCstVehSpdOn_kph@ */ Scalar_FLOAT32_IEEE 0 AppSwcVcu_CM_single_kph -300.0 300.0 /end CHARACTERISTIC
/begin CHARACTERISTIC KTQD_BrkPedPrsd_pct "" VALUE 0x0000 /* @ECU_Address@KTQD_BrkPedPrsd_pct@ */ Scalar_FLOAT32_IEEE 0 AppSwcVcu_CM_single_pct -100.0 200.0 /end CHARACTERISTIC
/begin CHARACTERISTIC KTQD_BrkPedReldDlyTm_s "" VALUE 0x0000 /* @ECU_Address@KTQD_BrkPedReldDlyTm_s@ */ Scalar_FLOAT32_IEEE 0 AppSwcVcu_CM_single_s 0.0 100.0 /end CHARACTERISTIC
/begin CHARACTERISTIC KTQD_CrpRsmPedPstn_pct "" VALUE 0x0000 /* @ECU_Address@KTQD_CrpRsmPedPstn_pct@ */ Scalar_FLOAT32_IEEE 0 AppSwcVcu_CM_single_pct -1000.0 1000.0 /end CHARACTERISTIC
/begin CHARACTERISTIC KTQD_CstRegenTqFiltAchvd_Nm "" VALUE 0x0000 /* @ECU_Address@KTQD_CstRegenTqFiltAchvd_Nm@ */ Scalar_FLOAT32_IEEE 0 AppSwcVcu_CM_single_Nmps 0.0 10000.0 /end CHARACTERISTIC
/begin CHARACTERISTIC KTQD_CstRegenTqReqWhlDecEnbl_Nmps "" VALUE 0x0000 /* @ECU_Address@KTQD_CstRegenTqReqWhlDecEnbl_Nmps@ */ Scalar_FLOAT32_IEEE 0 AppSwcVcu_CM_single_Nmps -100000.0 0.0 /end CHARACTERISTIC
/begin CHARACTERISTIC KTQD_CstRegenTqReqWhlDec_Nmps "" VALUE 0x0000 /* @ECU_Address@KTQD_CstRegenTqReqWhlDec_Nmps@ */ Scalar_FLOAT32_IEEE 0 AppSwcVcu_CM_single_Nmps -100000.0 0.0 /end CHARACTERISTIC
/begin CHARACTERISTIC KTQD_CstRegenTqReqWhlIncEnbl_Nmps "" VALUE 0x0000 /* @ECU_Address@KTQD_CstRegenTqReqWhlIncEnbl_Nmps@ */ Scalar_FLOAT32_IEEE 0 AppSwcVcu_CM_single_Nmps 0.0 100000.0 /end CHARACTERISTIC
/begin CHARACTERISTIC KTQD_CstRegenVehSpdOff_kph "" VALUE 0x0000 /* @ECU_Address@KTQD_CstRegenVehSpdOff_kph@ */ Scalar_FLOAT32_IEEE 0 AppSwcVcu_CM_single_kph -300.0 300.0 /end CHARACTERISTIC
/begin CHARACTERISTIC KTQD_CstRegenVehSpdOn_kph "" VALUE 0x0000 /* @ECU_Address@KTQD_CstRegenVehSpdOn_kph@ */ Scalar_FLOAT32_IEEE 0 AppSwcVcu_CM_single_kph -300.0 300.0 /end CHARACTERISTIC
/begin CHARACTERISTIC KTQD_EPBAppliedMaxTq_Nm "" VALUE 0x0000 /* @ECU_Address@KTQD_EPBAppliedMaxTq_Nm@ */ Scalar_FLOAT32_IEEE 0 AppSwcVcu_CM_single_Nm -10000.0 10000.0 /end CHARACTERISTIC
/begin CHARACTERISTIC KTQD_EnblDRShftVehSpd_kph "" VALUE 0x0000 /* @ECU_Address@KTQD_EnblDRShftVehSpd_kph@ */ Scalar_FLOAT32_IEEE 0 AppSwcVcu_CM_single_kph -300.0 300.0 /end CHARACTERISTIC
/begin CHARACTERISTIC KTQD_EnblDRShftWhlTq_Nm "" VALUE 0x0000 /* @ECU_Address@KTQD_EnblDRShftWhlTq_Nm@ */ Scalar_FLOAT32_IEEE 0 AppSwcVcu_CM_single_Nm -10000.0 10000.0 /end CHARACTERISTIC
/begin CHARACTERISTIC KTQD_PedTqReqFiltCoeffMAA_c "" VALUE 0x0000 /* @ECU_Address@KTQD_PedTqReqFiltCoeffMAA_c@ */ Scalar_FLOAT32_IEEE 0 AppSwcVcu_CM_single_c 0.0 1.0 /end CHARACTERISTIC
/begin CHARACTERISTIC KTQD_PlugOnTqZeroSpd_kph "" VALUE 0x0000 /* @ECU_Address@KTQD_PlugOnTqZeroSpd_kph@ */ Scalar_FLOAT32_IEEE 0 AppSwcVcu_CM_single_kph -300.0 300.0 /end CHARACTERISTIC
/begin CHARACTERISTIC KTQD_TqDrtFacLmtPerfmnRate_cps "" VALUE 0x0000 /* @ECU_Address@KTQD_TqDrtFacLmtPerfmnRate_cps@ */ Scalar_FLOAT32_IEEE 0 AppSwcVcu_CM_single_cps 0.0 10000.0 /end CHARACTERISTIC
/begin CHARACTERISTIC KTQD_TqDrtFacVehSpdDecRate_cps "" VALUE 0x0000 /* @ECU_Address@KTQD_TqDrtFacVehSpdDecRate_cps@ */ Scalar_FLOAT32_IEEE 0 AppSwcVcu_CM_single_cps -10000.0 0.0 /end CHARACTERISTIC
/begin CHARACTERISTIC KTQD_TqDrtFacVehSpdIncRate_cps "" VALUE 0x0000 /* @ECU_Address@KTQD_TqDrtFacVehSpdIncRate_cps@ */ Scalar_FLOAT32_IEEE 0 AppSwcVcu_CM_single_cps 0.0 10000.0 /end CHARACTERISTIC
/begin CHARACTERISTIC KTQF_TqRateDecMaxEndg_Nmps "decrease tq rate max in ending or decreasing period" VALUE 0x0000 /* @ECU_Address@KTQF_TqRateDecMaxEndg_Nmps@ */ Scalar_FLOAT32_IEEE 0 AppSwcVcu_CM_single_Nmps -100000.0 0.0 /end CHARACTERISTIC
/begin CHARACTERISTIC KTQF_TqRateDecMaxRegenACC_Nmps "" VALUE 0x0000 /* @ECU_Address@KTQF_TqRateDecMaxRegenACC_Nmps@ */ Scalar_FLOAT32_IEEE 0 AppSwcVcu_CM_single_Nmps -100000.0 0.0 /end CHARACTERISTIC
/begin CHARACTERISTIC KTQF_TqRateDecMaxStart_Nmps "" VALUE 0x0000 /* @ECU_Address@KTQF_TqRateDecMaxStart_Nmps@ */ Scalar_FLOAT32_IEEE 0 AppSwcVcu_CM_single_Nmps -100000.0 0.0 /end CHARACTERISTIC
/begin CHARACTERISTIC KTQF_TqRateIncMaxEndg_Nmps "increase tq rate max in ending or decreasing period" VALUE 0x0000 /* @ECU_Address@KTQF_TqRateIncMaxEndg_Nmps@ */ Scalar_FLOAT32_IEEE 0 AppSwcVcu_CM_single_Nmps 0.0 100000.0 /end CHARACTERISTIC
/begin CHARACTERISTIC KTQR_ASDEnblOscSpd_rpm "" VALUE 0x0000 /* @ECU_Address@KTQR_ASDEnblOscSpd_rpm@ */ Scalar_FLOAT32_IEEE 0 AppSwcVcu_CM_single_rpm 0.0 1000.0 /end CHARACTERISTIC
/begin CHARACTERISTIC KTQR_ASDOscTrigTm_s "" VALUE 0x0000 /* @ECU_Address@KTQR_ASDOscTrigTm_s@ */ Scalar_FLOAT32_IEEE 0 AppSwcVcu_CM_single_s 0.0 100000.0 /end CHARACTERISTIC
/begin CHARACTERISTIC KTQR_ASDPhCompKa_c "" VALUE 0x0000 /* @ECU_Address@KTQR_ASDPhCompKa_c@ */ Scalar_FLOAT32_IEEE 0 AppSwcVcu_CM_single_c -100000.0 100000.0 /end CHARACTERISTIC
/begin CHARACTERISTIC KTQR_ASDPhCompKb1_c "" VALUE 0x0000 /* @ECU_Address@KTQR_ASDPhCompKb1_c@ */ Scalar_FLOAT32_IEEE 0 AppSwcVcu_CM_single_c -100000.0 100000.0 /end CHARACTERISTIC
/begin CHARACTERISTIC KTQR_ASDPhCompKb2_c "" VALUE 0x0000 /* @ECU_Address@KTQR_ASDPhCompKb2_c@ */ Scalar_FLOAT32_IEEE 0 AppSwcVcu_CM_single_c -100000.0 100000.0 /end CHARACTERISTIC
/begin CHARACTERISTIC KTQR_ASDSpdFiltHiDecRate_nu "" VALUE 0x0000 /* @ECU_Address@KTQR_ASDSpdFiltHiDecRate_nu@ */ Scalar_FLOAT32_IEEE 0 AppSwcVcu_CM_single_nu -100000.0 0.0 /end CHARACTERISTIC
/begin CHARACTERISTIC KTQR_ASDSpdFiltHiIncRate_nu "" VALUE 0x0000 /* @ECU_Address@KTQR_ASDSpdFiltHiIncRate_nu@ */ Scalar_FLOAT32_IEEE 0 AppSwcVcu_CM_single_nu 0.0 100000.0 /end CHARACTERISTIC
/begin CHARACTERISTIC KTQR_ASDSpdFiltLo_s "" VALUE 0x0000 /* @ECU_Address@KTQR_ASDSpdFiltLo_s@ */ Scalar_FLOAT32_IEEE 0 AppSwcVcu_CM_single_s 0.0 1000.0 /end CHARACTERISTIC
/begin CHARACTERISTIC KTQR_ASDTqDbnd_Nm "" VALUE 0x0000 /* @ECU_Address@KTQR_ASDTqDbnd_Nm@ */ Scalar_FLOAT32_IEEE 0 AppSwcVcu_CM_single_Nm 0.0 100.0 /end CHARACTERISTIC
/begin CHARACTERISTIC KTQR_ASDTqMax_Nm "" VALUE 0x0000 /* @ECU_Address@KTQR_ASDTqMax_Nm@ */ Scalar_FLOAT32_IEEE 0 AppSwcVcu_CM_single_Nm 0.0 100.0 /end CHARACTERISTIC
/begin CHARACTERISTIC KTQR_ASDTqMin_Nm "" VALUE 0x0000 /* @ECU_Address@KTQR_ASDTqMin_Nm@ */ Scalar_FLOAT32_IEEE 0 AppSwcVcu_CM_single_Nm -100.0 0.0 /end CHARACTERISTIC
/begin CHARACTERISTIC KTZX_MotorTqDecDlyTm_s "" VALUE 0x0000 /* @ECU_Address@KTZX_MotorTqDecDlyTm_s@ */ Scalar_FLOAT32_IEEE 0 AppSwcVcu_CM_single_s 0.0 60.0 /end CHARACTERISTIC
/begin CHARACTERISTIC KTZX_MotorTqDecThr_Nm "" VALUE 0x0000 /* @ECU_Address@KTZX_MotorTqDecThr_Nm@ */ Scalar_FLOAT32_IEEE 0 AppSwcVcu_CM_single_Nm -100000.0 100000.0 /end CHARACTERISTIC
/begin CHARACTERISTIC KTZX_MotorTqIncDlyTm_s "" VALUE 0x0000 /* @ECU_Address@KTZX_MotorTqIncDlyTm_s@ */ Scalar_FLOAT32_IEEE 0 AppSwcVcu_CM_single_s 0.0 60.0 /end CHARACTERISTIC
/begin CHARACTERISTIC KTZX_MotorTqIncThr_Nm "" VALUE 0x0000 /* @ECU_Address@KTZX_MotorTqIncThr_Nm@ */ Scalar_FLOAT32_IEEE 0 AppSwcVcu_CM_single_Nm -100000.0 100000.0 /end CHARACTERISTIC
/begin CHARACTERISTIC KDAC_BypCruiseSdnCC_flg "" VALUE 0x0000 /* @ECU_Address@KDAC_BypCruiseSdnCC_flg@ */ Scalar_BOOLEAN 0 AppSwcVcu_CM_boolean_flg 0.0 1.0 /end CHARACTERISTIC
/begin CHARACTERISTIC KDAC_BypCruiseSdn_flg "" VALUE 0x0000 /* @ECU_Address@KDAC_BypCruiseSdn_flg@ */ Scalar_BOOLEAN 0 AppSwcVcu_CM_boolean_flg 0.0 1.0 /end CHARACTERISTIC
/begin CHARACTERISTIC KDAC_BypESPTqIntv_flg "" VALUE 0x0000 /* @ECU_Address@KDAC_BypESPTqIntv_flg@ */ Scalar_BOOLEAN 0 AppSwcVcu_CM_boolean_flg 0.0 1.0 /end CHARACTERISTIC
/begin CHARACTERISTIC KDAC_EnblOPDSpdClsLoopP_flg "" VALUE 0x0000 /* @ECU_Address@KDAC_EnblOPDSpdClsLoopP_flg@ */ Scalar_BOOLEAN 0 AppSwcVcu_CM_boolean_flg 0.0 1.0 /end CHARACTERISTIC
/begin CHARACTERISTIC KDAC_EnblOPDSpdClsLoop_flg "" VALUE 0x0000 /* @ECU_Address@KDAC_EnblOPDSpdClsLoop_flg@ */ Scalar_BOOLEAN 0 AppSwcVcu_CM_boolean_flg 0.0 1.0 /end CHARACTERISTIC
/begin CHARACTERISTIC KDAC_HDCFuncEnbl_flg "" VALUE 0x0000 /* @ECU_Address@KDAC_HDCFuncEnbl_flg@ */ Scalar_BOOLEAN 0 AppSwcVcu_CM_boolean_flg 0.0 1.0 /end CHARACTERISTIC
/begin CHARACTERISTIC KDAC_OPDOvrdFallRstLmt_flg "" VALUE 0x0000 /* @ECU_Address@KDAC_OPDOvrdFallRstLmt_flg@ */ Scalar_BOOLEAN 0 AppSwcVcu_CM_boolean_flg 0.0 1.0 /end CHARACTERISTIC
/begin CHARACTERISTIC KTQD_AdaptCstRegenEnbl_flg "" VALUE 0x0000 /* @ECU_Address@KTQD_AdaptCstRegenEnbl_flg@ */ Scalar_BOOLEAN 0 AppSwcVcu_CM_boolean_flg 0.0 1.0 /end CHARACTERISTIC
/begin CHARACTERISTIC KTQD_CrpEnbl_flg "" VALUE 0x0000 /* @ECU_Address@KTQD_CrpEnbl_flg@ */ Scalar_BOOLEAN 0 AppSwcVcu_CM_boolean_flg 0.0 1.0 /end CHARACTERISTIC
/begin CHARACTERISTIC KTQR_BypassASDOscTrig_flg "" VALUE 0x0000 /* @ECU_Address@KTQR_BypassASDOscTrig_flg@ */ Scalar_BOOLEAN 0 AppSwcVcu_CM_boolean_flg 0.0 1.0 /end CHARACTERISTIC
/begin CHARACTERISTIC KTZX_UseZeroTqAddRngFinshAZ_flg "" VALUE 0x0000 /* @ECU_Address@KTZX_UseZeroTqAddRngFinshAZ_flg@ */ Scalar_BOOLEAN 0 AppSwcVcu_CM_boolean_flg 0.0 1.0 /end CHARACTERISTIC
/begin CHARACTERISTIC KDAC_CCMaxTgtSpdE_kph "" VALUE 0x0000 /* @ECU_Address@KDAC_CCMaxTgtSpdE_kph@ */ Scalar_UBYTE 0 AppSwcVcu_CM_uint8_kph 0.0 255.0 /end CHARACTERISTIC
/begin CHARACTERISTIC KDAC_CCMaxTgtSpdN_kph "" VALUE 0x0000 /* @ECU_Address@KDAC_CCMaxTgtSpdN_kph@ */ Scalar_UBYTE 0 AppSwcVcu_CM_uint8_kph 0.0 255.0 /end CHARACTERISTIC
/begin CHARACTERISTIC KDAC_CCMaxTgtSpdS_kph "" VALUE 0x0000 /* @ECU_Address@KDAC_CCMaxTgtSpdS_kph@ */ Scalar_UBYTE 0 AppSwcVcu_CM_uint8_kph 0.0 255.0 /end CHARACTERISTIC
/begin CHARACTERISTIC KDAC_CCMaxTgtSpdSnow_kph "" VALUE 0x0000 /* @ECU_Address@KDAC_CCMaxTgtSpdSnow_kph@ */ Scalar_UBYTE 0 AppSwcVcu_CM_uint8_kph 0.0 255.0 /end CHARACTERISTIC
/begin CHARACTERISTIC KDAC_CCMinTgtSpd_kph "" VALUE 0x0000 /* @ECU_Address@KDAC_CCMinTgtSpd_kph@ */ Scalar_UBYTE 0 AppSwcVcu_CM_uint8_kph 0.0 255.0 /end CHARACTERISTIC
/begin CHARACTERISTIC KDAC_CCSpdChgLongDiv_cnt "" VALUE 0x0000 /* @ECU_Address@KDAC_CCSpdChgLongDiv_cnt@ */ Scalar_UBYTE 0 AppSwcVcu_CM_uint8_cnt 0.0 255.0 /end CHARACTERISTIC
/begin CHARACTERISTIC KDAC_CCSpdChgShort_kph "" VALUE 0x0000 /* @ECU_Address@KDAC_CCSpdChgShort_kph@ */ Scalar_UBYTE 0 AppSwcVcu_CM_uint8_kph 0.0 255.0 /end CHARACTERISTIC
/begin CHARACTERISTIC KDAC_CruzSetSwOpCntr_cnt "" VALUE 0x0000 /* @ECU_Address@KDAC_CruzSetSwOpCntr_cnt@ */ Scalar_UBYTE 0 AppSwcVcu_CM_uint8_cnt 0.0 255.0 /end CHARACTERISTIC
/begin CHARACTERISTIC KDAC_HDCActvSpdHiOfst_kph "" VALUE 0x0000 /* @ECU_Address@KDAC_HDCActvSpdHiOfst_kph@ */ Scalar_UBYTE 0 AppSwcVcu_CM_uint8_kph 0.0 50.0 /end CHARACTERISTIC
/begin CHARACTERISTIC KDAC_HDCActvSpdHi_kph "" VALUE 0x0000 /* @ECU_Address@KDAC_HDCActvSpdHi_kph@ */ Scalar_UBYTE 0 AppSwcVcu_CM_uint8_kph 0.0 200.0 /end CHARACTERISTIC
/begin CHARACTERISTIC KDAC_HDCActvSpdLoOfst_kph "" VALUE 0x0000 /* @ECU_Address@KDAC_HDCActvSpdLoOfst_kph@ */ Scalar_UBYTE 0 AppSwcVcu_CM_uint8_kph 0.0 20.0 /end CHARACTERISTIC
/begin CHARACTERISTIC KDAC_HDCActvSpdLo_kph "" VALUE 0x0000 /* @ECU_Address@KDAC_HDCActvSpdLo_kph@ */ Scalar_UBYTE 0 AppSwcVcu_CM_uint8_kph 0.0 200.0 /end CHARACTERISTIC
/begin CHARACTERISTIC KDAC_HDCStdbyAllwdSpd_kph "" VALUE 0x0000 /* @ECU_Address@KDAC_HDCStdbyAllwdSpd_kph@ */ Scalar_UBYTE 0 AppSwcVcu_CM_uint8_kph 0.0 200.0 /end CHARACTERISTIC
/begin CHARACTERISTIC KTQR_ASDSpdPhCompCout_Cnt "" VALUE 0x0000 /* @ECU_Address@KTQR_ASDSpdPhCompCout_Cnt@ */ Scalar_UBYTE 0 AppSwcVcu_CM_uint8_Cnt 0.0 4.0 /end CHARACTERISTIC
/begin MEASUREMENT VTQR_ASDSpdFltHi_rpm "" FLOAT32_IEEE AppSwcVcu_CM_single_rpm 0 0 -100000.0 100000.0 ECU_ADDRESS 0x0000 /* @ECU_Address@VTQR_ASDSpdFltHi_rpm@ */ /end MEASUREMENT
/begin MEASUREMENT VTQR_ASDSpdOscRaw_rpm "" FLOAT32_IEEE AppSwcVcu_CM_single_rpm 0 0 -100000.0 100000.0 ECU_ADDRESS 0x0000 /* @ECU_Address@VTQR_ASDSpdOscRaw_rpm@ */ /end MEASUREMENT
/begin MEASUREMENT VTQR_ASDSpdOsc_rpm "" FLOAT32_IEEE AppSwcVcu_CM_single_rpm 0 0 -100000.0 100000.0 ECU_ADDRESS 0x0000 /* @ECU_Address@VTQR_ASDSpdOsc_rpm@ */ /end MEASUREMENT
/begin MEASUREMENT VTQR_MotDampngLmt_Nm "" FLOAT32_IEEE AppSwcVcu_CM_single_Nm 0 0 -100000.0 100000.0 ECU_ADDRESS 0x0000 /* @ECU_Address@VTQR_MotDampngLmt_Nm@ */ /end MEASUREMENT
/begin MEASUREMENT VTQR_ASDTqReqRaw_Nm "" FLOAT32_IEEE AppSwcVcu_CM_single_Nm 0 0 -100000.0 100000.0 ECU_ADDRESS 0x0000 /* @ECU_Address@VTQR_ASDTqReqRaw_Nm@ */ /end MEASUREMENT
/begin MEASUREMENT VTQR_ASDTqReq_Nm "" FLOAT32_IEEE AppSwcVcu_CM_single_Nm 0 0 -100000.0 100000.0 ECU_ADDRESS 0x0000 /* @ECU_Address@VTQR_ASDTqReq_Nm@ */ /end MEASUREMENT
/begin MEASUREMENT VTZX_MotorTqReqPrdt_Nm "" FLOAT32_IEEE AppSwcVcu_CM_single_Nm 0 0 -100000.0 100000.0 ECU_ADDRESS 0x0000 /* @ECU_Address@VTZX_MotorTqReqPrdt_Nm@ */ /end MEASUREMENT
/begin MEASUREMENT VTQC_ABSorESPActvTm_s "" FLOAT32_IEEE AppSwcVcu_CM_single_s 0 0 -100000.0 100000.0 ECU_ADDRESS 0x0000 /* @ECU_Address@VTQC_ABSorESPActvTm_s@ */ /end MEASUREMENT
/begin MEASUREMENT VTQC_DrvTqReqWhlRBS_Nm "" FLOAT32_IEEE AppSwcVcu_CM_single_Nm 0 0 -100000.0 100000.0 ECU_ADDRESS 0x0000 /* @ECU_Address@VTQC_DrvTqReqWhlRBS_Nm@ */ /end MEASUREMENT
/begin MEASUREMENT VTQF_TipOutTqDecRateCoeff_rat "" FLOAT32_IEEE AppSwcVcu_CM_single_rat 0 0 -100000.0 100000.0 ECU_ADDRESS 0x0000 /* @ECU_Address@VTQF_TipOutTqDecRateCoeff_rat@ */ /end MEASUREMENT
/begin MEASUREMENT VTQF_TqOutChgRate_Nmps "" FLOAT32_IEEE AppSwcVcu_CM_single_Nmps 0 0 -100000.0 100000.0 ECU_ADDRESS 0x0000 /* @ECU_Address@VTQF_TqOutChgRate_Nmps@ */ /end MEASUREMENT
/begin MEASUREMENT VTQF_TqRawChgRate_Nmps "" FLOAT32_IEEE AppSwcVcu_CM_single_Nmps 0 0 -100000.0 100000.0 ECU_ADDRESS 0x0000 /* @ECU_Address@VTQF_TqRawChgRate_Nmps@ */ /end MEASUREMENT
/begin MEASUREMENT VTQF_TqRateDecTgtMax_Nmps "" FLOAT32_IEEE AppSwcVcu_CM_single_Nmps 0 0 -100000.0 100000.0 ECU_ADDRESS 0x0000 /* @ECU_Address@VTQF_TqRateDecTgtMax_Nmps@ */ /end MEASUREMENT
/begin MEASUREMENT VTQF_TqRateDecTgtMin_Nmps "" FLOAT32_IEEE AppSwcVcu_CM_single_Nmps 0 0 -100000.0 100000.0 ECU_ADDRESS 0x0000 /* @ECU_Address@VTQF_TqRateDecTgtMin_Nmps@ */ /end MEASUREMENT
/begin MEASUREMENT VTQF_TqRateLimDec_Nmps "" FLOAT32_IEEE AppSwcVcu_CM_single_Nmps 0 0 -100000.0 100000.0 ECU_ADDRESS 0x0000 /* @ECU_Address@VTQF_TqRateLimDec_Nmps@ */ /end MEASUREMENT
/begin MEASUREMENT VTQF_TqRateIncTgtMax_Nmps "" FLOAT32_IEEE AppSwcVcu_CM_single_Nmps 0 0 -100000.0 100000.0 ECU_ADDRESS 0x0000 /* @ECU_Address@VTQF_TqRateIncTgtMax_Nmps@ */ /end MEASUREMENT
/begin MEASUREMENT VTQF_TqRateIncTgtMin_Nmps "" FLOAT32_IEEE AppSwcVcu_CM_single_Nmps 0 0 -100000.0 100000.0 ECU_ADDRESS 0x0000 /* @ECU_Address@VTQF_TqRateIncTgtMin_Nmps@ */ /end MEASUREMENT
/begin MEASUREMENT VTQF_TqRateLimInc_Nmps "" FLOAT32_IEEE AppSwcVcu_CM_single_Nmps 0 0 -100000.0 100000.0 ECU_ADDRESS 0x0000 /* @ECU_Address@VTQF_TqRateLimInc_Nmps@ */ /end MEASUREMENT
/begin MEASUREMENT VTQF_WhlDrgMaxTqZX_Nm "" FLOAT32_IEEE AppSwcVcu_CM_single_Nm 0 0 -100000.0 100000.0 ECU_ADDRESS 0x0000 /* @ECU_Address@VTQF_WhlDrgMaxTqZX_Nm@ */ /end MEASUREMENT
/begin MEASUREMENT VTQF_WhlDrvMaxTqZX_Nm "" FLOAT32_IEEE AppSwcVcu_CM_single_Nm 0 0 -100000.0 100000.0 ECU_ADDRESS 0x0000 /* @ECU_Address@VTQF_WhlDrvMaxTqZX_Nm@ */ /end MEASUREMENT
/begin MEASUREMENT VTQD_CstRegenEndPstn_pct "" FLOAT32_IEEE AppSwcVcu_CM_single_pct 0 0 -100000.0 100000.0 ECU_ADDRESS 0x0000 /* @ECU_Address@VTQD_CstRegenEndPstn_pct@ */ /end MEASUREMENT
/begin MEASUREMENT VTQD_AccelPedPstnRescl_pct "" FLOAT32_IEEE AppSwcVcu_CM_single_pct 0 0 -100000.0 100000.0 ECU_ADDRESS 0x0000 /* @ECU_Address@VTQD_AccelPedPstnRescl_pct@ */ /end MEASUREMENT
/begin MEASUREMENT VTQD_CrpTqReqWhl_Nm "" FLOAT32_IEEE AppSwcVcu_CM_single_Nm 0 0 -100000.0 100000.0 ECU_ADDRESS 0x0000 /* @ECU_Address@VTQD_CrpTqReqWhl_Nm@ */ /end MEASUREMENT
/begin MEASUREMENT VTQD_DrvTqReqWhlRaw_Nm "" FLOAT32_IEEE AppSwcVcu_CM_single_Nm 0 0 -100000.0 100000.0 ECU_ADDRESS 0x0000 /* @ECU_Address@VTQD_DrvTqReqWhlRaw_Nm@ */ /end MEASUREMENT
/begin MEASUREMENT VTQD_AdaptCstMinTqWhl_Nm "" FLOAT32_IEEE AppSwcVcu_CM_single_Nm 0 0 -100000.0 100000.0 ECU_ADDRESS 0x0000 /* @ECU_Address@VTQD_AdaptCstMinTqWhl_Nm@ */ /end MEASUREMENT
/begin MEASUREMENT VTQD_AdaptCstMaxTqWhl_Nm "" FLOAT32_IEEE AppSwcVcu_CM_single_Nm 0 0 -100000.0 100000.0 ECU_ADDRESS 0x0000 /* @ECU_Address@VTQD_AdaptCstMaxTqWhl_Nm@ */ /end MEASUREMENT
/begin MEASUREMENT VTQD_CstRegenTqReqWhl_Nm "" FLOAT32_IEEE AppSwcVcu_CM_single_Nm 0 0 -100000.0 100000.0 ECU_ADDRESS 0x0000 /* @ECU_Address@VTQD_CstRegenTqReqWhl_Nm@ */ /end MEASUREMENT
/begin MEASUREMENT VTQD_FullPedDrvTqWhl_Nm "" FLOAT32_IEEE AppSwcVcu_CM_single_Nm 0 0 -100000.0 100000.0 ECU_ADDRESS 0x0000 /* @ECU_Address@VTQD_FullPedDrvTqWhl_Nm@ */ /end MEASUREMENT
/begin MEASUREMENT VTQD_DrvTqDrtFac_c "" FLOAT32_IEEE AppSwcVcu_CM_single_c 0 0 -100000.0 100000.0 ECU_ADDRESS 0x0000 /* @ECU_Address@VTQD_DrvTqDrtFac_c@ */ /end MEASUREMENT
/begin MEASUREMENT VTQD_DrvTqReqWhlMrg_Nm "" FLOAT32_IEEE AppSwcVcu_CM_single_Nm 0 0 -100000.0 100000.0 ECU_ADDRESS 0x0000 /* @ECU_Address@VTQD_DrvTqReqWhlMrg_Nm@ */ /end MEASUREMENT
/begin MEASUREMENT VTQD_AdaptCstTgtAcceltn_mps2 "" FLOAT32_IEEE AppSwcVcu_CM_single_mps2 0 0 -100000.0 100000.0 ECU_ADDRESS 0x0000 /* @ECU_Address@VTQD_AdaptCstTgtAcceltn_mps2@ */ /end MEASUREMENT
/begin MEASUREMENT VTQD_AdaptCstDeltaAcceltn_mps2 "" FLOAT32_IEEE AppSwcVcu_CM_single_mps2 0 0 -100000.0 100000.0 ECU_ADDRESS 0x0000 /* @ECU_Address@VTQD_AdaptCstDeltaAcceltn_mps2@ */ /end MEASUREMENT
/begin MEASUREMENT VTQD_AdaptCstDsrdTqFF_Nm "" FLOAT32_IEEE AppSwcVcu_CM_single_Nm 0 0 -100000.0 100000.0 ECU_ADDRESS 0x0000 /* @ECU_Address@VTQD_AdaptCstDsrdTqFF_Nm@ */ /end MEASUREMENT
/begin MEASUREMENT VTQD_AdaptCstDsrdTqP_N "" FLOAT32_IEEE AppSwcVcu_CM_single_N 0 0 -100000.0 100000.0 ECU_ADDRESS 0x0000 /* @ECU_Address@VTQD_AdaptCstDsrdTqP_N@ */ /end MEASUREMENT
/begin MEASUREMENT VTQD_AdaptCstDsrdTqI_N "" FLOAT32_IEEE AppSwcVcu_CM_single_N 0 0 -100000.0 100000.0 ECU_ADDRESS 0x0000 /* @ECU_Address@VTQD_AdaptCstDsrdTqI_N@ */ /end MEASUREMENT
/begin MEASUREMENT VTQD_AdaptCstDsrdTqPID_Nm "" FLOAT32_IEEE AppSwcVcu_CM_single_Nm 0 0 -100000.0 100000.0 ECU_ADDRESS 0x0000 /* @ECU_Address@VTQD_AdaptCstDsrdTqPID_Nm@ */ /end MEASUREMENT
/begin MEASUREMENT VTQD_AdaptCstTqReqWhl_Nm "" FLOAT32_IEEE AppSwcVcu_CM_single_Nm 0 0 -100000.0 100000.0 ECU_ADDRESS 0x0000 /* @ECU_Address@VTQD_AdaptCstTqReqWhl_Nm@ */ /end MEASUREMENT
/begin MEASUREMENT VTQD_FwdPedMap_pct "" FLOAT32_IEEE AppSwcVcu_CM_single_pct 0 0 -100000.0 100000.0 ECU_ADDRESS 0x0000 /* @ECU_Address@VTQD_FwdPedMap_pct@ */ /end MEASUREMENT
/begin MEASUREMENT VDAC_HDCTgtAcceltn_mps2 "" FLOAT32_IEEE AppSwcVcu_CM_single_mps2 0 0 -100000.0 100000.0 ECU_ADDRESS 0x0000 /* @ECU_Address@VDAC_HDCTgtAcceltn_mps2@ */ /end MEASUREMENT
/begin MEASUREMENT VDAC_HDCTqReqWhl_Nm "" FLOAT32_IEEE AppSwcVcu_CM_single_Nm 0 0 -100000.0 100000.0 ECU_ADDRESS 0x0000 /* @ECU_Address@VDAC_HDCTqReqWhl_Nm@ */ /end MEASUREMENT
/begin MEASUREMENT VDAC_OPDVehSpdMotorFac_rat "" FLOAT32_IEEE AppSwcVcu_CM_single_rat 0 0 0.0 1.0 ECU_ADDRESS 0x0000 /* @ECU_Address@VDAC_OPDVehSpdMotorFac_rat@ */ /end MEASUREMENT
/begin MEASUREMENT VDAC_OPDVehSpdMotor_kph "" FLOAT32_IEEE AppSwcVcu_CM_single_kph 0 0 -100000.0 100000.0 ECU_ADDRESS 0x0000 /* @ECU_Address@VDAC_OPDVehSpdMotor_kph@ */ /end MEASUREMENT
/begin MEASUREMENT VDAC_OPDVehAcceltn2_mps2 "" FLOAT32_IEEE AppSwcVcu_CM_single_mps2 0 0 -100000.0 100000.0 ECU_ADDRESS 0x0000 /* @ECU_Address@VDAC_OPDVehAcceltn2_mps2@ */ /end MEASUREMENT
/begin MEASUREMENT VDAC_OPDVehAcceltn_mps2 "" FLOAT32_IEEE AppSwcVcu_CM_single_mps2 0 0 -100000.0 100000.0 ECU_ADDRESS 0x0000 /* @ECU_Address@VDAC_OPDVehAcceltn_mps2@ */ /end MEASUREMENT
/begin MEASUREMENT VDAC_OPDVehSpd_kph "" FLOAT32_IEEE AppSwcVcu_CM_single_kph 0 0 -100000.0 100000.0 ECU_ADDRESS 0x0000 /* @ECU_Address@VDAC_OPDVehSpd_kph@ */ /end MEASUREMENT
/begin MEASUREMENT VDAC_OPDTgtAcceltn_mps2 "" FLOAT32_IEEE AppSwcVcu_CM_single_mps2 0 0 -100000.0 100000.0 ECU_ADDRESS 0x0000 /* @ECU_Address@VDAC_OPDTgtAcceltn_mps2@ */ /end MEASUREMENT
/begin MEASUREMENT VDAC_OPDTgtSpd_kph "" FLOAT32_IEEE AppSwcVcu_CM_single_kph 0 0 -100000.0 100000.0 ECU_ADDRESS 0x0000 /* @ECU_Address@VDAC_OPDTgtSpd_kph@ */ /end MEASUREMENT
/begin MEASUREMENT VDAC_OPDTqReqWhlLmt_Nm "" FLOAT32_IEEE AppSwcVcu_CM_single_Nm 0 0 -100000.0 100000.0 ECU_ADDRESS 0x0000 /* @ECU_Address@VDAC_OPDTqReqWhlLmt_Nm@ */ /end MEASUREMENT
/begin MEASUREMENT VDAC_OPDTqReqWhl_Nm "" FLOAT32_IEEE AppSwcVcu_CM_single_Nm 0 0 -100000.0 100000.0 ECU_ADDRESS 0x0000 /* @ECU_Address@VDAC_OPDTqReqWhl_Nm@ */ /end MEASUREMENT
/begin MEASUREMENT VDAC_OPDRtdTq_Nm "" FLOAT32_IEEE AppSwcVcu_CM_single_Nm 0 0 -100000.0 100000.0 ECU_ADDRESS 0x0000 /* @ECU_Address@VDAC_OPDRtdTq_Nm@ */ /end MEASUREMENT
/begin MEASUREMENT VDAC_OPDDsrdTqFF_Nm "" FLOAT32_IEEE AppSwcVcu_CM_single_Nm 0 0 -100000.0 100000.0 ECU_ADDRESS 0x0000 /* @ECU_Address@VDAC_OPDDsrdTqFF_Nm@ */ /end MEASUREMENT
/begin MEASUREMENT VDAC_OPDDeltaAcceltn_mps2 "" FLOAT32_IEEE AppSwcVcu_CM_single_mps2 0 0 -100000.0 100000.0 ECU_ADDRESS 0x0000 /* @ECU_Address@VDAC_OPDDeltaAcceltn_mps2@ */ /end MEASUREMENT
/begin MEASUREMENT VDAC_OPDDeltaSpd_kph "" FLOAT32_IEEE AppSwcVcu_CM_single_kph 0 0 -100000.0 100000.0 ECU_ADDRESS 0x0000 /* @ECU_Address@VDAC_OPDDeltaSpd_kph@ */ /end MEASUREMENT
/begin MEASUREMENT VDAC_OPDMaxDrgTqWhl_Nm "" FLOAT32_IEEE AppSwcVcu_CM_single_Nm 0 0 -100000.0 100000.0 ECU_ADDRESS 0x0000 /* @ECU_Address@VDAC_OPDMaxDrgTqWhl_Nm@ */ /end MEASUREMENT
/begin MEASUREMENT VDAC_OPDMaxDrvTqWhl_Nm "" FLOAT32_IEEE AppSwcVcu_CM_single_Nm 0 0 -100000.0 100000.0 ECU_ADDRESS 0x0000 /* @ECU_Address@VDAC_OPDMaxDrvTqWhl_Nm@ */ /end MEASUREMENT
/begin MEASUREMENT VDAC_OPDDsrdTqP_N "" FLOAT32_IEEE AppSwcVcu_CM_single_N 0 0 -100000.0 100000.0 ECU_ADDRESS 0x0000 /* @ECU_Address@VDAC_OPDDsrdTqP_N@ */ /end MEASUREMENT
/begin MEASUREMENT VDAC_OPDDsrdTqI_N "" FLOAT32_IEEE AppSwcVcu_CM_single_N 0 0 -100000.0 100000.0 ECU_ADDRESS 0x0000 /* @ECU_Address@VDAC_OPDDsrdTqI_N@ */ /end MEASUREMENT
/begin MEASUREMENT VDAC_OPDDsrdTqD_N "" FLOAT32_IEEE AppSwcVcu_CM_single_N 0 0 -100000.0 100000.0 ECU_ADDRESS 0x0000 /* @ECU_Address@VDAC_OPDDsrdTqD_N@ */ /end MEASUREMENT
/begin MEASUREMENT VDAC_OPDDsrdTqPID_Nm "" FLOAT32_IEEE AppSwcVcu_CM_single_Nm 0 0 -100000.0 100000.0 ECU_ADDRESS 0x0000 /* @ECU_Address@VDAC_OPDDsrdTqPID_Nm@ */ /end MEASUREMENT
/begin MEASUREMENT VDAC_OPDTqReqWhlFilt_Nm "" FLOAT32_IEEE AppSwcVcu_CM_single_Nm 0 0 -100000.0 100000.0 ECU_ADDRESS 0x0000 /* @ECU_Address@VDAC_OPDTqReqWhlFilt_Nm@ */ /end MEASUREMENT
/begin MEASUREMENT VDAC_HDCDsrdTqFF_Nm "" FLOAT32_IEEE AppSwcVcu_CM_single_Nm 0 0 -100000.0 100000.0 ECU_ADDRESS 0x0000 /* @ECU_Address@VDAC_HDCDsrdTqFF_Nm@ */ /end MEASUREMENT
/begin MEASUREMENT VDAC_HDCDeltaAcceltn_mps2 "" FLOAT32_IEEE AppSwcVcu_CM_single_mps2 0 0 -100000.0 100000.0 ECU_ADDRESS 0x0000 /* @ECU_Address@VDAC_HDCDeltaAcceltn_mps2@ */ /end MEASUREMENT
/begin MEASUREMENT VDAC_HDCDsrdTqP_N "" FLOAT32_IEEE AppSwcVcu_CM_single_N 0 0 -100000.0 100000.0 ECU_ADDRESS 0x0000 /* @ECU_Address@VDAC_HDCDsrdTqP_N@ */ /end MEASUREMENT
/begin MEASUREMENT VDAC_HDCDsrdTqI_N "" FLOAT32_IEEE AppSwcVcu_CM_single_N 0 0 -100000.0 100000.0 ECU_ADDRESS 0x0000 /* @ECU_Address@VDAC_HDCDsrdTqI_N@ */ /end MEASUREMENT
/begin MEASUREMENT VDAC_HDCDsrdTqPID_Nm "" FLOAT32_IEEE AppSwcVcu_CM_single_Nm 0 0 -100000.0 100000.0 ECU_ADDRESS 0x0000 /* @ECU_Address@VDAC_HDCDsrdTqPID_Nm@ */ /end MEASUREMENT
/begin MEASUREMENT VDAC_CCVehSpdNonDrvn_kph "" FLOAT32_IEEE AppSwcVcu_CM_single_kph 0 0 -100000.0 100000.0 ECU_ADDRESS 0x0000 /* @ECU_Address@VDAC_CCVehSpdNonDrvn_kph@ */ /end MEASUREMENT
/begin MEASUREMENT VDAC_CCSpdUnstabTm_s "" FLOAT32_IEEE AppSwcVcu_CM_single_s 0 0 -100000.0 100000.0 ECU_ADDRESS 0x0000 /* @ECU_Address@VDAC_CCSpdUnstabTm_s@ */ /end MEASUREMENT
/begin MEASUREMENT VDAC_CCTgtSpd_kph "" FLOAT32_IEEE AppSwcVcu_CM_single_kph 0 0 -100000.0 100000.0 ECU_ADDRESS 0x0000 /* @ECU_Address@VDAC_CCTgtSpd_kph@ */ /end MEASUREMENT
/begin MEASUREMENT VDAC_CCTgtSpdCtrl_kph "" FLOAT32_IEEE AppSwcVcu_CM_single_kph 0 0 -100000.0 100000.0 ECU_ADDRESS 0x0000 /* @ECU_Address@VDAC_CCTgtSpdCtrl_kph@ */ /end MEASUREMENT
/begin MEASUREMENT VDAC_CCDsrdAcceltn_mps2 "" FLOAT32_IEEE AppSwcVcu_CM_single_mps2 0 0 -100000.0 100000.0 ECU_ADDRESS 0x0000 /* @ECU_Address@VDAC_CCDsrdAcceltn_mps2@ */ /end MEASUREMENT
/begin MEASUREMENT VDAC_CCTqReqWhl_Nm "" FLOAT32_IEEE AppSwcVcu_CM_single_Nm 0 0 -100000.0 100000.0 ECU_ADDRESS 0x0000 /* @ECU_Address@VDAC_CCTqReqWhl_Nm@ */ /end MEASUREMENT
/begin MEASUREMENT VDAC_CCDsrdTqFF_N "" FLOAT32_IEEE AppSwcVcu_CM_single_N 0 0 -100000.0 100000.0 ECU_ADDRESS 0x0000 /* @ECU_Address@VDAC_CCDsrdTqFF_N@ */ /end MEASUREMENT
/begin MEASUREMENT VDAC_CCDeltaAcceltn_mps2 "" FLOAT32_IEEE AppSwcVcu_CM_single_mps2 0 0 -100000.0 100000.0 ECU_ADDRESS 0x0000 /* @ECU_Address@VDAC_CCDeltaAcceltn_mps2@ */ /end MEASUREMENT
/begin MEASUREMENT VDAC_CCDsrdTqP_N "" FLOAT32_IEEE AppSwcVcu_CM_single_N 0 0 -100000.0 100000.0 ECU_ADDRESS 0x0000 /* @ECU_Address@VDAC_CCDsrdTqP_N@ */ /end MEASUREMENT
/begin MEASUREMENT VDAC_CCDsrdTqI_N "" FLOAT32_IEEE AppSwcVcu_CM_single_N 0 0 -100000.0 100000.0 ECU_ADDRESS 0x0000 /* @ECU_Address@VDAC_CCDsrdTqI_N@ */ /end MEASUREMENT
/begin MEASUREMENT VDAC_CCDsrdTqPID_N "" FLOAT32_IEEE AppSwcVcu_CM_single_N 0 0 -100000.0 100000.0 ECU_ADDRESS 0x0000 /* @ECU_Address@VDAC_CCDsrdTqPID_N@ */ /end MEASUREMENT
/begin MEASUREMENT VDAC_CCDsrdAcceltnRaw_mps2 "" FLOAT32_IEEE AppSwcVcu_CM_single_mps2 0 0 -100000.0 100000.0 ECU_ADDRESS 0x0000 /* @ECU_Address@VDAC_CCDsrdAcceltnRaw_mps2@ */ /end MEASUREMENT
/begin MEASUREMENT VDAC_ACCTqReqWhl_Nm "" FLOAT32_IEEE AppSwcVcu_CM_single_Nm 0 0 -100000.0 100000.0 ECU_ADDRESS 0x0000 /* @ECU_Address@VDAC_ACCTqReqWhl_Nm@ */ /end MEASUREMENT
/begin MEASUREMENT VDAC_ACCDeltaAcceltn_mps2 "" FLOAT32_IEEE AppSwcVcu_CM_single_mps2 0 0 -100000.0 100000.0 ECU_ADDRESS 0x0000 /* @ECU_Address@VDAC_ACCDeltaAcceltn_mps2@ */ /end MEASUREMENT
/begin MEASUREMENT VDAC_ACCDsrdTqFF_Nm "" FLOAT32_IEEE AppSwcVcu_CM_single_Nm 0 0 -100000.0 100000.0 ECU_ADDRESS 0x0000 /* @ECU_Address@VDAC_ACCDsrdTqFF_Nm@ */ /end MEASUREMENT
/begin MEASUREMENT VDAC_ACCDsrdTqP_N "" FLOAT32_IEEE AppSwcVcu_CM_single_N 0 0 -100000.0 100000.0 ECU_ADDRESS 0x0000 /* @ECU_Address@VDAC_ACCDsrdTqP_N@ */ /end MEASUREMENT
/begin MEASUREMENT VDAC_ACCDsrdTqI_N "" FLOAT32_IEEE AppSwcVcu_CM_single_N 0 0 -100000.0 100000.0 ECU_ADDRESS 0x0000 /* @ECU_Address@VDAC_ACCDsrdTqI_N@ */ /end MEASUREMENT
/begin MEASUREMENT VDAC_ACCDsrdTqPID_Nm "" FLOAT32_IEEE AppSwcVcu_CM_single_Nm 0 0 -100000.0 100000.0 ECU_ADDRESS 0x0000 /* @ECU_Address@VDAC_ACCDsrdTqPID_Nm@ */ /end MEASUREMENT
/begin MEASUREMENT VIPC_AccPed1NormzAvg_pct "" FLOAT32_IEEE AppSwcVcu_CM_single_pct 0 0 0.0 100.0 ECU_ADDRESS 0x0000 /* @ECU_Address@VIPC_AccPed1NormzAvg_pct@ */ /end MEASUREMENT
/begin MEASUREMENT VIPC_AccPed2NormzAvg_pct "" FLOAT32_IEEE AppSwcVcu_CM_single_pct 0 0 0.0 100.0 ECU_ADDRESS 0x0000 /* @ECU_Address@VIPC_AccPed2NormzAvg_pct@ */ /end MEASUREMENT
/begin MEASUREMENT VDAC_CCNoActvCond_enum "" UWORD AppSwcVcu_CM_uint16_enum 0 0 0.0 65535.0 ECU_ADDRESS 0x0000 /* @ECU_Address@VDAC_CCNoActvCond_enum@ */ /end MEASUREMENT
/begin MEASUREMENT VDAC_CCQuitCond_enum "" UWORD AppSwcVcu_CM_uint16_enum 0 0 0.0 65535.0 ECU_ADDRESS 0x0000 /* @ECU_Address@VDAC_CCQuitCond_enum@ */ /end MEASUREMENT
/begin MEASUREMENT VDAC_HDCVehSpdHU_kph "" UBYTE AppSwcVcu_CM_uint8_kph 0 0 0.0 255.0 ECU_ADDRESS 0x0000 /* @ECU_Address@VDAC_HDCVehSpdHU_kph@ */ /end MEASUREMENT
/begin MEASUREMENT VDAC_AutoBrkReq_enum "" UBYTE AppSwcVcu_CM_uint8_enum 0 0 0.0 255.0 ECU_ADDRESS 0x0000 /* @ECU_Address@VDAC_AutoBrkReq_enum@ */ /end MEASUREMENT
/begin MEASUREMENT VDAC_VehSpdHU_kph "" UBYTE AppSwcVcu_CM_uint8_kph 0 0 0.0 255.0 ECU_ADDRESS 0x0000 /* @ECU_Address@VDAC_VehSpdHU_kph@ */ /end MEASUREMENT
/begin MEASUREMENT VDAC_CCTgtSpdHU_kph "" UBYTE AppSwcVcu_CM_uint8_kph 0 0 0.0 255.0 ECU_ADDRESS 0x0000 /* @ECU_Address@VDAC_CCTgtSpdHU_kph@ */ /end MEASUREMENT
/begin MEASUREMENT VGSM_VehTgtGrTrnsfr_enum "规范：换档请求信号" UBYTE AppSwcVcu_CM_uint8_enum 0 0 0.0 255.0 ECU_ADDRESS 0x0000 /* @ECU_Address@VGSM_VehTgtGrTrnsfr_enum@ */ /end MEASUREMENT
/begin MEASUREMENT VTZX_ClkActv_flg "" UBYTE AppSwcVcu_CM_boolean_flg 0 0 0.0 1.0 ECU_ADDRESS 0x0000 /* @ECU_Address@VTZX_ClkActv_flg@ */ /end MEASUREMENT
/begin MEASUREMENT VTZX_TqRateLimRamp_flg "" UBYTE AppSwcVcu_CM_boolean_flg 0 0 0.0 1.0 ECU_ADDRESS 0x0000 /* @ECU_Address@VTZX_TqRateLimRamp_flg@ */ /end MEASUREMENT
/begin MEASUREMENT VTZX_TqInc_flg "" UBYTE AppSwcVcu_CM_boolean_flg 0 0 0.0 1.0 ECU_ADDRESS 0x0000 /* @ECU_Address@VTZX_TqInc_flg@ */ /end MEASUREMENT
/begin MEASUREMENT VTZX_BypZX_flg "" UBYTE AppSwcVcu_CM_boolean_flg 0 0 0.0 1.0 ECU_ADDRESS 0x0000 /* @ECU_Address@VTZX_BypZX_flg@ */ /end MEASUREMENT
/begin MEASUREMENT VTQC_RBSActv_flg "" UBYTE AppSwcVcu_CM_boolean_flg 0 0 0.0 1.0 ECU_ADDRESS 0x0000 /* @ECU_Address@VTQC_RBSActv_flg@ */ /end MEASUREMENT
/begin MEASUREMENT VTQF_TqInc_flg "" UBYTE AppSwcVcu_CM_boolean_flg 0 0 0.0 1.0 ECU_ADDRESS 0x0000 /* @ECU_Address@VTQF_TqInc_flg@ */ /end MEASUREMENT
/begin MEASUREMENT VTQD_DsblCrp_flg "" UBYTE AppSwcVcu_CM_boolean_flg 0 0 0.0 1.0 ECU_ADDRESS 0x0000 /* @ECU_Address@VTQD_DsblCrp_flg@ */ /end MEASUREMENT
/begin MEASUREMENT VTQD_CstRegenEnbl_flg "" UBYTE AppSwcVcu_CM_boolean_flg 0 0 0.0 1.0 ECU_ADDRESS 0x0000 /* @ECU_Address@VTQD_CstRegenEnbl_flg@ */ /end MEASUREMENT
/begin MEASUREMENT VTQD_AdaptCstRegenEnbl_flg "" UBYTE AppSwcVcu_CM_boolean_flg 0 0 0.0 1.0 ECU_ADDRESS 0x0000 /* @ECU_Address@VTQD_AdaptCstRegenEnbl_flg@ */ /end MEASUREMENT
/begin MEASUREMENT VTQD_BrkRegenEnbl_flg "" UBYTE AppSwcVcu_CM_boolean_flg 0 0 0.0 1.0 ECU_ADDRESS 0x0000 /* @ECU_Address@VTQD_BrkRegenEnbl_flg@ */ /end MEASUREMENT
/begin MEASUREMENT VTQD_TqZeroFast_flg "" UBYTE AppSwcVcu_CM_boolean_flg 0 0 0.0 1.0 ECU_ADDRESS 0x0000 /* @ECU_Address@VTQD_TqZeroFast_flg@ */ /end MEASUREMENT
/begin MEASUREMENT VTQD_TqZeroSlow_flg "" UBYTE AppSwcVcu_CM_boolean_flg 0 0 0.0 1.0 ECU_ADDRESS 0x0000 /* @ECU_Address@VTQD_TqZeroSlow_flg@ */ /end MEASUREMENT
/begin MEASUREMENT VTQD_TqZero_flg "" UBYTE AppSwcVcu_CM_boolean_flg 0 0 0.0 1.0 ECU_ADDRESS 0x0000 /* @ECU_Address@VTQD_TqZero_flg@ */ /end MEASUREMENT
/begin MEASUREMENT VTQD_BkwdDrv_flg "" UBYTE AppSwcVcu_CM_boolean_flg 0 0 0.0 1.0 ECU_ADDRESS 0x0000 /* @ECU_Address@VTQD_BkwdDrv_flg@ */ /end MEASUREMENT
/begin MEASUREMENT VDAC_HDCIdle2Stdby_flg "" UBYTE AppSwcVcu_CM_boolean_flg 0 0 0.0 1.0 ECU_ADDRESS 0x0000 /* @ECU_Address@VDAC_HDCIdle2Stdby_flg@ */ /end MEASUREMENT
/begin MEASUREMENT VDAC_HDCStdby2Idle_flg "" UBYTE AppSwcVcu_CM_boolean_flg 0 0 0.0 1.0 ECU_ADDRESS 0x0000 /* @ECU_Address@VDAC_HDCStdby2Idle_flg@ */ /end MEASUREMENT
/begin MEASUREMENT VDAC_HDCStdby2Actv_flg "" UBYTE AppSwcVcu_CM_boolean_flg 0 0 0.0 1.0 ECU_ADDRESS 0x0000 /* @ECU_Address@VDAC_HDCStdby2Actv_flg@ */ /end MEASUREMENT
/begin MEASUREMENT VDAC_HDCActv2Stdby_flg "" UBYTE AppSwcVcu_CM_boolean_flg 0 0 0.0 1.0 ECU_ADDRESS 0x0000 /* @ECU_Address@VDAC_HDCActv2Stdby_flg@ */ /end MEASUREMENT
/begin MEASUREMENT VDAC_HDCActv2Idle_flg "" UBYTE AppSwcVcu_CM_boolean_flg 0 0 0.0 1.0 ECU_ADDRESS 0x0000 /* @ECU_Address@VDAC_HDCActv2Idle_flg@ */ /end MEASUREMENT
/begin MEASUREMENT VDAC_EnblEHBBrkRun_flg "" UBYTE AppSwcVcu_CM_boolean_flg 0 0 0.0 1.0 ECU_ADDRESS 0x0000 /* @ECU_Address@VDAC_EnblEHBBrkRun_flg@ */ /end MEASUREMENT
/begin MEASUREMENT VDAC_OPDAvail_flg "" UBYTE AppSwcVcu_CM_boolean_flg 0 0 0.0 1.0 ECU_ADDRESS 0x0000 /* @ECU_Address@VDAC_OPDAvail_flg@ */ /end MEASUREMENT
/begin MEASUREMENT VDAC_OPDActv_flg "" UBYTE AppSwcVcu_CM_boolean_flg 0 0 0.0 1.0 ECU_ADDRESS 0x0000 /* @ECU_Address@VDAC_OPDActv_flg@ */ /end MEASUREMENT
/begin MEASUREMENT VDAC_MstrCylPresDec_flg "" UBYTE AppSwcVcu_CM_boolean_flg 0 0 0.0 1.0 ECU_ADDRESS 0x0000 /* @ECU_Address@VDAC_MstrCylPresDec_flg@ */ /end MEASUREMENT
/begin MEASUREMENT VDAC_OPDTqReqUnload_flg "" UBYTE AppSwcVcu_CM_boolean_flg 0 0 0.0 1.0 ECU_ADDRESS 0x0000 /* @ECU_Address@VDAC_OPDTqReqUnload_flg@ */ /end MEASUREMENT
/begin MEASUREMENT VDAC_OPDOvrd_flg "" UBYTE AppSwcVcu_CM_boolean_flg 0 0 0.0 1.0 ECU_ADDRESS 0x0000 /* @ECU_Address@VDAC_OPDOvrd_flg@ */ /end MEASUREMENT
/begin MEASUREMENT VDAC_OPDSpdClsLoop_flg "" UBYTE AppSwcVcu_CM_boolean_flg 0 0 0.0 1.0 ECU_ADDRESS 0x0000 /* @ECU_Address@VDAC_OPDSpdClsLoop_flg@ */ /end MEASUREMENT
/begin MEASUREMENT VDAC_OPDDsrdTqHldI_flg "" UBYTE AppSwcVcu_CM_boolean_flg 0 0 0.0 1.0 ECU_ADDRESS 0x0000 /* @ECU_Address@VDAC_OPDDsrdTqHldI_flg@ */ /end MEASUREMENT
/begin MEASUREMENT VDAC_OPDDsrdTqFstI_flg "" UBYTE AppSwcVcu_CM_boolean_flg 0 0 0.0 1.0 ECU_ADDRESS 0x0000 /* @ECU_Address@VDAC_OPDDsrdTqFstI_flg@ */ /end MEASUREMENT
/begin MEASUREMENT VDAC_CruzOn_flg "" UBYTE AppSwcVcu_CM_boolean_flg 0 0 0.0 1.0 ECU_ADDRESS 0x0000 /* @ECU_Address@VDAC_CruzOn_flg@ */ /end MEASUREMENT
/begin MEASUREMENT VDAC_CCEnbl_flg "" UBYTE AppSwcVcu_CM_boolean_flg 0 0 0.0 1.0 ECU_ADDRESS 0x0000 /* @ECU_Address@VDAC_CCEnbl_flg@ */ /end MEASUREMENT
/begin MEASUREMENT VDAC_CruzCtrlSwVld_flg "" UBYTE AppSwcVcu_CM_boolean_flg 0 0 0.0 1.0 ECU_ADDRESS 0x0000 /* @ECU_Address@VDAC_CruzCtrlSwVld_flg@ */ /end MEASUREMENT
/begin MEASUREMENT VDAC_CCActvBascCond_flg "" UBYTE AppSwcVcu_CM_boolean_flg 0 0 0.0 1.0 ECU_ADDRESS 0x0000 /* @ECU_Address@VDAC_CCActvBascCond_flg@ */ /end MEASUREMENT
/begin MEASUREMENT VDAC_CruzRsmActv_flg "" UBYTE AppSwcVcu_CM_boolean_flg 0 0 0.0 1.0 ECU_ADDRESS 0x0000 /* @ECU_Address@VDAC_CruzRsmActv_flg@ */ /end MEASUREMENT
/begin MEASUREMENT VDAC_CruzSetActv_flg "" UBYTE AppSwcVcu_CM_boolean_flg 0 0 0.0 1.0 ECU_ADDRESS 0x0000 /* @ECU_Address@VDAC_CruzSetActv_flg@ */ /end MEASUREMENT
/begin MEASUREMENT VDAC_CCStby2Actv_flg "" UBYTE AppSwcVcu_CM_boolean_flg 0 0 0.0 1.0 ECU_ADDRESS 0x0000 /* @ECU_Address@VDAC_CCStby2Actv_flg@ */ /end MEASUREMENT
/begin MEASUREMENT VDAC_CCSpdUnstab_flg "" UBYTE AppSwcVcu_CM_boolean_flg 0 0 0.0 1.0 ECU_ADDRESS 0x0000 /* @ECU_Address@VDAC_CCSpdUnstab_flg@ */ /end MEASUREMENT
/begin MEASUREMENT VDAC_CCActv2Stby_flg "" UBYTE AppSwcVcu_CM_boolean_flg 0 0 0.0 1.0 ECU_ADDRESS 0x0000 /* @ECU_Address@VDAC_CCActv2Stby_flg@ */ /end MEASUREMENT
/begin MEASUREMENT VDAC_CruzSpdDecActv_flg "" UBYTE AppSwcVcu_CM_boolean_flg 0 0 0.0 1.0 ECU_ADDRESS 0x0000 /* @ECU_Address@VDAC_CruzSpdDecActv_flg@ */ /end MEASUREMENT
/begin MEASUREMENT VDAC_CruzSpdIncActv_flg "" UBYTE AppSwcVcu_CM_boolean_flg 0 0 0.0 1.0 ECU_ADDRESS 0x0000 /* @ECU_Address@VDAC_CruzSpdIncActv_flg@ */ /end MEASUREMENT
/begin MEASUREMENT VDAC_CCOvrd_flg "" UBYTE AppSwcVcu_CM_boolean_flg 0 0 0.0 1.0 ECU_ADDRESS 0x0000 /* @ECU_Address@VDAC_CCOvrd_flg@ */ /end MEASUREMENT
/begin MEASUREMENT VDAC_CruzCncl_flg "" UBYTE AppSwcVcu_CM_boolean_flg 0 0 0.0 1.0 ECU_ADDRESS 0x0000 /* @ECU_Address@VDAC_CruzCncl_flg@ */ /end MEASUREMENT
/begin MEASUREMENT VDAC_ACCAvail_flg "" UBYTE AppSwcVcu_CM_boolean_flg 0 0 0.0 1.0 ECU_ADDRESS 0x0000 /* @ECU_Address@VDAC_ACCAvail_flg@ */ /end MEASUREMENT
/begin MEASUREMENT VDAC_ACCEnbl_flg "" UBYTE AppSwcVcu_CM_boolean_flg 0 0 0.0 1.0 ECU_ADDRESS 0x0000 /* @ECU_Address@VDAC_ACCEnbl_flg@ */ /end MEASUREMENT
/begin MEASUREMENT VDAC_ACCOvrd_flg "" UBYTE AppSwcVcu_CM_boolean_flg 0 0 0.0 1.0 ECU_ADDRESS 0x0000 /* @ECU_Address@VDAC_ACCOvrd_flg@ */ /end MEASUREMENT
/begin MEASUREMENT VIPC_AccPed1LrnDwnActv_flg "" UBYTE AppSwcVcu_CM_boolean_flg 0 0 0.0 1.0 ECU_ADDRESS 0x0000 /* @ECU_Address@VIPC_AccPed1LrnDwnActv_flg@ */ /end MEASUREMENT
/begin MEASUREMENT VIPC_AccPed2LrnDwnActv_flg "" UBYTE AppSwcVcu_CM_boolean_flg 0 0 0.0 1.0 ECU_ADDRESS 0x0000 /* @ECU_Address@VIPC_AccPed2LrnDwnActv_flg@ */ /end MEASUREMENT
/begin MEASUREMENT VGSM_GrD2PExcdTm_flg "D档入P请求超时入N" UBYTE AppSwcVcu_CM_boolean_flg 0 0 0.0 1.0 ECU_ADDRESS 0x0000 /* @ECU_Address@VGSM_GrD2PExcdTm_flg@ */ /end MEASUREMENT
/begin MEASUREMENT VGSM_GrR2PExcdTm_flg "R档入P请求超时入N" UBYTE AppSwcVcu_CM_boolean_flg 0 0 0.0 1.0 ECU_ADDRESS 0x0000 /* @ECU_Address@VGSM_GrR2PExcdTm_flg@ */ /end MEASUREMENT
/begin MEASUREMENT VDAC_CruzCtrlStat_enum "" UBYTE AppSwcVcu_CM_EnumCruiseStatus 0 0 0 6 ECU_ADDRESS 0x0000 /* @ECU_Address@VDAC_CruzCtrlStat_enum@ */ /end MEASUREMENT
/begin MEASUREMENT VDAC_CCTgtSpdSt_enum "" UBYTE AppSwcVcu_CM_EnumCCTgtSpdSt 0 0 0 6 ECU_ADDRESS 0x0000 /* @ECU_Address@VDAC_CCTgtSpdSt_enum@ */ /end MEASUREMENT
/begin MEASUREMENT VDAC_CCSt_enum "" UBYTE AppSwcVcu_CM_EnumCCState 0 0 0 2 ECU_ADDRESS 0x0000 /* @ECU_Address@VDAC_CCSt_enum@ */ /end MEASUREMENT
/begin COMPU_METHOD AppSwcVcu_CM_single_pct "Q = V" RAT_FUNC "%8.6" "pct" COEFFS 0 1 0 0 0 1 /end COMPU_METHOD
/begin COMPU_METHOD AppSwcVcu_CM_single_c "Q = V" RAT_FUNC "%8.6" "c" COEFFS 0 1 0 0 0 1 /end COMPU_METHOD
/begin COMPU_METHOD AppSwcVcu_CM_single_kW "Q = V" RAT_FUNC "%8.6" "kW" COEFFS 0 1 0 0 0 1 /end COMPU_METHOD
/begin COMPU_METHOD AppSwcVcu_CM_single_rat "Q = V" RAT_FUNC "%8.6" "rat" COEFFS 0 1 0 0 0 1 /end COMPU_METHOD
/begin COMPU_METHOD AppSwcVcu_CM_single_C "Q = V" RAT_FUNC "%8.6" "C" COEFFS 0 1 0 0 0 1 /end COMPU_METHOD
/begin COMPU_METHOD AppSwcVcu_CM_single_A "Q = V" RAT_FUNC "%8.6" "A" COEFFS 0 1 0 0 0 1 /end COMPU_METHOD
/begin COMPU_METHOD AppSwcVcu_CM_uint8_Ah "Q = V" RAT_FUNC "%3.0" "Ah" COEFFS 0 1 0 0 0 1 /end COMPU_METHOD
/begin COMPU_METHOD AppSwcVcu_CM_single_mV "Q = V" RAT_FUNC "%8.6" "mV" COEFFS 0 1 0 0 0 1 /end COMPU_METHOD
/begin COMPU_METHOD AppSwcVcu_CM_single_kph "Q = V" RAT_FUNC "%8.6" "kph" COEFFS 0 1 0 0 0 1 /end COMPU_METHOD
/begin COMPU_METHOD AppSwcVcu_CM_single_rpm "Q = V" RAT_FUNC "%8.6" "rpm" COEFFS 0 1 0 0 0 1 /end COMPU_METHOD
/begin COMPU_METHOD AppSwcVcu_CM_single_V "Q = V" RAT_FUNC "%8.6" "V" COEFFS 0 1 0 0 0 1 /end COMPU_METHOD
/begin COMPU_METHOD AppSwcVcu_CM_single_Nm "Q = V" RAT_FUNC "%8.6" "Nm" COEFFS 0 1 0 0 0 1 /end COMPU_METHOD
/begin COMPU_METHOD AppSwcVcu_CM_single_mps3 "Q = V" RAT_FUNC "%8.6" "mps3" COEFFS 0 1 0 0 0 1 /end COMPU_METHOD
/begin COMPU_METHOD AppSwcVcu_CM_single_mps2 "Q = V" RAT_FUNC "%8.6" "mps2" COEFFS 0 1 0 0 0 1 /end COMPU_METHOD
/begin COMPU_METHOD AppSwcVcu_CM_single_Nmps "Q = V" RAT_FUNC "%8.6" "Nmps" COEFFS 0 1 0 0 0 1 /end COMPU_METHOD
/begin COMPU_METHOD AppSwcVcu_CM_single_s "Q = V" RAT_FUNC "%8.6" "s" COEFFS 0 1 0 0 0 1 /end COMPU_METHOD
/begin COMPU_METHOD AppSwcVcu_CM_uint8_enum "Q = V" RAT_FUNC "%3.0" "enum" COEFFS 0 1 0 0 0 1 /end COMPU_METHOD
/begin COMPU_METHOD AppSwcVcu_CM_single_kphps "Q = V" RAT_FUNC "%8.6" "kphps" COEFFS 0 1 0 0 0 1 /end COMPU_METHOD
/begin COMPU_METHOD AppSwcVcu_CM_single_N "Q = V" RAT_FUNC "%8.6" "N" COEFFS 0 1 0 0 0 1 /end COMPU_METHOD
/begin COMPU_METHOD AppSwcVcu_CM_single_cps "Q = V" RAT_FUNC "%8.6" "cps" COEFFS 0 1 0 0 0 1 /end COMPU_METHOD
/begin COMPU_METHOD AppSwcVcu_CM_single_nu "Q = V" RAT_FUNC "%8.6" "nu" COEFFS 0 1 0 0 0 1 /end COMPU_METHOD
/begin COMPU_METHOD AppSwcVcu_CM_uint16_enum "Q = V" RAT_FUNC "%5.0" "enum" COEFFS 0 1 0 0 0 1 /end COMPU_METHOD
/begin COMPU_METHOD AppSwcVcu_CM_boolean_flg "Q = V" RAT_FUNC "%1.0" "flg" COEFFS 0 1 0 0 0 1 /end COMPU_METHOD
/begin COMPU_METHOD AppSwcVcu_CM_uint8_kph "Q = V" RAT_FUNC "%3.0" "kph" COEFFS 0 1 0 0 0 1 /end COMPU_METHOD
/begin COMPU_METHOD AppSwcVcu_CM_uint8_cnt "Q = V" RAT_FUNC "%3.0" "cnt" COEFFS 0 1 0 0 0 1 /end COMPU_METHOD
/begin COMPU_METHOD AppSwcVcu_CM_uint8_Cnt "Q = V" RAT_FUNC "%3.0" "Cnt" COEFFS 0 1 0 0 0 1 /end COMPU_METHOD
/begin COMPU_METHOD AppSwcVcu_CM_EnumCruiseStatus "Enumerated data type: EnumCruiseStatus" TAB_VERB "%0.6" "" COMPU_TAB_REF VTAB_FOR_AppSwcVcu_CM_EnumCruiseStatus /end COMPU_METHOD
/begin COMPU_VTAB VTAB_FOR_AppSwcVcu_CM_EnumCruiseStatus "Enumerated data type: EnumCruiseStatus" TAB_VERB 7 0 "EnumCruiseStatus_NormOff" 1 "EnumCruiseStatus_ErrOff" 2 "EnumCruiseStatus_OutRngStby" 3 "EnumCruiseStatus_NormStby" 4 "EnumCruiseStatus_NormActv" 5 "EnumCruiseStatus_OvrdActv" 6 "EnumCruiseStatus_SpdLmt" /end COMPU_VTAB
/begin COMPU_METHOD AppSwcVcu_CM_EnumCCTgtSpdSt "Enumerated data type: EnumCCTgtSpdSt" TAB_VERB "%0.6" "" COMPU_TAB_REF VTAB_FOR_AppSwcVcu_CM_EnumCCTgtSpdSt /end COMPU_METHOD
/begin COMPU_VTAB VTAB_FOR_AppSwcVcu_CM_EnumCCTgtSpdSt "Enumerated data type: EnumCCTgtSpdSt" TAB_VERB 7 0 "EnumCCTgtSpdSt_Reset" 1 "EnumCCTgtSpdSt_Hold" 2 "EnumCCTgtSpdSt_Set" 3 "EnumCCTgtSpdSt_TapDwn" 4 "EnumCCTgtSpdSt_TapUp" 5 "EnumCCTgtSpdSt_Decelerate" 6 "EnumCCTgtSpdSt_Accelerate" /end COMPU_VTAB
/begin COMPU_METHOD AppSwcVcu_CM_EnumCCState "Enumerated data type: EnumCCState" TAB_VERB "%0.6" "" COMPU_TAB_REF VTAB_FOR_AppSwcVcu_CM_EnumCCState /end COMPU_METHOD
/begin COMPU_VTAB VTAB_FOR_AppSwcVcu_CM_EnumCCState "Enumerated data type: EnumCCState" TAB_VERB 3 0 "EnumCCState_Off" 1 "EnumCCState_Standby" 2 "EnumCCState_Active" /end COMPU_VTAB
/begin GROUP S1047_ACCControl "AppSwcVcu/VTM/DAC/Model/CruiseControl/ACCControl" /begin SUB_GROUP S1051_ACCEnable S1051_ACCOvrd S1051_ACCTqResp /end SUB_GROUP /end GROUP
/begin GROUP S1047_CruiseControl "AppSwcVcu/VTM/DAC/Model/CruiseControl/CruiseControl"
 /begin SUB_GROUP S1052_CCSpdCtrl S1052_CCStatDisp S1052_CCState S1052_CCTgtSpd S1052_CruzCtrlSwArb /end SUB_GROUP
/end GROUP
/begin GROUP S1048_HDCSpdCtrl "AppSwcVcu/VTM/DAC/Model/HillDescentControl/HDCSpdCtrl" /begin SUB_GROUP S1140_Active /end SUB_GROUP /begin REF_MEASUREMENT VDAC_HDCTgtAcceltn_mps2 VDAC_HDCTqReqWhl_Nm /end REF_MEASUREMENT /end GROUP
/begin GROUP S1048_HDCVehSpd "AppSwcVcu/VTM/DAC/Model/HillDescentControl/HDCVehSpd" /begin REF_MEASUREMENT VDAC_HDCVehSpdHU_kph /end REF_MEASUREMENT /end GROUP
/begin GROUP S1048_TransCond "AppSwcVcu/VTM/DAC/Model/HillDescentControl/TransCond"
 /begin REF_CHARACTERISTIC KDAC_HDCActvSlopOff_pct KDAC_HDCActvSlopOn_pct KDAC_HDCActvSpdHiOfst_kph KDAC_HDCActvSpdHi_kph KDAC_HDCActvSpdLoOfst_kph KDAC_HDCActvSpdLo_kph KDAC_HDCFuncEnbl_flg KDAC_HDCStdbyAllwdSpd_kph /end REF_CHARACTERISTIC
 /begin REF_MEASUREMENT VDAC_HDCActv2Idle_flg VDAC_HDCActv2Stdby_flg VDAC_HDCIdle2Stdby_flg VDAC_HDCStdby2Actv_flg VDAC_HDCStdby2Idle_flg /end REF_MEASUREMENT
/end GROUP
/begin GROUP S1049_AutoHoldCmd "AppSwcVcu/VTM/DAC/Model/OnePedalDrive/AutoHoldCmd" /begin SUB_GROUP S1161_MstrCylPresrDec S1161_RateLmtWithBypass /end SUB_GROUP
 /begin REF_CHARACTERISTIC KDAC_AutoHoldIntvDlyTm_s KDAC_MstrCylPresDecCfmTm_s KDAC_MstrCylPresDecRecTm_s KDAC_OPDAutoBrkDlyTmLong_s KDAC_OPDAutoBrkDlyTm_s KDAC_OPDOvrdTqOff_Nm KDAC_OPDOvrdTqOn_Nm KDAC_OPDTqReqUnloadRmn_Nm KDAC_OPDTqReqWhlLoadAchvd_Nm KDAC_OPDTqReqWhlLoadFstRate_Nmps KDAC_OPDTqReqWhlLoadRate_Nmps KDAC_OPDTqReqWhlUnloadRate_Nmps KDAC_OPDVehLnhSpd_kph KDAC_OPDVehStopSpd_kph MDAC_OPDOvrdAccPedPstn_pct /end REF_CHARACTERISTIC
 /begin REF_MEASUREMENT VDAC_AutoBrkReq_enum VDAC_OPDOvrd_flg VDAC_OPDTqReqUnload_flg /end REF_MEASUREMENT
/end GROUP
/begin GROUP S1049_OPDEnbl "AppSwcVcu/VTM/DAC/Model/OnePedalDrive/OPDEnbl" /begin SUB_GROUP S1162_RS_Latch1 /end SUB_GROUP
 /begin REF_CHARACTERISTIC KDAC_OPDAvailBMSChrgCur_A KDAC_OPDAvailBMSDchaCur_A KDAC_OPDAvailCapLoDlyTm_s KDAC_OPDAvailMotorDrvTq_Nm KDAC_OPDAvailMotorRegenTq_Nm KDAC_OPDDsblSpd_kph KDAC_OPDEnblSpd_kph KDAC_OPDExitAccPedPstn_pct KDAC_OPDExitBrkPedPstn_pct KDAC_OPDExitVehSpd_kph /end REF_CHARACTERISTIC
 /begin REF_MEASUREMENT VDAC_OPDAvail_flg /end REF_MEASUREMENT
/end GROUP
/begin GROUP S1049_OPDSpdAcceltn "AppSwcVcu/VTM/DAC/Model/OnePedalDrive/OPDSpdAcceltn" /begin SUB_GROUP S1163_LPF1_T_IV S1163_LPF1a_T_IV S1163_OPDActv /end SUB_GROUP
 /begin REF_CHARACTERISTIC KDAC_OPDVehAcceltnFilt2_rat KDAC_OPDVehAcceltnMax_mps2 KDAC_OPDVehAcceltnMin_mps2 KDAC_OPDVehSpdMotorFacFilt_s KDAC_OPDVehSpdUseMotorTgt_kph KDAC_OPDVehSpdUseMotorTm_s /end REF_CHARACTERISTIC
 /begin REF_MEASUREMENT VDAC_OPDTgtAcceltn_mps2 VDAC_OPDTgtSpd_kph VDAC_OPDVehAcceltn_mps2 VDAC_OPDVehSpdMotor_kph VDAC_OPDVehSpd_kph /end REF_MEASUREMENT
/end GROUP
/begin GROUP S1049_OPDSpdCtrl "AppSwcVcu/VTM/DAC/Model/OnePedalDrive/OPDSpdCtrl" /begin SUB_GROUP S1164_Active /end SUB_GROUP /begin REF_MEASUREMENT VDAC_OPDTqReqWhlLmt_Nm /end REF_MEASUREMENT /end GROUP
/begin GROUP S1050_RS_Latch "AppSwcVcu/VTM/DAC/Model/PostProcess/RS_Latch" /begin REF_MEASUREMENT VDAC_EnblEHBBrkRun_flg /end REF_MEASUREMENT /end GROUP
/begin GROUP S1249_Stop_Watch_R_IV "AppSwcVcu/VTM/TQC/Model/ABSActv/Stop_Watch_R_IV" /begin REF_MEASUREMENT VTQC_ABSorESPActvTm_s /end REF_MEASUREMENT /end GROUP
/begin GROUP S1251_Limit "AppSwcVcu/VTM/TQC/Model/RBSIntv/Limit" /begin REF_MEASUREMENT VTQC_DrvTqReqWhlRBS_Nm /end REF_MEASUREMENT /end GROUP
/begin GROUP S1251_RS_Latch "AppSwcVcu/VTM/TQC/Model/RBSIntv/RS_Latch" /begin REF_MEASUREMENT VTQC_RBSActv_flg /end REF_MEASUREMENT /end GROUP
/begin GROUP S1267_DrvTq "AppSwcVcu/VTM/TQD/Model/DriverTqReqOriginal/DrvTq" /begin SUB_GROUP S1270_CreepCtrl S1270_DrvTqCalcD /end SUB_GROUP
 /begin REF_MEASUREMENT VTQD_AccelPedPstnRescl_pct VTQD_DrvTqReqWhlRaw_Nm VTQD_FullPedDrvTqWhl_Nm /end REF_MEASUREMENT
/end GROUP
/begin GROUP S1267_RegenTq "AppSwcVcu/VTM/TQD/Model/DriverTqReqOriginal/RegenTq" /begin SUB_GROUP S1271_CoastRegen S1271_RegenEnableCalc /end SUB_GROUP /end GROUP
/begin GROUP S1268_TorqZeroReq "AppSwcVcu/VTM/TQD/Model/TorqueLimit/TorqZeroReq" /begin SUB_GROUP S1302_ShiftRisk /end SUB_GROUP /begin REF_CHARACTERISTIC KTQD_PlugOnTqZeroSpd_kph /end REF_CHARACTERISTIC /begin REF_MEASUREMENT VTQD_TqZeroFast_flg VTQD_TqZeroSlow_flg VTQD_TqZero_flg /end REF_MEASUREMENT /end GROUP
/begin GROUP S1269_TorqDerateFactor "AppSwcVcu/VTM/TQD/Model/TqSynthAndDerate/TorqDerateFactor"
 /begin SUB_GROUP S1310_BrakePedalPrior S1310_LimitPerformance S1310_VehicleSpeedOvershoot /end SUB_GROUP
 /begin REF_MEASUREMENT VTQD_DrvTqDrtFac_c /end REF_MEASUREMENT
/end GROUP
/begin GROUP S1269_TorqueSynthesize "AppSwcVcu/VTM/TQD/Model/TqSynthAndDerate/TorqueSynthesize" /begin REF_CHARACTERISTIC KTQD_EPBAppliedMaxTq_Nm KTQD_PedTqReqFiltCoeffMAA_c /end REF_CHARACTERISTIC /begin REF_MEASUREMENT VTQD_DrvTqReqWhlMrg_Nm /end REF_MEASUREMENT /end GROUP
/begin GROUP S1324_TqRateLimCalDec "AppSwcVcu/VTM/TQF/Model/FilterSlewRate/TqRateLimCalDec"
 /begin REF_CHARACTERISTIC KTQF_TqRateDecMaxEndg_Nmps KTQF_TqRateDecMaxRegenACC_Nmps KTQF_TqRateDecMaxStart_Nmps MTQF_DecEndRateFiltTmSMode_s MTQF_DecEndRateFiltTm_s MTQF_DecStartRateFiltTmACC_s MTQF_DecStartRateFiltTmSMode_s MTQF_DecStartRateFiltTm_s MTQF_TipOutTqDecRateCoeff_rat MTQF_TqRateDecMaxE_Nmps MTQF_TqRateDecMaxN_Nmps MTQF_TqRateDecMaxRegenE_Nmps MTQF_TqRateDecMaxRegenN_Nmps MTQF_TqRateDecMaxRegenS_Nmps MTQF_TqRateDecMaxS_Nmps /end REF_CHARACTERISTIC
 /begin REF_MEASUREMENT VTQF_TipOutTqDecRateCoeff_rat VTQF_TqRateDecTgtMax_Nmps VTQF_TqRateDecTgtMin_Nmps VTQF_TqRateLimDec_Nmps /end REF_MEASUREMENT
/end GROUP
/begin GROUP S1324_TqRateLimCalInc "AppSwcVcu/VTM/TQF/Model/FilterSlewRate/TqRateLimCalInc"
 /begin REF_CHARACTERISTIC KTQF_TqRateIncMaxEndg_Nmps MTQF_IncEndRateFiltTmSMode_s MTQF_IncEndRateFiltTm_s MTQF_IncStartRateFiltTmACC_s MTQF_IncStartRateFiltTmSMode_s MTQF_IncStartRateFiltTm_s MTQF_TqRateIncMaxE_Nmps MTQF_TqRateIncMaxN_Nmps MTQF_TqRateIncMaxS_Nmps /end REF_CHARACTERISTIC
 /begin REF_MEASUREMENT VTQF_TqRateIncTgtMax_Nmps VTQF_TqRateIncTgtMin_Nmps VTQF_TqRateLimInc_Nmps /end REF_MEASUREMENT
/end GROUP
/begin GROUP S1325_RS_Latch1 "AppSwcVcu/VTM/TQF/Model/TorqueDirection/RS_Latch1" /begin REF_MEASUREMENT VTQF_TqInc_flg /end REF_MEASUREMENT /end GROUP
/begin GROUP S1326_TZXLimTq "AppSwcVcu/VTM/TQF/Model/TorqueFilter/TZXLimTq" /begin REF_MEASUREMENT VTQF_WhlDrgMaxTqZX_Nm VTQF_WhlDrvMaxTqZX_Nm /end REF_MEASUREMENT /end GROUP
/begin GROUP S1327_LPF1a_T_IV "AppSwcVcu/VTM/TQF/Model/TqChgRate/LPF1a_T_IV" /begin REF_MEASUREMENT VTQF_TqRawChgRate_Nmps /end REF_MEASUREMENT /end GROUP
/begin GROUP S1327_LPF1a_T_IV1 "AppSwcVcu/VTM/TQF/Model/TqChgRate/LPF1a_T_IV1" /begin REF_MEASUREMENT VTQF_TqOutChgRate_Nmps /end REF_MEASUREMENT /end GROUP
/begin GROUP S1350_ASDSpdOsc "AppSwcVcu/VTM/TQR/Model/ActiveSurgeDamping/ASDSpdOsc" /begin SUB_GROUP S1355_LPF1_T_IV1 /end SUB_GROUP
 /begin REF_CHARACTERISTIC KTQR_ASDSpdFiltHiDecRate_nu KTQR_ASDSpdFiltHiIncRate_nu KTQR_ASDSpdFiltLo_s MTQR_ASDSpdFiltHi_s /end REF_CHARACTERISTIC
 /begin REF_MEASUREMENT VTQR_ASDSpdOscRaw_rpm /end REF_MEASUREMENT
/end GROUP
/begin GROUP S1350_ASDTqCal "AppSwcVcu/VTM/TQR/Model/ActiveSurgeDamping/ASDTqCal" /begin SUB_GROUP S1356_Limit /end SUB_GROUP
 /begin REF_CHARACTERISTIC KTQR_ASDEnblOscSpd_rpm KTQR_ASDOscTrigTm_s KTQR_ASDTqDbnd_Nm KTQR_ASDTqMax_Nm KTQR_ASDTqMin_Nm KTQR_BypassASDOscTrig_flg MTQR_ASDTqGain_c /end REF_CHARACTERISTIC
 /begin REF_MEASUREMENT VTQR_ASDTqReq_Nm /end REF_MEASUREMENT
/end GROUP
/begin GROUP S1350_OscSpdPhaseComp "AppSwcVcu/VTM/TQR/Model/ActiveSurgeDamping/OscSpdPhaseComp"
 /begin REF_CHARACTERISTIC KTQR_ASDPhCompKa_c KTQR_ASDPhCompKb1_c KTQR_ASDPhCompKb2_c KTQR_ASDSpdPhCompCout_Cnt /end REF_CHARACTERISTIC
 /begin REF_MEASUREMENT VTQR_ASDSpdOsc_rpm /end REF_MEASUREMENT
/end GROUP
/begin GROUP S1351_Limit "AppSwcVcu/VTM/TQR/Model/MotorDampngEnbl/Limit" /begin REF_MEASUREMENT VTQR_MotDampngLmt_Nm /end REF_MEASUREMENT /end GROUP
/begin GROUP S1383_RS_Latch "AppSwcVcu/VTM/TZX/Model/ClunkCtrl/RS_Latch" /begin REF_MEASUREMENT VTZX_ClkActv_flg /end REF_MEASUREMENT /end GROUP
/begin GROUP S1384_BypassZeroX "AppSwcVcu/VTM/TZX/Model/PreProc/BypassZeroX" /begin REF_MEASUREMENT VTZX_BypZX_flg /end REF_MEASUREMENT /end GROUP
/begin GROUP S1384_TorqueDirection "AppSwcVcu/VTM/TZX/Model/PreProc/TorqueDirection" /begin SUB_GROUP S1392_RS_Latch1 /end SUB_GROUP
 /begin REF_CHARACTERISTIC KTZX_MotorTqDecDlyTm_s KTZX_MotorTqDecThr_Nm KTZX_MotorTqIncDlyTm_s KTZX_MotorTqIncThr_Nm /end REF_CHARACTERISTIC
/end GROUP
/begin GROUP S1386_Limit "AppSwcVcu/VTM/TZX/Model/TqReqPrdt/Limit" /begin REF_MEASUREMENT VTZX_MotorTqReqPrdt_Nm /end REF_MEASUREMENT /end GROUP
/begin GROUP S1386_RS_Latch1 "AppSwcVcu/VTM/TZX/Model/TqReqPrdt/RS_Latch1" /begin REF_MEASUREMENT VTZX_TqRateLimRamp_flg /end REF_MEASUREMENT /end GROUP
/begin GROUP S1388_ZXCondCalc "AppSwcVcu/VTM/TZX/Model/ZeroXStat/ZXCondCalc" /begin SUB_GROUP S1407_CondAZD S1407_CondAZI /end SUB_GROUP /end GROUP
/begin GROUP S1502_DNRGearTrans "AppSwcVcu/gsm/GearShift/GearLogical/GearTransion/DNRGearTrans" /begin SUB_GROUP S1538_Subsystem S1538_Subsystem1 /end SUB_GROUP
 /begin REF_CHARACTERISTIC KGSM_GrShftF1R1HldTm_s KGSM_GrShftF2R2HldTm_s KGSM_TgtGrReqWatTm_s /end REF_CHARACTERISTIC
/end GROUP
/begin GROUP S1502_EnterGearP "AppSwcVcu/gsm/GearShift/GearLogical/GearTransion/EnterGearP"
 /begin SUB_GROUP S1539_Subsystem S1539_Subsystem1 S1539_Subsystem2 S1539_Turn_On_Delay1 S1539_Turn_On_Delay5 /end SUB_GROUP
 /begin REF_CHARACTERISTIC KGSM_EPBApld2PDlyTm_s KGSM_GrShftHwPHldTm_s KGSM_TgtGrReqWatTm_s /end REF_CHARACTERISTIC
/end GROUP
/begin GROUP S1502_ExitGearP "AppSwcVcu/gsm/GearShift/GearLogical/GearTransion/ExitGearP" /begin SUB_GROUP S1540_Subsystem S1540_Subsystem1 S1540_Subsystem2 /end SUB_GROUP
 /begin REF_CHARACTERISTIC KGSM_EPBReld2NDlyTm_s KGSM_GrShftF1R1HldTm_s KGSM_GrShftF2R2HldTm_s /end REF_CHARACTERISTIC
/end GROUP
/begin GROUP S1502_VehTargetGearTransferEnum "AppSwcVcu/gsm/GearShift/GearLogical/GearTransion/VehTargetGearTransferEnum" /begin REF_MEASUREMENT VGSM_VehTgtGrTrnsfr_enum /end REF_MEASUREMENT /end GROUP
/begin GROUP S835_LPF1a_T_IV "AppSwcVcu/InputProcess/Model/AccPedal/MinPstnLrnd/Ch1MinPstnLrn/LPF1a_T_IV" /begin REF_MEASUREMENT VIPC_AccPed1NormzAvg_pct /end REF_MEASUREMENT /end GROUP
/begin GROUP S835_Stop_Watch_R_TH1 "AppSwcVcu/InputProcess/Model/AccPedal/MinPstnLrnd/Ch1MinPstnLrn/Stop_Watch_R_TH1" /begin REF_MEASUREMENT VIPC_AccPed1LrnDwnActv_flg /end REF_MEASUREMENT /end GROUP
/begin GROUP S837_LPF1a_T_IV "AppSwcVcu/InputProcess/Model/AccPedal/MinPstnLrnd/Ch2MinPstnLrn/LPF1a_T_IV" /begin REF_MEASUREMENT VIPC_AccPed2NormzAvg_pct /end REF_MEASUREMENT /end GROUP
/begin GROUP S837_Stop_Watch_R_TH1 "AppSwcVcu/InputProcess/Model/AccPedal/MinPstnLrnd/Ch2MinPstnLrn/Stop_Watch_R_TH1" /begin REF_MEASUREMENT VIPC_AccPed2LrnDwnActv_flg /end REF_MEASUREMENT /end GROUP
/begin GROUP S1051_ACCEnable "AppSwcVcu/VTM/DAC/Model/CruiseControl/ACCControl/ACCEnable" /begin REF_CHARACTERISTIC KDAC_BypCruiseSdn_flg KDAC_BypESPTqIntv_flg /end REF_CHARACTERISTIC /begin REF_MEASUREMENT VDAC_ACCAvail_flg VDAC_ACCEnbl_flg /end REF_MEASUREMENT /end GROUP
/begin GROUP S1051_ACCOvrd "AppSwcVcu/VTM/DAC/Model/CruiseControl/ACCControl/ACCOvrd" /begin REF_CHARACTERISTIC MDAC_ACCOvrdTqOff_Nm MDAC_ACCOvrdTqOn_Nm /end REF_CHARACTERISTIC /begin REF_MEASUREMENT VDAC_ACCOvrd_flg /end REF_MEASUREMENT /end GROUP
/begin GROUP S1051_ACCTqResp "AppSwcVcu/VTM/DAC/Model/CruiseControl/ACCControl/ACCTqResp" /begin SUB_GROUP S1056_ACCDeceltn /end SUB_GROUP /begin REF_CHARACTERISTIC KDAC_AccReqStopAllwdSpd_kph /end REF_CHARACTERISTIC /begin REF_MEASUREMENT VDAC_ACCTqReqWhl_Nm /end REF_MEASUREMENT /end GROUP
/begin GROUP S1052_CCSpdCtrl "AppSwcVcu/VTM/DAC/Model/CruiseControl/CruiseControl/CCSpdCtrl" /begin SUB_GROUP S1068_CruzDsrdAcceltn S1068_CruzDsrdTq /end SUB_GROUP /end GROUP
/begin GROUP S1052_CCStatDisp "AppSwcVcu/VTM/DAC/Model/CruiseControl/CruiseControl/CCStatDisp" /begin REF_CHARACTERISTIC KDAC_CCOvrdTqOff_Nm KDAC_CCOvrdTqOn_Nm /end REF_CHARACTERISTIC /begin REF_MEASUREMENT VDAC_CCOvrd_flg VDAC_CruzCtrlStat_enum /end REF_MEASUREMENT /end GROUP
/begin GROUP S1052_CCState "AppSwcVcu/VTM/DAC/Model/CruiseControl/CruiseControl/CCState" /begin SUB_GROUP S1070_CCActive S1070_CCEnable /end SUB_GROUP /begin REF_MEASUREMENT VDAC_CCSt_enum /end REF_MEASUREMENT /end GROUP
/begin GROUP S1052_CCTgtSpd "AppSwcVcu/VTM/DAC/Model/CruiseControl/CruiseControl/CCTgtSpd" /begin SUB_GROUP S1071_RateLimit_R_IV S1071_TgtSpdLim /end SUB_GROUP
 /begin REF_CHARACTERISTIC KDAC_CCSpdChgLongDiv_cnt KDAC_CCSpdChgShort_kph KDAC_CCTgtSpdChgRate_kphps KDAC_TapDwnTmOut_s KDAC_TapUpTmOut_s /end REF_CHARACTERISTIC
 /begin REF_MEASUREMENT VDAC_CCTgtSpdHU_kph VDAC_CCTgtSpdSt_enum VDAC_CCTgtSpd_kph /end REF_MEASUREMENT
/end GROUP
/begin GROUP S1052_CruzCtrlSwArb "AppSwcVcu/VTM/DAC/Model/CruiseControl/CruiseControl/CruzCtrlSwArb"
 /begin SUB_GROUP S1072_Count_R S1072_RS_Latch1 S1072_RS_Latch2 S1072_RS_Latch3 S1072_RS_Latch4 S1072_Turn_On_Delay1 /end SUB_GROUP
 /begin REF_CHARACTERISTIC KDAC_CruzSetSwOpTm_s /end REF_CHARACTERISTIC
 /begin REF_MEASUREMENT VDAC_CruzCtrlSwVld_flg VDAC_CruzOn_flg /end REF_MEASUREMENT
/end GROUP
/begin GROUP S1140_Active "AppSwcVcu/VTM/DAC/Model/HillDescentControl/HDCSpdCtrl/Active" /begin SUB_GROUP S1144_HDCTgtAcceltn S1144_TqRampFilt S1144_TqReqCalc /end SUB_GROUP /end GROUP
/begin GROUP S1161_MstrCylPresrDec "AppSwcVcu/VTM/DAC/Model/OnePedalDrive/AutoHoldCmd/MstrCylPresrDec" /begin REF_MEASUREMENT VDAC_MstrCylPresDec_flg /end REF_MEASUREMENT /end GROUP
/begin GROUP S1161_RateLmtWithBypass "AppSwcVcu/VTM/DAC/Model/OnePedalDrive/AutoHoldCmd/RateLmtWithBypass" /begin REF_MEASUREMENT VDAC_OPDTqReqWhl_Nm /end REF_MEASUREMENT /end GROUP
/begin GROUP S1162_RS_Latch1 "AppSwcVcu/VTM/DAC/Model/OnePedalDrive/OPDEnbl/RS_Latch1" /begin REF_MEASUREMENT VDAC_OPDActv_flg /end REF_MEASUREMENT /end GROUP
/begin GROUP S1163_LPF1_T_IV "AppSwcVcu/VTM/DAC/Model/OnePedalDrive/OPDSpdAcceltn/LPF1_T_IV" /begin REF_MEASUREMENT VDAC_OPDVehSpdMotorFac_rat /end REF_MEASUREMENT /end GROUP
/begin GROUP S1163_LPF1a_T_IV "AppSwcVcu/VTM/DAC/Model/OnePedalDrive/OPDSpdAcceltn/LPF1a_T_IV" /begin REF_MEASUREMENT VDAC_OPDVehAcceltn2_mps2 /end REF_MEASUREMENT /end GROUP
/begin GROUP S1163_OPDActv "AppSwcVcu/VTM/DAC/Model/OnePedalDrive/OPDSpdAcceltn/OPDActv"
 /begin REF_CHARACTERISTIC KTQD_BrkPedPrsd_pct MDAC_OPDTgtAcceltnFiltCoeffInit_rat MDAC_OPDTgtAcceltnFiltCoeff_rat MDAC_OPDTgtAcceltn_mps2 MDAC_OPDTgtSpdChgRate_kphps MDAC_OPDTgtSpd_kph /end REF_CHARACTERISTIC
/end GROUP
/begin GROUP S1164_Active "AppSwcVcu/VTM/DAC/Model/OnePedalDrive/OPDSpdCtrl/Active" /begin SUB_GROUP S1198_FF_Items S1198_PID_Items S1198_TqLimitFilter /end SUB_GROUP /end GROUP
/begin GROUP S1270_CreepCtrl "AppSwcVcu/VTM/TQD/Model/DriverTqReqOriginal/DrvTq/CreepCtrl" /begin REF_CHARACTERISTIC KTQD_CrpEnbl_flg KTQD_CrpRsmPedPstn_pct /end REF_CHARACTERISTIC /begin REF_MEASUREMENT VTQD_CrpTqReqWhl_Nm VTQD_DsblCrp_flg /end REF_MEASUREMENT /end GROUP
/begin GROUP S1270_DrvTqCalcD "AppSwcVcu/VTM/TQD/Model/DriverTqReqOriginal/DrvTq/DrvTqCalcD"
 /begin REF_CHARACTERISTIC MTQD_FwdPedMapNoCrpEco_pct MTQD_FwdPedMapNoCrpNorm_pct MTQD_FwdPedMapNoCrpSnow_pct MTQD_FwdPedMapNoCrpSpt_pct /end REF_CHARACTERISTIC
 /begin REF_MEASUREMENT VTQD_FwdPedMap_pct /end REF_MEASUREMENT
/end GROUP
/begin GROUP S1271_CoastRegen "AppSwcVcu/VTM/TQD/Model/DriverTqReqOriginal/RegenTq/CoastRegen" /begin SUB_GROUP S1280_AdaptCoastRegen S1280_CstRegenTqArb /end SUB_GROUP
 /begin REF_CHARACTERISTIC MTQD_CstRegenTqReqWhlR_Nm MTQD_CstRegenTqReqWhlS_Nm MTQD_CstRegenTqReqWhlV_Nm MTQD_CstRegenTqReqWhlW_Nm /end REF_CHARACTERISTIC
/end GROUP
/begin GROUP S1271_RegenEnableCalc "AppSwcVcu/VTM/TQD/Model/DriverTqReqOriginal/RegenTq/RegenEnableCalc"
 /begin REF_CHARACTERISTIC KTQD_BrkPedPrsd_pct KTQD_CstRegenVehSpdOff_kph KTQD_CstRegenVehSpdOn_kph MTQD_CstRegenEndPstnA_pct MTQD_CstRegenEndPstnS_pct MTQD_CstRegenEndPstnV_pct MTQD_CstRegenEndPstnW_pct /end REF_CHARACTERISTIC
 /begin REF_MEASUREMENT VTQD_BrkRegenEnbl_flg VTQD_CstRegenEnbl_flg VTQD_CstRegenEndPstn_pct /end REF_MEASUREMENT
/end GROUP
/begin GROUP S1302_ShiftRisk "AppSwcVcu/VTM/TQD/Model/TorqueLimit/TorqZeroReq/ShiftRisk" /begin SUB_GROUP S1304_RS_Latch3 /end SUB_GROUP /begin REF_CHARACTERISTIC KTQD_EnblDRShftVehSpd_kph KTQD_EnblDRShftWhlTq_Nm /end REF_CHARACTERISTIC /end GROUP
/begin GROUP S1310_BrakePedalPrior "AppSwcVcu/VTM/TQD/Model/TqSynthAndDerate/TorqDerateFactor/BrakePedalPrior" /begin REF_CHARACTERISTIC KTQD_AccelPedPrsdOff_pct KTQD_AccelPedPrsdOn_pct /end REF_CHARACTERISTIC /end GROUP
/begin GROUP S1310_LimitPerformance "AppSwcVcu/VTM/TQD/Model/TqSynthAndDerate/TorqDerateFactor/LimitPerformance" /begin REF_CHARACTERISTIC KTQD_TqDrtFacLmtPerfmnRate_cps /end REF_CHARACTERISTIC /end GROUP
/begin GROUP S1310_VehicleSpeedOvershoot "AppSwcVcu/VTM/TQD/Model/TqSynthAndDerate/TorqDerateFactor/VehicleSpeedOvershoot"
 /begin REF_CHARACTERISTIC KTQD_TqDrtFacVehSpdDecRate_cps KTQD_TqDrtFacVehSpdIncRate_cps /end REF_CHARACTERISTIC
/end GROUP
/begin GROUP S1355_LPF1_T_IV1 "AppSwcVcu/VTM/TQR/Model/ActiveSurgeDamping/ASDSpdOsc/LPF1_T_IV1" /begin REF_MEASUREMENT VTQR_ASDSpdFltHi_rpm /end REF_MEASUREMENT /end GROUP
/begin GROUP S1356_Limit "AppSwcVcu/VTM/TQR/Model/ActiveSurgeDamping/ASDTqCal/Limit" /begin REF_MEASUREMENT VTQR_ASDTqReqRaw_Nm /end REF_MEASUREMENT /end GROUP
/begin GROUP S1392_RS_Latch1 "AppSwcVcu/VTM/TZX/Model/PreProc/TorqueDirection/RS_Latch1" /begin REF_MEASUREMENT VTZX_TqInc_flg /end REF_MEASUREMENT /end GROUP
/begin GROUP S1407_CondAZD "AppSwcVcu/VTM/TZX/Model/ZeroXStat/ZXCondCalc/CondAZD" /begin REF_CHARACTERISTIC KTZX_UseZeroTqAddRngFinshAZ_flg /end REF_CHARACTERISTIC /end GROUP
/begin GROUP S1407_CondAZI "AppSwcVcu/VTM/TZX/Model/ZeroXStat/ZXCondCalc/CondAZI" /begin REF_CHARACTERISTIC KTZX_UseZeroTqAddRngFinshAZ_flg /end REF_CHARACTERISTIC /end GROUP
/begin GROUP S1538_Subsystem "AppSwcVcu/gsm/GearShift/GearLogical/GearTransion/DNRGearTrans/Subsystem" /begin REF_CHARACTERISTIC KGSM_TgtGrReqWatTm_s /end REF_CHARACTERISTIC /end GROUP
/begin GROUP S1538_Subsystem1 "AppSwcVcu/gsm/GearShift/GearLogical/GearTransion/DNRGearTrans/Subsystem1" /begin REF_CHARACTERISTIC KGSM_TgtGrReqWatTm_s /end REF_CHARACTERISTIC /end GROUP
/begin GROUP S1539_Subsystem "AppSwcVcu/gsm/GearShift/GearLogical/GearTransion/EnterGearP/Subsystem" /begin REF_CHARACTERISTIC KGSM_TgtGrReqWatTm_s /end REF_CHARACTERISTIC /end GROUP
/begin GROUP S1539_Subsystem1 "AppSwcVcu/gsm/GearShift/GearLogical/GearTransion/EnterGearP/Subsystem1" /begin REF_CHARACTERISTIC KGSM_TgtGrReqWatTm_s /end REF_CHARACTERISTIC /end GROUP
/begin GROUP S1539_Subsystem2 "AppSwcVcu/gsm/GearShift/GearLogical/GearTransion/EnterGearP/Subsystem2" /begin REF_CHARACTERISTIC KGSM_TgtGrReqWatTm_s /end REF_CHARACTERISTIC /end GROUP
/begin GROUP S1539_Turn_On_Delay1 "AppSwcVcu/gsm/GearShift/GearLogical/GearTransion/EnterGearP/Turn_On_Delay1" /begin REF_MEASUREMENT VGSM_GrR2PExcdTm_flg /end REF_MEASUREMENT /end GROUP
/begin GROUP S1539_Turn_On_Delay5 "AppSwcVcu/gsm/GearShift/GearLogical/GearTransion/EnterGearP/Turn_On_Delay5" /begin REF_MEASUREMENT VGSM_GrD2PExcdTm_flg /end REF_MEASUREMENT /end GROUP
/begin GROUP S1540_Subsystem "AppSwcVcu/gsm/GearShift/GearLogical/GearTransion/ExitGearP/Subsystem" /begin REF_CHARACTERISTIC KGSM_TgtGrReqWatTm_s /end REF_CHARACTERISTIC /end GROUP
/begin GROUP S1540_Subsystem1 "AppSwcVcu/gsm/GearShift/GearLogical/GearTransion/ExitGearP/Subsystem1" /begin REF_CHARACTERISTIC KGSM_TgtGrReqWatTm_s /end REF_CHARACTERISTIC /end GROUP
/begin GROUP S1540_Subsystem2 "AppSwcVcu/gsm/GearShift/GearLogical/GearTransion/ExitGearP/Subsystem2" /begin REF_CHARACTERISTIC KGSM_TgtGrReqWatTm_s /end REF_CHARACTERISTIC /end GROUP
/begin GROUP S1056_ACCDeceltn "AppSwcVcu/VTM/DAC/Model/CruiseControl/ACCControl/ACCTqResp/ACCDeceltn"
 /begin REF_CHARACTERISTIC KDAC_ACCDsrdTqIMax_N KDAC_ACCDsrdTqIMin_N MDAC_ACCDsrdTqKi_c MDAC_ACCDsrdTqKp_c /end REF_CHARACTERISTIC
 /begin REF_MEASUREMENT VDAC_ACCDeltaAcceltn_mps2 VDAC_ACCDsrdTqFF_Nm VDAC_ACCDsrdTqI_N VDAC_ACCDsrdTqPID_Nm VDAC_ACCDsrdTqP_N /end REF_MEASUREMENT
/end GROUP
/begin GROUP S1068_CruzDsrdAcceltn "AppSwcVcu/VTM/DAC/Model/CruiseControl/CruiseControl/CCSpdCtrl/CruzDsrdAcceltn" /begin SUB_GROUP S1073_CCSActv S1073_LPF1a_T_IV1 /end SUB_GROUP /begin REF_MEASUREMENT VDAC_CCDsrdAcceltn_mps2 /end REF_MEASUREMENT /end GROUP
/begin GROUP S1068_CruzDsrdTq "AppSwcVcu/VTM/DAC/Model/CruiseControl/CruiseControl/CCSpdCtrl/CruzDsrdTq" /begin SUB_GROUP S1074_Active /end SUB_GROUP /begin REF_MEASUREMENT VDAC_CCTqReqWhl_Nm /end REF_MEASUREMENT /end GROUP
/begin GROUP S1070_CCActive "AppSwcVcu/VTM/DAC/Model/CruiseControl/CruiseControl/CCState/CCActive" /begin SUB_GROUP S1095_CCNoActvCond S1095_CCQuitCond S1095_VehSpdUnstab /end SUB_GROUP
 /begin REF_CHARACTERISTIC KDAC_ABSActvDlyTm4CC_s KDAC_BypCruiseSdnCC_flg KDAC_CCMaxSpdOfst_kph KDAC_CCMinSpdOfst_kph KDAC_ESCIntvDlyTm4CC_s KDAC_ESPActvDlyTm4CC_s KDAC_SpdOutRngDlyTm4CC_s KDAC_TCSActvDlyTm4CC_s KDAC_WhlSlipDiffSpd4CC_kph KDAC_WhlSlipDiffSpdOfst4CC_kph KDAC_WhlSlipDlyTm4CC_s /end REF_CHARACTERISTIC
 /begin REF_MEASUREMENT VDAC_CCActv2Stby_flg VDAC_CCActvBascCond_flg VDAC_CCStby2Actv_flg /end REF_MEASUREMENT
/end GROUP
/begin GROUP S1070_CCEnable "AppSwcVcu/VTM/DAC/Model/CruiseControl/CruiseControl/CCState/CCEnable" /begin REF_MEASUREMENT VDAC_CCEnbl_flg /end REF_MEASUREMENT /end GROUP
/begin GROUP S1071_RateLimit_R_IV "AppSwcVcu/VTM/DAC/Model/CruiseControl/CruiseControl/CCTgtSpd/RateLimit_R_IV" /begin REF_MEASUREMENT VDAC_CCTgtSpdCtrl_kph /end REF_MEASUREMENT /end GROUP
/begin GROUP S1071_TgtSpdLim "AppSwcVcu/VTM/DAC/Model/CruiseControl/CruiseControl/CCTgtSpd/TgtSpdLim"
 /begin REF_CHARACTERISTIC KDAC_CCMaxTgtSpdE_kph KDAC_CCMaxTgtSpdN_kph KDAC_CCMaxTgtSpdS_kph KDAC_CCMaxTgtSpdSnow_kph KDAC_CCMinTgtSpd_kph /end REF_CHARACTERISTIC
 /begin REF_MEASUREMENT VDAC_VehSpdHU_kph /end REF_MEASUREMENT
/end GROUP
/begin GROUP S1072_Count_R "AppSwcVcu/VTM/DAC/Model/CruiseControl/CruiseControl/CruzCtrlSwArb/Count_R" /begin REF_CHARACTERISTIC KDAC_CruzSetSwOpCntr_cnt /end REF_CHARACTERISTIC /end GROUP
/begin GROUP S1072_RS_Latch1 "AppSwcVcu/VTM/DAC/Model/CruiseControl/CruiseControl/CruzCtrlSwArb/RS_Latch1" /begin REF_MEASUREMENT VDAC_CruzSetActv_flg /end REF_MEASUREMENT /end GROUP
/begin GROUP S1072_RS_Latch2 "AppSwcVcu/VTM/DAC/Model/CruiseControl/CruiseControl/CruzCtrlSwArb/RS_Latch2" /begin REF_MEASUREMENT VDAC_CruzSpdDecActv_flg /end REF_MEASUREMENT /end GROUP
/begin GROUP S1072_RS_Latch3 "AppSwcVcu/VTM/DAC/Model/CruiseControl/CruiseControl/CruzCtrlSwArb/RS_Latch3" /begin REF_MEASUREMENT VDAC_CruzRsmActv_flg /end REF_MEASUREMENT /end GROUP
/begin GROUP S1072_RS_Latch4 "AppSwcVcu/VTM/DAC/Model/CruiseControl/CruiseControl/CruzCtrlSwArb/RS_Latch4" /begin REF_MEASUREMENT VDAC_CruzSpdIncActv_flg /end REF_MEASUREMENT /end GROUP
/begin GROUP S1072_Turn_On_Delay1 "AppSwcVcu/VTM/DAC/Model/CruiseControl/CruiseControl/CruzCtrlSwArb/Turn_On_Delay1" /begin REF_MEASUREMENT VDAC_CruzCncl_flg /end REF_MEASUREMENT /end GROUP
/begin GROUP S1144_HDCTgtAcceltn "AppSwcVcu/VTM/DAC/Model/HillDescentControl/HDCSpdCtrl/Active/HDCTgtAcceltn" /begin REF_CHARACTERISTIC KDAC_HDCTgtAcceltnFiltCoeff_rat MDAC_HDCTgtAcceltn_mps2 /end REF_CHARACTERISTIC /end GROUP
/begin GROUP S1144_TqReqCalc "AppSwcVcu/VTM/DAC/Model/HillDescentControl/HDCSpdCtrl/Active/TqReqCalc"
 /begin REF_CHARACTERISTIC KDAC_HDCDsrdTqIMax_N KDAC_HDCDsrdTqIMin_N MDAC_HDCDsrdTqKi_c MDAC_HDCDsrdTqKp_c /end REF_CHARACTERISTIC
 /begin REF_MEASUREMENT VDAC_HDCDeltaAcceltn_mps2 VDAC_HDCDsrdTqFF_Nm VDAC_HDCDsrdTqI_N VDAC_HDCDsrdTqPID_Nm VDAC_HDCDsrdTqP_N /end REF_MEASUREMENT
/end GROUP
/begin GROUP S1198_FF_Items "AppSwcVcu/VTM/DAC/Model/OnePedalDrive/OPDSpdCtrl/Active/FF_Items"
 /begin REF_CHARACTERISTIC KDAC_OPDVehResistTqAchvd_Nm KDAC_OPDVehResistTqDrtOff_kph KDAC_OPDVehResistTqDrtOn_kph KDAC_OPDVehResistTqDrt_rat KDAC_OPDVehResistTqFiltCoeff_c /end REF_CHARACTERISTIC
 /begin REF_MEASUREMENT VDAC_OPDDsrdTqFF_Nm VDAC_OPDRtdTq_Nm /end REF_MEASUREMENT
/end GROUP
/begin GROUP S1198_PID_Items "AppSwcVcu/VTM/DAC/Model/OnePedalDrive/OPDSpdCtrl/Active/PID_Items" /begin SUB_GROUP S1201_BackLash S1201_I_Ctrl S1201_LPF1a_T_R_IV1 /end SUB_GROUP
 /begin REF_CHARACTERISTIC KDAC_EnblOPDSpdClsLoopP_flg KDAC_EnblOPDSpdClsLoop_flg KDAC_OPDDsrdTqIMax_N KDAC_OPDDsrdTqIMin_N KDAC_OPDDsrdTqPAchvd_N KDAC_OPDDsrdTqPFiltCoeff_c KDAC_OPDSpdClsLoopOff_kph KDAC_OPDSpdClsLoopOn_kph MDAC_OPDDsrdTqKd_c MDAC_OPDDsrdTqKi2_c MDAC_OPDDsrdTqKi_c MDAC_OPDDsrdTqKp2_c MDAC_OPDDsrdTqKp_c /end REF_CHARACTERISTIC
 /begin REF_MEASUREMENT VDAC_OPDDeltaAcceltn_mps2 VDAC_OPDDeltaSpd_kph VDAC_OPDDsrdTqI_N VDAC_OPDDsrdTqPID_Nm VDAC_OPDSpdClsLoop_flg /end REF_MEASUREMENT
/end GROUP
/begin GROUP S1198_TqLimitFilter "AppSwcVcu/VTM/DAC/Model/OnePedalDrive/OPDSpdCtrl/Active/TqLimitFilter" /begin SUB_GROUP S1202_RateLmtWithBypass /end SUB_GROUP
 /begin REF_CHARACTERISTIC KDAC_OPDOvrdFallRstLmt_flg KDAC_OPDTqReqWhlAchvd_Nm KDAC_OPDTqReqWhlLmtPosOff_Nm KDAC_OPDTqReqWhlLmtPosOn_Nm KDAC_OPDTqReqWhlLmtPos_Nm KDAC_OPDTqReqWhlLmtRateFst_Nmps KDAC_OPDTqReqWhlLmtRate_Nmps MDAC_OPDTqReqWhlRate_Nmps /end REF_CHARACTERISTIC
/end GROUP
/begin GROUP S1280_AdaptCoastRegen "AppSwcVcu/VTM/TQD/Model/DriverTqReqOriginal/RegenTq/CoastRegen/AdaptCoastRegen" /begin SUB_GROUP S1282_RegenTqCalc /end SUB_GROUP
 /begin REF_CHARACTERISTIC KTQD_AdaptCstRegenEnbl_flg KTQD_AdaptCstVehSpdOff_kph KTQD_AdaptCstVehSpdOn_kph KTQD_BrkPedReldDlyTm_s MTQD_AdaptCstMaxTqWhl_Nm MTQD_AdaptCstMinTqWhl_Nm /end REF_CHARACTERISTIC
 /begin REF_MEASUREMENT VTQD_AdaptCstMaxTqWhl_Nm VTQD_AdaptCstMinTqWhl_Nm VTQD_AdaptCstRegenEnbl_flg /end REF_MEASUREMENT
/end GROUP
/begin GROUP S1280_CstRegenTqArb "AppSwcVcu/VTM/TQD/Model/DriverTqReqOriginal/RegenTq/CoastRegen/CstRegenTqArb"
 /begin REF_CHARACTERISTIC KTQD_CstRegenTqFiltAchvd_Nm KTQD_CstRegenTqReqWhlDecEnbl_Nmps KTQD_CstRegenTqReqWhlDec_Nmps KTQD_CstRegenTqReqWhlIncEnbl_Nmps MTQD_CstRegenTqReqWhlInc_Nmps /end REF_CHARACTERISTIC
 /begin REF_MEASUREMENT VTQD_CstRegenTqReqWhl_Nm /end REF_MEASUREMENT
/end GROUP
/begin GROUP S1304_RS_Latch3 "AppSwcVcu/VTM/TQD/Model/TorqueLimit/TorqZeroReq/ShiftRisk/RS_Latch3" /begin REF_MEASUREMENT VTQD_BkwdDrv_flg /end REF_MEASUREMENT /end GROUP
/begin GROUP S1073_CCSActv "AppSwcVcu/VTM/DAC/Model/CruiseControl/CruiseControl/CCSpdCtrl/CruzDsrdAcceltn/CCSActv"
 /begin REF_CHARACTERISTIC KDAC_CCDsrdAcceltnMax_mps2 KDAC_CCDsrdAcceltnMin_mps2 MDAC_CCDsrdAcceltn_mps2 /end REF_CHARACTERISTIC
 /begin REF_MEASUREMENT VDAC_CCDsrdAcceltnRaw_mps2 /end REF_MEASUREMENT
/end GROUP
/begin GROUP S1073_LPF1a_T_IV1 "AppSwcVcu/VTM/DAC/Model/CruiseControl/CruiseControl/CCSpdCtrl/CruzDsrdAcceltn/LPF1a_T_IV1" /begin REF_MEASUREMENT VDAC_CCVehSpdNonDrvn_kph /end REF_MEASUREMENT /end GROUP
/begin GROUP S1074_Active "AppSwcVcu/VTM/DAC/Model/CruiseControl/CruiseControl/CCSpdCtrl/CruzDsrdTq/Active" /begin SUB_GROUP S1079_FF_Items S1079_PI_Items S1079_TqLimit /end SUB_GROUP /end GROUP
/begin GROUP S1095_CCNoActvCond "AppSwcVcu/VTM/DAC/Model/CruiseControl/CruiseControl/CCState/CCActive/CCNoActvCond" /begin REF_MEASUREMENT VDAC_CCNoActvCond_enum /end REF_MEASUREMENT /end GROUP
/begin GROUP S1095_CCQuitCond "AppSwcVcu/VTM/DAC/Model/CruiseControl/CruiseControl/CCState/CCActive/CCQuitCond" /begin REF_MEASUREMENT VDAC_CCQuitCond_enum /end REF_MEASUREMENT /end GROUP
/begin GROUP S1095_VehSpdUnstab "AppSwcVcu/VTM/DAC/Model/CruiseControl/CruiseControl/CCState/CCActive/VehSpdUnstab"
 /begin REF_CHARACTERISTIC KDAC_SpdStabDlyTm4CC_s KDAC_SpdUnstabDlyTm4CC_s MDAC_CCSpdStabLowerOfst_kph MDAC_CCSpdStabUpprOfst_kph /end REF_CHARACTERISTIC
 /begin REF_MEASUREMENT VDAC_CCSpdUnstabTm_s VDAC_CCSpdUnstab_flg /end REF_MEASUREMENT
/end GROUP
/begin GROUP S1201_BackLash "AppSwcVcu/VTM/DAC/Model/OnePedalDrive/OPDSpdCtrl/Active/PID_Items/BackLash" /begin REF_CHARACTERISTIC KDAC_OPDDsrdTqPBckLsh_N /end REF_CHARACTERISTIC /begin REF_MEASUREMENT VDAC_OPDDsrdTqP_N /end REF_MEASUREMENT /end GROUP
/begin GROUP S1201_I_Ctrl "AppSwcVcu/VTM/DAC/Model/OnePedalDrive/OPDSpdCtrl/Active/PID_Items/I Ctrl"
 /begin REF_CHARACTERISTIC KDAC_OPDDsrdTqFastIAccErr_mps2 KDAC_OPDDsrdTqFastIFac_c KDAC_OPDDsrdTqFastISpd_kph KDAC_OPDDsrdTqFastITqErrOff_Nm KDAC_OPDDsrdTqFastITqErrOn_Nm MDAC_OPDDsrdTqFastIAcc_mps2 MDAC_OPDMaxDrgTqWhl_Nm MDAC_OPDMaxDrvTqWhl_Nm /end REF_CHARACTERISTIC
 /begin REF_MEASUREMENT VDAC_OPDDsrdTqFstI_flg VDAC_OPDDsrdTqHldI_flg VDAC_OPDMaxDrgTqWhl_Nm VDAC_OPDMaxDrvTqWhl_Nm /end REF_MEASUREMENT
/end GROUP
/begin GROUP S1201_LPF1a_T_R_IV1 "AppSwcVcu/VTM/DAC/Model/OnePedalDrive/OPDSpdCtrl/Active/PID_Items/LPF1a_T_R_IV1" /begin REF_MEASUREMENT VDAC_OPDDsrdTqD_N /end REF_MEASUREMENT /end GROUP
/begin GROUP S1202_RateLmtWithBypass "AppSwcVcu/VTM/DAC/Model/OnePedalDrive/OPDSpdCtrl/Active/TqLimitFilter/RateLmtWithBypass" /begin REF_MEASUREMENT VDAC_OPDTqReqWhlFilt_Nm /end REF_MEASUREMENT /end GROUP
/begin GROUP S1282_RegenTqCalc "AppSwcVcu/VTM/TQD/Model/DriverTqReqOriginal/RegenTq/CoastRegen/AdaptCoastRegen/RegenTqCalc" /begin SUB_GROUP S1286_LPF1_T_IV /end SUB_GROUP
 /begin REF_CHARACTERISTIC KTQD_AdaptCstDsrdTqIMax_N KTQD_AdaptCstDsrdTqIMin_N KTQD_AdaptCstTgtAcceltnFiltTm_s MTQD_AdaptCstAcceltnReqWhlEndPstn_mps2 MTQD_AdaptCstAcceltnReqWhlS_mps2 MTQD_AdaptCstAcceltnReqWhlW_mps2 MTQD_AdaptCstDsrdTqKi_c MTQD_AdaptCstDsrdTqKp_c /end REF_CHARACTERISTIC
 /begin REF_MEASUREMENT VTQD_AdaptCstDeltaAcceltn_mps2 VTQD_AdaptCstDsrdTqFF_Nm VTQD_AdaptCstDsrdTqI_N VTQD_AdaptCstDsrdTqPID_Nm VTQD_AdaptCstDsrdTqP_N VTQD_AdaptCstTqReqWhl_Nm /end REF_MEASUREMENT
/end GROUP
/begin GROUP S1079_FF_Items "AppSwcVcu/VTM/DAC/Model/CruiseControl/CruiseControl/CCSpdCtrl/CruzDsrdTq/Active/FF_Items" /begin REF_MEASUREMENT VDAC_CCDsrdTqFF_N /end REF_MEASUREMENT /end GROUP
/begin GROUP S1079_PI_Items "AppSwcVcu/VTM/DAC/Model/CruiseControl/CruiseControl/CCSpdCtrl/CruzDsrdTq/Active/PI_Items" /begin SUB_GROUP S1082_I_Ctrl /end SUB_GROUP
 /begin REF_CHARACTERISTIC KDAC_CCDsrdTqIMax_N KDAC_CCDsrdTqIMin_N MDAC_CCDsrdTqKi_c MDAC_CCDsrdTqKp_c /end REF_CHARACTERISTIC
 /begin REF_MEASUREMENT VDAC_CCDeltaAcceltn_mps2 VDAC_CCDsrdTqI_N VDAC_CCDsrdTqPID_N VDAC_CCDsrdTqP_N /end REF_MEASUREMENT
/end GROUP
/begin GROUP S1079_TqLimit "AppSwcVcu/VTM/DAC/Model/CruiseControl/CruiseControl/CCSpdCtrl/CruzDsrdTq/Active/TqLimit"
 /begin REF_CHARACTERISTIC KDAC_CCTqReqWhlAchvd_Nm KDAC_CCTqReqWhlDec_Nmps KDAC_CCTqReqWhlInc_Nmps /end REF_CHARACTERISTIC
/end GROUP
/begin GROUP S1286_LPF1_T_IV "AppSwcVcu/VTM/TQD/Model/DriverTqReqOriginal/RegenTq/CoastRegen/AdaptCoastRegen/RegenTqCalc/LPF1_T_IV" /begin REF_MEASUREMENT VTQD_AdaptCstTgtAcceltn_mps2 /end REF_MEASUREMENT /end GROUP
/begin GROUP S1082_I_Ctrl "AppSwcVcu/VTM/DAC/Model/CruiseControl/CruiseControl/CCSpdCtrl/CruzDsrdTq/Active/PI_Items/I Ctrl"
 /begin REF_CHARACTERISTIC KDAC_CCAccelPedPrsdOff_pct KDAC_CCAccelPedPrsdOn_pct KDAC_CCDsrdTqDecIDlyTm_s KDAC_CCDsrdTqIncIDlyTm_s KDAC_CCHldISpdOverOff_kph KDAC_CCHldISpdOverOn_kph MDAC_CCMaxDrgTqWhl_Nm /end REF_CHARACTERISTIC
/end GROUP
/end MODULE
/end PROJECT
