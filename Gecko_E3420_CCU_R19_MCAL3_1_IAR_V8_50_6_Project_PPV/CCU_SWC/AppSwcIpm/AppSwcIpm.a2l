ASAP2_VERSION 1 31
/begin PROJECT ProjectName "Project Comment Goes Here"
/begin HEADER "Header Comments go here" /end HEADER
/begin MODULE ModuleName "Module Comment Goes Here"
/begin MOD_COMMON "Mod Common Comment Here" BYTE_ORDER MSB_LAST /end MOD_COMMON
/begin RECORD_LAYOUT Scalar_BOOLEAN FNC_VALUES 1 UBYTE COLUMN_DIR DIRECT /end RECORD_LAYOUT
/begin RECORD_LAYOUT Scalar_UBYTE FNC_VALUES 1 UBYTE COLUMN_DIR DIRECT /end RECORD_LAYOUT
/begin RECORD_LAYOUT Scalar_FLOAT32_IEEE FNC_VALUES 1 FLOAT32_IEEE COLUMN_DIR DIRECT /end RECORD_LAYOUT
/begin RECORD_LAYOUT Lookup2D_X_BYTE AXIS_PTS_X 1 SBYTE INDEX_INCR DIRECT /end RECORD_LAYOUT
/begin RECORD_LAYOUT Lookup2D_UWORD FNC_VALUES 1 UWORD COLUMN_DIR DIRECT /end RECORD_LAYOUT
/begin RECORD_LAYOUT Lookup2D_X_UWORD AXIS_PTS_X 1 UWORD INDEX_INCR DIRECT /end RECORD_LAYOUT
/begin RECORD_LAYOUT Lookup2D_WORD FNC_VALUES 1 SWORD COLUMN_DIR DIRECT /end RECORD_LAYOUT
/begin RECORD_LAYOUT Lookup2D_X_WORD AXIS_PTS_X 1 SWORD INDEX_INCR DIRECT /end RECORD_LAYOUT
/begin RECORD_LAYOUT Lookup2D_ULONG FNC_VALUES 1 ULONG COLUMN_DIR DIRECT /end RECORD_LAYOUT
/begin RECORD_LAYOUT Lookup2D_X_ULONG AXIS_PTS_X 1 ULONG INDEX_INCR DIRECT /end RECORD_LAYOUT
/begin RECORD_LAYOUT Lookup2D_LONG FNC_VALUES 1 SLONG COLUMN_DIR DIRECT /end RECORD_LAYOUT
/begin RECORD_LAYOUT Lookup2D_X_LONG AXIS_PTS_X 1 SLONG INDEX_INCR DIRECT /end RECORD_LAYOUT
/begin RECORD_LAYOUT Lookup2D_FLOAT32_IEEE FNC_VALUES 1 FLOAT32_IEEE COLUMN_DIR DIRECT /end RECORD_LAYOUT
/begin RECORD_LAYOUT Lookup2D_X_FLOAT32_IEEE AXIS_PTS_X 1 FLOAT32_IEEE INDEX_INCR DIRECT /end RECORD_LAYOUT
/begin RECORD_LAYOUT Lookup2D_FLOAT64_IEEE FNC_VALUES 1 FLOAT64_IEEE COLUMN_DIR DIRECT /end RECORD_LAYOUT
/begin RECORD_LAYOUT Lookup2D_X_FLOAT64_IEEE AXIS_PTS_X 1 FLOAT64_IEEE INDEX_INCR DIRECT /end RECORD_LAYOUT
/begin CHARACTERISTIC KIPM_BMSActExchgCurntDflt_A "" VALUE 0x0000 /* @ECU_Address@KIPM_BMSActExchgCurntDflt_A@ */ Scalar_FLOAT32_IEEE 0 AppSwcIpm_CM_single_A -100000.0 100000.0 /end CHARACTERISTIC
/begin CHARACTERISTIC KIPM_BMSActExchgCurntHi_A "" VALUE 0x0000 /* @ECU_Address@KIPM_BMSActExchgCurntHi_A@ */ Scalar_FLOAT32_IEEE 0 AppSwcIpm_CM_single_A -100000.0 100000.0 /end CHARACTERISTIC
/begin CHARACTERISTIC KIPM_BMSActExchgCurntLo_A "" VALUE 0x0000 /* @ECU_Address@KIPM_BMSActExchgCurntLo_A@ */ Scalar_FLOAT32_IEEE 0 AppSwcIpm_CM_single_A -100000.0 100000.0 /end CHARACTERISTIC
/begin CHARACTERISTIC KIPM_BMSActExchgCurnt_A_ovrdval "" VALUE 0x0000 /* @ECU_Address@KIPM_BMSActExchgCurnt_A_ovrdval@ */ Scalar_FLOAT32_IEEE 0 AppSwcIpm_CM_single_A -100000.0 100000.0 /end CHARACTERISTIC
/begin CHARACTERISTIC KIPM_BMSBatSOCActDflt_pct "" VALUE 0x0000 /* @ECU_Address@KIPM_BMSBatSOCActDflt_pct@ */ Scalar_FLOAT32_IEEE 0 AppSwcIpm_CM_single_pct -100000.0 100000.0 /end CHARACTERISTIC
/begin CHARACTERISTIC KIPM_BMSBatSOCActHi_pct "" VALUE 0x0000 /* @ECU_Address@KIPM_BMSBatSOCActHi_pct@ */ Scalar_FLOAT32_IEEE 0 AppSwcIpm_CM_single_pct -100000.0 100000.0 /end CHARACTERISTIC
/begin CHARACTERISTIC KIPM_BMSBatSOCActLo_pct "" VALUE 0x0000 /* @ECU_Address@KIPM_BMSBatSOCActLo_pct@ */ Scalar_FLOAT32_IEEE 0 AppSwcIpm_CM_single_pct -100000.0 100000.0 /end CHARACTERISTIC
/begin CHARACTERISTIC KIPM_BMSBatSOCAct_pct_ovrdval "" VALUE 0x0000 /* @ECU_Address@KIPM_BMSBatSOCAct_pct_ovrdval@ */ Scalar_FLOAT32_IEEE 0 AppSwcIpm_CM_single_pct -100000.0 100000.0 /end CHARACTERISTIC
/begin CHARACTERISTIC KIPM_BMSBatSOCRptDflt_pct "" VALUE 0x0000 /* @ECU_Address@KIPM_BMSBatSOCRptDflt_pct@ */ Scalar_FLOAT32_IEEE 0 AppSwcIpm_CM_single_pct -100000.0 100000.0 /end CHARACTERISTIC
/begin CHARACTERISTIC KIPM_BMSBatSOCRptHi_pct "" VALUE 0x0000 /* @ECU_Address@KIPM_BMSBatSOCRptHi_pct@ */ Scalar_FLOAT32_IEEE 0 AppSwcIpm_CM_single_pct -100000.0 100000.0 /end CHARACTERISTIC
/begin CHARACTERISTIC KIPM_BMSBatSOCRptLo_pct "" VALUE 0x0000 /* @ECU_Address@KIPM_BMSBatSOCRptLo_pct@ */ Scalar_FLOAT32_IEEE 0 AppSwcIpm_CM_single_pct -100000.0 100000.0 /end CHARACTERISTIC
/begin CHARACTERISTIC KIPM_BMSBatSOCRpt_pct_ovrdval "" VALUE 0x0000 /* @ECU_Address@KIPM_BMSBatSOCRpt_pct_ovrdval@ */ Scalar_FLOAT32_IEEE 0 AppSwcIpm_CM_single_pct -100000.0 100000.0 /end CHARACTERISTIC
/begin CHARACTERISTIC KIPM_BMSBatSOHDflt_pct "" VALUE 0x0000 /* @ECU_Address@KIPM_BMSBatSOHDflt_pct@ */ Scalar_FLOAT32_IEEE 0 AppSwcIpm_CM_single_pct -100000.0 100000.0 /end CHARACTERISTIC
/begin CHARACTERISTIC KIPM_BMSBatSOHHi_pct "" VALUE 0x0000 /* @ECU_Address@KIPM_BMSBatSOHHi_pct@ */ Scalar_FLOAT32_IEEE 0 AppSwcIpm_CM_single_pct -100000.0 100000.0 /end CHARACTERISTIC
/begin CHARACTERISTIC KIPM_BMSBatSOHLo_pct "" VALUE 0x0000 /* @ECU_Address@KIPM_BMSBatSOHLo_pct@ */ Scalar_FLOAT32_IEEE 0 AppSwcIpm_CM_single_pct -100000.0 100000.0 /end CHARACTERISTIC
/begin CHARACTERISTIC KIPM_BMSBatSOH_pct_ovrdval "" VALUE 0x0000 /* @ECU_Address@KIPM_BMSBatSOH_pct_ovrdval@ */ Scalar_FLOAT32_IEEE 0 AppSwcIpm_CM_single_pct -100000.0 100000.0 /end CHARACTERISTIC
/begin CHARACTERISTIC KIPM_BMSCellVoltMaxDflt_mV "" VALUE 0x0000 /* @ECU_Address@KIPM_BMSCellVoltMaxDflt_mV@ */ Scalar_FLOAT32_IEEE 0 AppSwcIpm_CM_single_mV -100000.0 100000.0 /end CHARACTERISTIC
/begin CHARACTERISTIC KIPM_BMSCellVoltMaxHi_mV "" VALUE 0x0000 /* @ECU_Address@KIPM_BMSCellVoltMaxHi_mV@ */ Scalar_FLOAT32_IEEE 0 AppSwcIpm_CM_single_mV -100000.0 100000.0 /end CHARACTERISTIC
/begin CHARACTERISTIC KIPM_BMSCellVoltMaxLo_mV "" VALUE 0x0000 /* @ECU_Address@KIPM_BMSCellVoltMaxLo_mV@ */ Scalar_FLOAT32_IEEE 0 AppSwcIpm_CM_single_mV -100000.0 100000.0 /end CHARACTERISTIC
/begin CHARACTERISTIC KIPM_BMSCellVoltMax_mV_ovrdval "" VALUE 0x0000 /* @ECU_Address@KIPM_BMSCellVoltMax_mV_ovrdval@ */ Scalar_FLOAT32_IEEE 0 AppSwcIpm_CM_single_mV -100000.0 100000.0 /end CHARACTERISTIC
/begin CHARACTERISTIC KIPM_BMSCellVoltMinDflt_mV "" VALUE 0x0000 /* @ECU_Address@KIPM_BMSCellVoltMinDflt_mV@ */ Scalar_FLOAT32_IEEE 0 AppSwcIpm_CM_single_mV -100000.0 100000.0 /end CHARACTERISTIC
/begin CHARACTERISTIC KIPM_BMSCellVoltMinHi_mV "" VALUE 0x0000 /* @ECU_Address@KIPM_BMSCellVoltMinHi_mV@ */ Scalar_FLOAT32_IEEE 0 AppSwcIpm_CM_single_mV -100000.0 100000.0 /end CHARACTERISTIC
/begin CHARACTERISTIC KIPM_BMSCellVoltMinLo_mV "" VALUE 0x0000 /* @ECU_Address@KIPM_BMSCellVoltMinLo_mV@ */ Scalar_FLOAT32_IEEE 0 AppSwcIpm_CM_single_mV -100000.0 100000.0 /end CHARACTERISTIC
/begin CHARACTERISTIC KIPM_BMSCellVoltMin_mV_ovrdval "" VALUE 0x0000 /* @ECU_Address@KIPM_BMSCellVoltMin_mV_ovrdval@ */ Scalar_FLOAT32_IEEE 0 AppSwcIpm_CM_single_mV -100000.0 100000.0 /end CHARACTERISTIC
/begin CHARACTERISTIC KIPM_BMSHVBatActVoltDflt_V "" VALUE 0x0000 /* @ECU_Address@KIPM_BMSHVBatActVoltDflt_V@ */ Scalar_FLOAT32_IEEE 0 AppSwcIpm_CM_single_V -100000.0 100000.0 /end CHARACTERISTIC
/begin CHARACTERISTIC KIPM_BMSHVBatActVoltHi_V "" VALUE 0x0000 /* @ECU_Address@KIPM_BMSHVBatActVoltHi_V@ */ Scalar_FLOAT32_IEEE 0 AppSwcIpm_CM_single_V -100000.0 100000.0 /end CHARACTERISTIC
/begin CHARACTERISTIC KIPM_BMSHVBatActVoltLo_V "" VALUE 0x0000 /* @ECU_Address@KIPM_BMSHVBatActVoltLo_V@ */ Scalar_FLOAT32_IEEE 0 AppSwcIpm_CM_single_V -100000.0 100000.0 /end CHARACTERISTIC
/begin CHARACTERISTIC KIPM_BMSHVBatActVolt_V_ovrdval "" VALUE 0x0000 /* @ECU_Address@KIPM_BMSHVBatActVolt_V_ovrdval@ */ Scalar_FLOAT32_IEEE 0 AppSwcIpm_CM_single_V -100000.0 100000.0 /end CHARACTERISTIC
/begin CHARACTERISTIC KIPM_BMSInletCooltActlTempDflt_C "" VALUE 0x0000 /* @ECU_Address@KIPM_BMSInletCooltActlTempDflt_C@ */ Scalar_FLOAT32_IEEE 0 AppSwcIpm_CM_single_C -100000.0 100000.0 /end CHARACTERISTIC
/begin CHARACTERISTIC KIPM_BMSInletCooltActlTempHi_C "" VALUE 0x0000 /* @ECU_Address@KIPM_BMSInletCooltActlTempHi_C@ */ Scalar_FLOAT32_IEEE 0 AppSwcIpm_CM_single_C -100000.0 100000.0 /end CHARACTERISTIC
/begin CHARACTERISTIC KIPM_BMSInletCooltActlTempLo_C "" VALUE 0x0000 /* @ECU_Address@KIPM_BMSInletCooltActlTempLo_C@ */ Scalar_FLOAT32_IEEE 0 AppSwcIpm_CM_single_C -100000.0 100000.0 /end CHARACTERISTIC
/begin CHARACTERISTIC KIPM_BMSInletCooltActlTemp_C_ovrdval "" VALUE 0x0000 /* @ECU_Address@KIPM_BMSInletCooltActlTemp_C_ovrdval@ */ Scalar_FLOAT32_IEEE 0 AppSwcIpm_CM_single_C -100000.0 100000.0 /end CHARACTERISTIC
/begin CHARACTERISTIC KIPM_BMSIsoResistDflt_MOhm "" VALUE 0x0000 /* @ECU_Address@KIPM_BMSIsoResistDflt_MOhm@ */ Scalar_FLOAT32_IEEE 0 AppSwcIpm_CM_single_Mohm -100000.0 100000.0 /end CHARACTERISTIC
/begin CHARACTERISTIC KIPM_BMSIsoResistHi_MOhm "" VALUE 0x0000 /* @ECU_Address@KIPM_BMSIsoResistHi_MOhm@ */ Scalar_FLOAT32_IEEE 0 AppSwcIpm_CM_single_MOhm -100000.0 100000.0 /end CHARACTERISTIC
/begin CHARACTERISTIC KIPM_BMSIsoResistLo_MOhm "" VALUE 0x0000 /* @ECU_Address@KIPM_BMSIsoResistLo_MOhm@ */ Scalar_FLOAT32_IEEE 0 AppSwcIpm_CM_single_MOhm -100000.0 100000.0 /end CHARACTERISTIC
/begin CHARACTERISTIC KIPM_BMSIsoResist_MOhm_ovrdval "" VALUE 0x0000 /* @ECU_Address@KIPM_BMSIsoResist_MOhm_ovrdval@ */ Scalar_FLOAT32_IEEE 0 AppSwcIpm_CM_single_Mohm -100000.0 100000.0 /end CHARACTERISTIC
/begin CHARACTERISTIC KIPM_BMSMaxChrgCurntACDflt_A "" VALUE 0x0000 /* @ECU_Address@KIPM_BMSMaxChrgCurntACDflt_A@ */ Scalar_FLOAT32_IEEE 0 AppSwcIpm_CM_single_A -100000.0 100000.0 /end CHARACTERISTIC
/begin CHARACTERISTIC KIPM_BMSMaxChrgCurntACHi_A "" VALUE 0x0000 /* @ECU_Address@KIPM_BMSMaxChrgCurntACHi_A@ */ Scalar_FLOAT32_IEEE 0 AppSwcIpm_CM_single_A -100000.0 100000.0 /end CHARACTERISTIC
/begin CHARACTERISTIC KIPM_BMSMaxChrgCurntACLo_A "" VALUE 0x0000 /* @ECU_Address@KIPM_BMSMaxChrgCurntACLo_A@ */ Scalar_FLOAT32_IEEE 0 AppSwcIpm_CM_single_A -100000.0 100000.0 /end CHARACTERISTIC
/begin CHARACTERISTIC KIPM_BMSMaxChrgCurntAC_A_ovrdval "" VALUE 0x0000 /* @ECU_Address@KIPM_BMSMaxChrgCurntAC_A_ovrdval@ */ Scalar_FLOAT32_IEEE 0 AppSwcIpm_CM_single_A -100000.0 100000.0 /end CHARACTERISTIC
/begin CHARACTERISTIC KIPM_BMSMaxChrgVoltACDflt_V "" VALUE 0x0000 /* @ECU_Address@KIPM_BMSMaxChrgVoltACDflt_V@ */ Scalar_FLOAT32_IEEE 0 AppSwcIpm_CM_single_V -100000.0 100000.0 /end CHARACTERISTIC
/begin CHARACTERISTIC KIPM_BMSMaxChrgVoltACHi_V "" VALUE 0x0000 /* @ECU_Address@KIPM_BMSMaxChrgVoltACHi_V@ */ Scalar_FLOAT32_IEEE 0 AppSwcIpm_CM_single_V -100000.0 100000.0 /end CHARACTERISTIC
/begin CHARACTERISTIC KIPM_BMSMaxChrgVoltACLo_V "" VALUE 0x0000 /* @ECU_Address@KIPM_BMSMaxChrgVoltACLo_V@ */ Scalar_FLOAT32_IEEE 0 AppSwcIpm_CM_single_V -100000.0 100000.0 /end CHARACTERISTIC
/begin CHARACTERISTIC KIPM_BMSMaxChrgVoltAC_V_ovrdval "" VALUE 0x0000 /* @ECU_Address@KIPM_BMSMaxChrgVoltAC_V_ovrdval@ */ Scalar_FLOAT32_IEEE 0 AppSwcIpm_CM_single_V -100000.0 100000.0 /end CHARACTERISTIC
/begin CHARACTERISTIC KIPM_BMSMaxConChrgCurntDflt_A "" VALUE 0x0000 /* @ECU_Address@KIPM_BMSMaxConChrgCurntDflt_A@ */ Scalar_FLOAT32_IEEE 0 AppSwcIpm_CM_single_A -100000.0 100000.0 /end CHARACTERISTIC
/begin CHARACTERISTIC KIPM_BMSMaxConChrgCurntHi_A "" VALUE 0x0000 /* @ECU_Address@KIPM_BMSMaxConChrgCurntHi_A@ */ Scalar_FLOAT32_IEEE 0 AppSwcIpm_CM_single_A -100000.0 100000.0 /end CHARACTERISTIC
/begin CHARACTERISTIC KIPM_BMSMaxConChrgCurntLo_A "" VALUE 0x0000 /* @ECU_Address@KIPM_BMSMaxConChrgCurntLo_A@ */ Scalar_FLOAT32_IEEE 0 AppSwcIpm_CM_single_A -100000.0 100000.0 /end CHARACTERISTIC
/begin CHARACTERISTIC KIPM_BMSMaxConChrgCurnt_A_ovrdval "" VALUE 0x0000 /* @ECU_Address@KIPM_BMSMaxConChrgCurnt_A_ovrdval@ */ Scalar_FLOAT32_IEEE 0 AppSwcIpm_CM_single_A -100000.0 100000.0 /end CHARACTERISTIC
/begin CHARACTERISTIC KIPM_BMSMaxConDisCurntDflt_A "" VALUE 0x0000 /* @ECU_Address@KIPM_BMSMaxConDisCurntDflt_A@ */ Scalar_FLOAT32_IEEE 0 AppSwcIpm_CM_single_A -100000.0 100000.0 /end CHARACTERISTIC
/begin CHARACTERISTIC KIPM_BMSMaxConDisCurntHi_A "" VALUE 0x0000 /* @ECU_Address@KIPM_BMSMaxConDisCurntHi_A@ */ Scalar_FLOAT32_IEEE 0 AppSwcIpm_CM_single_A -100000.0 100000.0 /end CHARACTERISTIC
/begin CHARACTERISTIC KIPM_BMSMaxConDisCurntLo_A "" VALUE 0x0000 /* @ECU_Address@KIPM_BMSMaxConDisCurntLo_A@ */ Scalar_FLOAT32_IEEE 0 AppSwcIpm_CM_single_A -100000.0 100000.0 /end CHARACTERISTIC
/begin CHARACTERISTIC KIPM_BMSMaxConDisCurnt_A_ovrdval "" VALUE 0x0000 /* @ECU_Address@KIPM_BMSMaxConDisCurnt_A_ovrdval@ */ Scalar_FLOAT32_IEEE 0 AppSwcIpm_CM_single_A -100000.0 100000.0 /end CHARACTERISTIC
/begin CHARACTERISTIC KIPM_BMSMaxInsChrgCurntDflt_A "" VALUE 0x0000 /* @ECU_Address@KIPM_BMSMaxInsChrgCurntDflt_A@ */ Scalar_FLOAT32_IEEE 0 AppSwcIpm_CM_single_A -100000.0 100000.0 /end CHARACTERISTIC
/begin CHARACTERISTIC KIPM_BMSMaxInsChrgCurntHi_A "" VALUE 0x0000 /* @ECU_Address@KIPM_BMSMaxInsChrgCurntHi_A@ */ Scalar_FLOAT32_IEEE 0 AppSwcIpm_CM_single_A -100000.0 100000.0 /end CHARACTERISTIC
/begin CHARACTERISTIC KIPM_BMSMaxInsChrgCurntLo_A "" VALUE 0x0000 /* @ECU_Address@KIPM_BMSMaxInsChrgCurntLo_A@ */ Scalar_FLOAT32_IEEE 0 AppSwcIpm_CM_single_A -100000.0 100000.0 /end CHARACTERISTIC
/begin CHARACTERISTIC KIPM_BMSMaxInsChrgCurnt_A_ovrdval "" VALUE 0x0000 /* @ECU_Address@KIPM_BMSMaxInsChrgCurnt_A_ovrdval@ */ Scalar_FLOAT32_IEEE 0 AppSwcIpm_CM_single_A -100000.0 100000.0 /end CHARACTERISTIC
/begin CHARACTERISTIC KIPM_BMSMaxInsDisCurntDflt_A "" VALUE 0x0000 /* @ECU_Address@KIPM_BMSMaxInsDisCurntDflt_A@ */ Scalar_FLOAT32_IEEE 0 AppSwcIpm_CM_single_A -100000.0 100000.0 /end CHARACTERISTIC
/begin CHARACTERISTIC KIPM_BMSMaxInsDisCurntHi_A "" VALUE 0x0000 /* @ECU_Address@KIPM_BMSMaxInsDisCurntHi_A@ */ Scalar_FLOAT32_IEEE 0 AppSwcIpm_CM_single_A -100000.0 100000.0 /end CHARACTERISTIC
/begin CHARACTERISTIC KIPM_BMSMaxInsDisCurntLo_A "" VALUE 0x0000 /* @ECU_Address@KIPM_BMSMaxInsDisCurntLo_A@ */ Scalar_FLOAT32_IEEE 0 AppSwcIpm_CM_single_A -100000.0 100000.0 /end CHARACTERISTIC
/begin CHARACTERISTIC KIPM_BMSMaxInsDisCurnt_A_ovrdval "" VALUE 0x0000 /* @ECU_Address@KIPM_BMSMaxInsDisCurnt_A_ovrdval@ */ Scalar_FLOAT32_IEEE 0 AppSwcIpm_CM_single_A -100000.0 100000.0 /end CHARACTERISTIC
/begin CHARACTERISTIC KIPM_BMSOutlCooltActlTempDflt_C "" VALUE 0x0000 /* @ECU_Address@KIPM_BMSOutlCooltActlTempDflt_C@ */ Scalar_FLOAT32_IEEE 0 AppSwcIpm_CM_single_C -100000.0 100000.0 /end CHARACTERISTIC
/begin CHARACTERISTIC KIPM_BMSOutlCooltActlTempHi_C "" VALUE 0x0000 /* @ECU_Address@KIPM_BMSOutlCooltActlTempHi_C@ */ Scalar_FLOAT32_IEEE 0 AppSwcIpm_CM_single_C -100000.0 100000.0 /end CHARACTERISTIC
/begin CHARACTERISTIC KIPM_BMSOutlCooltActlTempLo_C "" VALUE 0x0000 /* @ECU_Address@KIPM_BMSOutlCooltActlTempLo_C@ */ Scalar_FLOAT32_IEEE 0 AppSwcIpm_CM_single_C -100000.0 100000.0 /end CHARACTERISTIC
/begin CHARACTERISTIC KIPM_BMSOutlCooltActlTemp_C_ovrdval "" VALUE 0x0000 /* @ECU_Address@KIPM_BMSOutlCooltActlTemp_C_ovrdval@ */ Scalar_FLOAT32_IEEE 0 AppSwcIpm_CM_single_C -100000.0 100000.0 /end CHARACTERISTIC
/begin CHARACTERISTIC KIPM_FCMACCWhlDeceDflt_mps2 "" VALUE 0x0000 /* @ECU_Address@KIPM_FCMACCWhlDeceDflt_mps2@ */ Scalar_FLOAT32_IEEE 0 AppSwcIpm_CM_single_mps2 -100000.0 100000.0 /end CHARACTERISTIC
/begin CHARACTERISTIC KIPM_FCMACCWhlDeceHi_mps2 "" VALUE 0x0000 /* @ECU_Address@KIPM_FCMACCWhlDeceHi_mps2@ */ Scalar_FLOAT32_IEEE 0 AppSwcIpm_CM_single_mps2 -100000.0 100000.0 /end CHARACTERISTIC
/begin CHARACTERISTIC KIPM_FCMACCWhlDeceLo_mps2 "" VALUE 0x0000 /* @ECU_Address@KIPM_FCMACCWhlDeceLo_mps2@ */ Scalar_FLOAT32_IEEE 0 AppSwcIpm_CM_single_mps2 -100000.0 100000.0 /end CHARACTERISTIC
/begin CHARACTERISTIC KIPM_FCMACCWhlDece_mps2_ovrdval "" VALUE 0x0000 /* @ECU_Address@KIPM_FCMACCWhlDece_mps2_ovrdval@ */ Scalar_FLOAT32_IEEE 0 AppSwcIpm_CM_single_mps2 -100000.0 100000.0 /end CHARACTERISTIC
/begin CHARACTERISTIC KIPM_FCMACCWhlTqReqValDflt_Nm "" VALUE 0x0000 /* @ECU_Address@KIPM_FCMACCWhlTqReqValDflt_Nm@ */ Scalar_FLOAT32_IEEE 0 AppSwcIpm_CM_single_Nm -100000.0 100000.0 /end CHARACTERISTIC
/begin CHARACTERISTIC KIPM_FCMACCWhlTqReqValHi_Nm "" VALUE 0x0000 /* @ECU_Address@KIPM_FCMACCWhlTqReqValHi_Nm@ */ Scalar_FLOAT32_IEEE 0 AppSwcIpm_CM_single_Nm -100000.0 100000.0 /end CHARACTERISTIC
/begin CHARACTERISTIC KIPM_FCMACCWhlTqReqValLo_Nm "" VALUE 0x0000 /* @ECU_Address@KIPM_FCMACCWhlTqReqValLo_Nm@ */ Scalar_FLOAT32_IEEE 0 AppSwcIpm_CM_single_Nm -100000.0 100000.0 /end CHARACTERISTIC
/begin CHARACTERISTIC KIPM_FCMACCWhlTqReqVal_Nm_ovrdval "" VALUE 0x0000 /* @ECU_Address@KIPM_FCMACCWhlTqReqVal_Nm_ovrdval@ */ Scalar_FLOAT32_IEEE 0 AppSwcIpm_CM_single_Nm -100000.0 100000.0 /end CHARACTERISTIC
/begin CHARACTERISTIC KIPM_FCMAccTarAccrnDflt_mps2 "" VALUE 0x0000 /* @ECU_Address@KIPM_FCMAccTarAccrnDflt_mps2@ */ Scalar_FLOAT32_IEEE 0 AppSwcIpm_CM_single_mps2 -100000.0 100000.0 /end CHARACTERISTIC
/begin CHARACTERISTIC KIPM_FCMAccTarAccrnHi_mps2 "" VALUE 0x0000 /* @ECU_Address@KIPM_FCMAccTarAccrnHi_mps2@ */ Scalar_FLOAT32_IEEE 0 AppSwcIpm_CM_single_mps2 -100000.0 100000.0 /end CHARACTERISTIC
/begin CHARACTERISTIC KIPM_FCMAccTarAccrnLo_mps2 "" VALUE 0x0000 /* @ECU_Address@KIPM_FCMAccTarAccrnLo_mps2@ */ Scalar_FLOAT32_IEEE 0 AppSwcIpm_CM_single_mps2 -100000.0 100000.0 /end CHARACTERISTIC
/begin CHARACTERISTIC KIPM_FCMAccTarAccrn_mps2_ovrdval "" VALUE 0x0000 /* @ECU_Address@KIPM_FCMAccTarAccrn_mps2_ovrdval@ */ Scalar_FLOAT32_IEEE 0 AppSwcIpm_CM_single_mps2 -100000.0 100000.0 /end CHARACTERISTIC
/begin CHARACTERISTIC KIPM_FCMAccTgtAxDflt_mps2 "" VALUE 0x0000 /* @ECU_Address@KIPM_FCMAccTgtAxDflt_mps2@ */ Scalar_FLOAT32_IEEE 0 AppSwcIpm_CM_single_mps2 -100000.0 100000.0 /end CHARACTERISTIC
/begin CHARACTERISTIC KIPM_FCMAccTgtAxHi_mps2 "" VALUE 0x0000 /* @ECU_Address@KIPM_FCMAccTgtAxHi_mps2@ */ Scalar_FLOAT32_IEEE 0 AppSwcIpm_CM_single_mps2 -100000.0 100000.0 /end CHARACTERISTIC
/begin CHARACTERISTIC KIPM_FCMAccTgtAxLo_mps2 "" VALUE 0x0000 /* @ECU_Address@KIPM_FCMAccTgtAxLo_mps2@ */ Scalar_FLOAT32_IEEE 0 AppSwcIpm_CM_single_mps2 -100000.0 100000.0 /end CHARACTERISTIC
/begin CHARACTERISTIC KIPM_FCMAccTgtAx_mps2_ovrdval "" VALUE 0x0000 /* @ECU_Address@KIPM_FCMAccTgtAx_mps2_ovrdval@ */ Scalar_FLOAT32_IEEE 0 AppSwcIpm_CM_single_mps2 -100000.0 100000.0 /end CHARACTERISTIC
/begin CHARACTERISTIC KIPM_INV2InpVoltDflt_V "" VALUE 0x0000 /* @ECU_Address@KIPM_INV2InpVoltDflt_V@ */ Scalar_FLOAT32_IEEE 0 AppSwcIpm_CM_single_V -100000.0 100000.0 /end CHARACTERISTIC
/begin CHARACTERISTIC KIPM_INV2InpVoltHi_V "" VALUE 0x0000 /* @ECU_Address@KIPM_INV2InpVoltHi_V@ */ Scalar_FLOAT32_IEEE 0 AppSwcIpm_CM_single_V -100000.0 100000.0 /end CHARACTERISTIC
/begin CHARACTERISTIC KIPM_INV2InpVoltLo_V "" VALUE 0x0000 /* @ECU_Address@KIPM_INV2InpVoltLo_V@ */ Scalar_FLOAT32_IEEE 0 AppSwcIpm_CM_single_V -100000.0 100000.0 /end CHARACTERISTIC
/begin CHARACTERISTIC KIPM_INV2InpVolt_V_ovrdval "" VALUE 0x0000 /* @ECU_Address@KIPM_INV2InpVolt_V_ovrdval@ */ Scalar_FLOAT32_IEEE 0 AppSwcIpm_CM_single_V -100000.0 100000.0 /end CHARACTERISTIC
/begin CHARACTERISTIC KIPM_INV2MotorMaxTempDflt_C "" VALUE 0x0000 /* @ECU_Address@KIPM_INV2MotorMaxTempDflt_C@ */ Scalar_FLOAT32_IEEE 0 AppSwcIpm_CM_single_C -100000.0 100000.0 /end CHARACTERISTIC
/begin CHARACTERISTIC KIPM_INV2MotorMaxTempHi_C "" VALUE 0x0000 /* @ECU_Address@KIPM_INV2MotorMaxTempHi_C@ */ Scalar_FLOAT32_IEEE 0 AppSwcIpm_CM_single_C -100000.0 100000.0 /end CHARACTERISTIC
/begin CHARACTERISTIC KIPM_INV2MotorMaxTempLo_C "" VALUE 0x0000 /* @ECU_Address@KIPM_INV2MotorMaxTempLo_C@ */ Scalar_FLOAT32_IEEE 0 AppSwcIpm_CM_single_C -100000.0 100000.0 /end CHARACTERISTIC
/begin CHARACTERISTIC KIPM_INV2MotorMaxTemp_C_ovrdval "" VALUE 0x0000 /* @ECU_Address@KIPM_INV2MotorMaxTemp_C_ovrdval@ */ Scalar_FLOAT32_IEEE 0 AppSwcIpm_CM_single_C -100000.0 100000.0 /end CHARACTERISTIC
/begin CHARACTERISTIC KIPM_INV3DrvTqAllwdMaxDflt_Nm "" VALUE 0x0000 /* @ECU_Address@KIPM_INV3DrvTqAllwdMaxDflt_Nm@ */ Scalar_FLOAT32_IEEE 0 AppSwcIpm_CM_single_Nm -100000.0 100000.0 /end CHARACTERISTIC
/begin CHARACTERISTIC KIPM_INV3DrvTqAllwdMaxHi_Nm "" VALUE 0x0000 /* @ECU_Address@KIPM_INV3DrvTqAllwdMaxHi_Nm@ */ Scalar_FLOAT32_IEEE 0 AppSwcIpm_CM_single_Nm -100000.0 100000.0 /end CHARACTERISTIC
/begin CHARACTERISTIC KIPM_INV3DrvTqAllwdMaxLo_Nm "" VALUE 0x0000 /* @ECU_Address@KIPM_INV3DrvTqAllwdMaxLo_Nm@ */ Scalar_FLOAT32_IEEE 0 AppSwcIpm_CM_single_Nm -100000.0 100000.0 /end CHARACTERISTIC
/begin CHARACTERISTIC KIPM_INV3DrvTqAllwdMax_Nm_ovrdval "" VALUE 0x0000 /* @ECU_Address@KIPM_INV3DrvTqAllwdMax_Nm_ovrdval@ */ Scalar_FLOAT32_IEEE 0 AppSwcIpm_CM_single_Nm -100000.0 100000.0 /end CHARACTERISTIC
/begin CHARACTERISTIC KIPM_INV3RecupTqAllwdMaxDflt_Nm "" VALUE 0x0000 /* @ECU_Address@KIPM_INV3RecupTqAllwdMaxDflt_Nm@ */ Scalar_FLOAT32_IEEE 0 AppSwcIpm_CM_single_Nm -100000.0 100000.0 /end CHARACTERISTIC
/begin CHARACTERISTIC KIPM_INV3RecupTqAllwdMaxHi_Nm "" VALUE 0x0000 /* @ECU_Address@KIPM_INV3RecupTqAllwdMaxHi_Nm@ */ Scalar_FLOAT32_IEEE 0 AppSwcIpm_CM_single_Nm -100000.0 100000.0 /end CHARACTERISTIC
/begin CHARACTERISTIC KIPM_INV3RecupTqAllwdMaxLo_Nm "" VALUE 0x0000 /* @ECU_Address@KIPM_INV3RecupTqAllwdMaxLo_Nm@ */ Scalar_FLOAT32_IEEE 0 AppSwcIpm_CM_single_Nm -100000.0 100000.0 /end CHARACTERISTIC
/begin CHARACTERISTIC KIPM_INV3RecupTqAllwdMax_Nm_ovrdval "" VALUE 0x0000 /* @ECU_Address@KIPM_INV3RecupTqAllwdMax_Nm_ovrdval@ */ Scalar_FLOAT32_IEEE 0 AppSwcIpm_CM_single_Nm -100000.0 100000.0 /end CHARACTERISTIC
/begin CHARACTERISTIC KIPM_FCMAccModeDflt_enum "" VALUE 0x0000 /* @ECU_Address@KIPM_FCMAccModeDflt_enum@ */ Scalar_UBYTE 0 AppSwcIpm_CM_EnumACCMode 0 7 /end CHARACTERISTIC
/begin CHARACTERISTIC KIPM_FCMAccMode_enum_ovrdval "" VALUE 0x0000 /* @ECU_Address@KIPM_FCMAccMode_enum_ovrdval@ */ Scalar_UBYTE 0 AppSwcIpm_CM_EnumACCMode 0 7 /end CHARACTERISTIC
/begin CHARACTERISTIC KIPM_EHBAVHAppldStDflt_enum "" VALUE 0x0000 /* @ECU_Address@KIPM_EHBAVHAppldStDflt_enum@ */ Scalar_UBYTE 0 AppSwcIpm_CM_EnumAVHSt 0 7 /end CHARACTERISTIC
/begin CHARACTERISTIC KIPM_EHBAVHAppldSt_enum_ovrdval "" VALUE 0x0000 /* @ECU_Address@KIPM_EHBAVHAppldSt_enum_ovrdval@ */ Scalar_UBYTE 0 AppSwcIpm_CM_EnumAVHSt 0 7 /end CHARACTERISTIC
/begin CHARACTERISTIC KIPM_BMSACChrgAtclStaDflt_enum "" VALUE 0x0000 /* @ECU_Address@KIPM_BMSACChrgAtclStaDflt_enum@ */ Scalar_UBYTE 0 AppSwcIpm_CM_EnumBMSACChrgSt 0 15 /end CHARACTERISTIC
/begin CHARACTERISTIC KIPM_BMSACChrgAtclSta_enum_ovrdval "" VALUE 0x0000 /* @ECU_Address@KIPM_BMSACChrgAtclSta_enum_ovrdval@ */ Scalar_UBYTE 0 AppSwcIpm_CM_EnumBMSACChrgSt 0 15 /end CHARACTERISTIC
/begin CHARACTERISTIC KIPM_BMSDCSActOprtModeDflt_enum "" VALUE 0x0000 /* @ECU_Address@KIPM_BMSDCSActOprtModeDflt_enum@ */ Scalar_UBYTE 0 AppSwcIpm_CM_EnumBMSDCSMd 0 7 /end CHARACTERISTIC
/begin CHARACTERISTIC KIPM_BMSDCSActOprtMode_enum_ovrdval "" VALUE 0x0000 /* @ECU_Address@KIPM_BMSDCSActOprtMode_enum_ovrdval@ */ Scalar_UBYTE 0 AppSwcIpm_CM_EnumBMSDCSMd 0 7 /end CHARACTERISTIC
/begin CHARACTERISTIC KIPM_BMSRunStaDflt_enum "" VALUE 0x0000 /* @ECU_Address@KIPM_BMSRunStaDflt_enum@ */ Scalar_UBYTE 0 AppSwcIpm_CM_EnumBMSRunSt 0 7 /end CHARACTERISTIC
/begin CHARACTERISTIC KIPM_BMSRunSta_enum_ovrdval "" VALUE 0x0000 /* @ECU_Address@KIPM_BMSRunSta_enum_ovrdval@ */ Scalar_UBYTE 0 AppSwcIpm_CM_EnumBMSRunSt 0 7 /end CHARACTERISTIC
/begin CHARACTERISTIC KIPM_EHBEPBActuatorStLDflt_enum "" VALUE 0x0000 /* @ECU_Address@KIPM_EHBEPBActuatorStLDflt_enum@ */ Scalar_UBYTE 0 AppSwcIpm_CM_EnumEPBState 0 6 /end CHARACTERISTIC
/begin CHARACTERISTIC KIPM_EHBEPBActuatorStL_enum_ovrdval "" VALUE 0x0000 /* @ECU_Address@KIPM_EHBEPBActuatorStL_enum_ovrdval@ */ Scalar_UBYTE 0 AppSwcIpm_CM_EnumEPBState 0 6 /end CHARACTERISTIC
/begin CHARACTERISTIC KIPM_EHBEPBSwitchStsDflt_enum "" VALUE 0x0000 /* @ECU_Address@KIPM_EHBEPBSwitchStsDflt_enum@ */ Scalar_UBYTE 0 AppSwcIpm_CM_EnumEPBSwSt 0 3 /end CHARACTERISTIC
/begin CHARACTERISTIC KIPM_EHBEPBSwitchSts_enum_ovrdval "" VALUE 0x0000 /* @ECU_Address@KIPM_EHBEPBSwitchSts_enum_ovrdval@ */ Scalar_UBYTE 0 AppSwcIpm_CM_EnumEPBSwSt 0 3 /end CHARACTERISTIC
/begin CHARACTERISTIC KIPM_EHBEPBSysStDflt_enum "" VALUE 0x0000 /* @ECU_Address@KIPM_EHBEPBSysStDflt_enum@ */ Scalar_UBYTE 0 AppSwcIpm_CM_EnumEPBSysSt 0 12 /end CHARACTERISTIC
/begin CHARACTERISTIC KIPM_EHBEPBSysSt_enum_ovrdval "" VALUE 0x0000 /* @ECU_Address@KIPM_EHBEPBSysSt_enum_ovrdval@ */ Scalar_UBYTE 0 AppSwcIpm_CM_EnumEPBSysSt 0 12 /end CHARACTERISTIC
/begin CHARACTERISTIC KIPM_SCSGrShftLvrPstnReqDflt_enum "" VALUE 0x0000 /* @ECU_Address@KIPM_SCSGrShftLvrPstnReqDflt_enum@ */ Scalar_UBYTE 0 AppSwcIpm_CM_EnumGrShftLvrPstnReq 0 5 /end CHARACTERISTIC
/begin CHARACTERISTIC KIPM_SCSGrShftLvrPstnReq_enum_ovrdval "" VALUE 0x0000 /* @ECU_Address@KIPM_SCSGrShftLvrPstnReq_enum_ovrdval@ */ Scalar_UBYTE 0 AppSwcIpm_CM_EnumGrShftLvrPstnReq 0 5 /end CHARACTERISTIC
/begin CHARACTERISTIC KIPM_BMSACChrgAtclSta_enum_ovrdflg "" VALUE 0x0000 /* @ECU_Address@KIPM_BMSACChrgAtclSta_enum_ovrdflg@ */ Scalar_BOOLEAN 0 AppSwcIpm_CM_boolean_flg 0.0 1.0 /end CHARACTERISTIC
/begin CHARACTERISTIC KIPM_BMSActExchgCurnt_A_ovrdflg "" VALUE 0x0000 /* @ECU_Address@KIPM_BMSActExchgCurnt_A_ovrdflg@ */ Scalar_BOOLEAN 0 AppSwcIpm_CM_boolean_flg 0.0 1.0 /end CHARACTERISTIC
/begin CHARACTERISTIC KIPM_BMSBatSOCAct_pct_ovrdflg "" VALUE 0x0000 /* @ECU_Address@KIPM_BMSBatSOCAct_pct_ovrdflg@ */ Scalar_BOOLEAN 0 AppSwcIpm_CM_boolean_flg 0.0 1.0 /end CHARACTERISTIC
/begin CHARACTERISTIC KIPM_BMSBatSOCRpt_pct_ovrdflg "" VALUE 0x0000 /* @ECU_Address@KIPM_BMSBatSOCRpt_pct_ovrdflg@ */ Scalar_BOOLEAN 0 AppSwcIpm_CM_boolean_flg 0.0 1.0 /end CHARACTERISTIC
/begin CHARACTERISTIC KIPM_BMSBatSOH_pct_ovrdflg "" VALUE 0x0000 /* @ECU_Address@KIPM_BMSBatSOH_pct_ovrdflg@ */ Scalar_BOOLEAN 0 AppSwcIpm_CM_boolean_flg 0.0 1.0 /end CHARACTERISTIC
/begin CHARACTERISTIC KIPM_BMSCellVoltMax_mV_ovrdflg "" VALUE 0x0000 /* @ECU_Address@KIPM_BMSCellVoltMax_mV_ovrdflg@ */ Scalar_BOOLEAN 0 AppSwcIpm_CM_boolean_flg 0.0 1.0 /end CHARACTERISTIC
/begin CHARACTERISTIC KIPM_BMSCellVoltMin_mV_ovrdflg "" VALUE 0x0000 /* @ECU_Address@KIPM_BMSCellVoltMin_mV_ovrdflg@ */ Scalar_BOOLEAN 0 AppSwcIpm_CM_boolean_flg 0.0 1.0 /end CHARACTERISTIC
/begin CHARACTERISTIC KIPM_BMSChrgInterlockSta_enum_ovrdflg "" VALUE 0x0000 /* @ECU_Address@KIPM_BMSChrgInterlockSta_enum_ovrdflg@ */ Scalar_BOOLEAN 0 AppSwcIpm_CM_boolean_flg 0.0 1.0 /end CHARACTERISTIC
/begin CHARACTERISTIC KIPM_BMSDCSActOprtMode_enum_ovrdflg "" VALUE 0x0000 /* @ECU_Address@KIPM_BMSDCSActOprtMode_enum_ovrdflg@ */ Scalar_BOOLEAN 0 AppSwcIpm_CM_boolean_flg 0.0 1.0 /end CHARACTERISTIC
/begin CHARACTERISTIC KIPM_BMSDCSChrgReqDflt_flg "" VALUE 0x0000 /* @ECU_Address@KIPM_BMSDCSChrgReqDflt_flg@ */ Scalar_BOOLEAN 0 AppSwcIpm_CM_boolean_flg 0.0 1.0 /end CHARACTERISTIC
/begin CHARACTERISTIC KIPM_BMSDCSChrgReq_flg_ovrdflg "" VALUE 0x0000 /* @ECU_Address@KIPM_BMSDCSChrgReq_flg_ovrdflg@ */ Scalar_BOOLEAN 0 AppSwcIpm_CM_boolean_flg 0.0 1.0 /end CHARACTERISTIC
/begin CHARACTERISTIC KIPM_BMSDCSChrgReq_flg_ovrdval "" VALUE 0x0000 /* @ECU_Address@KIPM_BMSDCSChrgReq_flg_ovrdval@ */ Scalar_BOOLEAN 0 AppSwcIpm_CM_boolean_flg 0.0 1.0 /end CHARACTERISTIC
/begin CHARACTERISTIC KIPM_BMSDCSInletConnectStaDflt_flg "" VALUE 0x0000 /* @ECU_Address@KIPM_BMSDCSInletConnectStaDflt_flg@ */ Scalar_BOOLEAN 0 AppSwcIpm_CM_boolean_flg 0.0 1.0 /end CHARACTERISTIC
/begin CHARACTERISTIC KIPM_BMSDCSInletConnectSta_flg_ovrdflg "" VALUE 0x0000 /* @ECU_Address@KIPM_BMSDCSInletConnectSta_flg_ovrdflg@ */ Scalar_BOOLEAN 0 AppSwcIpm_CM_boolean_flg 0.0 1.0 /end CHARACTERISTIC
/begin CHARACTERISTIC KIPM_BMSDCSInletConnectSta_flg_ovrdval "" VALUE 0x0000 /* @ECU_Address@KIPM_BMSDCSInletConnectSta_flg_ovrdval@ */ Scalar_BOOLEAN 0 AppSwcIpm_CM_boolean_flg 0.0 1.0 /end CHARACTERISTIC
/begin CHARACTERISTIC KIPM_BMSDchrgInterlockSta_enum_ovrdflg "" VALUE 0x0000 /* @ECU_Address@KIPM_BMSDchrgInterlockSta_enum_ovrdflg@ */ Scalar_BOOLEAN 0 AppSwcIpm_CM_boolean_flg 0.0 1.0 /end CHARACTERISTIC
/begin CHARACTERISTIC KIPM_BMSEmgcySdnReqDflt_flg "" VALUE 0x0000 /* @ECU_Address@KIPM_BMSEmgcySdnReqDflt_flg@ */ Scalar_BOOLEAN 0 AppSwcIpm_CM_boolean_flg 0.0 1.0 /end CHARACTERISTIC
/begin CHARACTERISTIC KIPM_BMSEmgcySdnReq_flg_ovrdflg "" VALUE 0x0000 /* @ECU_Address@KIPM_BMSEmgcySdnReq_flg_ovrdflg@ */ Scalar_BOOLEAN 0 AppSwcIpm_CM_boolean_flg 0.0 1.0 /end CHARACTERISTIC
/begin CHARACTERISTIC KIPM_BMSEmgcySdnReq_flg_ovrdval "" VALUE 0x0000 /* @ECU_Address@KIPM_BMSEmgcySdnReq_flg_ovrdval@ */ Scalar_BOOLEAN 0 AppSwcIpm_CM_boolean_flg 0.0 1.0 /end CHARACTERISTIC
/begin CHARACTERISTIC KIPM_BMSHVBatActVolt_V_ovrdflg "" VALUE 0x0000 /* @ECU_Address@KIPM_BMSHVBatActVolt_V_ovrdflg@ */ Scalar_BOOLEAN 0 AppSwcIpm_CM_boolean_flg 0.0 1.0 /end CHARACTERISTIC
/begin CHARACTERISTIC KIPM_BMSInletCooltActlTemp_C_ovrdflg "" VALUE 0x0000 /* @ECU_Address@KIPM_BMSInletCooltActlTemp_C_ovrdflg@ */ Scalar_BOOLEAN 0 AppSwcIpm_CM_boolean_flg 0.0 1.0 /end CHARACTERISTIC
/begin CHARACTERISTIC KIPM_BMSIsoResist_MOhm_ovrdflg "" VALUE 0x0000 /* @ECU_Address@KIPM_BMSIsoResist_MOhm_ovrdflg@ */ Scalar_BOOLEAN 0 AppSwcIpm_CM_boolean_flg 0.0 1.0 /end CHARACTERISTIC
/begin CHARACTERISTIC KIPM_BMSMaxChrgCurntAC_A_ovrdflg "" VALUE 0x0000 /* @ECU_Address@KIPM_BMSMaxChrgCurntAC_A_ovrdflg@ */ Scalar_BOOLEAN 0 AppSwcIpm_CM_boolean_flg 0.0 1.0 /end CHARACTERISTIC
/begin CHARACTERISTIC KIPM_BMSMaxChrgVoltAC_V_ovrdflg "" VALUE 0x0000 /* @ECU_Address@KIPM_BMSMaxChrgVoltAC_V_ovrdflg@ */ Scalar_BOOLEAN 0 AppSwcIpm_CM_boolean_flg 0.0 1.0 /end CHARACTERISTIC
/begin CHARACTERISTIC KIPM_BMSMaxConChrgCurnt_A_ovrdflg "" VALUE 0x0000 /* @ECU_Address@KIPM_BMSMaxConChrgCurnt_A_ovrdflg@ */ Scalar_BOOLEAN 0 AppSwcIpm_CM_boolean_flg 0.0 1.0 /end CHARACTERISTIC
/begin CHARACTERISTIC KIPM_BMSMaxConDisCurnt_A_ovrdflg "" VALUE 0x0000 /* @ECU_Address@KIPM_BMSMaxConDisCurnt_A_ovrdflg@ */ Scalar_BOOLEAN 0 AppSwcIpm_CM_boolean_flg 0.0 1.0 /end CHARACTERISTIC
/begin CHARACTERISTIC KIPM_BMSMaxInsChrgCurnt_A_ovrdflg "" VALUE 0x0000 /* @ECU_Address@KIPM_BMSMaxInsChrgCurnt_A_ovrdflg@ */ Scalar_BOOLEAN 0 AppSwcIpm_CM_boolean_flg 0.0 1.0 /end CHARACTERISTIC
/begin CHARACTERISTIC KIPM_BMSMaxInsDisCurnt_A_ovrdflg "" VALUE 0x0000 /* @ECU_Address@KIPM_BMSMaxInsDisCurnt_A_ovrdflg@ */ Scalar_BOOLEAN 0 AppSwcIpm_CM_boolean_flg 0.0 1.0 /end CHARACTERISTIC
/begin CHARACTERISTIC KIPM_BMSOutlCooltActlTemp_C_ovrdflg "" VALUE 0x0000 /* @ECU_Address@KIPM_BMSOutlCooltActlTemp_C_ovrdflg@ */ Scalar_BOOLEAN 0 AppSwcIpm_CM_boolean_flg 0.0 1.0 /end CHARACTERISTIC
/begin CHARACTERISTIC KIPM_BMSPwrTrainConnectSta_enum_ovrdflg "" VALUE 0x0000 /* @ECU_Address@KIPM_BMSPwrTrainConnectSta_enum_ovrdflg@ */ Scalar_BOOLEAN 0 AppSwcIpm_CM_boolean_flg 0.0 1.0 /end CHARACTERISTIC
/begin CHARACTERISTIC KIPM_BMSRunSta_enum_ovrdflg "" VALUE 0x0000 /* @ECU_Address@KIPM_BMSRunSta_enum_ovrdflg@ */ Scalar_BOOLEAN 0 AppSwcIpm_CM_boolean_flg 0.0 1.0 /end CHARACTERISTIC
/begin CHARACTERISTIC KIPM_BMSSysFailSta_enum_ovrdflg "" VALUE 0x0000 /* @ECU_Address@KIPM_BMSSysFailSta_enum_ovrdflg@ */ Scalar_BOOLEAN 0 AppSwcIpm_CM_boolean_flg 0.0 1.0 /end CHARACTERISTIC
/begin CHARACTERISTIC KIPM_BMSThermrunawayWrn_enum_ovrdflg "" VALUE 0x0000 /* @ECU_Address@KIPM_BMSThermrunawayWrn_enum_ovrdflg@ */ Scalar_BOOLEAN 0 AppSwcIpm_CM_boolean_flg 0.0 1.0 /end CHARACTERISTIC
/begin CHARACTERISTIC KIPM_CCPACAutoKeyDflt_flg "" VALUE 0x0000 /* @ECU_Address@KIPM_CCPACAutoKeyDflt_flg@ */ Scalar_BOOLEAN 0 AppSwcIpm_CM_boolean_flg 0.0 1.0 /end CHARACTERISTIC
/begin CHARACTERISTIC KIPM_CCPACAutoKey_flg_ovrdflg "" VALUE 0x0000 /* @ECU_Address@KIPM_CCPACAutoKey_flg_ovrdflg@ */ Scalar_BOOLEAN 0 AppSwcIpm_CM_boolean_flg 0.0 1.0 /end CHARACTERISTIC
/begin CHARACTERISTIC KIPM_CCPACAutoKey_flg_ovrdval "" VALUE 0x0000 /* @ECU_Address@KIPM_CCPACAutoKey_flg_ovrdval@ */ Scalar_BOOLEAN 0 AppSwcIpm_CM_boolean_flg 0.0 1.0 /end CHARACTERISTIC
/begin CHARACTERISTIC KIPM_CCPACSwKeyDflt_flg "" VALUE 0x0000 /* @ECU_Address@KIPM_CCPACSwKeyDflt_flg@ */ Scalar_BOOLEAN 0 AppSwcIpm_CM_boolean_flg 0.0 1.0 /end CHARACTERISTIC
/begin CHARACTERISTIC KIPM_CCPACSwKey_flg_ovrdflg "" VALUE 0x0000 /* @ECU_Address@KIPM_CCPACSwKey_flg_ovrdflg@ */ Scalar_BOOLEAN 0 AppSwcIpm_CM_boolean_flg 0.0 1.0 /end CHARACTERISTIC
/begin CHARACTERISTIC KIPM_CCPACSwKey_flg_ovrdval "" VALUE 0x0000 /* @ECU_Address@KIPM_CCPACSwKey_flg_ovrdval@ */ Scalar_BOOLEAN 0 AppSwcIpm_CM_boolean_flg 0.0 1.0 /end CHARACTERISTIC
/begin CHARACTERISTIC KIPM_CCPAVASOffKeyDflt_flg "" VALUE 0x0000 /* @ECU_Address@KIPM_CCPAVASOffKeyDflt_flg@ */ Scalar_BOOLEAN 0 AppSwcIpm_CM_boolean_flg 0.0 1.0 /end CHARACTERISTIC
/begin CHARACTERISTIC KIPM_CCPAVASOffKey_flg_ovrdflg "" VALUE 0x0000 /* @ECU_Address@KIPM_CCPAVASOffKey_flg_ovrdflg@ */ Scalar_BOOLEAN 0 AppSwcIpm_CM_boolean_flg 0.0 1.0 /end CHARACTERISTIC
/begin CHARACTERISTIC KIPM_CCPAVASOffKey_flg_ovrdval "" VALUE 0x0000 /* @ECU_Address@KIPM_CCPAVASOffKey_flg_ovrdval@ */ Scalar_BOOLEAN 0 AppSwcIpm_CM_boolean_flg 0.0 1.0 /end CHARACTERISTIC
/begin CHARACTERISTIC KIPM_CCPAVHKeyDflt_flg "" VALUE 0x0000 /* @ECU_Address@KIPM_CCPAVHKeyDflt_flg@ */ Scalar_BOOLEAN 0 AppSwcIpm_CM_boolean_flg 0.0 1.0 /end CHARACTERISTIC
/begin CHARACTERISTIC KIPM_CCPAVHKey_flg_ovrdflg "" VALUE 0x0000 /* @ECU_Address@KIPM_CCPAVHKey_flg_ovrdflg@ */ Scalar_BOOLEAN 0 AppSwcIpm_CM_boolean_flg 0.0 1.0 /end CHARACTERISTIC
/begin CHARACTERISTIC KIPM_CCPAVHKey_flg_ovrdval "" VALUE 0x0000 /* @ECU_Address@KIPM_CCPAVHKey_flg_ovrdval@ */ Scalar_BOOLEAN 0 AppSwcIpm_CM_boolean_flg 0.0 1.0 /end CHARACTERISTIC
/begin CHARACTERISTIC KIPM_CCPAirInletModeKeyDflt_flg "" VALUE 0x0000 /* @ECU_Address@KIPM_CCPAirInletModeKeyDflt_flg@ */ Scalar_BOOLEAN 0 AppSwcIpm_CM_boolean_flg 0.0 1.0 /end CHARACTERISTIC
/begin CHARACTERISTIC KIPM_CCPAirInletModeKey_flg_ovrdflg "" VALUE 0x0000 /* @ECU_Address@KIPM_CCPAirInletModeKey_flg_ovrdflg@ */ Scalar_BOOLEAN 0 AppSwcIpm_CM_boolean_flg 0.0 1.0 /end CHARACTERISTIC
/begin CHARACTERISTIC KIPM_CCPAirInletModeKey_flg_ovrdval "" VALUE 0x0000 /* @ECU_Address@KIPM_CCPAirInletModeKey_flg_ovrdval@ */ Scalar_BOOLEAN 0 AppSwcIpm_CM_boolean_flg 0.0 1.0 /end CHARACTERISTIC
/begin CHARACTERISTIC KIPM_CCPBlwngModeNextKeyDflt_flg "" VALUE 0x0000 /* @ECU_Address@KIPM_CCPBlwngModeNextKeyDflt_flg@ */ Scalar_BOOLEAN 0 AppSwcIpm_CM_boolean_flg 0.0 1.0 /end CHARACTERISTIC
/begin CHARACTERISTIC KIPM_CCPBlwngModeNextKey_flg_ovrdflg "" VALUE 0x0000 /* @ECU_Address@KIPM_CCPBlwngModeNextKey_flg_ovrdflg@ */ Scalar_BOOLEAN 0 AppSwcIpm_CM_boolean_flg 0.0 1.0 /end CHARACTERISTIC
/begin CHARACTERISTIC KIPM_CCPBlwngModeNextKey_flg_ovrdval "" VALUE 0x0000 /* @ECU_Address@KIPM_CCPBlwngModeNextKey_flg_ovrdval@ */ Scalar_BOOLEAN 0 AppSwcIpm_CM_boolean_flg 0.0 1.0 /end CHARACTERISTIC
/begin CHARACTERISTIC KIPM_CCPBlwngModePrevKeyDflt_flg "" VALUE 0x0000 /* @ECU_Address@KIPM_CCPBlwngModePrevKeyDflt_flg@ */ Scalar_BOOLEAN 0 AppSwcIpm_CM_boolean_flg 0.0 1.0 /end CHARACTERISTIC
/begin CHARACTERISTIC KIPM_CCPBlwngModePrevKey_flg_ovrdflg "" VALUE 0x0000 /* @ECU_Address@KIPM_CCPBlwngModePrevKey_flg_ovrdflg@ */ Scalar_BOOLEAN 0 AppSwcIpm_CM_boolean_flg 0.0 1.0 /end CHARACTERISTIC
/begin CHARACTERISTIC KIPM_CCPBlwngModePrevKey_flg_ovrdval "" VALUE 0x0000 /* @ECU_Address@KIPM_CCPBlwngModePrevKey_flg_ovrdval@ */ Scalar_BOOLEAN 0 AppSwcIpm_CM_boolean_flg 0.0 1.0 /end CHARACTERISTIC
/begin CHARACTERISTIC KIPM_CCPBlwrLvlAddKeyDflt_flg "" VALUE 0x0000 /* @ECU_Address@KIPM_CCPBlwrLvlAddKeyDflt_flg@ */ Scalar_BOOLEAN 0 AppSwcIpm_CM_boolean_flg 0.0 1.0 /end CHARACTERISTIC
/begin CHARACTERISTIC KIPM_CCPBlwrLvlAddKey_flg_ovrdflg "" VALUE 0x0000 /* @ECU_Address@KIPM_CCPBlwrLvlAddKey_flg_ovrdflg@ */ Scalar_BOOLEAN 0 AppSwcIpm_CM_boolean_flg 0.0 1.0 /end CHARACTERISTIC
/begin CHARACTERISTIC KIPM_CCPBlwrLvlAddKey_flg_ovrdval "" VALUE 0x0000 /* @ECU_Address@KIPM_CCPBlwrLvlAddKey_flg_ovrdval@ */ Scalar_BOOLEAN 0 AppSwcIpm_CM_boolean_flg 0.0 1.0 /end CHARACTERISTIC
/begin CHARACTERISTIC KIPM_CCPBlwrLvlDecKeyDflt_flg "" VALUE 0x0000 /* @ECU_Address@KIPM_CCPBlwrLvlDecKeyDflt_flg@ */ Scalar_BOOLEAN 0 AppSwcIpm_CM_boolean_flg 0.0 1.0 /end CHARACTERISTIC
/begin CHARACTERISTIC KIPM_CCPBlwrLvlDecKey_flg_ovrdflg "" VALUE 0x0000 /* @ECU_Address@KIPM_CCPBlwrLvlDecKey_flg_ovrdflg@ */ Scalar_BOOLEAN 0 AppSwcIpm_CM_boolean_flg 0.0 1.0 /end CHARACTERISTIC
/begin CHARACTERISTIC KIPM_CCPBlwrLvlDecKey_flg_ovrdval "" VALUE 0x0000 /* @ECU_Address@KIPM_CCPBlwrLvlDecKey_flg_ovrdval@ */ Scalar_BOOLEAN 0 AppSwcIpm_CM_boolean_flg 0.0 1.0 /end CHARACTERISTIC
/begin CHARACTERISTIC KIPM_CCPCenLckKeyDflt_flg "" VALUE 0x0000 /* @ECU_Address@KIPM_CCPCenLckKeyDflt_flg@ */ Scalar_BOOLEAN 0 AppSwcIpm_CM_boolean_flg 0.0 1.0 /end CHARACTERISTIC
/begin CHARACTERISTIC KIPM_CCPCenLckKey_flg_ovrdflg "" VALUE 0x0000 /* @ECU_Address@KIPM_CCPCenLckKey_flg_ovrdflg@ */ Scalar_BOOLEAN 0 AppSwcIpm_CM_boolean_flg 0.0 1.0 /end CHARACTERISTIC
/begin CHARACTERISTIC KIPM_CCPCenLckKey_flg_ovrdval "" VALUE 0x0000 /* @ECU_Address@KIPM_CCPCenLckKey_flg_ovrdval@ */ Scalar_BOOLEAN 0 AppSwcIpm_CM_boolean_flg 0.0 1.0 /end CHARACTERISTIC
/begin CHARACTERISTIC KIPM_CCPESCOffKeyDflt_flg "" VALUE 0x0000 /* @ECU_Address@KIPM_CCPESCOffKeyDflt_flg@ */ Scalar_BOOLEAN 0 AppSwcIpm_CM_boolean_flg 0.0 1.0 /end CHARACTERISTIC
/begin CHARACTERISTIC KIPM_CCPESCOffKey_flg_ovrdflg "" VALUE 0x0000 /* @ECU_Address@KIPM_CCPESCOffKey_flg_ovrdflg@ */ Scalar_BOOLEAN 0 AppSwcIpm_CM_boolean_flg 0.0 1.0 /end CHARACTERISTIC
/begin CHARACTERISTIC KIPM_CCPESCOffKey_flg_ovrdval "" VALUE 0x0000 /* @ECU_Address@KIPM_CCPESCOffKey_flg_ovrdval@ */ Scalar_BOOLEAN 0 AppSwcIpm_CM_boolean_flg 0.0 1.0 /end CHARACTERISTIC
/begin CHARACTERISTIC KIPM_CCPFrntWindDefrstKeyDflt_flg "" VALUE 0x0000 /* @ECU_Address@KIPM_CCPFrntWindDefrstKeyDflt_flg@ */ Scalar_BOOLEAN 0 AppSwcIpm_CM_boolean_flg 0.0 1.0 /end CHARACTERISTIC
/begin CHARACTERISTIC KIPM_CCPFrntWindDefrstKey_flg_ovrdflg "" VALUE 0x0000 /* @ECU_Address@KIPM_CCPFrntWindDefrstKey_flg_ovrdflg@ */ Scalar_BOOLEAN 0 AppSwcIpm_CM_boolean_flg 0.0 1.0 /end CHARACTERISTIC
/begin CHARACTERISTIC KIPM_CCPFrntWindDefrstKey_flg_ovrdval "" VALUE 0x0000 /* @ECU_Address@KIPM_CCPFrntWindDefrstKey_flg_ovrdval@ */ Scalar_BOOLEAN 0 AppSwcIpm_CM_boolean_flg 0.0 1.0 /end CHARACTERISTIC
/begin CHARACTERISTIC KIPM_CCPHDCKeyDflt_flg "" VALUE 0x0000 /* @ECU_Address@KIPM_CCPHDCKeyDflt_flg@ */ Scalar_BOOLEAN 0 AppSwcIpm_CM_boolean_flg 0.0 1.0 /end CHARACTERISTIC
/begin CHARACTERISTIC KIPM_CCPHDCKey_flg_ovrdflg "" VALUE 0x0000 /* @ECU_Address@KIPM_CCPHDCKey_flg_ovrdflg@ */ Scalar_BOOLEAN 0 AppSwcIpm_CM_boolean_flg 0.0 1.0 /end CHARACTERISTIC
/begin CHARACTERISTIC KIPM_CCPHDCKey_flg_ovrdval "" VALUE 0x0000 /* @ECU_Address@KIPM_CCPHDCKey_flg_ovrdval@ */ Scalar_BOOLEAN 0 AppSwcIpm_CM_boolean_flg 0.0 1.0 /end CHARACTERISTIC
/begin CHARACTERISTIC KIPM_CCPHzrdKeyDflt_flg "" VALUE 0x0000 /* @ECU_Address@KIPM_CCPHzrdKeyDflt_flg@ */ Scalar_BOOLEAN 0 AppSwcIpm_CM_boolean_flg 0.0 1.0 /end CHARACTERISTIC
/begin CHARACTERISTIC KIPM_CCPHzrdKey_flg_ovrdflg "" VALUE 0x0000 /* @ECU_Address@KIPM_CCPHzrdKey_flg_ovrdflg@ */ Scalar_BOOLEAN 0 AppSwcIpm_CM_boolean_flg 0.0 1.0 /end CHARACTERISTIC
/begin CHARACTERISTIC KIPM_CCPHzrdKey_flg_ovrdval "" VALUE 0x0000 /* @ECU_Address@KIPM_CCPHzrdKey_flg_ovrdval@ */ Scalar_BOOLEAN 0 AppSwcIpm_CM_boolean_flg 0.0 1.0 /end CHARACTERISTIC
/begin CHARACTERISTIC KIPM_CCPModeKeyDflt_flg "" VALUE 0x0000 /* @ECU_Address@KIPM_CCPModeKeyDflt_flg@ */ Scalar_BOOLEAN 0 AppSwcIpm_CM_boolean_flg 0.0 1.0 /end CHARACTERISTIC
/begin CHARACTERISTIC KIPM_CCPModeKey_flg_ovrdflg "" VALUE 0x0000 /* @ECU_Address@KIPM_CCPModeKey_flg_ovrdflg@ */ Scalar_BOOLEAN 0 AppSwcIpm_CM_boolean_flg 0.0 1.0 /end CHARACTERISTIC
/begin CHARACTERISTIC KIPM_CCPModeKey_flg_ovrdval "" VALUE 0x0000 /* @ECU_Address@KIPM_CCPModeKey_flg_ovrdval@ */ Scalar_BOOLEAN 0 AppSwcIpm_CM_boolean_flg 0.0 1.0 /end CHARACTERISTIC
/begin CHARACTERISTIC KIPM_CCPPwrRecupLvlKeyDflt_flg "" VALUE 0x0000 /* @ECU_Address@KIPM_CCPPwrRecupLvlKeyDflt_flg@ */ Scalar_BOOLEAN 0 AppSwcIpm_CM_boolean_flg 0.0 1.0 /end CHARACTERISTIC
/begin CHARACTERISTIC KIPM_CCPPwrRecupLvlKey_flg_ovrdflg "" VALUE 0x0000 /* @ECU_Address@KIPM_CCPPwrRecupLvlKey_flg_ovrdflg@ */ Scalar_BOOLEAN 0 AppSwcIpm_CM_boolean_flg 0.0 1.0 /end CHARACTERISTIC
/begin CHARACTERISTIC KIPM_CCPPwrRecupLvlKey_flg_ovrdval "" VALUE 0x0000 /* @ECU_Address@KIPM_CCPPwrRecupLvlKey_flg_ovrdval@ */ Scalar_BOOLEAN 0 AppSwcIpm_CM_boolean_flg 0.0 1.0 /end CHARACTERISTIC
/begin CHARACTERISTIC KIPM_CCPRrViewMirrHeatgKeyDflt_flg "" VALUE 0x0000 /* @ECU_Address@KIPM_CCPRrViewMirrHeatgKeyDflt_flg@ */ Scalar_BOOLEAN 0 AppSwcIpm_CM_boolean_flg 0.0 1.0 /end CHARACTERISTIC
/begin CHARACTERISTIC KIPM_CCPRrViewMirrHeatgKey_flg_ovrdflg "" VALUE 0x0000 /* @ECU_Address@KIPM_CCPRrViewMirrHeatgKey_flg_ovrdflg@ */ Scalar_BOOLEAN 0 AppSwcIpm_CM_boolean_flg 0.0 1.0 /end CHARACTERISTIC
/begin CHARACTERISTIC KIPM_CCPRrViewMirrHeatgKey_flg_ovrdval "" VALUE 0x0000 /* @ECU_Address@KIPM_CCPRrViewMirrHeatgKey_flg_ovrdval@ */ Scalar_BOOLEAN 0 AppSwcIpm_CM_boolean_flg 0.0 1.0 /end CHARACTERISTIC
/begin CHARACTERISTIC KIPM_CCPTPMSKeyDflt_flg "" VALUE 0x0000 /* @ECU_Address@KIPM_CCPTPMSKeyDflt_flg@ */ Scalar_BOOLEAN 0 AppSwcIpm_CM_boolean_flg 0.0 1.0 /end CHARACTERISTIC
/begin CHARACTERISTIC KIPM_CCPTPMSKey_flg_ovrdflg "" VALUE 0x0000 /* @ECU_Address@KIPM_CCPTPMSKey_flg_ovrdflg@ */ Scalar_BOOLEAN 0 AppSwcIpm_CM_boolean_flg 0.0 1.0 /end CHARACTERISTIC
/begin CHARACTERISTIC KIPM_CCPTPMSKey_flg_ovrdval "" VALUE 0x0000 /* @ECU_Address@KIPM_CCPTPMSKey_flg_ovrdval@ */ Scalar_BOOLEAN 0 AppSwcIpm_CM_boolean_flg 0.0 1.0 /end CHARACTERISTIC
/begin CHARACTERISTIC KIPM_CCPTempAddKeyDflt_flg "" VALUE 0x0000 /* @ECU_Address@KIPM_CCPTempAddKeyDflt_flg@ */ Scalar_BOOLEAN 0 AppSwcIpm_CM_boolean_flg 0.0 1.0 /end CHARACTERISTIC
/begin CHARACTERISTIC KIPM_CCPTempAddKey_flg_ovrdflg "" VALUE 0x0000 /* @ECU_Address@KIPM_CCPTempAddKey_flg_ovrdflg@ */ Scalar_BOOLEAN 0 AppSwcIpm_CM_boolean_flg 0.0 1.0 /end CHARACTERISTIC
/begin CHARACTERISTIC KIPM_CCPTempAddKey_flg_ovrdval "" VALUE 0x0000 /* @ECU_Address@KIPM_CCPTempAddKey_flg_ovrdval@ */ Scalar_BOOLEAN 0 AppSwcIpm_CM_boolean_flg 0.0 1.0 /end CHARACTERISTIC
/begin CHARACTERISTIC KIPM_CCPTempDecKeyDflt_flg "" VALUE 0x0000 /* @ECU_Address@KIPM_CCPTempDecKeyDflt_flg@ */ Scalar_BOOLEAN 0 AppSwcIpm_CM_boolean_flg 0.0 1.0 /end CHARACTERISTIC
/begin CHARACTERISTIC KIPM_CCPTempDecKey_flg_ovrdflg "" VALUE 0x0000 /* @ECU_Address@KIPM_CCPTempDecKey_flg_ovrdflg@ */ Scalar_BOOLEAN 0 AppSwcIpm_CM_boolean_flg 0.0 1.0 /end CHARACTERISTIC
/begin CHARACTERISTIC KIPM_CCPTempDecKey_flg_ovrdval "" VALUE 0x0000 /* @ECU_Address@KIPM_CCPTempDecKey_flg_ovrdval@ */ Scalar_BOOLEAN 0 AppSwcIpm_CM_boolean_flg 0.0 1.0 /end CHARACTERISTIC
/begin CHARACTERISTIC KIPM_CRRRBSDWarnLt_enum_ovrdflg "" VALUE 0x0000 /* @ECU_Address@KIPM_CRRRBSDWarnLt_enum_ovrdflg@ */ Scalar_BOOLEAN 0 AppSwcIpm_CM_boolean_flg 0.0 1.0 /end CHARACTERISTIC
/begin CHARACTERISTIC KIPM_CRRRBSDWarnRt_enum_ovrdflg "" VALUE 0x0000 /* @ECU_Address@KIPM_CRRRBSDWarnRt_enum_ovrdflg@ */ Scalar_BOOLEAN 0 AppSwcIpm_CM_boolean_flg 0.0 1.0 /end CHARACTERISTIC
/begin CHARACTERISTIC KIPM_CRRRDOWWarnLt_enum_ovrdflg "" VALUE 0x0000 /* @ECU_Address@KIPM_CRRRDOWWarnLt_enum_ovrdflg@ */ Scalar_BOOLEAN 0 AppSwcIpm_CM_boolean_flg 0.0 1.0 /end CHARACTERISTIC
/begin CHARACTERISTIC KIPM_CRRRDOWWarnRt_enum_ovrdflg "" VALUE 0x0000 /* @ECU_Address@KIPM_CRRRDOWWarnRt_enum_ovrdflg@ */ Scalar_BOOLEAN 0 AppSwcIpm_CM_boolean_flg 0.0 1.0 /end CHARACTERISTIC
/begin CHARACTERISTIC KIPM_CRRRRCTAWarnLt_enum_ovrdflg "" VALUE 0x0000 /* @ECU_Address@KIPM_CRRRRCTAWarnLt_enum_ovrdflg@ */ Scalar_BOOLEAN 0 AppSwcIpm_CM_boolean_flg 0.0 1.0 /end CHARACTERISTIC
/begin CHARACTERISTIC KIPM_CRRRRCTAWarnRt_enum_ovrdflg "" VALUE 0x0000 /* @ECU_Address@KIPM_CRRRRCTAWarnRt_enum_ovrdflg@ */ Scalar_BOOLEAN 0 AppSwcIpm_CM_boolean_flg 0.0 1.0 /end CHARACTERISTIC
/begin CHARACTERISTIC KIPM_EHBAVHAppldSt_enum_ovrdflg "" VALUE 0x0000 /* @ECU_Address@KIPM_EHBAVHAppldSt_enum_ovrdflg@ */ Scalar_BOOLEAN 0 AppSwcIpm_CM_boolean_flg 0.0 1.0 /end CHARACTERISTIC
/begin CHARACTERISTIC KIPM_EHBBLADflt_flg "" VALUE 0x0000 /* @ECU_Address@KIPM_EHBBLADflt_flg@ */ Scalar_BOOLEAN 0 AppSwcIpm_CM_boolean_flg 0.0 1.0 /end CHARACTERISTIC
/begin CHARACTERISTIC KIPM_EHBBLA_flg_ovrdflg "" VALUE 0x0000 /* @ECU_Address@KIPM_EHBBLA_flg_ovrdflg@ */ Scalar_BOOLEAN 0 AppSwcIpm_CM_boolean_flg 0.0 1.0 /end CHARACTERISTIC
/begin CHARACTERISTIC KIPM_EHBBLA_flg_ovrdval "" VALUE 0x0000 /* @ECU_Address@KIPM_EHBBLA_flg_ovrdval@ */ Scalar_BOOLEAN 0 AppSwcIpm_CM_boolean_flg 0.0 1.0 /end CHARACTERISTIC
/begin CHARACTERISTIC KIPM_EHBEPBActuatorStL_enum_ovrdflg "" VALUE 0x0000 /* @ECU_Address@KIPM_EHBEPBActuatorStL_enum_ovrdflg@ */ Scalar_BOOLEAN 0 AppSwcIpm_CM_boolean_flg 0.0 1.0 /end CHARACTERISTIC
/begin CHARACTERISTIC KIPM_EHBEPBSwitchSts_enum_ovrdflg "" VALUE 0x0000 /* @ECU_Address@KIPM_EHBEPBSwitchSts_enum_ovrdflg@ */ Scalar_BOOLEAN 0 AppSwcIpm_CM_boolean_flg 0.0 1.0 /end CHARACTERISTIC
/begin CHARACTERISTIC KIPM_EHBEPBSysSt_enum_ovrdflg "" VALUE 0x0000 /* @ECU_Address@KIPM_EHBEPBSysSt_enum_ovrdflg@ */ Scalar_BOOLEAN 0 AppSwcIpm_CM_boolean_flg 0.0 1.0 /end CHARACTERISTIC
/begin CHARACTERISTIC KIPM_EHBHDCFucFaultDflt_flg "" VALUE 0x0000 /* @ECU_Address@KIPM_EHBHDCFucFaultDflt_flg@ */ Scalar_BOOLEAN 0 AppSwcIpm_CM_boolean_flg 0.0 1.0 /end CHARACTERISTIC
/begin CHARACTERISTIC KIPM_EHBHDCFucFault_flg_ovrdflg "" VALUE 0x0000 /* @ECU_Address@KIPM_EHBHDCFucFault_flg_ovrdflg@ */ Scalar_BOOLEAN 0 AppSwcIpm_CM_boolean_flg 0.0 1.0 /end CHARACTERISTIC
/begin CHARACTERISTIC KIPM_EHBHDCFucFault_flg_ovrdval "" VALUE 0x0000 /* @ECU_Address@KIPM_EHBHDCFucFault_flg_ovrdval@ */ Scalar_BOOLEAN 0 AppSwcIpm_CM_boolean_flg 0.0 1.0 /end CHARACTERISTIC
/begin CHARACTERISTIC KIPM_ESCLUnOrLockfeedback_nu_ovrdflg "" VALUE 0x0000 /* @ECU_Address@KIPM_ESCLUnOrLockfeedback_nu_ovrdflg@ */ Scalar_BOOLEAN 0 AppSwcIpm_CM_boolean_flg 0.0 1.0 /end CHARACTERISTIC
/begin CHARACTERISTIC KIPM_FCMACCSdnMode_enum_ovrdflg "" VALUE 0x0000 /* @ECU_Address@KIPM_FCMACCSdnMode_enum_ovrdflg@ */ Scalar_BOOLEAN 0 AppSwcIpm_CM_boolean_flg 0.0 1.0 /end CHARACTERISTIC
/begin CHARACTERISTIC KIPM_FCMACCWhlDece_mps2_ovrdflg "" VALUE 0x0000 /* @ECU_Address@KIPM_FCMACCWhlDece_mps2_ovrdflg@ */ Scalar_BOOLEAN 0 AppSwcIpm_CM_boolean_flg 0.0 1.0 /end CHARACTERISTIC
/begin CHARACTERISTIC KIPM_FCMACCWhlTqReqActvDflt_flg "" VALUE 0x0000 /* @ECU_Address@KIPM_FCMACCWhlTqReqActvDflt_flg@ */ Scalar_BOOLEAN 0 AppSwcIpm_CM_boolean_flg 0.0 1.0 /end CHARACTERISTIC
/begin CHARACTERISTIC KIPM_FCMACCWhlTqReqActv_flg_ovrdflg "" VALUE 0x0000 /* @ECU_Address@KIPM_FCMACCWhlTqReqActv_flg_ovrdflg@ */ Scalar_BOOLEAN 0 AppSwcIpm_CM_boolean_flg 0.0 1.0 /end CHARACTERISTIC
/begin CHARACTERISTIC KIPM_FCMACCWhlTqReqActv_flg_ovrdval "" VALUE 0x0000 /* @ECU_Address@KIPM_FCMACCWhlTqReqActv_flg_ovrdval@ */ Scalar_BOOLEAN 0 AppSwcIpm_CM_boolean_flg 0.0 1.0 /end CHARACTERISTIC
/begin CHARACTERISTIC KIPM_FCMACCWhlTqReqVal_Nm_ovrdflg "" VALUE 0x0000 /* @ECU_Address@KIPM_FCMACCWhlTqReqVal_Nm_ovrdflg@ */ Scalar_BOOLEAN 0 AppSwcIpm_CM_boolean_flg 0.0 1.0 /end CHARACTERISTIC
/begin CHARACTERISTIC KIPM_FCMAEBReqDflt_flg "" VALUE 0x0000 /* @ECU_Address@KIPM_FCMAEBReqDflt_flg@ */ Scalar_BOOLEAN 0 AppSwcIpm_CM_boolean_flg 0.0 1.0 /end CHARACTERISTIC
/begin CHARACTERISTIC KIPM_FCMAEBReq_flg_ovrdflg "" VALUE 0x0000 /* @ECU_Address@KIPM_FCMAEBReq_flg_ovrdflg@ */ Scalar_BOOLEAN 0 AppSwcIpm_CM_boolean_flg 0.0 1.0 /end CHARACTERISTIC
/begin CHARACTERISTIC KIPM_FCMAEBReq_flg_ovrdval "" VALUE 0x0000 /* @ECU_Address@KIPM_FCMAEBReq_flg_ovrdval@ */ Scalar_BOOLEAN 0 AppSwcIpm_CM_boolean_flg 0.0 1.0 /end CHARACTERISTIC
/begin CHARACTERISTIC KIPM_FCMAccMode_enum_ovrdflg "" VALUE 0x0000 /* @ECU_Address@KIPM_FCMAccMode_enum_ovrdflg@ */ Scalar_BOOLEAN 0 AppSwcIpm_CM_boolean_flg 0.0 1.0 /end CHARACTERISTIC
/begin CHARACTERISTIC KIPM_FCMAccReqDriveOffDflt_flg "" VALUE 0x0000 /* @ECU_Address@KIPM_FCMAccReqDriveOffDflt_flg@ */ Scalar_BOOLEAN 0 AppSwcIpm_CM_boolean_flg 0.0 1.0 /end CHARACTERISTIC
/begin CHARACTERISTIC KIPM_FCMAccReqDriveOff_flg_ovrdflg "" VALUE 0x0000 /* @ECU_Address@KIPM_FCMAccReqDriveOff_flg_ovrdflg@ */ Scalar_BOOLEAN 0 AppSwcIpm_CM_boolean_flg 0.0 1.0 /end CHARACTERISTIC
/begin CHARACTERISTIC KIPM_FCMAccReqDriveOff_flg_ovrdval "" VALUE 0x0000 /* @ECU_Address@KIPM_FCMAccReqDriveOff_flg_ovrdval@ */ Scalar_BOOLEAN 0 AppSwcIpm_CM_boolean_flg 0.0 1.0 /end CHARACTERISTIC
/begin CHARACTERISTIC KIPM_FCMAccReqStandstillDflt_flg "" VALUE 0x0000 /* @ECU_Address@KIPM_FCMAccReqStandstillDflt_flg@ */ Scalar_BOOLEAN 0 AppSwcIpm_CM_boolean_flg 0.0 1.0 /end CHARACTERISTIC
/begin CHARACTERISTIC KIPM_FCMAccReqStandstill_flg_ovrdflg "" VALUE 0x0000 /* @ECU_Address@KIPM_FCMAccReqStandstill_flg_ovrdflg@ */ Scalar_BOOLEAN 0 AppSwcIpm_CM_boolean_flg 0.0 1.0 /end CHARACTERISTIC
/begin CHARACTERISTIC KIPM_FCMAccReqStandstill_flg_ovrdval "" VALUE 0x0000 /* @ECU_Address@KIPM_FCMAccReqStandstill_flg_ovrdval@ */ Scalar_BOOLEAN 0 AppSwcIpm_CM_boolean_flg 0.0 1.0 /end CHARACTERISTIC
/begin CHARACTERISTIC KIPM_FCMAccTarAccrnReqActvDflt_flg "" VALUE 0x0000 /* @ECU_Address@KIPM_FCMAccTarAccrnReqActvDflt_flg@ */ Scalar_BOOLEAN 0 AppSwcIpm_CM_boolean_flg 0.0 1.0 /end CHARACTERISTIC
/begin CHARACTERISTIC KIPM_FCMAccTarAccrnReqActv_flg_ovrdflg "" VALUE 0x0000 /* @ECU_Address@KIPM_FCMAccTarAccrnReqActv_flg_ovrdflg@ */ Scalar_BOOLEAN 0 AppSwcIpm_CM_boolean_flg 0.0 1.0 /end CHARACTERISTIC
/begin CHARACTERISTIC KIPM_FCMAccTarAccrnReqActv_flg_ovrdval "" VALUE 0x0000 /* @ECU_Address@KIPM_FCMAccTarAccrnReqActv_flg_ovrdval@ */ Scalar_BOOLEAN 0 AppSwcIpm_CM_boolean_flg 0.0 1.0 /end CHARACTERISTIC
/begin CHARACTERISTIC KIPM_FCMAccTarAccrn_mps2_ovrdflg "" VALUE 0x0000 /* @ECU_Address@KIPM_FCMAccTarAccrn_mps2_ovrdflg@ */ Scalar_BOOLEAN 0 AppSwcIpm_CM_boolean_flg 0.0 1.0 /end CHARACTERISTIC
/begin CHARACTERISTIC KIPM_FCMAccTgtAxReqDflt_flg "" VALUE 0x0000 /* @ECU_Address@KIPM_FCMAccTgtAxReqDflt_flg@ */ Scalar_BOOLEAN 0 AppSwcIpm_CM_boolean_flg 0.0 1.0 /end CHARACTERISTIC
/begin CHARACTERISTIC KIPM_FCMAccTgtAxReq_flg_ovrdflg "" VALUE 0x0000 /* @ECU_Address@KIPM_FCMAccTgtAxReq_flg_ovrdflg@ */ Scalar_BOOLEAN 0 AppSwcIpm_CM_boolean_flg 0.0 1.0 /end CHARACTERISTIC
/begin CHARACTERISTIC KIPM_FCMAccTgtAxReq_flg_ovrdval "" VALUE 0x0000 /* @ECU_Address@KIPM_FCMAccTgtAxReq_flg_ovrdval@ */ Scalar_BOOLEAN 0 AppSwcIpm_CM_boolean_flg 0.0 1.0 /end CHARACTERISTIC
/begin CHARACTERISTIC KIPM_FCMAccTgtAx_mps2_ovrdflg "" VALUE 0x0000 /* @ECU_Address@KIPM_FCMAccTgtAx_mps2_ovrdflg@ */ Scalar_BOOLEAN 0 AppSwcIpm_CM_boolean_flg 0.0 1.0 /end CHARACTERISTIC
/begin CHARACTERISTIC KIPM_FCMEPBReq_enum_ovrdflg "" VALUE 0x0000 /* @ECU_Address@KIPM_FCMEPBReq_enum_ovrdflg@ */ Scalar_BOOLEAN 0 AppSwcIpm_CM_boolean_flg 0.0 1.0 /end CHARACTERISTIC
/begin CHARACTERISTIC KIPM_FCMTrnLampReq_enum_ovrdflg "" VALUE 0x0000 /* @ECU_Address@KIPM_FCMTrnLampReq_enum_ovrdflg@ */ Scalar_BOOLEAN 0 AppSwcIpm_CM_boolean_flg 0.0 1.0 /end CHARACTERISTIC
/begin CHARACTERISTIC KIPM_INV2InpVolt_V_ovrdflg "" VALUE 0x0000 /* @ECU_Address@KIPM_INV2InpVolt_V_ovrdflg@ */ Scalar_BOOLEAN 0 AppSwcIpm_CM_boolean_flg 0.0 1.0 /end CHARACTERISTIC
/begin CHARACTERISTIC KIPM_INV2MotorMaxTemp_C_ovrdflg "" VALUE 0x0000 /* @ECU_Address@KIPM_INV2MotorMaxTemp_C_ovrdflg@ */ Scalar_BOOLEAN 0 AppSwcIpm_CM_boolean_flg 0.0 1.0 /end CHARACTERISTIC
/begin CHARACTERISTIC KIPM_INV3DrvTqAllwdMax_Nm_ovrdflg "" VALUE 0x0000 /* @ECU_Address@KIPM_INV3DrvTqAllwdMax_Nm_ovrdflg@ */ Scalar_BOOLEAN 0 AppSwcIpm_CM_boolean_flg 0.0 1.0 /end CHARACTERISTIC
/begin CHARACTERISTIC KIPM_INV3RecupTqAllwdMax_Nm_ovrdflg "" VALUE 0x0000 /* @ECU_Address@KIPM_INV3RecupTqAllwdMax_Nm_ovrdflg@ */ Scalar_BOOLEAN 0 AppSwcIpm_CM_boolean_flg 0.0 1.0 /end CHARACTERISTIC
/begin CHARACTERISTIC KIPM_INV4FltLvl_enum_ovrdflg "" VALUE 0x0000 /* @ECU_Address@KIPM_INV4FltLvl_enum_ovrdflg@ */ Scalar_BOOLEAN 0 AppSwcIpm_CM_boolean_flg 0.0 1.0 /end CHARACTERISTIC
/begin CHARACTERISTIC KIPM_SCSFrntWiprSwtSt_enum_ovrdflg "" VALUE 0x0000 /* @ECU_Address@KIPM_SCSFrntWiprSwtSt_enum_ovrdflg@ */ Scalar_BOOLEAN 0 AppSwcIpm_CM_boolean_flg 0.0 1.0 /end CHARACTERISTIC
/begin CHARACTERISTIC KIPM_SCSFrntWshrSwtStDflt_flg "" VALUE 0x0000 /* @ECU_Address@KIPM_SCSFrntWshrSwtStDflt_flg@ */ Scalar_BOOLEAN 0 AppSwcIpm_CM_boolean_flg 0.0 1.0 /end CHARACTERISTIC
/begin CHARACTERISTIC KIPM_SCSFrntWshrSwtSt_flg_ovrdflg "" VALUE 0x0000 /* @ECU_Address@KIPM_SCSFrntWshrSwtSt_flg_ovrdflg@ */ Scalar_BOOLEAN 0 AppSwcIpm_CM_boolean_flg 0.0 1.0 /end CHARACTERISTIC
/begin CHARACTERISTIC KIPM_SCSFrntWshrSwtSt_flg_ovrdval "" VALUE 0x0000 /* @ECU_Address@KIPM_SCSFrntWshrSwtSt_flg_ovrdval@ */ Scalar_BOOLEAN 0 AppSwcIpm_CM_boolean_flg 0.0 1.0 /end CHARACTERISTIC
/begin CHARACTERISTIC KIPM_SCSGrShftLvrPstnReq_enum_ovrdflg "" VALUE 0x0000 /* @ECU_Address@KIPM_SCSGrShftLvrPstnReq_enum_ovrdflg@ */ Scalar_BOOLEAN 0 AppSwcIpm_CM_boolean_flg 0.0 1.0 /end CHARACTERISTIC
/begin CHARACTERISTIC KIPM_SCSHiBeamSwStDflt_flg "" VALUE 0x0000 /* @ECU_Address@KIPM_SCSHiBeamSwStDflt_flg@ */ Scalar_BOOLEAN 0 AppSwcIpm_CM_boolean_flg 0.0 1.0 /end CHARACTERISTIC
/begin CHARACTERISTIC KIPM_SCSHiBeamSwSt_flg_ovrdflg "" VALUE 0x0000 /* @ECU_Address@KIPM_SCSHiBeamSwSt_flg_ovrdflg@ */ Scalar_BOOLEAN 0 AppSwcIpm_CM_boolean_flg 0.0 1.0 /end CHARACTERISTIC
/begin CHARACTERISTIC KIPM_SCSHiBeamSwSt_flg_ovrdval "" VALUE 0x0000 /* @ECU_Address@KIPM_SCSHiBeamSwSt_flg_ovrdval@ */ Scalar_BOOLEAN 0 AppSwcIpm_CM_boolean_flg 0.0 1.0 /end CHARACTERISTIC
/begin CHARACTERISTIC KIPM_SCSLampAutoStDflt_flg "" VALUE 0x0000 /* @ECU_Address@KIPM_SCSLampAutoStDflt_flg@ */ Scalar_BOOLEAN 0 AppSwcIpm_CM_boolean_flg 0.0 1.0 /end CHARACTERISTIC
/begin CHARACTERISTIC KIPM_SCSLampAutoSt_flg_ovrdflg "" VALUE 0x0000 /* @ECU_Address@KIPM_SCSLampAutoSt_flg_ovrdflg@ */ Scalar_BOOLEAN 0 AppSwcIpm_CM_boolean_flg 0.0 1.0 /end CHARACTERISTIC
/begin CHARACTERISTIC KIPM_SCSLampAutoSt_flg_ovrdval "" VALUE 0x0000 /* @ECU_Address@KIPM_SCSLampAutoSt_flg_ovrdval@ */ Scalar_BOOLEAN 0 AppSwcIpm_CM_boolean_flg 0.0 1.0 /end CHARACTERISTIC
/begin CHARACTERISTIC KIPM_SCSLeTrnLmpSwStDflt_flg "" VALUE 0x0000 /* @ECU_Address@KIPM_SCSLeTrnLmpSwStDflt_flg@ */ Scalar_BOOLEAN 0 AppSwcIpm_CM_boolean_flg 0.0 1.0 /end CHARACTERISTIC
/begin CHARACTERISTIC KIPM_SCSLeTrnLmpSwSt_flg_ovrdflg "" VALUE 0x0000 /* @ECU_Address@KIPM_SCSLeTrnLmpSwSt_flg_ovrdflg@ */ Scalar_BOOLEAN 0 AppSwcIpm_CM_boolean_flg 0.0 1.0 /end CHARACTERISTIC
/begin CHARACTERISTIC KIPM_SCSLeTrnLmpSwSt_flg_ovrdval "" VALUE 0x0000 /* @ECU_Address@KIPM_SCSLeTrnLmpSwSt_flg_ovrdval@ */ Scalar_BOOLEAN 0 AppSwcIpm_CM_boolean_flg 0.0 1.0 /end CHARACTERISTIC
/begin CHARACTERISTIC KIPM_SCSLoBeamSwStDflt_flg "" VALUE 0x0000 /* @ECU_Address@KIPM_SCSLoBeamSwStDflt_flg@ */ Scalar_BOOLEAN 0 AppSwcIpm_CM_boolean_flg 0.0 1.0 /end CHARACTERISTIC
/begin CHARACTERISTIC KIPM_SCSLoBeamSwSt_flg_ovrdflg "" VALUE 0x0000 /* @ECU_Address@KIPM_SCSLoBeamSwSt_flg_ovrdflg@ */ Scalar_BOOLEAN 0 AppSwcIpm_CM_boolean_flg 0.0 1.0 /end CHARACTERISTIC
/begin CHARACTERISTIC KIPM_SCSLoBeamSwSt_flg_ovrdval "" VALUE 0x0000 /* @ECU_Address@KIPM_SCSLoBeamSwSt_flg_ovrdval@ */ Scalar_BOOLEAN 0 AppSwcIpm_CM_boolean_flg 0.0 1.0 /end CHARACTERISTIC
/begin CHARACTERISTIC KIPM_SCSOvrVehBeamSwStDflt_flg "" VALUE 0x0000 /* @ECU_Address@KIPM_SCSOvrVehBeamSwStDflt_flg@ */ Scalar_BOOLEAN 0 AppSwcIpm_CM_boolean_flg 0.0 1.0 /end CHARACTERISTIC
/begin CHARACTERISTIC KIPM_SCSOvrVehBeamSwSt_flg_ovrdflg "" VALUE 0x0000 /* @ECU_Address@KIPM_SCSOvrVehBeamSwSt_flg_ovrdflg@ */ Scalar_BOOLEAN 0 AppSwcIpm_CM_boolean_flg 0.0 1.0 /end CHARACTERISTIC
/begin CHARACTERISTIC KIPM_SCSOvrVehBeamSwSt_flg_ovrdval "" VALUE 0x0000 /* @ECU_Address@KIPM_SCSOvrVehBeamSwSt_flg_ovrdval@ */ Scalar_BOOLEAN 0 AppSwcIpm_CM_boolean_flg 0.0 1.0 /end CHARACTERISTIC
/begin CHARACTERISTIC KIPM_SCSPstnLghtSwStDflt_flg "" VALUE 0x0000 /* @ECU_Address@KIPM_SCSPstnLghtSwStDflt_flg@ */ Scalar_BOOLEAN 0 AppSwcIpm_CM_boolean_flg 0.0 1.0 /end CHARACTERISTIC
/begin CHARACTERISTIC KIPM_SCSPstnLghtSwSt_flg_ovrdflg "" VALUE 0x0000 /* @ECU_Address@KIPM_SCSPstnLghtSwSt_flg_ovrdflg@ */ Scalar_BOOLEAN 0 AppSwcIpm_CM_boolean_flg 0.0 1.0 /end CHARACTERISTIC
/begin CHARACTERISTIC KIPM_SCSPstnLghtSwSt_flg_ovrdval "" VALUE 0x0000 /* @ECU_Address@KIPM_SCSPstnLghtSwSt_flg_ovrdval@ */ Scalar_BOOLEAN 0 AppSwcIpm_CM_boolean_flg 0.0 1.0 /end CHARACTERISTIC
/begin CHARACTERISTIC KIPM_SCSRght11SwDflt_flg "" VALUE 0x0000 /* @ECU_Address@KIPM_SCSRght11SwDflt_flg@ */ Scalar_BOOLEAN 0 AppSwcIpm_CM_boolean_flg 0.0 1.0 /end CHARACTERISTIC
/begin CHARACTERISTIC KIPM_SCSRght11Sw_flg_ovrdflg "" VALUE 0x0000 /* @ECU_Address@KIPM_SCSRght11Sw_flg_ovrdflg@ */ Scalar_BOOLEAN 0 AppSwcIpm_CM_boolean_flg 0.0 1.0 /end CHARACTERISTIC
/begin CHARACTERISTIC KIPM_SCSRght11Sw_flg_ovrdval "" VALUE 0x0000 /* @ECU_Address@KIPM_SCSRght11Sw_flg_ovrdval@ */ Scalar_BOOLEAN 0 AppSwcIpm_CM_boolean_flg 0.0 1.0 /end CHARACTERISTIC
/begin CHARACTERISTIC KIPM_SCSRght12SwDflt_flg "" VALUE 0x0000 /* @ECU_Address@KIPM_SCSRght12SwDflt_flg@ */ Scalar_BOOLEAN 0 AppSwcIpm_CM_boolean_flg 0.0 1.0 /end CHARACTERISTIC
/begin CHARACTERISTIC KIPM_SCSRght12Sw_flg_ovrdflg "" VALUE 0x0000 /* @ECU_Address@KIPM_SCSRght12Sw_flg_ovrdflg@ */ Scalar_BOOLEAN 0 AppSwcIpm_CM_boolean_flg 0.0 1.0 /end CHARACTERISTIC
/begin CHARACTERISTIC KIPM_SCSRght12Sw_flg_ovrdval "" VALUE 0x0000 /* @ECU_Address@KIPM_SCSRght12Sw_flg_ovrdval@ */ Scalar_BOOLEAN 0 AppSwcIpm_CM_boolean_flg 0.0 1.0 /end CHARACTERISTIC
/begin CHARACTERISTIC KIPM_SCSRght13SwDflt_flg "" VALUE 0x0000 /* @ECU_Address@KIPM_SCSRght13SwDflt_flg@ */ Scalar_BOOLEAN 0 AppSwcIpm_CM_boolean_flg 0.0 1.0 /end CHARACTERISTIC
/begin CHARACTERISTIC KIPM_SCSRght13Sw_flg_ovrdflg "" VALUE 0x0000 /* @ECU_Address@KIPM_SCSRght13Sw_flg_ovrdflg@ */ Scalar_BOOLEAN 0 AppSwcIpm_CM_boolean_flg 0.0 1.0 /end CHARACTERISTIC
/begin CHARACTERISTIC KIPM_SCSRght13Sw_flg_ovrdval "" VALUE 0x0000 /* @ECU_Address@KIPM_SCSRght13Sw_flg_ovrdval@ */ Scalar_BOOLEAN 0 AppSwcIpm_CM_boolean_flg 0.0 1.0 /end CHARACTERISTIC
/begin CHARACTERISTIC KIPM_SCSRghtSwVldtyDflt_flg "" VALUE 0x0000 /* @ECU_Address@KIPM_SCSRghtSwVldtyDflt_flg@ */ Scalar_BOOLEAN 0 AppSwcIpm_CM_boolean_flg 0.0 1.0 /end CHARACTERISTIC
/begin CHARACTERISTIC KIPM_SCSRghtSwVldty_flg_ovrdflg "" VALUE 0x0000 /* @ECU_Address@KIPM_SCSRghtSwVldty_flg_ovrdflg@ */ Scalar_BOOLEAN 0 AppSwcIpm_CM_boolean_flg 0.0 1.0 /end CHARACTERISTIC
/begin CHARACTERISTIC KIPM_SCSRghtSwVldty_flg_ovrdval "" VALUE 0x0000 /* @ECU_Address@KIPM_SCSRghtSwVldty_flg_ovrdval@ */ Scalar_BOOLEAN 0 AppSwcIpm_CM_boolean_flg 0.0 1.0 /end CHARACTERISTIC
/begin CHARACTERISTIC KIPM_SCSRiTrnLmpSwStDflt_flg "" VALUE 0x0000 /* @ECU_Address@KIPM_SCSRiTrnLmpSwStDflt_flg@ */ Scalar_BOOLEAN 0 AppSwcIpm_CM_boolean_flg 0.0 1.0 /end CHARACTERISTIC
/begin CHARACTERISTIC KIPM_SCSRiTrnLmpSwSt_flg_ovrdflg "" VALUE 0x0000 /* @ECU_Address@KIPM_SCSRiTrnLmpSwSt_flg_ovrdflg@ */ Scalar_BOOLEAN 0 AppSwcIpm_CM_boolean_flg 0.0 1.0 /end CHARACTERISTIC
/begin CHARACTERISTIC KIPM_SCSRiTrnLmpSwSt_flg_ovrdval "" VALUE 0x0000 /* @ECU_Address@KIPM_SCSRiTrnLmpSwSt_flg_ovrdval@ */ Scalar_BOOLEAN 0 AppSwcIpm_CM_boolean_flg 0.0 1.0 /end CHARACTERISTIC
/begin CHARACTERISTIC KIPM_SRSCrashOutputSts_enum_ovrdflg "" VALUE 0x0000 /* @ECU_Address@KIPM_SRSCrashOutputSts_enum_ovrdflg@ */ Scalar_BOOLEAN 0 AppSwcIpm_CM_boolean_flg 0.0 1.0 /end CHARACTERISTIC
/begin CHARACTERISTIC KIPM_SRSDrvSeatbeltBkldDflt_flg "" VALUE 0x0000 /* @ECU_Address@KIPM_SRSDrvSeatbeltBkldDflt_flg@ */ Scalar_BOOLEAN 0 AppSwcIpm_CM_boolean_flg 0.0 1.0 /end CHARACTERISTIC
/begin CHARACTERISTIC KIPM_SRSDrvSeatbeltBkld_flg_ovrdflg "" VALUE 0x0000 /* @ECU_Address@KIPM_SRSDrvSeatbeltBkld_flg_ovrdflg@ */ Scalar_BOOLEAN 0 AppSwcIpm_CM_boolean_flg 0.0 1.0 /end CHARACTERISTIC
/begin CHARACTERISTIC KIPM_SRSDrvSeatbeltBkld_flg_ovrdval "" VALUE 0x0000 /* @ECU_Address@KIPM_SRSDrvSeatbeltBkld_flg_ovrdval@ */ Scalar_BOOLEAN 0 AppSwcIpm_CM_boolean_flg 0.0 1.0 /end CHARACTERISTIC
/begin CHARACTERISTIC KIPM_BMSChrgInterlockStaDflt_enum "" VALUE 0x0000 /* @ECU_Address@KIPM_BMSChrgInterlockStaDflt_enum@ */ Scalar_UBYTE 0 AppSwcIpm_CM_uint8_enum 0.0 255.0 /end CHARACTERISTIC
/begin CHARACTERISTIC KIPM_BMSChrgInterlockSta_enum_ovrdval "" VALUE 0x0000 /* @ECU_Address@KIPM_BMSChrgInterlockSta_enum_ovrdval@ */ Scalar_UBYTE 0 AppSwcIpm_CM_uint8_enum 0.0 255.0 /end CHARACTERISTIC
/begin CHARACTERISTIC KIPM_BMSDchrgInterlockStaDflt_enum "" VALUE 0x0000 /* @ECU_Address@KIPM_BMSDchrgInterlockStaDflt_enum@ */ Scalar_UBYTE 0 AppSwcIpm_CM_uint8_enum 0.0 255.0 /end CHARACTERISTIC
/begin CHARACTERISTIC KIPM_BMSDchrgInterlockSta_enum_ovrdval "" VALUE 0x0000 /* @ECU_Address@KIPM_BMSDchrgInterlockSta_enum_ovrdval@ */ Scalar_UBYTE 0 AppSwcIpm_CM_uint8_enum 0.0 255.0 /end CHARACTERISTIC
/begin CHARACTERISTIC KIPM_BMSPwrTrainConnectStaDflt_enum "" VALUE 0x0000 /* @ECU_Address@KIPM_BMSPwrTrainConnectStaDflt_enum@ */ Scalar_UBYTE 0 AppSwcIpm_CM_uint8_enum 0.0 255.0 /end CHARACTERISTIC
/begin CHARACTERISTIC KIPM_BMSPwrTrainConnectSta_enum_ovrdval "" VALUE 0x0000 /* @ECU_Address@KIPM_BMSPwrTrainConnectSta_enum_ovrdval@ */ Scalar_UBYTE 0 AppSwcIpm_CM_uint8_enum 0.0 255.0 /end CHARACTERISTIC
/begin CHARACTERISTIC KIPM_BMSSysFailStaDflt_enum "" VALUE 0x0000 /* @ECU_Address@KIPM_BMSSysFailStaDflt_enum@ */ Scalar_UBYTE 0 AppSwcIpm_CM_uint8_enum 0.0 255.0 /end CHARACTERISTIC
/begin CHARACTERISTIC KIPM_BMSSysFailSta_enum_ovrdval "" VALUE 0x0000 /* @ECU_Address@KIPM_BMSSysFailSta_enum_ovrdval@ */ Scalar_UBYTE 0 AppSwcIpm_CM_uint8_enum 0.0 255.0 /end CHARACTERISTIC
/begin CHARACTERISTIC KIPM_BMSThermrunawayWrnDflt_enum "" VALUE 0x0000 /* @ECU_Address@KIPM_BMSThermrunawayWrnDflt_enum@ */ Scalar_UBYTE 0 AppSwcIpm_CM_uint8_enum 0.0 255.0 /end CHARACTERISTIC
/begin CHARACTERISTIC KIPM_BMSThermrunawayWrn_enum_ovrdval "" VALUE 0x0000 /* @ECU_Address@KIPM_BMSThermrunawayWrn_enum_ovrdval@ */ Scalar_UBYTE 0 AppSwcIpm_CM_uint8_enum 0.0 255.0 /end CHARACTERISTIC
/begin CHARACTERISTIC KIPM_CRRRBSDWarnLtDflt_enum "" VALUE 0x0000 /* @ECU_Address@KIPM_CRRRBSDWarnLtDflt_enum@ */ Scalar_UBYTE 0 AppSwcIpm_CM_uint8_enum 0.0 255.0 /end CHARACTERISTIC
/begin CHARACTERISTIC KIPM_CRRRBSDWarnLt_enum_ovrdval "" VALUE 0x0000 /* @ECU_Address@KIPM_CRRRBSDWarnLt_enum_ovrdval@ */ Scalar_UBYTE 0 AppSwcIpm_CM_uint8_enum 0.0 255.0 /end CHARACTERISTIC
/begin CHARACTERISTIC KIPM_CRRRBSDWarnRtDflt_enum "" VALUE 0x0000 /* @ECU_Address@KIPM_CRRRBSDWarnRtDflt_enum@ */ Scalar_UBYTE 0 AppSwcIpm_CM_uint8_enum 0.0 255.0 /end CHARACTERISTIC
/begin CHARACTERISTIC KIPM_CRRRBSDWarnRt_enum_ovrdval "" VALUE 0x0000 /* @ECU_Address@KIPM_CRRRBSDWarnRt_enum_ovrdval@ */ Scalar_UBYTE 0 AppSwcIpm_CM_uint8_enum 0.0 255.0 /end CHARACTERISTIC
/begin CHARACTERISTIC KIPM_CRRRDOWWarnLtDflt_enum "" VALUE 0x0000 /* @ECU_Address@KIPM_CRRRDOWWarnLtDflt_enum@ */ Scalar_UBYTE 0 AppSwcIpm_CM_uint8_enum 0.0 255.0 /end CHARACTERISTIC
/begin CHARACTERISTIC KIPM_CRRRDOWWarnLt_enum_ovrdval "" VALUE 0x0000 /* @ECU_Address@KIPM_CRRRDOWWarnLt_enum_ovrdval@ */ Scalar_UBYTE 0 AppSwcIpm_CM_uint8_enum 0.0 255.0 /end CHARACTERISTIC
/begin CHARACTERISTIC KIPM_CRRRDOWWarnRtDflt_enum "" VALUE 0x0000 /* @ECU_Address@KIPM_CRRRDOWWarnRtDflt_enum@ */ Scalar_UBYTE 0 AppSwcIpm_CM_uint8_enum 0.0 255.0 /end CHARACTERISTIC
/begin CHARACTERISTIC KIPM_CRRRDOWWarnRt_enum_ovrdval "" VALUE 0x0000 /* @ECU_Address@KIPM_CRRRDOWWarnRt_enum_ovrdval@ */ Scalar_UBYTE 0 AppSwcIpm_CM_uint8_enum 0.0 255.0 /end CHARACTERISTIC
/begin CHARACTERISTIC KIPM_CRRRRCTAWarnLtDflt_enum "" VALUE 0x0000 /* @ECU_Address@KIPM_CRRRRCTAWarnLtDflt_enum@ */ Scalar_UBYTE 0 AppSwcIpm_CM_uint8_enum 0.0 255.0 /end CHARACTERISTIC
/begin CHARACTERISTIC KIPM_CRRRRCTAWarnLt_enum_ovrdval "" VALUE 0x0000 /* @ECU_Address@KIPM_CRRRRCTAWarnLt_enum_ovrdval@ */ Scalar_UBYTE 0 AppSwcIpm_CM_uint8_enum 0.0 255.0 /end CHARACTERISTIC
/begin CHARACTERISTIC KIPM_CRRRRCTAWarnRtDflt_enum "" VALUE 0x0000 /* @ECU_Address@KIPM_CRRRRCTAWarnRtDflt_enum@ */ Scalar_UBYTE 0 AppSwcIpm_CM_uint8_enum 0.0 255.0 /end CHARACTERISTIC
/begin CHARACTERISTIC KIPM_CRRRRCTAWarnRt_enum_ovrdval "" VALUE 0x0000 /* @ECU_Address@KIPM_CRRRRCTAWarnRt_enum_ovrdval@ */ Scalar_UBYTE 0 AppSwcIpm_CM_uint8_enum 0.0 255.0 /end CHARACTERISTIC
/begin CHARACTERISTIC KIPM_FCMACCSdnModeDflt_enum "" VALUE 0x0000 /* @ECU_Address@KIPM_FCMACCSdnModeDflt_enum@ */ Scalar_UBYTE 0 AppSwcIpm_CM_uint8_enum 0.0 255.0 /end CHARACTERISTIC
/begin CHARACTERISTIC KIPM_FCMACCSdnMode_enum_ovrdval "" VALUE 0x0000 /* @ECU_Address@KIPM_FCMACCSdnMode_enum_ovrdval@ */ Scalar_UBYTE 0 AppSwcIpm_CM_uint8_enum 0.0 255.0 /end CHARACTERISTIC
/begin CHARACTERISTIC KIPM_FCMEPBReqDflt_enum "" VALUE 0x0000 /* @ECU_Address@KIPM_FCMEPBReqDflt_enum@ */ Scalar_UBYTE 0 AppSwcIpm_CM_uint8_enum 0.0 255.0 /end CHARACTERISTIC
/begin CHARACTERISTIC KIPM_FCMEPBReq_enum_ovrdval "" VALUE 0x0000 /* @ECU_Address@KIPM_FCMEPBReq_enum_ovrdval@ */ Scalar_UBYTE 0 AppSwcIpm_CM_uint8_enum 0.0 255.0 /end CHARACTERISTIC
/begin CHARACTERISTIC KIPM_FCMTrnLampReqDflt_enum "" VALUE 0x0000 /* @ECU_Address@KIPM_FCMTrnLampReqDflt_enum@ */ Scalar_UBYTE 0 AppSwcIpm_CM_uint8_enum 0.0 255.0 /end CHARACTERISTIC
/begin CHARACTERISTIC KIPM_FCMTrnLampReq_enum_ovrdval "" VALUE 0x0000 /* @ECU_Address@KIPM_FCMTrnLampReq_enum_ovrdval@ */ Scalar_UBYTE 0 AppSwcIpm_CM_uint8_enum 0.0 255.0 /end CHARACTERISTIC
/begin CHARACTERISTIC KIPM_INV4FltLvlDflt_enum "" VALUE 0x0000 /* @ECU_Address@KIPM_INV4FltLvlDflt_enum@ */ Scalar_UBYTE 0 AppSwcIpm_CM_uint8_enum 0.0 255.0 /end CHARACTERISTIC
/begin CHARACTERISTIC KIPM_INV4FltLvl_enum_ovrdval "" VALUE 0x0000 /* @ECU_Address@KIPM_INV4FltLvl_enum_ovrdval@ */ Scalar_UBYTE 0 AppSwcIpm_CM_uint8_enum 0.0 255.0 /end CHARACTERISTIC
/begin CHARACTERISTIC KIPM_SCSFrntWiprSwtStDflt_enum "" VALUE 0x0000 /* @ECU_Address@KIPM_SCSFrntWiprSwtStDflt_enum@ */ Scalar_UBYTE 0 AppSwcIpm_CM_uint8 0.0 255.0 /end CHARACTERISTIC
/begin CHARACTERISTIC KIPM_SCSFrntWiprSwtSt_enum_ovrdval "" VALUE 0x0000 /* @ECU_Address@KIPM_SCSFrntWiprSwtSt_enum_ovrdval@ */ Scalar_UBYTE 0 AppSwcIpm_CM_uint8 0.0 255.0 /end CHARACTERISTIC
/begin CHARACTERISTIC KIPM_SRSCrashOutputStsDflt_enum "" VALUE 0x0000 /* @ECU_Address@KIPM_SRSCrashOutputStsDflt_enum@ */ Scalar_UBYTE 0 AppSwcIpm_CM_uint8 0.0 255.0 /end CHARACTERISTIC
/begin CHARACTERISTIC KIPM_SRSCrashOutputSts_enum_ovrdval "" VALUE 0x0000 /* @ECU_Address@KIPM_SRSCrashOutputSts_enum_ovrdval@ */ Scalar_UBYTE 0 AppSwcIpm_CM_uint8 0.0 255.0 /end CHARACTERISTIC
/begin MEASUREMENT VIPM_BMSCellVoltMin_mV "" FLOAT32_IEEE AppSwcIpm_CM_single_mV 0 0 -100000.0 100000.0 ECU_ADDRESS 0x0000 /* @ECU_Address@VIPM_BMSCellVoltMin_mV@ */ /end MEASUREMENT
/begin MEASUREMENT VIPM_BMSCellVoltMax_mV "" FLOAT32_IEEE AppSwcIpm_CM_single_mV 0 0 -100000.0 100000.0 ECU_ADDRESS 0x0000 /* @ECU_Address@VIPM_BMSCellVoltMax_mV@ */ /end MEASUREMENT
/begin MEASUREMENT VIPM_BMSMaxInsDisCurnt_A "" FLOAT32_IEEE AppSwcIpm_CM_single_A 0 0 -100000.0 100000.0 ECU_ADDRESS 0x0000 /* @ECU_Address@VIPM_BMSMaxInsDisCurnt_A@ */ /end MEASUREMENT
/begin MEASUREMENT VIPM_BMSMaxInsChrgCurnt_A "" FLOAT32_IEEE AppSwcIpm_CM_single_A 0 0 -100000.0 100000.0 ECU_ADDRESS 0x0000 /* @ECU_Address@VIPM_BMSMaxInsChrgCurnt_A@ */ /end MEASUREMENT
/begin MEASUREMENT VIPM_BMSMaxConDisCurnt_A "" FLOAT32_IEEE AppSwcIpm_CM_single_A 0 0 -100000.0 100000.0 ECU_ADDRESS 0x0000 /* @ECU_Address@VIPM_BMSMaxConDisCurnt_A@ */ /end MEASUREMENT
/begin MEASUREMENT VIPM_BMSMaxConChrgCurnt_A "" FLOAT32_IEEE AppSwcIpm_CM_single_A 0 0 -100000.0 100000.0 ECU_ADDRESS 0x0000 /* @ECU_Address@VIPM_BMSMaxConChrgCurnt_A@ */ /end MEASUREMENT
/begin MEASUREMENT VIPM_BMSOutlCooltActlTemp_C "" FLOAT32_IEEE AppSwcIpm_CM_single_C 0 0 -100000.0 100000.0 ECU_ADDRESS 0x0000 /* @ECU_Address@VIPM_BMSOutlCooltActlTemp_C@ */ /end MEASUREMENT
/begin MEASUREMENT VIPM_BMSMaxChrgVoltAC_V "" FLOAT32_IEEE AppSwcIpm_CM_single_V 0 0 -100000.0 100000.0 ECU_ADDRESS 0x0000 /* @ECU_Address@VIPM_BMSMaxChrgVoltAC_V@ */ /end MEASUREMENT
/begin MEASUREMENT VIPM_BMSMaxChrgCurntAC_A "" FLOAT32_IEEE AppSwcIpm_CM_single_A 0 0 -100000.0 100000.0 ECU_ADDRESS 0x0000 /* @ECU_Address@VIPM_BMSMaxChrgCurntAC_A@ */ /end MEASUREMENT
/begin MEASUREMENT VIPM_BMSIsoResist_MOhm "" FLOAT32_IEEE AppSwcIpm_CM_single_MOhm 0 0 -100000.0 100000.0 ECU_ADDRESS 0x0000 /* @ECU_Address@VIPM_BMSIsoResist_MOhm@ */ /end MEASUREMENT
/begin MEASUREMENT VIPM_BMSInletCooltActlTemp_C "" FLOAT32_IEEE AppSwcIpm_CM_single_C 0 0 -100000.0 100000.0 ECU_ADDRESS 0x0000 /* @ECU_Address@VIPM_BMSInletCooltActlTemp_C@ */ /end MEASUREMENT
/begin MEASUREMENT VIPM_BMSHVBatActVolt_V "" FLOAT32_IEEE AppSwcIpm_CM_single_V 0 0 -100000.0 100000.0 ECU_ADDRESS 0x0000 /* @ECU_Address@VIPM_BMSHVBatActVolt_V@ */ /end MEASUREMENT
/begin MEASUREMENT VIPM_BMSBatSOH_pct "" FLOAT32_IEEE AppSwcIpm_CM_single_pct 0 0 -100000.0 100000.0 ECU_ADDRESS 0x0000 /* @ECU_Address@VIPM_BMSBatSOH_pct@ */ /end MEASUREMENT
/begin MEASUREMENT VIPM_BMSBatSOCRpt_pct "" FLOAT32_IEEE AppSwcIpm_CM_single_pct 0 0 -100000.0 100000.0 ECU_ADDRESS 0x0000 /* @ECU_Address@VIPM_BMSBatSOCRpt_pct@ */ /end MEASUREMENT
/begin MEASUREMENT VIPM_BMSBatSOCAct_pct "" FLOAT32_IEEE AppSwcIpm_CM_single_pct 0 0 -100000.0 100000.0 ECU_ADDRESS 0x0000 /* @ECU_Address@VIPM_BMSBatSOCAct_pct@ */ /end MEASUREMENT
/begin MEASUREMENT VIPM_BMSActExchgCurnt_A "" FLOAT32_IEEE AppSwcIpm_CM_single_A 0 0 -100000.0 100000.0 ECU_ADDRESS 0x0000 /* @ECU_Address@VIPM_BMSActExchgCurnt_A@ */ /end MEASUREMENT
/begin MEASUREMENT VIPM_FCMAccTgtAx_mps2 "" FLOAT32_IEEE AppSwcIpm_CM_single_mps2 0 0 -100000.0 100000.0 ECU_ADDRESS 0x0000 /* @ECU_Address@VIPM_FCMAccTgtAx_mps2@ */ /end MEASUREMENT
/begin MEASUREMENT VIPM_FCMAccTarAccrn_mps2 "" FLOAT32_IEEE AppSwcIpm_CM_single_mps2 0 0 -100000.0 100000.0 ECU_ADDRESS 0x0000 /* @ECU_Address@VIPM_FCMAccTarAccrn_mps2@ */ /end MEASUREMENT
/begin MEASUREMENT VIPM_FCMACCWhlTqReqVal_Nm "" FLOAT32_IEEE AppSwcIpm_CM_single_Nm 0 0 -100000.0 100000.0 ECU_ADDRESS 0x0000 /* @ECU_Address@VIPM_FCMACCWhlTqReqVal_Nm@ */ /end MEASUREMENT
/begin MEASUREMENT VIPM_FCMACCWhlDece_mps2 "" FLOAT32_IEEE AppSwcIpm_CM_single_mps2 0 0 -100000.0 100000.0 ECU_ADDRESS 0x0000 /* @ECU_Address@VIPM_FCMACCWhlDece_mps2@ */ /end MEASUREMENT
/begin MEASUREMENT VIPM_INV3RecupTqAllwdMax_Nm "" FLOAT32_IEEE AppSwcIpm_CM_single_Nm 0 0 -100000.0 100000.0 ECU_ADDRESS 0x0000 /* @ECU_Address@VIPM_INV3RecupTqAllwdMax_Nm@ */ /end MEASUREMENT
/begin MEASUREMENT VIPM_INV3DrvTqAllwdMax_Nm "" FLOAT32_IEEE AppSwcIpm_CM_single_Nm 0 0 -100000.0 100000.0 ECU_ADDRESS 0x0000 /* @ECU_Address@VIPM_INV3DrvTqAllwdMax_Nm@ */ /end MEASUREMENT
/begin MEASUREMENT VIPM_INV2MotorMaxTemp_C "" FLOAT32_IEEE AppSwcIpm_CM_single_C 0 0 -100000.0 100000.0 ECU_ADDRESS 0x0000 /* @ECU_Address@VIPM_INV2MotorMaxTemp_C@ */ /end MEASUREMENT
/begin MEASUREMENT VIPM_INV2InpVolt_V "" FLOAT32_IEEE AppSwcIpm_CM_single_V 0 0 -100000.0 100000.0 ECU_ADDRESS 0x0000 /* @ECU_Address@VIPM_INV2InpVolt_V@ */ /end MEASUREMENT
/begin MEASUREMENT VIPM_SRSCrashOutputSts_enum "" UBYTE AppSwcIpm_CM_uint8 0 0 0.0 255.0 ECU_ADDRESS 0x0000 /* @ECU_Address@VIPM_SRSCrashOutputSts_enum@ */ /end MEASUREMENT
/begin MEASUREMENT VIPM_SCSFrntWiprSwtSt_enum "" UBYTE AppSwcIpm_CM_uint8 0 0 0.0 255.0 ECU_ADDRESS 0x0000 /* @ECU_Address@VIPM_SCSFrntWiprSwtSt_enum@ */ /end MEASUREMENT
/begin MEASUREMENT VIPM_BMSThermrunawayWrn_enum "" UBYTE AppSwcIpm_CM_uint8_enum 0 0 0.0 255.0 ECU_ADDRESS 0x0000 /* @ECU_Address@VIPM_BMSThermrunawayWrn_enum@ */ /end MEASUREMENT
/begin MEASUREMENT VIPM_BMSSysFailSta_enum "" UBYTE AppSwcIpm_CM_uint8_enum 0 0 0.0 255.0 ECU_ADDRESS 0x0000 /* @ECU_Address@VIPM_BMSSysFailSta_enum@ */ /end MEASUREMENT
/begin MEASUREMENT VIPM_BMSPwrTrainConnectSta_enum "" UBYTE AppSwcIpm_CM_uint8_enum 0 0 0.0 255.0 ECU_ADDRESS 0x0000 /* @ECU_Address@VIPM_BMSPwrTrainConnectSta_enum@ */ /end MEASUREMENT
/begin MEASUREMENT VIPM_BMSDchrgInterlockSta_enum "" UBYTE AppSwcIpm_CM_uint8_enum 0 0 0.0 255.0 ECU_ADDRESS 0x0000 /* @ECU_Address@VIPM_BMSDchrgInterlockSta_enum@ */ /end MEASUREMENT
/begin MEASUREMENT VIPM_BMSChrgInterlockSta_enum "" UBYTE AppSwcIpm_CM_uint8_enum 0 0 0.0 255.0 ECU_ADDRESS 0x0000 /* @ECU_Address@VIPM_BMSChrgInterlockSta_enum@ */ /end MEASUREMENT
/begin MEASUREMENT VIPM_FCMTrnLampReq_enum "" UBYTE AppSwcIpm_CM_uint8_enum 0 0 0.0 255.0 ECU_ADDRESS 0x0000 /* @ECU_Address@VIPM_FCMTrnLampReq_enum@ */ /end MEASUREMENT
/begin MEASUREMENT VIPM_FCMEPBReq_enum "" UBYTE AppSwcIpm_CM_uint8_enum 0 0 0.0 255.0 ECU_ADDRESS 0x0000 /* @ECU_Address@VIPM_FCMEPBReq_enum@ */ /end MEASUREMENT
/begin MEASUREMENT VIPM_FCMACCSdnMode_enum "" UBYTE AppSwcIpm_CM_uint8_enum 0 0 0.0 255.0 ECU_ADDRESS 0x0000 /* @ECU_Address@VIPM_FCMACCSdnMode_enum@ */ /end MEASUREMENT
/begin MEASUREMENT VIPM_CRRRRCTAWarnRt_enum "" UBYTE AppSwcIpm_CM_uint8_enum 0 0 0.0 255.0 ECU_ADDRESS 0x0000 /* @ECU_Address@VIPM_CRRRRCTAWarnRt_enum@ */ /end MEASUREMENT
/begin MEASUREMENT VIPM_CRRRRCTAWarnLt_enum "" UBYTE AppSwcIpm_CM_uint8_enum 0 0 0.0 255.0 ECU_ADDRESS 0x0000 /* @ECU_Address@VIPM_CRRRRCTAWarnLt_enum@ */ /end MEASUREMENT
/begin MEASUREMENT VIPM_CRRRDOWWarnRt_enum "" UBYTE AppSwcIpm_CM_uint8_enum 0 0 0.0 255.0 ECU_ADDRESS 0x0000 /* @ECU_Address@VIPM_CRRRDOWWarnRt_enum@ */ /end MEASUREMENT
/begin MEASUREMENT VIPM_CRRRDOWWarnLt_enum "" UBYTE AppSwcIpm_CM_uint8_enum 0 0 0.0 255.0 ECU_ADDRESS 0x0000 /* @ECU_Address@VIPM_CRRRDOWWarnLt_enum@ */ /end MEASUREMENT
/begin MEASUREMENT VIPM_CRRRBSDWarnRt_enum "" UBYTE AppSwcIpm_CM_uint8_enum 0 0 0.0 255.0 ECU_ADDRESS 0x0000 /* @ECU_Address@VIPM_CRRRBSDWarnRt_enum@ */ /end MEASUREMENT
/begin MEASUREMENT VIPM_CRRRBSDWarnLt_enum "" UBYTE AppSwcIpm_CM_uint8_enum 0 0 0.0 255.0 ECU_ADDRESS 0x0000 /* @ECU_Address@VIPM_CRRRBSDWarnLt_enum@ */ /end MEASUREMENT
/begin MEASUREMENT VIPM_INV4FltLvl_enum "" UBYTE AppSwcIpm_CM_uint8_enum 0 0 0.0 255.0 ECU_ADDRESS 0x0000 /* @ECU_Address@VIPM_INV4FltLvl_enum@ */ /end MEASUREMENT
/begin MEASUREMENT VIPM_SRSDrvSeatbeltBkldVld_flg "" UBYTE AppSwcIpm_CM_boolean_flg 0 0 0.0 1.0 ECU_ADDRESS 0x0000 /* @ECU_Address@VIPM_SRSDrvSeatbeltBkldVld_flg@ */ /end MEASUREMENT
/begin MEASUREMENT VIPM_SRSDrvSeatbeltBkld_flg "" UBYTE AppSwcIpm_CM_boolean_flg 0 0 0.0 1.0 ECU_ADDRESS 0x0000 /* @ECU_Address@VIPM_SRSDrvSeatbeltBkld_flg@ */ /end MEASUREMENT
/begin MEASUREMENT VIPM_SRSCrashOutputStsVld_flg "" UBYTE AppSwcIpm_CM_boolean_flg 0 0 0.0 1.0 ECU_ADDRESS 0x0000 /* @ECU_Address@VIPM_SRSCrashOutputStsVld_flg@ */ /end MEASUREMENT
/begin MEASUREMENT VIPM_SCSRiTrnLmpSwStVld_flg "" UBYTE AppSwcIpm_CM_boolean_flg 0 0 0.0 1.0 ECU_ADDRESS 0x0000 /* @ECU_Address@VIPM_SCSRiTrnLmpSwStVld_flg@ */ /end MEASUREMENT
/begin MEASUREMENT VIPM_SCSRiTrnLmpSwSt_flg "" UBYTE AppSwcIpm_CM_boolean_flg 0 0 0.0 1.0 ECU_ADDRESS 0x0000 /* @ECU_Address@VIPM_SCSRiTrnLmpSwSt_flg@ */ /end MEASUREMENT
/begin MEASUREMENT VIPM_SCSPstnLghtSwStVld_flg "" UBYTE AppSwcIpm_CM_boolean_flg 0 0 0.0 1.0 ECU_ADDRESS 0x0000 /* @ECU_Address@VIPM_SCSPstnLghtSwStVld_flg@ */ /end MEASUREMENT
/begin MEASUREMENT VIPM_SCSPstnLghtSwSt_flg "" UBYTE AppSwcIpm_CM_boolean_flg 0 0 0.0 1.0 ECU_ADDRESS 0x0000 /* @ECU_Address@VIPM_SCSPstnLghtSwSt_flg@ */ /end MEASUREMENT
/begin MEASUREMENT VIPM_SCSOvrVehBeamSwStVld_flg "" UBYTE AppSwcIpm_CM_boolean_flg 0 0 0.0 1.0 ECU_ADDRESS 0x0000 /* @ECU_Address@VIPM_SCSOvrVehBeamSwStVld_flg@ */ /end MEASUREMENT
/begin MEASUREMENT VIPM_SCSOvrVehBeamSwSt_flg "" UBYTE AppSwcIpm_CM_boolean_flg 0 0 0.0 1.0 ECU_ADDRESS 0x0000 /* @ECU_Address@VIPM_SCSOvrVehBeamSwSt_flg@ */ /end MEASUREMENT
/begin MEASUREMENT VIPM_SCSLoBeamSwStVld_flg "" UBYTE AppSwcIpm_CM_boolean_flg 0 0 0.0 1.0 ECU_ADDRESS 0x0000 /* @ECU_Address@VIPM_SCSLoBeamSwStVld_flg@ */ /end MEASUREMENT
/begin MEASUREMENT VIPM_SCSLoBeamSwSt_flg "" UBYTE AppSwcIpm_CM_boolean_flg 0 0 0.0 1.0 ECU_ADDRESS 0x0000 /* @ECU_Address@VIPM_SCSLoBeamSwSt_flg@ */ /end MEASUREMENT
/begin MEASUREMENT VIPM_SCSLeTrnLmpSwStVld_flg "" UBYTE AppSwcIpm_CM_boolean_flg 0 0 0.0 1.0 ECU_ADDRESS 0x0000 /* @ECU_Address@VIPM_SCSLeTrnLmpSwStVld_flg@ */ /end MEASUREMENT
/begin MEASUREMENT VIPM_SCSLeTrnLmpSwSt_flg "" UBYTE AppSwcIpm_CM_boolean_flg 0 0 0.0 1.0 ECU_ADDRESS 0x0000 /* @ECU_Address@VIPM_SCSLeTrnLmpSwSt_flg@ */ /end MEASUREMENT
/begin MEASUREMENT VIPM_SCSLampAutoStVld_flg "" UBYTE AppSwcIpm_CM_boolean_flg 0 0 0.0 1.0 ECU_ADDRESS 0x0000 /* @ECU_Address@VIPM_SCSLampAutoStVld_flg@ */ /end MEASUREMENT
/begin MEASUREMENT VIPM_SCSLampAutoSt_flg "" UBYTE AppSwcIpm_CM_boolean_flg 0 0 0.0 1.0 ECU_ADDRESS 0x0000 /* @ECU_Address@VIPM_SCSLampAutoSt_flg@ */ /end MEASUREMENT
/begin MEASUREMENT VIPM_SCSHiBeamSwStVld_flg "" UBYTE AppSwcIpm_CM_boolean_flg 0 0 0.0 1.0 ECU_ADDRESS 0x0000 /* @ECU_Address@VIPM_SCSHiBeamSwStVld_flg@ */ /end MEASUREMENT
/begin MEASUREMENT VIPM_SCSHiBeamSwSt_flg "" UBYTE AppSwcIpm_CM_boolean_flg 0 0 0.0 1.0 ECU_ADDRESS 0x0000 /* @ECU_Address@VIPM_SCSHiBeamSwSt_flg@ */ /end MEASUREMENT
/begin MEASUREMENT VIPM_SCSFrntWshrSwtStVld_flg "" UBYTE AppSwcIpm_CM_boolean_flg 0 0 0.0 1.0 ECU_ADDRESS 0x0000 /* @ECU_Address@VIPM_SCSFrntWshrSwtStVld_flg@ */ /end MEASUREMENT
/begin MEASUREMENT VIPM_SCSFrntWshrSwtSt_flg "" UBYTE AppSwcIpm_CM_boolean_flg 0 0 0.0 1.0 ECU_ADDRESS 0x0000 /* @ECU_Address@VIPM_SCSFrntWshrSwtSt_flg@ */ /end MEASUREMENT
/begin MEASUREMENT VIPM_SCSFrntWiprSwtStVld_flg "" UBYTE AppSwcIpm_CM_boolean_flg 0 0 0.0 1.0 ECU_ADDRESS 0x0000 /* @ECU_Address@VIPM_SCSFrntWiprSwtStVld_flg@ */ /end MEASUREMENT
/begin MEASUREMENT VIPM_ESCLUnOrLockfeedbackVld_flg "" UBYTE AppSwcIpm_CM_boolean_flg 0 0 0.0 1.0 ECU_ADDRESS 0x0000 /* @ECU_Address@VIPM_ESCLUnOrLockfeedbackVld_flg@ */ /end MEASUREMENT
/begin MEASUREMENT VIPM_CCPTempDecKeyVld_flg "" UBYTE AppSwcIpm_CM_boolean_flg 0 0 0.0 1.0 ECU_ADDRESS 0x0000 /* @ECU_Address@VIPM_CCPTempDecKeyVld_flg@ */ /end MEASUREMENT
/begin MEASUREMENT VIPM_CCPTempDecKey_flg "" UBYTE AppSwcIpm_CM_boolean_flg 0 0 0.0 1.0 ECU_ADDRESS 0x0000 /* @ECU_Address@VIPM_CCPTempDecKey_flg@ */ /end MEASUREMENT
/begin MEASUREMENT VIPM_CCPTempAddKeyVld_flg "" UBYTE AppSwcIpm_CM_boolean_flg 0 0 0.0 1.0 ECU_ADDRESS 0x0000 /* @ECU_Address@VIPM_CCPTempAddKeyVld_flg@ */ /end MEASUREMENT
/begin MEASUREMENT VIPM_CCPTempAddKey_flg "" UBYTE AppSwcIpm_CM_boolean_flg 0 0 0.0 1.0 ECU_ADDRESS 0x0000 /* @ECU_Address@VIPM_CCPTempAddKey_flg@ */ /end MEASUREMENT
/begin MEASUREMENT VIPM_CCPTPMSKeyVld_flg "" UBYTE AppSwcIpm_CM_boolean_flg 0 0 0.0 1.0 ECU_ADDRESS 0x0000 /* @ECU_Address@VIPM_CCPTPMSKeyVld_flg@ */ /end MEASUREMENT
/begin MEASUREMENT VIPM_CCPTPMSKey_flg "" UBYTE AppSwcIpm_CM_boolean_flg 0 0 0.0 1.0 ECU_ADDRESS 0x0000 /* @ECU_Address@VIPM_CCPTPMSKey_flg@ */ /end MEASUREMENT
/begin MEASUREMENT VIPM_CCPRrViewMirrHeatgKeyVld_flg "" UBYTE AppSwcIpm_CM_boolean_flg 0 0 0.0 1.0 ECU_ADDRESS 0x0000 /* @ECU_Address@VIPM_CCPRrViewMirrHeatgKeyVld_flg@ */ /end MEASUREMENT
/begin MEASUREMENT VIPM_CCPRrViewMirrHeatgKey_flg "" UBYTE AppSwcIpm_CM_boolean_flg 0 0 0.0 1.0 ECU_ADDRESS 0x0000 /* @ECU_Address@VIPM_CCPRrViewMirrHeatgKey_flg@ */ /end MEASUREMENT
/begin MEASUREMENT VIPM_CCPPwrRecupLvlKeyVld_flg "" UBYTE AppSwcIpm_CM_boolean_flg 0 0 0.0 1.0 ECU_ADDRESS 0x0000 /* @ECU_Address@VIPM_CCPPwrRecupLvlKeyVld_flg@ */ /end MEASUREMENT
/begin MEASUREMENT VIPM_CCPPwrRecupLvlKey_flg "" UBYTE AppSwcIpm_CM_boolean_flg 0 0 0.0 1.0 ECU_ADDRESS 0x0000 /* @ECU_Address@VIPM_CCPPwrRecupLvlKey_flg@ */ /end MEASUREMENT
/begin MEASUREMENT VIPM_CCPModeKeyVld_flg "" UBYTE AppSwcIpm_CM_boolean_flg 0 0 0.0 1.0 ECU_ADDRESS 0x0000 /* @ECU_Address@VIPM_CCPModeKeyVld_flg@ */ /end MEASUREMENT
/begin MEASUREMENT VIPM_CCPModeKey_flg "" UBYTE AppSwcIpm_CM_boolean_flg 0 0 0.0 1.0 ECU_ADDRESS 0x0000 /* @ECU_Address@VIPM_CCPModeKey_flg@ */ /end MEASUREMENT
/begin MEASUREMENT VIPM_CCPHzrdKeyVld_flg "" UBYTE AppSwcIpm_CM_boolean_flg 0 0 0.0 1.0 ECU_ADDRESS 0x0000 /* @ECU_Address@VIPM_CCPHzrdKeyVld_flg@ */ /end MEASUREMENT
/begin MEASUREMENT VIPM_CCPHzrdKey_flg "" UBYTE AppSwcIpm_CM_boolean_flg 0 0 0.0 1.0 ECU_ADDRESS 0x0000 /* @ECU_Address@VIPM_CCPHzrdKey_flg@ */ /end MEASUREMENT
/begin MEASUREMENT VIPM_CCPHDCKeyVld_flg "" UBYTE AppSwcIpm_CM_boolean_flg 0 0 0.0 1.0 ECU_ADDRESS 0x0000 /* @ECU_Address@VIPM_CCPHDCKeyVld_flg@ */ /end MEASUREMENT
/begin MEASUREMENT VIPM_CCPHDCKey_flg "" UBYTE AppSwcIpm_CM_boolean_flg 0 0 0.0 1.0 ECU_ADDRESS 0x0000 /* @ECU_Address@VIPM_CCPHDCKey_flg@ */ /end MEASUREMENT
/begin MEASUREMENT VIPM_CCPFrntWindDefrstKeyVld_flg "" UBYTE AppSwcIpm_CM_boolean_flg 0 0 0.0 1.0 ECU_ADDRESS 0x0000 /* @ECU_Address@VIPM_CCPFrntWindDefrstKeyVld_flg@ */ /end MEASUREMENT
/begin MEASUREMENT VIPM_CCPFrntWindDefrstKey_flg "" UBYTE AppSwcIpm_CM_boolean_flg 0 0 0.0 1.0 ECU_ADDRESS 0x0000 /* @ECU_Address@VIPM_CCPFrntWindDefrstKey_flg@ */ /end MEASUREMENT
/begin MEASUREMENT VIPM_CCPESCOffKeyVld_flg "" UBYTE AppSwcIpm_CM_boolean_flg 0 0 0.0 1.0 ECU_ADDRESS 0x0000 /* @ECU_Address@VIPM_CCPESCOffKeyVld_flg@ */ /end MEASUREMENT
/begin MEASUREMENT VIPM_CCPESCOffKey_flg "" UBYTE AppSwcIpm_CM_boolean_flg 0 0 0.0 1.0 ECU_ADDRESS 0x0000 /* @ECU_Address@VIPM_CCPESCOffKey_flg@ */ /end MEASUREMENT
/begin MEASUREMENT VIPM_CCPCenLckKeyVld_flg "" UBYTE AppSwcIpm_CM_boolean_flg 0 0 0.0 1.0 ECU_ADDRESS 0x0000 /* @ECU_Address@VIPM_CCPCenLckKeyVld_flg@ */ /end MEASUREMENT
/begin MEASUREMENT VIPM_CCPCenLckKey_flg "" UBYTE AppSwcIpm_CM_boolean_flg 0 0 0.0 1.0 ECU_ADDRESS 0x0000 /* @ECU_Address@VIPM_CCPCenLckKey_flg@ */ /end MEASUREMENT
/begin MEASUREMENT VIPM_CCPBlwrLvlDecKeyVld_flg "" UBYTE AppSwcIpm_CM_boolean_flg 0 0 0.0 1.0 ECU_ADDRESS 0x0000 /* @ECU_Address@VIPM_CCPBlwrLvlDecKeyVld_flg@ */ /end MEASUREMENT
/begin MEASUREMENT VIPM_CCPBlwrLvlDecKey_flg "" UBYTE AppSwcIpm_CM_boolean_flg 0 0 0.0 1.0 ECU_ADDRESS 0x0000 /* @ECU_Address@VIPM_CCPBlwrLvlDecKey_flg@ */ /end MEASUREMENT
/begin MEASUREMENT VIPM_CCPBlwrLvlAddKeyVld_flg "" UBYTE AppSwcIpm_CM_boolean_flg 0 0 0.0 1.0 ECU_ADDRESS 0x0000 /* @ECU_Address@VIPM_CCPBlwrLvlAddKeyVld_flg@ */ /end MEASUREMENT
/begin MEASUREMENT VIPM_CCPBlwrLvlAddKey_flg "" UBYTE AppSwcIpm_CM_boolean_flg 0 0 0.0 1.0 ECU_ADDRESS 0x0000 /* @ECU_Address@VIPM_CCPBlwrLvlAddKey_flg@ */ /end MEASUREMENT
/begin MEASUREMENT VIPM_CCPBlwngModePrevKeyVld_flg "" UBYTE AppSwcIpm_CM_boolean_flg 0 0 0.0 1.0 ECU_ADDRESS 0x0000 /* @ECU_Address@VIPM_CCPBlwngModePrevKeyVld_flg@ */ /end MEASUREMENT
/begin MEASUREMENT VIPM_CCPBlwngModePrevKey_flg "" UBYTE AppSwcIpm_CM_boolean_flg 0 0 0.0 1.0 ECU_ADDRESS 0x0000 /* @ECU_Address@VIPM_CCPBlwngModePrevKey_flg@ */ /end MEASUREMENT
/begin MEASUREMENT VIPM_CCPBlwngModeNextKeyVld_flg "" UBYTE AppSwcIpm_CM_boolean_flg 0 0 0.0 1.0 ECU_ADDRESS 0x0000 /* @ECU_Address@VIPM_CCPBlwngModeNextKeyVld_flg@ */ /end MEASUREMENT
/begin MEASUREMENT VIPM_CCPBlwngModeNextKey_flg "" UBYTE AppSwcIpm_CM_boolean_flg 0 0 0.0 1.0 ECU_ADDRESS 0x0000 /* @ECU_Address@VIPM_CCPBlwngModeNextKey_flg@ */ /end MEASUREMENT
/begin MEASUREMENT VIPM_CCPAirInletModeKeyVld_flg "" UBYTE AppSwcIpm_CM_boolean_flg 0 0 0.0 1.0 ECU_ADDRESS 0x0000 /* @ECU_Address@VIPM_CCPAirInletModeKeyVld_flg@ */ /end MEASUREMENT
/begin MEASUREMENT VIPM_CCPAirInletModeKey_flg "" UBYTE AppSwcIpm_CM_boolean_flg 0 0 0.0 1.0 ECU_ADDRESS 0x0000 /* @ECU_Address@VIPM_CCPAirInletModeKey_flg@ */ /end MEASUREMENT
/begin MEASUREMENT VIPM_CCPAVHKeyVld_flg "" UBYTE AppSwcIpm_CM_boolean_flg 0 0 0.0 1.0 ECU_ADDRESS 0x0000 /* @ECU_Address@VIPM_CCPAVHKeyVld_flg@ */ /end MEASUREMENT
/begin MEASUREMENT VIPM_CCPAVHKey_flg "" UBYTE AppSwcIpm_CM_boolean_flg 0 0 0.0 1.0 ECU_ADDRESS 0x0000 /* @ECU_Address@VIPM_CCPAVHKey_flg@ */ /end MEASUREMENT
/begin MEASUREMENT VIPM_CCPAVASOffKeyVld_flg "" UBYTE AppSwcIpm_CM_boolean_flg 0 0 0.0 1.0 ECU_ADDRESS 0x0000 /* @ECU_Address@VIPM_CCPAVASOffKeyVld_flg@ */ /end MEASUREMENT
/begin MEASUREMENT VIPM_CCPAVASOffKey_flg "" UBYTE AppSwcIpm_CM_boolean_flg 0 0 0.0 1.0 ECU_ADDRESS 0x0000 /* @ECU_Address@VIPM_CCPAVASOffKey_flg@ */ /end MEASUREMENT
/begin MEASUREMENT VIPM_CCPACSwKeyVld_flg "" UBYTE AppSwcIpm_CM_boolean_flg 0 0 0.0 1.0 ECU_ADDRESS 0x0000 /* @ECU_Address@VIPM_CCPACSwKeyVld_flg@ */ /end MEASUREMENT
/begin MEASUREMENT VIPM_CCPACSwKey_flg "" UBYTE AppSwcIpm_CM_boolean_flg 0 0 0.0 1.0 ECU_ADDRESS 0x0000 /* @ECU_Address@VIPM_CCPACSwKey_flg@ */ /end MEASUREMENT
/begin MEASUREMENT VIPM_CCPACAutoKeyVld_flg "" UBYTE AppSwcIpm_CM_boolean_flg 0 0 0.0 1.0 ECU_ADDRESS 0x0000 /* @ECU_Address@VIPM_CCPACAutoKeyVld_flg@ */ /end MEASUREMENT
/begin MEASUREMENT VIPM_CCPACAutoKey_flg "" UBYTE AppSwcIpm_CM_boolean_flg 0 0 0.0 1.0 ECU_ADDRESS 0x0000 /* @ECU_Address@VIPM_CCPACAutoKey_flg@ */ /end MEASUREMENT
/begin MEASUREMENT VIPM_BMSCellVoltMinVld_flg "" UBYTE AppSwcIpm_CM_boolean_flg 0 0 0.0 1.0 ECU_ADDRESS 0x0000 /* @ECU_Address@VIPM_BMSCellVoltMinVld_flg@ */ /end MEASUREMENT
/begin MEASUREMENT VIPM_BMSCellVoltMaxVld_flg "" UBYTE AppSwcIpm_CM_boolean_flg 0 0 0.0 1.0 ECU_ADDRESS 0x0000 /* @ECU_Address@VIPM_BMSCellVoltMaxVld_flg@ */ /end MEASUREMENT
/begin MEASUREMENT VIPM_BMSMaxInsDisCurntVld_flg "" UBYTE AppSwcIpm_CM_boolean_flg 0 0 0.0 1.0 ECU_ADDRESS 0x0000 /* @ECU_Address@VIPM_BMSMaxInsDisCurntVld_flg@ */ /end MEASUREMENT
/begin MEASUREMENT VIPM_BMSMaxInsChrgCurntVld_flg "" UBYTE AppSwcIpm_CM_boolean_flg 0 0 0.0 1.0 ECU_ADDRESS 0x0000 /* @ECU_Address@VIPM_BMSMaxInsChrgCurntVld_flg@ */ /end MEASUREMENT
/begin MEASUREMENT VIPM_BMSMaxConDisCurntVld_flg "" UBYTE AppSwcIpm_CM_boolean_flg 0 0 0.0 1.0 ECU_ADDRESS 0x0000 /* @ECU_Address@VIPM_BMSMaxConDisCurntVld_flg@ */ /end MEASUREMENT
/begin MEASUREMENT VIPM_BMSMaxConChrgCurntVld_flg "" UBYTE AppSwcIpm_CM_boolean_flg 0 0 0.0 1.0 ECU_ADDRESS 0x0000 /* @ECU_Address@VIPM_BMSMaxConChrgCurntVld_flg@ */ /end MEASUREMENT
/begin MEASUREMENT VIPM_BMSOutlCooltActlTempVld_flg "" UBYTE AppSwcIpm_CM_boolean_flg 0 0 0.0 1.0 ECU_ADDRESS 0x0000 /* @ECU_Address@VIPM_BMSOutlCooltActlTempVld_flg@ */ /end MEASUREMENT
/begin MEASUREMENT VIPM_BMSMaxChrgVoltACVld_flg "" UBYTE AppSwcIpm_CM_boolean_flg 0 0 0.0 1.0 ECU_ADDRESS 0x0000 /* @ECU_Address@VIPM_BMSMaxChrgVoltACVld_flg@ */ /end MEASUREMENT
/begin MEASUREMENT VIPM_BMSMaxChrgCurntACVld_flg "" UBYTE AppSwcIpm_CM_boolean_flg 0 0 0.0 1.0 ECU_ADDRESS 0x0000 /* @ECU_Address@VIPM_BMSMaxChrgCurntACVld_flg@ */ /end MEASUREMENT
/begin MEASUREMENT VIPM_BMSIsoResistVld_flg "" UBYTE AppSwcIpm_CM_boolean_flg 0 0 0.0 1.0 ECU_ADDRESS 0x0000 /* @ECU_Address@VIPM_BMSIsoResistVld_flg@ */ /end MEASUREMENT
/begin MEASUREMENT VIPM_BMSInletCooltActlTempVld_flg "" UBYTE AppSwcIpm_CM_boolean_flg 0 0 0.0 1.0 ECU_ADDRESS 0x0000 /* @ECU_Address@VIPM_BMSInletCooltActlTempVld_flg@ */ /end MEASUREMENT
/begin MEASUREMENT VIPM_BMSACChrgAtclStaVld_flg "" UBYTE AppSwcIpm_CM_boolean_flg 0 0 0.0 1.0 ECU_ADDRESS 0x0000 /* @ECU_Address@VIPM_BMSACChrgAtclStaVld_flg@ */ /end MEASUREMENT
/begin MEASUREMENT VIPM_BMSDCSChrgReqVld_flg "" UBYTE AppSwcIpm_CM_boolean_flg 0 0 0.0 1.0 ECU_ADDRESS 0x0000 /* @ECU_Address@VIPM_BMSDCSChrgReqVld_flg@ */ /end MEASUREMENT
/begin MEASUREMENT VIPM_BMSDCSChrgReq_flg "" UBYTE AppSwcIpm_CM_boolean_flg 0 0 0.0 1.0 ECU_ADDRESS 0x0000 /* @ECU_Address@VIPM_BMSDCSChrgReq_flg@ */ /end MEASUREMENT
/begin MEASUREMENT VIPM_BMSHVBatActVoltVld_flg "" UBYTE AppSwcIpm_CM_boolean_flg 0 0 0.0 1.0 ECU_ADDRESS 0x0000 /* @ECU_Address@VIPM_BMSHVBatActVoltVld_flg@ */ /end MEASUREMENT
/begin MEASUREMENT VIPM_BMSBatSOHVld_flg "" UBYTE AppSwcIpm_CM_boolean_flg 0 0 0.0 1.0 ECU_ADDRESS 0x0000 /* @ECU_Address@VIPM_BMSBatSOHVld_flg@ */ /end MEASUREMENT
/begin MEASUREMENT VIPM_BMSBatSOCRptVld_flg "" UBYTE AppSwcIpm_CM_boolean_flg 0 0 0.0 1.0 ECU_ADDRESS 0x0000 /* @ECU_Address@VIPM_BMSBatSOCRptVld_flg@ */ /end MEASUREMENT
/begin MEASUREMENT VIPM_BMSBatSOCActVld_flg "" UBYTE AppSwcIpm_CM_boolean_flg 0 0 0.0 1.0 ECU_ADDRESS 0x0000 /* @ECU_Address@VIPM_BMSBatSOCActVld_flg@ */ /end MEASUREMENT
/begin MEASUREMENT VIPM_BMSThermrunawayWrnVld_flg "" UBYTE AppSwcIpm_CM_boolean_flg 0 0 0.0 1.0 ECU_ADDRESS 0x0000 /* @ECU_Address@VIPM_BMSThermrunawayWrnVld_flg@ */ /end MEASUREMENT
/begin MEASUREMENT VIPM_BMSSysFailStaVld_flg "" UBYTE AppSwcIpm_CM_boolean_flg 0 0 0.0 1.0 ECU_ADDRESS 0x0000 /* @ECU_Address@VIPM_BMSSysFailStaVld_flg@ */ /end MEASUREMENT
/begin MEASUREMENT VIPM_BMSRunStaVld_flg "" UBYTE AppSwcIpm_CM_boolean_flg 0 0 0.0 1.0 ECU_ADDRESS 0x0000 /* @ECU_Address@VIPM_BMSRunStaVld_flg@ */ /end MEASUREMENT
/begin MEASUREMENT VIPM_BMSPwrTrainConnectStaVld_flg "" UBYTE AppSwcIpm_CM_boolean_flg 0 0 0.0 1.0 ECU_ADDRESS 0x0000 /* @ECU_Address@VIPM_BMSPwrTrainConnectStaVld_flg@ */ /end MEASUREMENT
/begin MEASUREMENT VIPM_BMSEmgcySdnReqVld_flg "" UBYTE AppSwcIpm_CM_boolean_flg 0 0 0.0 1.0 ECU_ADDRESS 0x0000 /* @ECU_Address@VIPM_BMSEmgcySdnReqVld_flg@ */ /end MEASUREMENT
/begin MEASUREMENT VIPM_BMSEmgcySdnReq_flg "" UBYTE AppSwcIpm_CM_boolean_flg 0 0 0.0 1.0 ECU_ADDRESS 0x0000 /* @ECU_Address@VIPM_BMSEmgcySdnReq_flg@ */ /end MEASUREMENT
/begin MEASUREMENT VIPM_BMSDchrgInterlockStaVld_flg "" UBYTE AppSwcIpm_CM_boolean_flg 0 0 0.0 1.0 ECU_ADDRESS 0x0000 /* @ECU_Address@VIPM_BMSDchrgInterlockStaVld_flg@ */ /end MEASUREMENT
/begin MEASUREMENT VIPM_BMSChrgInterlockStaVld_flg "" UBYTE AppSwcIpm_CM_boolean_flg 0 0 0.0 1.0 ECU_ADDRESS 0x0000 /* @ECU_Address@VIPM_BMSChrgInterlockStaVld_flg@ */ /end MEASUREMENT
/begin MEASUREMENT VIPM_BMSActExchgCurntVld_flg "" UBYTE AppSwcIpm_CM_boolean_flg 0 0 0.0 1.0 ECU_ADDRESS 0x0000 /* @ECU_Address@VIPM_BMSActExchgCurntVld_flg@ */ /end MEASUREMENT
/begin MEASUREMENT VIPM_BMSDCSInletConnectStaVld_flg "" UBYTE AppSwcIpm_CM_boolean_flg 0 0 0.0 1.0 ECU_ADDRESS 0x0000 /* @ECU_Address@VIPM_BMSDCSInletConnectStaVld_flg@ */ /end MEASUREMENT
/begin MEASUREMENT VIPM_BMSDCSInletConnectSta_flg "" UBYTE AppSwcIpm_CM_boolean_flg 0 0 0.0 1.0 ECU_ADDRESS 0x0000 /* @ECU_Address@VIPM_BMSDCSInletConnectSta_flg@ */ /end MEASUREMENT
/begin MEASUREMENT VIPM_BMSDCSActOprtModeVld_flg "" UBYTE AppSwcIpm_CM_boolean_flg 0 0 0.0 1.0 ECU_ADDRESS 0x0000 /* @ECU_Address@VIPM_BMSDCSActOprtModeVld_flg@ */ /end MEASUREMENT
/begin MEASUREMENT VIPM_FCMTrnLampReqVld_flg "" UBYTE AppSwcIpm_CM_boolean_flg 0 0 0.0 1.0 ECU_ADDRESS 0x0000 /* @ECU_Address@VIPM_FCMTrnLampReqVld_flg@ */ /end MEASUREMENT
/begin MEASUREMENT VIPM_FCMEPBReqVld_flg "" UBYTE AppSwcIpm_CM_boolean_flg 0 0 0.0 1.0 ECU_ADDRESS 0x0000 /* @ECU_Address@VIPM_FCMEPBReqVld_flg@ */ /end MEASUREMENT
/begin MEASUREMENT VIPM_FCMAccTgtAxVld_flg "" UBYTE AppSwcIpm_CM_boolean_flg 0 0 0.0 1.0 ECU_ADDRESS 0x0000 /* @ECU_Address@VIPM_FCMAccTgtAxVld_flg@ */ /end MEASUREMENT
/begin MEASUREMENT VIPM_FCMAccTgtAxReqVld_flg "" UBYTE AppSwcIpm_CM_boolean_flg 0 0 0.0 1.0 ECU_ADDRESS 0x0000 /* @ECU_Address@VIPM_FCMAccTgtAxReqVld_flg@ */ /end MEASUREMENT
/begin MEASUREMENT VIPM_FCMAccTgtAxReq_flg "" UBYTE AppSwcIpm_CM_boolean_flg 0 0 0.0 1.0 ECU_ADDRESS 0x0000 /* @ECU_Address@VIPM_FCMAccTgtAxReq_flg@ */ /end MEASUREMENT
/begin MEASUREMENT VIPM_FCMAccTarAccrnVld_flg "" UBYTE AppSwcIpm_CM_boolean_flg 0 0 0.0 1.0 ECU_ADDRESS 0x0000 /* @ECU_Address@VIPM_FCMAccTarAccrnVld_flg@ */ /end MEASUREMENT
/begin MEASUREMENT VIPM_FCMAccTarAccrnReqActvVld_flg "" UBYTE AppSwcIpm_CM_boolean_flg 0 0 0.0 1.0 ECU_ADDRESS 0x0000 /* @ECU_Address@VIPM_FCMAccTarAccrnReqActvVld_flg@ */ /end MEASUREMENT
/begin MEASUREMENT VIPM_FCMAccTarAccrnReqActv_flg "" UBYTE AppSwcIpm_CM_boolean_flg 0 0 0.0 1.0 ECU_ADDRESS 0x0000 /* @ECU_Address@VIPM_FCMAccTarAccrnReqActv_flg@ */ /end MEASUREMENT
/begin MEASUREMENT VIPM_FCMAccReqStandstillVld_flg "" UBYTE AppSwcIpm_CM_boolean_flg 0 0 0.0 1.0 ECU_ADDRESS 0x0000 /* @ECU_Address@VIPM_FCMAccReqStandstillVld_flg@ */ /end MEASUREMENT
/begin MEASUREMENT VIPM_FCMAccReqStandstill_flg "" UBYTE AppSwcIpm_CM_boolean_flg 0 0 0.0 1.0 ECU_ADDRESS 0x0000 /* @ECU_Address@VIPM_FCMAccReqStandstill_flg@ */ /end MEASUREMENT
/begin MEASUREMENT VIPM_FCMAccReqDriveOffVld_flg "" UBYTE AppSwcIpm_CM_boolean_flg 0 0 0.0 1.0 ECU_ADDRESS 0x0000 /* @ECU_Address@VIPM_FCMAccReqDriveOffVld_flg@ */ /end MEASUREMENT
/begin MEASUREMENT VIPM_FCMAccReqDriveOff_flg "" UBYTE AppSwcIpm_CM_boolean_flg 0 0 0.0 1.0 ECU_ADDRESS 0x0000 /* @ECU_Address@VIPM_FCMAccReqDriveOff_flg@ */ /end MEASUREMENT
/begin MEASUREMENT VIPM_FCMAccModeVld_flg "" UBYTE AppSwcIpm_CM_boolean_flg 0 0 0.0 1.0 ECU_ADDRESS 0x0000 /* @ECU_Address@VIPM_FCMAccModeVld_flg@ */ /end MEASUREMENT
/begin MEASUREMENT VIPM_FCMAEBReqVld_flg "" UBYTE AppSwcIpm_CM_boolean_flg 0 0 0.0 1.0 ECU_ADDRESS 0x0000 /* @ECU_Address@VIPM_FCMAEBReqVld_flg@ */ /end MEASUREMENT
/begin MEASUREMENT VIPM_FCMAEBReq_flg "" UBYTE AppSwcIpm_CM_boolean_flg 0 0 0.0 1.0 ECU_ADDRESS 0x0000 /* @ECU_Address@VIPM_FCMAEBReq_flg@ */ /end MEASUREMENT
/begin MEASUREMENT VIPM_FCMACCWhlTqReqValVld_flg "" UBYTE AppSwcIpm_CM_boolean_flg 0 0 0.0 1.0 ECU_ADDRESS 0x0000 /* @ECU_Address@VIPM_FCMACCWhlTqReqValVld_flg@ */ /end MEASUREMENT
/begin MEASUREMENT VIPM_FCMACCWhlTqReqActvVld_flg "" UBYTE AppSwcIpm_CM_boolean_flg 0 0 0.0 1.0 ECU_ADDRESS 0x0000 /* @ECU_Address@VIPM_FCMACCWhlTqReqActvVld_flg@ */ /end MEASUREMENT
/begin MEASUREMENT VIPM_FCMACCWhlTqReqActv_flg "" UBYTE AppSwcIpm_CM_boolean_flg 0 0 0.0 1.0 ECU_ADDRESS 0x0000 /* @ECU_Address@VIPM_FCMACCWhlTqReqActv_flg@ */ /end MEASUREMENT
/begin MEASUREMENT VIPM_FCMACCWhlDeceVld_flg "" UBYTE AppSwcIpm_CM_boolean_flg 0 0 0.0 1.0 ECU_ADDRESS 0x0000 /* @ECU_Address@VIPM_FCMACCWhlDeceVld_flg@ */ /end MEASUREMENT
/begin MEASUREMENT VIPM_FCMACCSdnModeVld_flg "" UBYTE AppSwcIpm_CM_boolean_flg 0 0 0.0 1.0 ECU_ADDRESS 0x0000 /* @ECU_Address@VIPM_FCMACCSdnModeVld_flg@ */ /end MEASUREMENT
/begin MEASUREMENT VIPM_EHBHDCFucFaultVld_flg "" UBYTE AppSwcIpm_CM_boolean_flg 0 0 0.0 1.0 ECU_ADDRESS 0x0000 /* @ECU_Address@VIPM_EHBHDCFucFaultVld_flg@ */ /end MEASUREMENT
/begin MEASUREMENT VIPM_EHBHDCFucFault_flg "" UBYTE AppSwcIpm_CM_boolean_flg 0 0 0.0 1.0 ECU_ADDRESS 0x0000 /* @ECU_Address@VIPM_EHBHDCFucFault_flg@ */ /end MEASUREMENT
/begin MEASUREMENT VIPM_EHBEPBSysStVld_flg "" UBYTE AppSwcIpm_CM_boolean_flg 0 0 0.0 1.0 ECU_ADDRESS 0x0000 /* @ECU_Address@VIPM_EHBEPBSysStVld_flg@ */ /end MEASUREMENT
/begin MEASUREMENT VIPM_EHBEPBSwitchStsVld_flg "" UBYTE AppSwcIpm_CM_boolean_flg 0 0 0.0 1.0 ECU_ADDRESS 0x0000 /* @ECU_Address@VIPM_EHBEPBSwitchStsVld_flg@ */ /end MEASUREMENT
/begin MEASUREMENT VIPM_EHBEPBActuatorStLVld_flg "" UBYTE AppSwcIpm_CM_boolean_flg 0 0 0.0 1.0 ECU_ADDRESS 0x0000 /* @ECU_Address@VIPM_EHBEPBActuatorStLVld_flg@ */ /end MEASUREMENT
/begin MEASUREMENT VIPM_EHBBLAVld_flg "" UBYTE AppSwcIpm_CM_boolean_flg 0 0 0.0 1.0 ECU_ADDRESS 0x0000 /* @ECU_Address@VIPM_EHBBLAVld_flg@ */ /end MEASUREMENT
/begin MEASUREMENT VIPM_EHBBLA_flg "" UBYTE AppSwcIpm_CM_boolean_flg 0 0 0.0 1.0 ECU_ADDRESS 0x0000 /* @ECU_Address@VIPM_EHBBLA_flg@ */ /end MEASUREMENT
/begin MEASUREMENT VIPM_EHBAVHAppldStVld_flg "" UBYTE AppSwcIpm_CM_boolean_flg 0 0 0.0 1.0 ECU_ADDRESS 0x0000 /* @ECU_Address@VIPM_EHBAVHAppldStVld_flg@ */ /end MEASUREMENT
/begin MEASUREMENT VIPM_CRRRRCTAWarnRtVld_flg "" UBYTE AppSwcIpm_CM_boolean_flg 0 0 0.0 1.0 ECU_ADDRESS 0x0000 /* @ECU_Address@VIPM_CRRRRCTAWarnRtVld_flg@ */ /end MEASUREMENT
/begin MEASUREMENT VIPM_CRRRRCTAWarnLtVld_flg "" UBYTE AppSwcIpm_CM_boolean_flg 0 0 0.0 1.0 ECU_ADDRESS 0x0000 /* @ECU_Address@VIPM_CRRRRCTAWarnLtVld_flg@ */ /end MEASUREMENT
/begin MEASUREMENT VIPM_CRRRDOWWarnRtVld_flg "" UBYTE AppSwcIpm_CM_boolean_flg 0 0 0.0 1.0 ECU_ADDRESS 0x0000 /* @ECU_Address@VIPM_CRRRDOWWarnRtVld_flg@ */ /end MEASUREMENT
/begin MEASUREMENT VIPM_CRRRDOWWarnLtVld_flg "" UBYTE AppSwcIpm_CM_boolean_flg 0 0 0.0 1.0 ECU_ADDRESS 0x0000 /* @ECU_Address@VIPM_CRRRDOWWarnLtVld_flg@ */ /end MEASUREMENT
/begin MEASUREMENT VIPM_CRRRBSDWarnRtVld_flg "" UBYTE AppSwcIpm_CM_boolean_flg 0 0 0.0 1.0 ECU_ADDRESS 0x0000 /* @ECU_Address@VIPM_CRRRBSDWarnRtVld_flg@ */ /end MEASUREMENT
/begin MEASUREMENT VIPM_CRRRBSDWarnLtVld_flg "" UBYTE AppSwcIpm_CM_boolean_flg 0 0 0.0 1.0 ECU_ADDRESS 0x0000 /* @ECU_Address@VIPM_CRRRBSDWarnLtVld_flg@ */ /end MEASUREMENT
/begin MEASUREMENT VIPM_SCSRghtSwVldtyVld_flg "" UBYTE AppSwcIpm_CM_boolean_flg 0 0 0.0 1.0 ECU_ADDRESS 0x0000 /* @ECU_Address@VIPM_SCSRghtSwVldtyVld_flg@ */ /end MEASUREMENT
/begin MEASUREMENT VIPM_SCSRghtSwVldty_flg "" UBYTE AppSwcIpm_CM_boolean_flg 0 0 0.0 1.0 ECU_ADDRESS 0x0000 /* @ECU_Address@VIPM_SCSRghtSwVldty_flg@ */ /end MEASUREMENT
/begin MEASUREMENT VIPM_SCSRght13SwVld_flg "" UBYTE AppSwcIpm_CM_boolean_flg 0 0 0.0 1.0 ECU_ADDRESS 0x0000 /* @ECU_Address@VIPM_SCSRght13SwVld_flg@ */ /end MEASUREMENT
/begin MEASUREMENT VIPM_SCSRght13Sw_flg "" UBYTE AppSwcIpm_CM_boolean_flg 0 0 0.0 1.0 ECU_ADDRESS 0x0000 /* @ECU_Address@VIPM_SCSRght13Sw_flg@ */ /end MEASUREMENT
/begin MEASUREMENT VIPM_SCSRght12SwVld_flg "" UBYTE AppSwcIpm_CM_boolean_flg 0 0 0.0 1.0 ECU_ADDRESS 0x0000 /* @ECU_Address@VIPM_SCSRght12SwVld_flg@ */ /end MEASUREMENT
/begin MEASUREMENT VIPM_SCSRght12Sw_flg "" UBYTE AppSwcIpm_CM_boolean_flg 0 0 0.0 1.0 ECU_ADDRESS 0x0000 /* @ECU_Address@VIPM_SCSRght12Sw_flg@ */ /end MEASUREMENT
/begin MEASUREMENT VIPM_SCSRght11SwVld_flg "" UBYTE AppSwcIpm_CM_boolean_flg 0 0 0.0 1.0 ECU_ADDRESS 0x0000 /* @ECU_Address@VIPM_SCSRght11SwVld_flg@ */ /end MEASUREMENT
/begin MEASUREMENT VIPM_SCSRght11Sw_flg "" UBYTE AppSwcIpm_CM_boolean_flg 0 0 0.0 1.0 ECU_ADDRESS 0x0000 /* @ECU_Address@VIPM_SCSRght11Sw_flg@ */ /end MEASUREMENT
/begin MEASUREMENT VIPM_SCSGrShftLvrPstnReqVld_flg "" UBYTE AppSwcIpm_CM_boolean_flg 0 0 0.0 1.0 ECU_ADDRESS 0x0000 /* @ECU_Address@VIPM_SCSGrShftLvrPstnReqVld_flg@ */ /end MEASUREMENT
/begin MEASUREMENT VIPM_INV4FltLvlVld_flg "" UBYTE AppSwcIpm_CM_boolean_flg 0 0 0.0 1.0 ECU_ADDRESS 0x0000 /* @ECU_Address@VIPM_INV4FltLvlVld_flg@ */ /end MEASUREMENT
/begin MEASUREMENT VIPM_INV3RecupTqAllwdMaxVld_flg "" UBYTE AppSwcIpm_CM_boolean_flg 0 0 0.0 1.0 ECU_ADDRESS 0x0000 /* @ECU_Address@VIPM_INV3RecupTqAllwdMaxVld_flg@ */ /end MEASUREMENT
/begin MEASUREMENT VIPM_INV3DrvTqAllwdMaxVld_flg "" UBYTE AppSwcIpm_CM_boolean_flg 0 0 0.0 1.0 ECU_ADDRESS 0x0000 /* @ECU_Address@VIPM_INV3DrvTqAllwdMaxVld_flg@ */ /end MEASUREMENT
/begin MEASUREMENT VIPM_INV2MotorMaxTempVld_flg "" UBYTE AppSwcIpm_CM_boolean_flg 0 0 0.0 1.0 ECU_ADDRESS 0x0000 /* @ECU_Address@VIPM_INV2MotorMaxTempVld_flg@ */ /end MEASUREMENT
/begin MEASUREMENT VIPM_INV2InpVoltVld_flg "" UBYTE AppSwcIpm_CM_boolean_flg 0 0 0.0 1.0 ECU_ADDRESS 0x0000 /* @ECU_Address@VIPM_INV2InpVoltVld_flg@ */ /end MEASUREMENT
/begin MEASUREMENT VIPM_SCSGrShftLvrPstnReq_enum "" UBYTE AppSwcIpm_CM_EnumGrShftLvrPstnReq 0 0 0 5 ECU_ADDRESS 0x0000 /* @ECU_Address@VIPM_SCSGrShftLvrPstnReq_enum@ */ /end MEASUREMENT
/begin MEASUREMENT VIPM_EHBEPBSysSt_enum "" UBYTE AppSwcIpm_CM_EnumEPBSysSt 0 0 0 12 ECU_ADDRESS 0x0000 /* @ECU_Address@VIPM_EHBEPBSysSt_enum@ */ /end MEASUREMENT
/begin MEASUREMENT VIPM_EHBEPBSwitchSts_enum "" UBYTE AppSwcIpm_CM_EnumEPBSwSt 0 0 0 3 ECU_ADDRESS 0x0000 /* @ECU_Address@VIPM_EHBEPBSwitchSts_enum@ */ /end MEASUREMENT
/begin MEASUREMENT VIPM_EHBEPBActuatorStL_enum "" UBYTE AppSwcIpm_CM_EnumEPBState 0 0 0 6 ECU_ADDRESS 0x0000 /* @ECU_Address@VIPM_EHBEPBActuatorStL_enum@ */ /end MEASUREMENT
/begin MEASUREMENT VIPM_BMSRunSta_enum "" UBYTE AppSwcIpm_CM_EnumBMSRunSt 0 0 0 7 ECU_ADDRESS 0x0000 /* @ECU_Address@VIPM_BMSRunSta_enum@ */ /end MEASUREMENT
/begin MEASUREMENT VIPM_BMSDCSActOprtMode_enum "" UBYTE AppSwcIpm_CM_EnumBMSDCSMd 0 0 0 7 ECU_ADDRESS 0x0000 /* @ECU_Address@VIPM_BMSDCSActOprtMode_enum@ */ /end MEASUREMENT
/begin MEASUREMENT VIPM_BMSACChrgAtclSta_enum "" UBYTE AppSwcIpm_CM_EnumBMSACChrgSt 0 0 0 15 ECU_ADDRESS 0x0000 /* @ECU_Address@VIPM_BMSACChrgAtclSta_enum@ */ /end MEASUREMENT
/begin MEASUREMENT VIPM_EHBAVHAppldSt_enum "" UBYTE AppSwcIpm_CM_EnumAVHSt 0 0 0 7 ECU_ADDRESS 0x0000 /* @ECU_Address@VIPM_EHBAVHAppldSt_enum@ */ /end MEASUREMENT
/begin MEASUREMENT VIPM_FCMAccMode_enum "" UBYTE AppSwcIpm_CM_EnumACCMode 0 0 0 7 ECU_ADDRESS 0x0000 /* @ECU_Address@VIPM_FCMAccMode_enum@ */ /end MEASUREMENT
/begin COMPU_METHOD AppSwcIpm_CM_single_A "Q = V" RAT_FUNC "%8.6" "A" COEFFS 0 1 0 0 0 1 /end COMPU_METHOD
/begin COMPU_METHOD AppSwcIpm_CM_single_pct "Q = V" RAT_FUNC "%8.6" "pct" COEFFS 0 1 0 0 0 1 /end COMPU_METHOD
/begin COMPU_METHOD AppSwcIpm_CM_single_mV "Q = V" RAT_FUNC "%8.6" "mV" COEFFS 0 1 0 0 0 1 /end COMPU_METHOD
/begin COMPU_METHOD AppSwcIpm_CM_single_V "Q = V" RAT_FUNC "%8.6" "V" COEFFS 0 1 0 0 0 1 /end COMPU_METHOD
/begin COMPU_METHOD AppSwcIpm_CM_single_C "Q = V" RAT_FUNC "%8.6" "C" COEFFS 0 1 0 0 0 1 /end COMPU_METHOD
/begin COMPU_METHOD AppSwcIpm_CM_single_Mohm "Q = V" RAT_FUNC "%8.6" "Mohm" COEFFS 0 1 0 0 0 1 /end COMPU_METHOD
/begin COMPU_METHOD AppSwcIpm_CM_single_MOhm "Q = V" RAT_FUNC "%8.6" "MOhm" COEFFS 0 1 0 0 0 1 /end COMPU_METHOD
/begin COMPU_METHOD AppSwcIpm_CM_single_Nm "Q = V" RAT_FUNC "%8.6" "Nm" COEFFS 0 1 0 0 0 1 /end COMPU_METHOD
/begin COMPU_METHOD AppSwcIpm_CM_single_mps2 "Q = V" RAT_FUNC "%8.6" "mps2" COEFFS 0 1 0 0 0 1 /end COMPU_METHOD
/begin COMPU_METHOD AppSwcIpm_CM_EnumACCMode "Enumerated data type: EnumACCMode" TAB_VERB "%0.6" "" COMPU_TAB_REF VTAB_FOR_AppSwcIpm_CM_EnumACCMode /end COMPU_METHOD
/begin COMPU_VTAB VTAB_FOR_AppSwcIpm_CM_EnumACCMode "Enumerated data type: EnumACCMode" TAB_VERB 8 0 "EnumACCMode_Off" 1 "EnumACCMode_Passive" 2 "EnumACCMode_Standby" 3 "EnumACCMode_Active" 4 "EnumACCMode_StandWait" 5 "EnumACCMode_Override" 6 "EnumACCMode_StandStill" 7 "EnumACCMode_Failure" /end COMPU_VTAB
/begin COMPU_METHOD AppSwcIpm_CM_EnumAVHSt "Enumerated data type: EnumAVHSt" TAB_VERB "%0.6" "" COMPU_TAB_REF VTAB_FOR_AppSwcIpm_CM_EnumAVHSt /end COMPU_METHOD
/begin COMPU_VTAB VTAB_FOR_AppSwcIpm_CM_EnumAVHSt "Enumerated data type: EnumAVHSt" TAB_VERB 8 0 "EnumAVHSt_Off" 1 "EnumAVHSt_Ready" 2 "EnumAVHSt_Clmpng" 3 "EnumAVHSt_Clmpd" 4 "EnumAVHSt_Releasing" 5 "EnumAVHSt_Released" 6 "EnumAVHSt_Fail" 7 "EnumAVHSt_TempOff" /end COMPU_VTAB
/begin COMPU_METHOD AppSwcIpm_CM_EnumBMSACChrgSt "Enumerated data type: EnumBMSACChrgSt" TAB_VERB "%0.6" "" COMPU_TAB_REF VTAB_FOR_AppSwcIpm_CM_EnumBMSACChrgSt /end COMPU_METHOD
/begin COMPU_VTAB VTAB_FOR_AppSwcIpm_CM_EnumBMSACChrgSt "Enumerated data type: EnumBMSACChrgSt" TAB_VERB 16 0 "EnumBMSACChrgSt_ChrgOff" 1 "EnumBMSACChrgSt_ChrgInPrgs" 2 "EnumBMSACChrgSt_ChrgRdy" 3 "EnumBMSACChrgSt_ChrgFinshd" 4 "EnumBMSACChrgSt_FailrStop" 5 "EnumBMSACChrgSt_Standby" 6 "EnumBMSACChrgSt_DisChrgRdy" 7 "EnumBMSACChrgSt_DisChrging" 8 "EnumBMSACChrgSt_DisChrgFinshd" 9 "EnumBMSACChrgSt_Rsrvd1" 10 "EnumBMSACChrgSt_Rsrvd2" 11 "EnumBMSACChrgSt_Rsrvd3" 12 "EnumBMSACChrgSt_Rsrvd4" 13 "EnumBMSACChrgSt_Rsrvd5" 14 "EnumBMSACChrgSt_Rsrvd6" 15 "EnumBMSACChrgSt_Invld" /end COMPU_VTAB
/begin COMPU_METHOD AppSwcIpm_CM_EnumBMSDCSMd "Enumerated data type: EnumBMSDCSMd" TAB_VERB "%0.6" "" COMPU_TAB_REF VTAB_FOR_AppSwcIpm_CM_EnumBMSDCSMd /end COMPU_METHOD
/begin COMPU_VTAB VTAB_FOR_AppSwcIpm_CM_EnumBMSDCSMd "Enumerated data type: EnumBMSDCSMd" TAB_VERB 8 0 "EnumBMSDCSMd_OFF" 1 "EnumBMSDCSMd_Standby" 2 "EnumBMSDCSMd_Connectng2Chrg" 3 "EnumBMSDCSMd_Connected2Chrg" 4 "EnumBMSDCSMd_ConnectChrgFail" 5 "EnumBMSDCSMd_ChrgnginPrgs" 6 "EnumBMSDCSMd_ChrgngFinshd" 7 "EnumBMSDCSMd_EmgcySdn" /end COMPU_VTAB
/begin COMPU_METHOD AppSwcIpm_CM_EnumBMSRunSt "Enumerated data type: EnumBMSRunSt" TAB_VERB "%0.6" "" COMPU_TAB_REF VTAB_FOR_AppSwcIpm_CM_EnumBMSRunSt /end COMPU_METHOD
/begin COMPU_VTAB VTAB_FOR_AppSwcIpm_CM_EnumBMSRunSt "Enumerated data type: EnumBMSRunSt" TAB_VERB 8 0 "EnumBMSRunSt_Invld" 1 "EnumBMSRunSt_OFF" 2 "EnumBMSRunSt_PwrHld" 3 "EnumBMSRunSt_Norm" 4 "EnumBMSRunSt_Standby" 5 "EnumBMSRunSt_ChrgHeating" 6 "EnumBMSRunSt_Rsrvd2" 7 "EnumBMSRunSt_Rsrvd3" /end COMPU_VTAB
/begin COMPU_METHOD AppSwcIpm_CM_EnumEPBState "Enumerated data type: EnumEPBState" TAB_VERB "%0.6" "" COMPU_TAB_REF VTAB_FOR_AppSwcIpm_CM_EnumEPBState /end COMPU_METHOD
/begin COMPU_VTAB VTAB_FOR_AppSwcIpm_CM_EnumEPBState "Enumerated data type: EnumEPBState" TAB_VERB 7 0 "EnumEPBState_Releasing" 1 "EnumEPBState_Applied" 2 "EnumEPBState_Released" 3 "EnumEPBState_Applying" 4 "EnumEPBState_CmpltReleased" 5 "EnumEPBState_Unknown" 6 "EnumEPBState_Hold" /end COMPU_VTAB
/begin COMPU_METHOD AppSwcIpm_CM_EnumEPBSwSt "Enumerated data type: EnumEPBSwSt" TAB_VERB "%0.6" "" COMPU_TAB_REF VTAB_FOR_AppSwcIpm_CM_EnumEPBSwSt /end COMPU_METHOD
/begin COMPU_VTAB VTAB_FOR_AppSwcIpm_CM_EnumEPBSwSt "Enumerated data type: EnumEPBSwSt" TAB_VERB 4 0 "EnumEPBSwSt_Neutral" 1 "EnumEPBSwSt_Release" 2 "EnumEPBSwSt_Apply" 3 "EnumEPBSwSt_Invalid" /end COMPU_VTAB
/begin COMPU_METHOD AppSwcIpm_CM_EnumEPBSysSt "Enumerated data type: EnumEPBSysSt" TAB_VERB "%0.6" "" COMPU_TAB_REF VTAB_FOR_AppSwcIpm_CM_EnumEPBSysSt /end COMPU_METHOD
/begin COMPU_VTAB VTAB_FOR_AppSwcIpm_CM_EnumEPBSysSt "Enumerated data type: EnumEPBSysSt" TAB_VERB 13 0 "EnumEPBSysSt_NotInit" 1 "EnumEPBSysSt_Released" 2 "EnumEPBSysSt_Applied" 3 "EnumEPBSysSt_Applying" 4 "EnumEPBSysSt_Releasing" 5 "EnumEPBSysSt_Unknown" 6 "EnumEPBSysSt_TrctnReld" 7 "EnumEPBSysSt_ReprRelng" 8 "EnumEPBSysSt_ReprReld" 9 "EnumEPBSysSt_DrumClmpng" 10 "EnumEPBSysSt_DrumClmpd" 11 "EnumEPBSysSt_ReqBrk" 12 "EnumEPBSysSt_DynBrk" /end COMPU_VTAB
/begin COMPU_METHOD AppSwcIpm_CM_EnumGrShftLvrPstnReq "Enumerated data type: EnumGrShftLvrPstnReq" TAB_VERB "%0.6" "" COMPU_TAB_REF VTAB_FOR_AppSwcIpm_CM_EnumGrShftLvrPstnReq /end COMPU_METHOD
/begin COMPU_VTAB VTAB_FOR_AppSwcIpm_CM_EnumGrShftLvrPstnReq "Enumerated data type: EnumGrShftLvrPstnReq" TAB_VERB 6 0 "EnumGrShftLvrPstnReq_Invalid" 1 "EnumGrShftLvrPstnReq_DfltPstn" 2 "EnumGrShftLvrPstnReq_F1" 3 "EnumGrShftLvrPstnReq_F2" 4 "EnumGrShftLvrPstnReq_R1" 5 "EnumGrShftLvrPstnReq_R2" /end COMPU_VTAB
/begin COMPU_METHOD AppSwcIpm_CM_boolean_flg "Q = V" RAT_FUNC "%1.0" "flg" COEFFS 0 1 0 0 0 1 /end COMPU_METHOD
/begin COMPU_METHOD AppSwcIpm_CM_uint8_enum "Q = V" RAT_FUNC "%3.0" "enum" COEFFS 0 1 0 0 0 1 /end COMPU_METHOD
/begin COMPU_METHOD AppSwcIpm_CM_uint8 "Q = V" RAT_FUNC "%3.0" "" COEFFS 0 1 0 0 0 1 /end COMPU_METHOD
/begin GROUP S228_Subsys_VIPM_INV2InpVolt_V "AppSwcIpm/Ipm10ms/EPTCAN_IN_10ms/Msg_INV_2_Value_EPT/Subsys_VIPM_INV2InpVolt_V"
 /begin REF_CHARACTERISTIC KIPM_INV2InpVoltDflt_V KIPM_INV2InpVoltHi_V KIPM_INV2InpVoltLo_V KIPM_INV2InpVolt_V_ovrdflg KIPM_INV2InpVolt_V_ovrdval /end REF_CHARACTERISTIC
 /begin REF_MEASUREMENT VIPM_INV2InpVoltVld_flg VIPM_INV2InpVolt_V /end REF_MEASUREMENT
/end GROUP
/begin GROUP S228_Subsys_VIPM_INV2MotorMaxTemp_C "AppSwcIpm/Ipm10ms/EPTCAN_IN_10ms/Msg_INV_2_Value_EPT/Subsys_VIPM_INV2MotorMaxTemp_C"
 /begin REF_CHARACTERISTIC KIPM_INV2MotorMaxTempDflt_C KIPM_INV2MotorMaxTempHi_C KIPM_INV2MotorMaxTempLo_C KIPM_INV2MotorMaxTemp_C_ovrdflg KIPM_INV2MotorMaxTemp_C_ovrdval /end REF_CHARACTERISTIC
 /begin REF_MEASUREMENT VIPM_INV2MotorMaxTempVld_flg VIPM_INV2MotorMaxTemp_C /end REF_MEASUREMENT
/end GROUP
/begin GROUP S229_Subsys_VIPM_INV3DrvTqAllwdMax_Nm "AppSwcIpm/Ipm10ms/EPTCAN_IN_10ms/Msg_INV_3_Value_EPT/Subsys_VIPM_INV3DrvTqAllwdMax_Nm"
 /begin REF_CHARACTERISTIC KIPM_INV3DrvTqAllwdMaxDflt_Nm KIPM_INV3DrvTqAllwdMaxHi_Nm KIPM_INV3DrvTqAllwdMaxLo_Nm KIPM_INV3DrvTqAllwdMax_Nm_ovrdflg KIPM_INV3DrvTqAllwdMax_Nm_ovrdval /end REF_CHARACTERISTIC
 /begin REF_MEASUREMENT VIPM_INV3DrvTqAllwdMaxVld_flg VIPM_INV3DrvTqAllwdMax_Nm /end REF_MEASUREMENT
/end GROUP
/begin GROUP S229_Subsys_VIPM_INV3RecupTqAllwdMax_Nm "AppSwcIpm/Ipm10ms/EPTCAN_IN_10ms/Msg_INV_3_Value_EPT/Subsys_VIPM_INV3RecupTqAllwdMax_Nm"
 /begin REF_CHARACTERISTIC KIPM_INV3RecupTqAllwdMaxDflt_Nm KIPM_INV3RecupTqAllwdMaxHi_Nm KIPM_INV3RecupTqAllwdMaxLo_Nm KIPM_INV3RecupTqAllwdMax_Nm_ovrdflg KIPM_INV3RecupTqAllwdMax_Nm_ovrdval /end REF_CHARACTERISTIC
 /begin REF_MEASUREMENT VIPM_INV3RecupTqAllwdMaxVld_flg VIPM_INV3RecupTqAllwdMax_Nm /end REF_MEASUREMENT
/end GROUP
/begin GROUP S230_Subsys_VIPM_INV4FltLvl_enum "AppSwcIpm/Ipm10ms/EPTCAN_IN_10ms/Msg_INV_4_Value_EPT/Subsys_VIPM_INV4FltLvl_enum"
 /begin REF_CHARACTERISTIC KIPM_INV4FltLvlDflt_enum KIPM_INV4FltLvl_enum_ovrdflg KIPM_INV4FltLvl_enum_ovrdval /end REF_CHARACTERISTIC
 /begin REF_MEASUREMENT VIPM_INV4FltLvlVld_flg VIPM_INV4FltLvl_enum /end REF_MEASUREMENT
/end GROUP
/begin GROUP S255_Subsys_VIPM_SCSGrShftLvrPstnReq_enum "AppSwcIpm/Ipm20ms/BodCAN_IN_20ms/Msg_SCS_RiSwitchSts_BOD/Subsys_VIPM_SCSGrShftLvrPstnReq_enum"
 /begin REF_CHARACTERISTIC KIPM_SCSGrShftLvrPstnReqDflt_enum KIPM_SCSGrShftLvrPstnReq_enum_ovrdflg KIPM_SCSGrShftLvrPstnReq_enum_ovrdval /end REF_CHARACTERISTIC
 /begin REF_MEASUREMENT VIPM_SCSGrShftLvrPstnReqVld_flg VIPM_SCSGrShftLvrPstnReq_enum /end REF_MEASUREMENT
/end GROUP
/begin GROUP S255_Subsys_VIPM_SCSRght11Sw_flg "AppSwcIpm/Ipm20ms/BodCAN_IN_20ms/Msg_SCS_RiSwitchSts_BOD/Subsys_VIPM_SCSRght11Sw_flg"
 /begin REF_CHARACTERISTIC KIPM_SCSRght11SwDflt_flg KIPM_SCSRght11Sw_flg_ovrdflg KIPM_SCSRght11Sw_flg_ovrdval /end REF_CHARACTERISTIC
 /begin REF_MEASUREMENT VIPM_SCSRght11SwVld_flg VIPM_SCSRght11Sw_flg /end REF_MEASUREMENT
/end GROUP
/begin GROUP S255_Subsys_VIPM_SCSRght12Sw_flg "AppSwcIpm/Ipm20ms/BodCAN_IN_20ms/Msg_SCS_RiSwitchSts_BOD/Subsys_VIPM_SCSRght12Sw_flg"
 /begin REF_CHARACTERISTIC KIPM_SCSRght12SwDflt_flg KIPM_SCSRght12Sw_flg_ovrdflg KIPM_SCSRght12Sw_flg_ovrdval /end REF_CHARACTERISTIC
 /begin REF_MEASUREMENT VIPM_SCSRght12SwVld_flg VIPM_SCSRght12Sw_flg /end REF_MEASUREMENT
/end GROUP
/begin GROUP S255_Subsys_VIPM_SCSRght13Sw_flg "AppSwcIpm/Ipm20ms/BodCAN_IN_20ms/Msg_SCS_RiSwitchSts_BOD/Subsys_VIPM_SCSRght13Sw_flg"
 /begin REF_CHARACTERISTIC KIPM_SCSRght13SwDflt_flg KIPM_SCSRght13Sw_flg_ovrdflg KIPM_SCSRght13Sw_flg_ovrdval /end REF_CHARACTERISTIC
 /begin REF_MEASUREMENT VIPM_SCSRght13SwVld_flg VIPM_SCSRght13Sw_flg /end REF_MEASUREMENT
/end GROUP
/begin GROUP S255_Subsys_VIPM_SCSRghtSwVldty_flg "AppSwcIpm/Ipm20ms/BodCAN_IN_20ms/Msg_SCS_RiSwitchSts_BOD/Subsys_VIPM_SCSRghtSwVldty_flg"
 /begin REF_CHARACTERISTIC KIPM_SCSRghtSwVldtyDflt_flg KIPM_SCSRghtSwVldty_flg_ovrdflg KIPM_SCSRghtSwVldty_flg_ovrdval /end REF_CHARACTERISTIC
 /begin REF_MEASUREMENT VIPM_SCSRghtSwVldtyVld_flg VIPM_SCSRghtSwVldty_flg /end REF_MEASUREMENT
/end GROUP
/begin GROUP S261_Subsys_VIPM_CRRRBSDWarnLt_enum "AppSwcIpm/Ipm20ms/ChaCAN_IN_20ms/Msg_CRRR_A_CHA/Subsys_VIPM_CRRRBSDWarnLt_enum"
 /begin REF_CHARACTERISTIC KIPM_CRRRBSDWarnLtDflt_enum KIPM_CRRRBSDWarnLt_enum_ovrdflg KIPM_CRRRBSDWarnLt_enum_ovrdval /end REF_CHARACTERISTIC
 /begin REF_MEASUREMENT VIPM_CRRRBSDWarnLtVld_flg VIPM_CRRRBSDWarnLt_enum /end REF_MEASUREMENT
/end GROUP
/begin GROUP S261_Subsys_VIPM_CRRRBSDWarnRt_enum "AppSwcIpm/Ipm20ms/ChaCAN_IN_20ms/Msg_CRRR_A_CHA/Subsys_VIPM_CRRRBSDWarnRt_enum"
 /begin REF_CHARACTERISTIC KIPM_CRRRBSDWarnRtDflt_enum KIPM_CRRRBSDWarnRt_enum_ovrdflg KIPM_CRRRBSDWarnRt_enum_ovrdval /end REF_CHARACTERISTIC
 /begin REF_MEASUREMENT VIPM_CRRRBSDWarnRtVld_flg VIPM_CRRRBSDWarnRt_enum /end REF_MEASUREMENT
/end GROUP
/begin GROUP S261_Subsys_VIPM_CRRRDOWWarnLt_enum "AppSwcIpm/Ipm20ms/ChaCAN_IN_20ms/Msg_CRRR_A_CHA/Subsys_VIPM_CRRRDOWWarnLt_enum"
 /begin REF_CHARACTERISTIC KIPM_CRRRDOWWarnLtDflt_enum KIPM_CRRRDOWWarnLt_enum_ovrdflg KIPM_CRRRDOWWarnLt_enum_ovrdval /end REF_CHARACTERISTIC
 /begin REF_MEASUREMENT VIPM_CRRRDOWWarnLtVld_flg VIPM_CRRRDOWWarnLt_enum /end REF_MEASUREMENT
/end GROUP
/begin GROUP S261_Subsys_VIPM_CRRRDOWWarnRt_enum "AppSwcIpm/Ipm20ms/ChaCAN_IN_20ms/Msg_CRRR_A_CHA/Subsys_VIPM_CRRRDOWWarnRt_enum"
 /begin REF_CHARACTERISTIC KIPM_CRRRDOWWarnRtDflt_enum KIPM_CRRRDOWWarnRt_enum_ovrdflg KIPM_CRRRDOWWarnRt_enum_ovrdval /end REF_CHARACTERISTIC
 /begin REF_MEASUREMENT VIPM_CRRRDOWWarnRtVld_flg VIPM_CRRRDOWWarnRt_enum /end REF_MEASUREMENT
/end GROUP
/begin GROUP S261_Subsys_VIPM_CRRRRCTAWarnLt_enum "AppSwcIpm/Ipm20ms/ChaCAN_IN_20ms/Msg_CRRR_A_CHA/Subsys_VIPM_CRRRRCTAWarnLt_enum"
 /begin REF_CHARACTERISTIC KIPM_CRRRRCTAWarnLtDflt_enum KIPM_CRRRRCTAWarnLt_enum_ovrdflg KIPM_CRRRRCTAWarnLt_enum_ovrdval /end REF_CHARACTERISTIC
 /begin REF_MEASUREMENT VIPM_CRRRRCTAWarnLtVld_flg VIPM_CRRRRCTAWarnLt_enum /end REF_MEASUREMENT
/end GROUP
/begin GROUP S261_Subsys_VIPM_CRRRRCTAWarnRt_enum "AppSwcIpm/Ipm20ms/ChaCAN_IN_20ms/Msg_CRRR_A_CHA/Subsys_VIPM_CRRRRCTAWarnRt_enum"
 /begin REF_CHARACTERISTIC KIPM_CRRRRCTAWarnRtDflt_enum KIPM_CRRRRCTAWarnRt_enum_ovrdflg KIPM_CRRRRCTAWarnRt_enum_ovrdval /end REF_CHARACTERISTIC
 /begin REF_MEASUREMENT VIPM_CRRRRCTAWarnRtVld_flg VIPM_CRRRRCTAWarnRt_enum /end REF_MEASUREMENT
/end GROUP
/begin GROUP S262_Subsys_VIPM_EHBAVHAppldSt_enum "AppSwcIpm/Ipm20ms/ChaCAN_IN_20ms/Msg_EHB_A_CHA/Subsys_VIPM_EHBAVHAppldSt_enum"
 /begin REF_CHARACTERISTIC KIPM_EHBAVHAppldStDflt_enum KIPM_EHBAVHAppldSt_enum_ovrdflg KIPM_EHBAVHAppldSt_enum_ovrdval /end REF_CHARACTERISTIC
 /begin REF_MEASUREMENT VIPM_EHBAVHAppldStVld_flg VIPM_EHBAVHAppldSt_enum /end REF_MEASUREMENT
/end GROUP
/begin GROUP S262_Subsys_VIPM_EHBBLA_flg "AppSwcIpm/Ipm20ms/ChaCAN_IN_20ms/Msg_EHB_A_CHA/Subsys_VIPM_EHBBLA_flg"
 /begin REF_CHARACTERISTIC KIPM_EHBBLADflt_flg KIPM_EHBBLA_flg_ovrdflg KIPM_EHBBLA_flg_ovrdval /end REF_CHARACTERISTIC
 /begin REF_MEASUREMENT VIPM_EHBBLAVld_flg VIPM_EHBBLA_flg /end REF_MEASUREMENT
/end GROUP
/begin GROUP S262_Subsys_VIPM_EHBEPBActuatorStL_enum "AppSwcIpm/Ipm20ms/ChaCAN_IN_20ms/Msg_EHB_A_CHA/Subsys_VIPM_EHBEPBActuatorStL_enum"
 /begin REF_CHARACTERISTIC KIPM_EHBEPBActuatorStLDflt_enum KIPM_EHBEPBActuatorStL_enum_ovrdflg KIPM_EHBEPBActuatorStL_enum_ovrdval /end REF_CHARACTERISTIC
 /begin REF_MEASUREMENT VIPM_EHBEPBActuatorStLVld_flg VIPM_EHBEPBActuatorStL_enum /end REF_MEASUREMENT
/end GROUP
/begin GROUP S262_Subsys_VIPM_EHBEPBSwitchSts_enum "AppSwcIpm/Ipm20ms/ChaCAN_IN_20ms/Msg_EHB_A_CHA/Subsys_VIPM_EHBEPBSwitchSts_enum"
 /begin REF_CHARACTERISTIC KIPM_EHBEPBSwitchStsDflt_enum KIPM_EHBEPBSwitchSts_enum_ovrdflg KIPM_EHBEPBSwitchSts_enum_ovrdval /end REF_CHARACTERISTIC
 /begin REF_MEASUREMENT VIPM_EHBEPBSwitchStsVld_flg VIPM_EHBEPBSwitchSts_enum /end REF_MEASUREMENT
/end GROUP
/begin GROUP S262_Subsys_VIPM_EHBEPBSysSt_enum "AppSwcIpm/Ipm20ms/ChaCAN_IN_20ms/Msg_EHB_A_CHA/Subsys_VIPM_EHBEPBSysSt_enum"
 /begin REF_CHARACTERISTIC KIPM_EHBEPBSysStDflt_enum KIPM_EHBEPBSysSt_enum_ovrdflg KIPM_EHBEPBSysSt_enum_ovrdval /end REF_CHARACTERISTIC
 /begin REF_MEASUREMENT VIPM_EHBEPBSysStVld_flg VIPM_EHBEPBSysSt_enum /end REF_MEASUREMENT
/end GROUP
/begin GROUP S262_Subsys_VIPM_EHBHDCFucFault_flg "AppSwcIpm/Ipm20ms/ChaCAN_IN_20ms/Msg_EHB_A_CHA/Subsys_VIPM_EHBHDCFucFault_flg"
 /begin REF_CHARACTERISTIC KIPM_EHBHDCFucFaultDflt_flg KIPM_EHBHDCFucFault_flg_ovrdflg KIPM_EHBHDCFucFault_flg_ovrdval /end REF_CHARACTERISTIC
 /begin REF_MEASUREMENT VIPM_EHBHDCFucFaultVld_flg VIPM_EHBHDCFucFault_flg /end REF_MEASUREMENT
/end GROUP
/begin GROUP S263_Subsys_VIPM_FCMACCSdnMode_enum "AppSwcIpm/Ipm20ms/ChaCAN_IN_20ms/Msg_FCM_B_CHA/Subsys_VIPM_FCMACCSdnMode_enum"
 /begin REF_CHARACTERISTIC KIPM_FCMACCSdnModeDflt_enum KIPM_FCMACCSdnMode_enum_ovrdflg KIPM_FCMACCSdnMode_enum_ovrdval /end REF_CHARACTERISTIC
 /begin REF_MEASUREMENT VIPM_FCMACCSdnModeVld_flg VIPM_FCMACCSdnMode_enum /end REF_MEASUREMENT
/end GROUP
/begin GROUP S263_Subsys_VIPM_FCMACCWhlDece_mps2 "AppSwcIpm/Ipm20ms/ChaCAN_IN_20ms/Msg_FCM_B_CHA/Subsys_VIPM_FCMACCWhlDece_mps2"
 /begin REF_CHARACTERISTIC KIPM_FCMACCWhlDeceDflt_mps2 KIPM_FCMACCWhlDeceHi_mps2 KIPM_FCMACCWhlDeceLo_mps2 KIPM_FCMACCWhlDece_mps2_ovrdflg KIPM_FCMACCWhlDece_mps2_ovrdval /end REF_CHARACTERISTIC
 /begin REF_MEASUREMENT VIPM_FCMACCWhlDeceVld_flg VIPM_FCMACCWhlDece_mps2 /end REF_MEASUREMENT
/end GROUP
/begin GROUP S263_Subsys_VIPM_FCMACCWhlTqReqActv_flg "AppSwcIpm/Ipm20ms/ChaCAN_IN_20ms/Msg_FCM_B_CHA/Subsys_VIPM_FCMACCWhlTqReqActv_flg"
 /begin REF_CHARACTERISTIC KIPM_FCMACCWhlTqReqActvDflt_flg KIPM_FCMACCWhlTqReqActv_flg_ovrdflg KIPM_FCMACCWhlTqReqActv_flg_ovrdval /end REF_CHARACTERISTIC
 /begin REF_MEASUREMENT VIPM_FCMACCWhlTqReqActvVld_flg VIPM_FCMACCWhlTqReqActv_flg /end REF_MEASUREMENT
/end GROUP
/begin GROUP S263_Subsys_VIPM_FCMACCWhlTqReqVal_Nm "AppSwcIpm/Ipm20ms/ChaCAN_IN_20ms/Msg_FCM_B_CHA/Subsys_VIPM_FCMACCWhlTqReqVal_Nm"
 /begin REF_CHARACTERISTIC KIPM_FCMACCWhlTqReqValDflt_Nm KIPM_FCMACCWhlTqReqValHi_Nm KIPM_FCMACCWhlTqReqValLo_Nm KIPM_FCMACCWhlTqReqVal_Nm_ovrdflg KIPM_FCMACCWhlTqReqVal_Nm_ovrdval /end REF_CHARACTERISTIC
 /begin REF_MEASUREMENT VIPM_FCMACCWhlTqReqValVld_flg VIPM_FCMACCWhlTqReqVal_Nm /end REF_MEASUREMENT
/end GROUP
/begin GROUP S263_Subsys_VIPM_FCMAEBReq_flg "AppSwcIpm/Ipm20ms/ChaCAN_IN_20ms/Msg_FCM_B_CHA/Subsys_VIPM_FCMAEBReq_flg"
 /begin REF_CHARACTERISTIC KIPM_FCMAEBReqDflt_flg KIPM_FCMAEBReq_flg_ovrdflg KIPM_FCMAEBReq_flg_ovrdval /end REF_CHARACTERISTIC
 /begin REF_MEASUREMENT VIPM_FCMAEBReqVld_flg VIPM_FCMAEBReq_flg /end REF_MEASUREMENT
/end GROUP
/begin GROUP S263_Subsys_VIPM_FCMAccMode_enum "AppSwcIpm/Ipm20ms/ChaCAN_IN_20ms/Msg_FCM_B_CHA/Subsys_VIPM_FCMAccMode_enum"
 /begin REF_CHARACTERISTIC KIPM_FCMAccModeDflt_enum KIPM_FCMAccMode_enum_ovrdflg KIPM_FCMAccMode_enum_ovrdval /end REF_CHARACTERISTIC
 /begin REF_MEASUREMENT VIPM_FCMAccModeVld_flg VIPM_FCMAccMode_enum /end REF_MEASUREMENT
/end GROUP
/begin GROUP S263_Subsys_VIPM_FCMAccReqDriveOff_flg "AppSwcIpm/Ipm20ms/ChaCAN_IN_20ms/Msg_FCM_B_CHA/Subsys_VIPM_FCMAccReqDriveOff_flg"
 /begin REF_CHARACTERISTIC KIPM_FCMAccReqDriveOffDflt_flg KIPM_FCMAccReqDriveOff_flg_ovrdflg KIPM_FCMAccReqDriveOff_flg_ovrdval /end REF_CHARACTERISTIC
 /begin REF_MEASUREMENT VIPM_FCMAccReqDriveOffVld_flg VIPM_FCMAccReqDriveOff_flg /end REF_MEASUREMENT
/end GROUP
/begin GROUP S263_Subsys_VIPM_FCMAccReqStandstill_flg "AppSwcIpm/Ipm20ms/ChaCAN_IN_20ms/Msg_FCM_B_CHA/Subsys_VIPM_FCMAccReqStandstill_flg"
 /begin REF_CHARACTERISTIC KIPM_FCMAccReqStandstillDflt_flg KIPM_FCMAccReqStandstill_flg_ovrdflg KIPM_FCMAccReqStandstill_flg_ovrdval /end REF_CHARACTERISTIC
 /begin REF_MEASUREMENT VIPM_FCMAccReqStandstillVld_flg VIPM_FCMAccReqStandstill_flg /end REF_MEASUREMENT
/end GROUP
/begin GROUP S263_Subsys_VIPM_FCMAccTarAccrnReqActv_flg "AppSwcIpm/Ipm20ms/ChaCAN_IN_20ms/Msg_FCM_B_CHA/Subsys_VIPM_FCMAccTarAccrnReqActv_flg"
 /begin REF_CHARACTERISTIC KIPM_FCMAccTarAccrnReqActvDflt_flg KIPM_FCMAccTarAccrnReqActv_flg_ovrdflg KIPM_FCMAccTarAccrnReqActv_flg_ovrdval /end REF_CHARACTERISTIC
 /begin REF_MEASUREMENT VIPM_FCMAccTarAccrnReqActvVld_flg VIPM_FCMAccTarAccrnReqActv_flg /end REF_MEASUREMENT
/end GROUP
/begin GROUP S263_Subsys_VIPM_FCMAccTarAccrn_mps2 "AppSwcIpm/Ipm20ms/ChaCAN_IN_20ms/Msg_FCM_B_CHA/Subsys_VIPM_FCMAccTarAccrn_mps2"
 /begin REF_CHARACTERISTIC KIPM_FCMAccTarAccrnDflt_mps2 KIPM_FCMAccTarAccrnHi_mps2 KIPM_FCMAccTarAccrnLo_mps2 KIPM_FCMAccTarAccrn_mps2_ovrdflg KIPM_FCMAccTarAccrn_mps2_ovrdval /end REF_CHARACTERISTIC
 /begin REF_MEASUREMENT VIPM_FCMAccTarAccrnVld_flg VIPM_FCMAccTarAccrn_mps2 /end REF_MEASUREMENT
/end GROUP
/begin GROUP S263_Subsys_VIPM_FCMAccTgtAxReq_flg "AppSwcIpm/Ipm20ms/ChaCAN_IN_20ms/Msg_FCM_B_CHA/Subsys_VIPM_FCMAccTgtAxReq_flg"
 /begin REF_CHARACTERISTIC KIPM_FCMAccTgtAxReqDflt_flg KIPM_FCMAccTgtAxReq_flg_ovrdflg KIPM_FCMAccTgtAxReq_flg_ovrdval /end REF_CHARACTERISTIC
 /begin REF_MEASUREMENT VIPM_FCMAccTgtAxReqVld_flg VIPM_FCMAccTgtAxReq_flg /end REF_MEASUREMENT
/end GROUP
/begin GROUP S263_Subsys_VIPM_FCMAccTgtAx_mps2 "AppSwcIpm/Ipm20ms/ChaCAN_IN_20ms/Msg_FCM_B_CHA/Subsys_VIPM_FCMAccTgtAx_mps2"
 /begin REF_CHARACTERISTIC KIPM_FCMAccTgtAxDflt_mps2 KIPM_FCMAccTgtAxHi_mps2 KIPM_FCMAccTgtAxLo_mps2 KIPM_FCMAccTgtAx_mps2_ovrdflg KIPM_FCMAccTgtAx_mps2_ovrdval /end REF_CHARACTERISTIC
 /begin REF_MEASUREMENT VIPM_FCMAccTgtAxVld_flg VIPM_FCMAccTgtAx_mps2 /end REF_MEASUREMENT
/end GROUP
/begin GROUP S263_Subsys_VIPM_FCMEPBReq_enum "AppSwcIpm/Ipm20ms/ChaCAN_IN_20ms/Msg_FCM_B_CHA/Subsys_VIPM_FCMEPBReq_enum"
 /begin REF_CHARACTERISTIC KIPM_FCMEPBReqDflt_enum KIPM_FCMEPBReq_enum_ovrdflg KIPM_FCMEPBReq_enum_ovrdval /end REF_CHARACTERISTIC
 /begin REF_MEASUREMENT VIPM_FCMEPBReqVld_flg VIPM_FCMEPBReq_enum /end REF_MEASUREMENT
/end GROUP
/begin GROUP S263_Subsys_VIPM_FCMTrnLampReq_enum "AppSwcIpm/Ipm20ms/ChaCAN_IN_20ms/Msg_FCM_B_CHA/Subsys_VIPM_FCMTrnLampReq_enum"
 /begin REF_CHARACTERISTIC KIPM_FCMTrnLampReqDflt_enum KIPM_FCMTrnLampReq_enum_ovrdflg KIPM_FCMTrnLampReq_enum_ovrdval /end REF_CHARACTERISTIC
 /begin REF_MEASUREMENT VIPM_FCMTrnLampReqVld_flg VIPM_FCMTrnLampReq_enum /end REF_MEASUREMENT
/end GROUP
/begin GROUP S294_Subsys_VIPM_BMSDCSActOprtMode_enum "AppSwcIpm/Ipm20ms/EptCAN_IN_20ms/Msg_BMS_10_DC_ChargeStates_EPT/Subsys_VIPM_BMSDCSActOprtMode_enum"
 /begin REF_CHARACTERISTIC KIPM_BMSDCSActOprtModeDflt_enum KIPM_BMSDCSActOprtMode_enum_ovrdflg KIPM_BMSDCSActOprtMode_enum_ovrdval /end REF_CHARACTERISTIC
 /begin REF_MEASUREMENT VIPM_BMSDCSActOprtModeVld_flg VIPM_BMSDCSActOprtMode_enum /end REF_MEASUREMENT
/end GROUP
/begin GROUP S294_Subsys_VIPM_BMSDCSInletConnectSta_flg "AppSwcIpm/Ipm20ms/EptCAN_IN_20ms/Msg_BMS_10_DC_ChargeStates_EPT/Subsys_VIPM_BMSDCSInletConnectSta_flg"
 /begin REF_CHARACTERISTIC KIPM_BMSDCSInletConnectStaDflt_flg KIPM_BMSDCSInletConnectSta_flg_ovrdflg KIPM_BMSDCSInletConnectSta_flg_ovrdval /end REF_CHARACTERISTIC
 /begin REF_MEASUREMENT VIPM_BMSDCSInletConnectStaVld_flg VIPM_BMSDCSInletConnectSta_flg /end REF_MEASUREMENT
/end GROUP
/begin GROUP S295_Subsys_VIPM_BMSActExchgCurnt_A "AppSwcIpm/Ipm20ms/EptCAN_IN_20ms/Msg_BMS_1_MainState_EPT/Subsys_VIPM_BMSActExchgCurnt_A"
 /begin REF_CHARACTERISTIC KIPM_BMSActExchgCurntDflt_A KIPM_BMSActExchgCurntHi_A KIPM_BMSActExchgCurntLo_A KIPM_BMSActExchgCurnt_A_ovrdflg KIPM_BMSActExchgCurnt_A_ovrdval /end REF_CHARACTERISTIC
 /begin REF_MEASUREMENT VIPM_BMSActExchgCurntVld_flg VIPM_BMSActExchgCurnt_A /end REF_MEASUREMENT
/end GROUP
/begin GROUP S295_Subsys_VIPM_BMSChrgInterlockSta_enum "AppSwcIpm/Ipm20ms/EptCAN_IN_20ms/Msg_BMS_1_MainState_EPT/Subsys_VIPM_BMSChrgInterlockSta_enum"
 /begin REF_CHARACTERISTIC KIPM_BMSChrgInterlockStaDflt_enum KIPM_BMSChrgInterlockSta_enum_ovrdflg KIPM_BMSChrgInterlockSta_enum_ovrdval /end REF_CHARACTERISTIC
 /begin REF_MEASUREMENT VIPM_BMSChrgInterlockStaVld_flg VIPM_BMSChrgInterlockSta_enum /end REF_MEASUREMENT
/end GROUP
/begin GROUP S295_Subsys_VIPM_BMSDchrgInterlockSta_enum "AppSwcIpm/Ipm20ms/EptCAN_IN_20ms/Msg_BMS_1_MainState_EPT/Subsys_VIPM_BMSDchrgInterlockSta_enum"
 /begin REF_CHARACTERISTIC KIPM_BMSDchrgInterlockStaDflt_enum KIPM_BMSDchrgInterlockSta_enum_ovrdflg KIPM_BMSDchrgInterlockSta_enum_ovrdval /end REF_CHARACTERISTIC
 /begin REF_MEASUREMENT VIPM_BMSDchrgInterlockStaVld_flg VIPM_BMSDchrgInterlockSta_enum /end REF_MEASUREMENT
/end GROUP
/begin GROUP S295_Subsys_VIPM_BMSEmgcySdnReq_flg "AppSwcIpm/Ipm20ms/EptCAN_IN_20ms/Msg_BMS_1_MainState_EPT/Subsys_VIPM_BMSEmgcySdnReq_flg"
 /begin REF_CHARACTERISTIC KIPM_BMSEmgcySdnReqDflt_flg KIPM_BMSEmgcySdnReq_flg_ovrdflg KIPM_BMSEmgcySdnReq_flg_ovrdval /end REF_CHARACTERISTIC
 /begin REF_MEASUREMENT VIPM_BMSEmgcySdnReqVld_flg VIPM_BMSEmgcySdnReq_flg /end REF_MEASUREMENT
/end GROUP
/begin GROUP S295_Subsys_VIPM_BMSPwrTrainConnectSta_enum "AppSwcIpm/Ipm20ms/EptCAN_IN_20ms/Msg_BMS_1_MainState_EPT/Subsys_VIPM_BMSPwrTrainConnectSta_enum"
 /begin REF_CHARACTERISTIC KIPM_BMSPwrTrainConnectStaDflt_enum KIPM_BMSPwrTrainConnectSta_enum_ovrdflg KIPM_BMSPwrTrainConnectSta_enum_ovrdval /end REF_CHARACTERISTIC
 /begin REF_MEASUREMENT VIPM_BMSPwrTrainConnectStaVld_flg VIPM_BMSPwrTrainConnectSta_enum /end REF_MEASUREMENT
/end GROUP
/begin GROUP S295_Subsys_VIPM_BMSRunSta_enum "AppSwcIpm/Ipm20ms/EptCAN_IN_20ms/Msg_BMS_1_MainState_EPT/Subsys_VIPM_BMSRunSta_enum"
 /begin REF_CHARACTERISTIC KIPM_BMSRunStaDflt_enum KIPM_BMSRunSta_enum_ovrdflg KIPM_BMSRunSta_enum_ovrdval /end REF_CHARACTERISTIC
 /begin REF_MEASUREMENT VIPM_BMSRunStaVld_flg VIPM_BMSRunSta_enum /end REF_MEASUREMENT
/end GROUP
/begin GROUP S295_Subsys_VIPM_BMSSysFailSta_enum "AppSwcIpm/Ipm20ms/EptCAN_IN_20ms/Msg_BMS_1_MainState_EPT/Subsys_VIPM_BMSSysFailSta_enum"
 /begin REF_CHARACTERISTIC KIPM_BMSSysFailStaDflt_enum KIPM_BMSSysFailSta_enum_ovrdflg KIPM_BMSSysFailSta_enum_ovrdval /end REF_CHARACTERISTIC
 /begin REF_MEASUREMENT VIPM_BMSSysFailStaVld_flg VIPM_BMSSysFailSta_enum /end REF_MEASUREMENT
/end GROUP
/begin GROUP S295_Subsys_VIPM_BMSThermrunawayWrn_enum "AppSwcIpm/Ipm20ms/EptCAN_IN_20ms/Msg_BMS_1_MainState_EPT/Subsys_VIPM_BMSThermrunawayWrn_enum"
 /begin REF_CHARACTERISTIC KIPM_BMSThermrunawayWrnDflt_enum KIPM_BMSThermrunawayWrn_enum_ovrdflg KIPM_BMSThermrunawayWrn_enum_ovrdval /end REF_CHARACTERISTIC
 /begin REF_MEASUREMENT VIPM_BMSThermrunawayWrnVld_flg VIPM_BMSThermrunawayWrn_enum /end REF_MEASUREMENT
/end GROUP
/begin GROUP S296_Subsys_VIPM_BMSBatSOCAct_pct "AppSwcIpm/Ipm20ms/EptCAN_IN_20ms/Msg_BMS_2_BatState_EPT/Subsys_VIPM_BMSBatSOCAct_pct"
 /begin REF_CHARACTERISTIC KIPM_BMSBatSOCActDflt_pct KIPM_BMSBatSOCActHi_pct KIPM_BMSBatSOCActLo_pct KIPM_BMSBatSOCAct_pct_ovrdflg KIPM_BMSBatSOCAct_pct_ovrdval /end REF_CHARACTERISTIC
 /begin REF_MEASUREMENT VIPM_BMSBatSOCActVld_flg VIPM_BMSBatSOCAct_pct /end REF_MEASUREMENT
/end GROUP
/begin GROUP S296_Subsys_VIPM_BMSBatSOCRpt_pct "AppSwcIpm/Ipm20ms/EptCAN_IN_20ms/Msg_BMS_2_BatState_EPT/Subsys_VIPM_BMSBatSOCRpt_pct"
 /begin REF_CHARACTERISTIC KIPM_BMSBatSOCRptDflt_pct KIPM_BMSBatSOCRptHi_pct KIPM_BMSBatSOCRptLo_pct KIPM_BMSBatSOCRpt_pct_ovrdflg KIPM_BMSBatSOCRpt_pct_ovrdval /end REF_CHARACTERISTIC
 /begin REF_MEASUREMENT VIPM_BMSBatSOCRptVld_flg VIPM_BMSBatSOCRpt_pct /end REF_MEASUREMENT
/end GROUP
/begin GROUP S296_Subsys_VIPM_BMSBatSOH_pct "AppSwcIpm/Ipm20ms/EptCAN_IN_20ms/Msg_BMS_2_BatState_EPT/Subsys_VIPM_BMSBatSOH_pct"
 /begin REF_CHARACTERISTIC KIPM_BMSBatSOHDflt_pct KIPM_BMSBatSOHHi_pct KIPM_BMSBatSOHLo_pct KIPM_BMSBatSOH_pct_ovrdflg KIPM_BMSBatSOH_pct_ovrdval /end REF_CHARACTERISTIC
 /begin REF_MEASUREMENT VIPM_BMSBatSOHVld_flg VIPM_BMSBatSOH_pct /end REF_MEASUREMENT
/end GROUP
/begin GROUP S296_Subsys_VIPM_BMSHVBatActVolt_V "AppSwcIpm/Ipm20ms/EptCAN_IN_20ms/Msg_BMS_2_BatState_EPT/Subsys_VIPM_BMSHVBatActVolt_V"
 /begin REF_CHARACTERISTIC KIPM_BMSHVBatActVoltDflt_V KIPM_BMSHVBatActVoltHi_V KIPM_BMSHVBatActVoltLo_V KIPM_BMSHVBatActVolt_V_ovrdflg KIPM_BMSHVBatActVolt_V_ovrdval /end REF_CHARACTERISTIC
 /begin REF_MEASUREMENT VIPM_BMSHVBatActVoltVld_flg VIPM_BMSHVBatActVolt_V /end REF_MEASUREMENT
/end GROUP
/begin GROUP S297_Subsys_VIPM_BMSDCSChrgReq_flg "AppSwcIpm/Ipm20ms/EptCAN_IN_20ms/Msg_BMS_3_DC_ChargeState_EPT/Subsys_VIPM_BMSDCSChrgReq_flg"
 /begin REF_CHARACTERISTIC KIPM_BMSDCSChrgReqDflt_flg KIPM_BMSDCSChrgReq_flg_ovrdflg KIPM_BMSDCSChrgReq_flg_ovrdval /end REF_CHARACTERISTIC
 /begin REF_MEASUREMENT VIPM_BMSDCSChrgReqVld_flg VIPM_BMSDCSChrgReq_flg /end REF_MEASUREMENT
/end GROUP
/begin GROUP S298_Subsys_VIPM_BMSACChrgAtclSta_enum "AppSwcIpm/Ipm20ms/EptCAN_IN_20ms/Msg_BMS_4_AC_ChargeState_EPT/Subsys_VIPM_BMSACChrgAtclSta_enum"
 /begin REF_CHARACTERISTIC KIPM_BMSACChrgAtclStaDflt_enum KIPM_BMSACChrgAtclSta_enum_ovrdflg KIPM_BMSACChrgAtclSta_enum_ovrdval /end REF_CHARACTERISTIC
 /begin REF_MEASUREMENT VIPM_BMSACChrgAtclStaVld_flg VIPM_BMSACChrgAtclSta_enum /end REF_MEASUREMENT
/end GROUP
/begin GROUP S298_Subsys_VIPM_BMSInletCooltActlTemp_C "AppSwcIpm/Ipm20ms/EptCAN_IN_20ms/Msg_BMS_4_AC_ChargeState_EPT/Subsys_VIPM_BMSInletCooltActlTemp_C"
 /begin REF_CHARACTERISTIC KIPM_BMSInletCooltActlTempDflt_C KIPM_BMSInletCooltActlTempHi_C KIPM_BMSInletCooltActlTempLo_C KIPM_BMSInletCooltActlTemp_C_ovrdflg KIPM_BMSInletCooltActlTemp_C_ovrdval /end REF_CHARACTERISTIC
 /begin REF_MEASUREMENT VIPM_BMSInletCooltActlTempVld_flg VIPM_BMSInletCooltActlTemp_C /end REF_MEASUREMENT
/end GROUP
/begin GROUP S298_Subsys_VIPM_BMSIsoResist_MOhm "AppSwcIpm/Ipm20ms/EptCAN_IN_20ms/Msg_BMS_4_AC_ChargeState_EPT/Subsys_VIPM_BMSIsoResist_MOhm"
 /begin REF_CHARACTERISTIC KIPM_BMSIsoResistDflt_MOhm KIPM_BMSIsoResistHi_MOhm KIPM_BMSIsoResistLo_MOhm KIPM_BMSIsoResist_MOhm_ovrdflg KIPM_BMSIsoResist_MOhm_ovrdval /end REF_CHARACTERISTIC
 /begin REF_MEASUREMENT VIPM_BMSIsoResistVld_flg VIPM_BMSIsoResist_MOhm /end REF_MEASUREMENT
/end GROUP
/begin GROUP S298_Subsys_VIPM_BMSMaxChrgCurntAC_A "AppSwcIpm/Ipm20ms/EptCAN_IN_20ms/Msg_BMS_4_AC_ChargeState_EPT/Subsys_VIPM_BMSMaxChrgCurntAC_A"
 /begin REF_CHARACTERISTIC KIPM_BMSMaxChrgCurntACDflt_A KIPM_BMSMaxChrgCurntACHi_A KIPM_BMSMaxChrgCurntACLo_A KIPM_BMSMaxChrgCurntAC_A_ovrdflg KIPM_BMSMaxChrgCurntAC_A_ovrdval /end REF_CHARACTERISTIC
 /begin REF_MEASUREMENT VIPM_BMSMaxChrgCurntACVld_flg VIPM_BMSMaxChrgCurntAC_A /end REF_MEASUREMENT
/end GROUP
/begin GROUP S298_Subsys_VIPM_BMSMaxChrgVoltAC_V "AppSwcIpm/Ipm20ms/EptCAN_IN_20ms/Msg_BMS_4_AC_ChargeState_EPT/Subsys_VIPM_BMSMaxChrgVoltAC_V"
 /begin REF_CHARACTERISTIC KIPM_BMSMaxChrgVoltACDflt_V KIPM_BMSMaxChrgVoltACHi_V KIPM_BMSMaxChrgVoltACLo_V KIPM_BMSMaxChrgVoltAC_V_ovrdflg KIPM_BMSMaxChrgVoltAC_V_ovrdval /end REF_CHARACTERISTIC
 /begin REF_MEASUREMENT VIPM_BMSMaxChrgVoltACVld_flg VIPM_BMSMaxChrgVoltAC_V /end REF_MEASUREMENT
/end GROUP
/begin GROUP S298_Subsys_VIPM_BMSOutlCooltActlTemp_C "AppSwcIpm/Ipm20ms/EptCAN_IN_20ms/Msg_BMS_4_AC_ChargeState_EPT/Subsys_VIPM_BMSOutlCooltActlTemp_C"
 /begin REF_CHARACTERISTIC KIPM_BMSOutlCooltActlTempDflt_C KIPM_BMSOutlCooltActlTempHi_C KIPM_BMSOutlCooltActlTempLo_C KIPM_BMSOutlCooltActlTemp_C_ovrdflg KIPM_BMSOutlCooltActlTemp_C_ovrdval /end REF_CHARACTERISTIC
 /begin REF_MEASUREMENT VIPM_BMSOutlCooltActlTempVld_flg VIPM_BMSOutlCooltActlTemp_C /end REF_MEASUREMENT
/end GROUP
/begin GROUP S299_Subsys_VIPM_BMSMaxConChrgCurnt_A "AppSwcIpm/Ipm20ms/EptCAN_IN_20ms/Msg_BMS_6_DischrgRecup_EPT/Subsys_VIPM_BMSMaxConChrgCurnt_A"
 /begin REF_CHARACTERISTIC KIPM_BMSMaxConChrgCurntDflt_A KIPM_BMSMaxConChrgCurntHi_A KIPM_BMSMaxConChrgCurntLo_A KIPM_BMSMaxConChrgCurnt_A_ovrdflg KIPM_BMSMaxConChrgCurnt_A_ovrdval /end REF_CHARACTERISTIC
 /begin REF_MEASUREMENT VIPM_BMSMaxConChrgCurntVld_flg VIPM_BMSMaxConChrgCurnt_A /end REF_MEASUREMENT
/end GROUP
/begin GROUP S299_Subsys_VIPM_BMSMaxConDisCurnt_A "AppSwcIpm/Ipm20ms/EptCAN_IN_20ms/Msg_BMS_6_DischrgRecup_EPT/Subsys_VIPM_BMSMaxConDisCurnt_A"
 /begin REF_CHARACTERISTIC KIPM_BMSMaxConDisCurntDflt_A KIPM_BMSMaxConDisCurntHi_A KIPM_BMSMaxConDisCurntLo_A KIPM_BMSMaxConDisCurnt_A_ovrdflg KIPM_BMSMaxConDisCurnt_A_ovrdval /end REF_CHARACTERISTIC
 /begin REF_MEASUREMENT VIPM_BMSMaxConDisCurntVld_flg VIPM_BMSMaxConDisCurnt_A /end REF_MEASUREMENT
/end GROUP
/begin GROUP S299_Subsys_VIPM_BMSMaxInsChrgCurnt_A "AppSwcIpm/Ipm20ms/EptCAN_IN_20ms/Msg_BMS_6_DischrgRecup_EPT/Subsys_VIPM_BMSMaxInsChrgCurnt_A"
 /begin REF_CHARACTERISTIC KIPM_BMSMaxInsChrgCurntDflt_A KIPM_BMSMaxInsChrgCurntHi_A KIPM_BMSMaxInsChrgCurntLo_A KIPM_BMSMaxInsChrgCurnt_A_ovrdflg KIPM_BMSMaxInsChrgCurnt_A_ovrdval /end REF_CHARACTERISTIC
 /begin REF_MEASUREMENT VIPM_BMSMaxInsChrgCurntVld_flg VIPM_BMSMaxInsChrgCurnt_A /end REF_MEASUREMENT
/end GROUP
/begin GROUP S299_Subsys_VIPM_BMSMaxInsDisCurnt_A "AppSwcIpm/Ipm20ms/EptCAN_IN_20ms/Msg_BMS_6_DischrgRecup_EPT/Subsys_VIPM_BMSMaxInsDisCurnt_A"
 /begin REF_CHARACTERISTIC KIPM_BMSMaxInsDisCurntDflt_A KIPM_BMSMaxInsDisCurntHi_A KIPM_BMSMaxInsDisCurntLo_A KIPM_BMSMaxInsDisCurnt_A_ovrdflg KIPM_BMSMaxInsDisCurnt_A_ovrdval /end REF_CHARACTERISTIC
 /begin REF_MEASUREMENT VIPM_BMSMaxInsDisCurntVld_flg VIPM_BMSMaxInsDisCurnt_A /end REF_MEASUREMENT
/end GROUP
/begin GROUP S300_Subsys_VIPM_BMSCellVoltMax_mV "AppSwcIpm/Ipm20ms/EptCAN_IN_20ms/Msg_BMS_7_CellVolt_EPT/Subsys_VIPM_BMSCellVoltMax_mV"
 /begin REF_CHARACTERISTIC KIPM_BMSCellVoltMaxDflt_mV KIPM_BMSCellVoltMaxHi_mV KIPM_BMSCellVoltMaxLo_mV KIPM_BMSCellVoltMax_mV_ovrdflg KIPM_BMSCellVoltMax_mV_ovrdval /end REF_CHARACTERISTIC
 /begin REF_MEASUREMENT VIPM_BMSCellVoltMaxVld_flg VIPM_BMSCellVoltMax_mV /end REF_MEASUREMENT
/end GROUP
/begin GROUP S300_Subsys_VIPM_BMSCellVoltMin_mV "AppSwcIpm/Ipm20ms/EptCAN_IN_20ms/Msg_BMS_7_CellVolt_EPT/Subsys_VIPM_BMSCellVoltMin_mV"
 /begin REF_CHARACTERISTIC KIPM_BMSCellVoltMinDflt_mV KIPM_BMSCellVoltMinHi_mV KIPM_BMSCellVoltMinLo_mV KIPM_BMSCellVoltMin_mV_ovrdflg KIPM_BMSCellVoltMin_mV_ovrdval /end REF_CHARACTERISTIC
 /begin REF_MEASUREMENT VIPM_BMSCellVoltMinVld_flg VIPM_BMSCellVoltMin_mV /end REF_MEASUREMENT
/end GROUP
/begin GROUP S344_Subsys_VIPM_CCPACAutoKey_flg "AppSwcIpm/Ipm50ms/BodCAN_IN_50ms/Msg_CCP_PanelStatus_BOD/Subsys_VIPM_CCPACAutoKey_flg"
 /begin REF_CHARACTERISTIC KIPM_CCPACAutoKeyDflt_flg KIPM_CCPACAutoKey_flg_ovrdflg KIPM_CCPACAutoKey_flg_ovrdval /end REF_CHARACTERISTIC
 /begin REF_MEASUREMENT VIPM_CCPACAutoKeyVld_flg VIPM_CCPACAutoKey_flg /end REF_MEASUREMENT
/end GROUP
/begin GROUP S344_Subsys_VIPM_CCPACSwKey_flg "AppSwcIpm/Ipm50ms/BodCAN_IN_50ms/Msg_CCP_PanelStatus_BOD/Subsys_VIPM_CCPACSwKey_flg"
 /begin REF_CHARACTERISTIC KIPM_CCPACSwKeyDflt_flg KIPM_CCPACSwKey_flg_ovrdflg KIPM_CCPACSwKey_flg_ovrdval /end REF_CHARACTERISTIC
 /begin REF_MEASUREMENT VIPM_CCPACSwKeyVld_flg VIPM_CCPACSwKey_flg /end REF_MEASUREMENT
/end GROUP
/begin GROUP S344_Subsys_VIPM_CCPAVASOffKey_flg "AppSwcIpm/Ipm50ms/BodCAN_IN_50ms/Msg_CCP_PanelStatus_BOD/Subsys_VIPM_CCPAVASOffKey_flg"
 /begin REF_CHARACTERISTIC KIPM_CCPAVASOffKeyDflt_flg KIPM_CCPAVASOffKey_flg_ovrdflg KIPM_CCPAVASOffKey_flg_ovrdval /end REF_CHARACTERISTIC
 /begin REF_MEASUREMENT VIPM_CCPAVASOffKeyVld_flg VIPM_CCPAVASOffKey_flg /end REF_MEASUREMENT
/end GROUP
/begin GROUP S344_Subsys_VIPM_CCPAVHKey_flg "AppSwcIpm/Ipm50ms/BodCAN_IN_50ms/Msg_CCP_PanelStatus_BOD/Subsys_VIPM_CCPAVHKey_flg"
 /begin REF_CHARACTERISTIC KIPM_CCPAVHKeyDflt_flg KIPM_CCPAVHKey_flg_ovrdflg KIPM_CCPAVHKey_flg_ovrdval /end REF_CHARACTERISTIC
 /begin REF_MEASUREMENT VIPM_CCPAVHKeyVld_flg VIPM_CCPAVHKey_flg /end REF_MEASUREMENT
/end GROUP
/begin GROUP S344_Subsys_VIPM_CCPAirInletModeKey_flg "AppSwcIpm/Ipm50ms/BodCAN_IN_50ms/Msg_CCP_PanelStatus_BOD/Subsys_VIPM_CCPAirInletModeKey_flg"
 /begin REF_CHARACTERISTIC KIPM_CCPAirInletModeKeyDflt_flg KIPM_CCPAirInletModeKey_flg_ovrdflg KIPM_CCPAirInletModeKey_flg_ovrdval /end REF_CHARACTERISTIC
 /begin REF_MEASUREMENT VIPM_CCPAirInletModeKeyVld_flg VIPM_CCPAirInletModeKey_flg /end REF_MEASUREMENT
/end GROUP
/begin GROUP S344_Subsys_VIPM_CCPBlwngModeNextKey_flg "AppSwcIpm/Ipm50ms/BodCAN_IN_50ms/Msg_CCP_PanelStatus_BOD/Subsys_VIPM_CCPBlwngModeNextKey_flg"
 /begin REF_CHARACTERISTIC KIPM_CCPBlwngModeNextKeyDflt_flg KIPM_CCPBlwngModeNextKey_flg_ovrdflg KIPM_CCPBlwngModeNextKey_flg_ovrdval /end REF_CHARACTERISTIC
 /begin REF_MEASUREMENT VIPM_CCPBlwngModeNextKeyVld_flg VIPM_CCPBlwngModeNextKey_flg /end REF_MEASUREMENT
/end GROUP
/begin GROUP S344_Subsys_VIPM_CCPBlwngModePrevKey_flg "AppSwcIpm/Ipm50ms/BodCAN_IN_50ms/Msg_CCP_PanelStatus_BOD/Subsys_VIPM_CCPBlwngModePrevKey_flg"
 /begin REF_CHARACTERISTIC KIPM_CCPBlwngModePrevKeyDflt_flg KIPM_CCPBlwngModePrevKey_flg_ovrdflg KIPM_CCPBlwngModePrevKey_flg_ovrdval /end REF_CHARACTERISTIC
 /begin REF_MEASUREMENT VIPM_CCPBlwngModePrevKeyVld_flg VIPM_CCPBlwngModePrevKey_flg /end REF_MEASUREMENT
/end GROUP
/begin GROUP S344_Subsys_VIPM_CCPBlwrLvlAddKey_flg "AppSwcIpm/Ipm50ms/BodCAN_IN_50ms/Msg_CCP_PanelStatus_BOD/Subsys_VIPM_CCPBlwrLvlAddKey_flg"
 /begin REF_CHARACTERISTIC KIPM_CCPBlwrLvlAddKeyDflt_flg KIPM_CCPBlwrLvlAddKey_flg_ovrdflg KIPM_CCPBlwrLvlAddKey_flg_ovrdval /end REF_CHARACTERISTIC
 /begin REF_MEASUREMENT VIPM_CCPBlwrLvlAddKeyVld_flg VIPM_CCPBlwrLvlAddKey_flg /end REF_MEASUREMENT
/end GROUP
/begin GROUP S344_Subsys_VIPM_CCPBlwrLvlDecKey_flg "AppSwcIpm/Ipm50ms/BodCAN_IN_50ms/Msg_CCP_PanelStatus_BOD/Subsys_VIPM_CCPBlwrLvlDecKey_flg"
 /begin REF_CHARACTERISTIC KIPM_CCPBlwrLvlDecKeyDflt_flg KIPM_CCPBlwrLvlDecKey_flg_ovrdflg KIPM_CCPBlwrLvlDecKey_flg_ovrdval /end REF_CHARACTERISTIC
 /begin REF_MEASUREMENT VIPM_CCPBlwrLvlDecKeyVld_flg VIPM_CCPBlwrLvlDecKey_flg /end REF_MEASUREMENT
/end GROUP
/begin GROUP S344_Subsys_VIPM_CCPCenLckKey_flg "AppSwcIpm/Ipm50ms/BodCAN_IN_50ms/Msg_CCP_PanelStatus_BOD/Subsys_VIPM_CCPCenLckKey_flg"
 /begin REF_CHARACTERISTIC KIPM_CCPCenLckKeyDflt_flg KIPM_CCPCenLckKey_flg_ovrdflg KIPM_CCPCenLckKey_flg_ovrdval /end REF_CHARACTERISTIC
 /begin REF_MEASUREMENT VIPM_CCPCenLckKeyVld_flg VIPM_CCPCenLckKey_flg /end REF_MEASUREMENT
/end GROUP
/begin GROUP S344_Subsys_VIPM_CCPESCOffKey_flg "AppSwcIpm/Ipm50ms/BodCAN_IN_50ms/Msg_CCP_PanelStatus_BOD/Subsys_VIPM_CCPESCOffKey_flg"
 /begin REF_CHARACTERISTIC KIPM_CCPESCOffKeyDflt_flg KIPM_CCPESCOffKey_flg_ovrdflg KIPM_CCPESCOffKey_flg_ovrdval /end REF_CHARACTERISTIC
 /begin REF_MEASUREMENT VIPM_CCPESCOffKeyVld_flg VIPM_CCPESCOffKey_flg /end REF_MEASUREMENT
/end GROUP
/begin GROUP S344_Subsys_VIPM_CCPFrntWindDefrstKey_flg "AppSwcIpm/Ipm50ms/BodCAN_IN_50ms/Msg_CCP_PanelStatus_BOD/Subsys_VIPM_CCPFrntWindDefrstKey_flg"
 /begin REF_CHARACTERISTIC KIPM_CCPFrntWindDefrstKeyDflt_flg KIPM_CCPFrntWindDefrstKey_flg_ovrdflg KIPM_CCPFrntWindDefrstKey_flg_ovrdval /end REF_CHARACTERISTIC
 /begin REF_MEASUREMENT VIPM_CCPFrntWindDefrstKeyVld_flg VIPM_CCPFrntWindDefrstKey_flg /end REF_MEASUREMENT
/end GROUP
/begin GROUP S344_Subsys_VIPM_CCPHDCKey_flg "AppSwcIpm/Ipm50ms/BodCAN_IN_50ms/Msg_CCP_PanelStatus_BOD/Subsys_VIPM_CCPHDCKey_flg"
 /begin REF_CHARACTERISTIC KIPM_CCPHDCKeyDflt_flg KIPM_CCPHDCKey_flg_ovrdflg KIPM_CCPHDCKey_flg_ovrdval /end REF_CHARACTERISTIC
 /begin REF_MEASUREMENT VIPM_CCPHDCKeyVld_flg VIPM_CCPHDCKey_flg /end REF_MEASUREMENT
/end GROUP
/begin GROUP S344_Subsys_VIPM_CCPHzrdKey_flg "AppSwcIpm/Ipm50ms/BodCAN_IN_50ms/Msg_CCP_PanelStatus_BOD/Subsys_VIPM_CCPHzrdKey_flg"
 /begin REF_CHARACTERISTIC KIPM_CCPHzrdKeyDflt_flg KIPM_CCPHzrdKey_flg_ovrdflg KIPM_CCPHzrdKey_flg_ovrdval /end REF_CHARACTERISTIC
 /begin REF_MEASUREMENT VIPM_CCPHzrdKeyVld_flg VIPM_CCPHzrdKey_flg /end REF_MEASUREMENT
/end GROUP
/begin GROUP S344_Subsys_VIPM_CCPModeKey_flg "AppSwcIpm/Ipm50ms/BodCAN_IN_50ms/Msg_CCP_PanelStatus_BOD/Subsys_VIPM_CCPModeKey_flg"
 /begin REF_CHARACTERISTIC KIPM_CCPModeKeyDflt_flg KIPM_CCPModeKey_flg_ovrdflg KIPM_CCPModeKey_flg_ovrdval /end REF_CHARACTERISTIC
 /begin REF_MEASUREMENT VIPM_CCPModeKeyVld_flg VIPM_CCPModeKey_flg /end REF_MEASUREMENT
/end GROUP
/begin GROUP S344_Subsys_VIPM_CCPPwrRecupLvlKey_flg "AppSwcIpm/Ipm50ms/BodCAN_IN_50ms/Msg_CCP_PanelStatus_BOD/Subsys_VIPM_CCPPwrRecupLvlKey_flg"
 /begin REF_CHARACTERISTIC KIPM_CCPPwrRecupLvlKeyDflt_flg KIPM_CCPPwrRecupLvlKey_flg_ovrdflg KIPM_CCPPwrRecupLvlKey_flg_ovrdval /end REF_CHARACTERISTIC
 /begin REF_MEASUREMENT VIPM_CCPPwrRecupLvlKeyVld_flg VIPM_CCPPwrRecupLvlKey_flg /end REF_MEASUREMENT
/end GROUP
/begin GROUP S344_Subsys_VIPM_CCPRrViewMirrHeatgKey_flg "AppSwcIpm/Ipm50ms/BodCAN_IN_50ms/Msg_CCP_PanelStatus_BOD/Subsys_VIPM_CCPRrViewMirrHeatgKey_flg"
 /begin REF_CHARACTERISTIC KIPM_CCPRrViewMirrHeatgKeyDflt_flg KIPM_CCPRrViewMirrHeatgKey_flg_ovrdflg KIPM_CCPRrViewMirrHeatgKey_flg_ovrdval /end REF_CHARACTERISTIC
 /begin REF_MEASUREMENT VIPM_CCPRrViewMirrHeatgKeyVld_flg VIPM_CCPRrViewMirrHeatgKey_flg /end REF_MEASUREMENT
/end GROUP
/begin GROUP S344_Subsys_VIPM_CCPTPMSKey_flg "AppSwcIpm/Ipm50ms/BodCAN_IN_50ms/Msg_CCP_PanelStatus_BOD/Subsys_VIPM_CCPTPMSKey_flg"
 /begin REF_CHARACTERISTIC KIPM_CCPTPMSKeyDflt_flg KIPM_CCPTPMSKey_flg_ovrdflg KIPM_CCPTPMSKey_flg_ovrdval /end REF_CHARACTERISTIC
 /begin REF_MEASUREMENT VIPM_CCPTPMSKeyVld_flg VIPM_CCPTPMSKey_flg /end REF_MEASUREMENT
/end GROUP
/begin GROUP S344_Subsys_VIPM_CCPTempAddKey_flg "AppSwcIpm/Ipm50ms/BodCAN_IN_50ms/Msg_CCP_PanelStatus_BOD/Subsys_VIPM_CCPTempAddKey_flg"
 /begin REF_CHARACTERISTIC KIPM_CCPTempAddKeyDflt_flg KIPM_CCPTempAddKey_flg_ovrdflg KIPM_CCPTempAddKey_flg_ovrdval /end REF_CHARACTERISTIC
 /begin REF_MEASUREMENT VIPM_CCPTempAddKeyVld_flg VIPM_CCPTempAddKey_flg /end REF_MEASUREMENT
/end GROUP
/begin GROUP S344_Subsys_VIPM_CCPTempDecKey_flg "AppSwcIpm/Ipm50ms/BodCAN_IN_50ms/Msg_CCP_PanelStatus_BOD/Subsys_VIPM_CCPTempDecKey_flg"
 /begin REF_CHARACTERISTIC KIPM_CCPTempDecKeyDflt_flg KIPM_CCPTempDecKey_flg_ovrdflg KIPM_CCPTempDecKey_flg_ovrdval /end REF_CHARACTERISTIC
 /begin REF_MEASUREMENT VIPM_CCPTempDecKeyVld_flg VIPM_CCPTempDecKey_flg /end REF_MEASUREMENT
/end GROUP
/begin GROUP S345_Subsys_VIPM_ESCLUnOrLockfeedback_nu "AppSwcIpm/Ipm50ms/BodCAN_IN_50ms/Msg_ESCL_ESCLStatus_BOD/Subsys_VIPM_ESCLUnOrLockfeedback_nu" /begin REF_CHARACTERISTIC KIPM_ESCLUnOrLockfeedback_nu_ovrdflg /end REF_CHARACTERISTIC /begin REF_MEASUREMENT VIPM_ESCLUnOrLockfeedbackVld_flg /end REF_MEASUREMENT /end GROUP
/begin GROUP S346_Subsys_VIPM_SCSFrntWiprSwtSt_enum "AppSwcIpm/Ipm50ms/BodCAN_IN_50ms/Msg_SCS_LeSwitchSts_BOD/Subsys_VIPM_SCSFrntWiprSwtSt_enum"
 /begin REF_CHARACTERISTIC KIPM_SCSFrntWiprSwtStDflt_enum KIPM_SCSFrntWiprSwtSt_enum_ovrdflg KIPM_SCSFrntWiprSwtSt_enum_ovrdval /end REF_CHARACTERISTIC
 /begin REF_MEASUREMENT VIPM_SCSFrntWiprSwtStVld_flg VIPM_SCSFrntWiprSwtSt_enum /end REF_MEASUREMENT
/end GROUP
/begin GROUP S346_Subsys_VIPM_SCSFrntWshrSwtSt_flg "AppSwcIpm/Ipm50ms/BodCAN_IN_50ms/Msg_SCS_LeSwitchSts_BOD/Subsys_VIPM_SCSFrntWshrSwtSt_flg"
 /begin REF_CHARACTERISTIC KIPM_SCSFrntWshrSwtStDflt_flg KIPM_SCSFrntWshrSwtSt_flg_ovrdflg KIPM_SCSFrntWshrSwtSt_flg_ovrdval /end REF_CHARACTERISTIC
 /begin REF_MEASUREMENT VIPM_SCSFrntWshrSwtStVld_flg VIPM_SCSFrntWshrSwtSt_flg /end REF_MEASUREMENT
/end GROUP
/begin GROUP S346_Subsys_VIPM_SCSHiBeamSwSt_flg "AppSwcIpm/Ipm50ms/BodCAN_IN_50ms/Msg_SCS_LeSwitchSts_BOD/Subsys_VIPM_SCSHiBeamSwSt_flg"
 /begin REF_CHARACTERISTIC KIPM_SCSHiBeamSwStDflt_flg KIPM_SCSHiBeamSwSt_flg_ovrdflg KIPM_SCSHiBeamSwSt_flg_ovrdval /end REF_CHARACTERISTIC
 /begin REF_MEASUREMENT VIPM_SCSHiBeamSwStVld_flg VIPM_SCSHiBeamSwSt_flg /end REF_MEASUREMENT
/end GROUP
/begin GROUP S346_Subsys_VIPM_SCSLampAutoSt_flg "AppSwcIpm/Ipm50ms/BodCAN_IN_50ms/Msg_SCS_LeSwitchSts_BOD/Subsys_VIPM_SCSLampAutoSt_flg"
 /begin REF_CHARACTERISTIC KIPM_SCSLampAutoStDflt_flg KIPM_SCSLampAutoSt_flg_ovrdflg KIPM_SCSLampAutoSt_flg_ovrdval /end REF_CHARACTERISTIC
 /begin REF_MEASUREMENT VIPM_SCSLampAutoStVld_flg VIPM_SCSLampAutoSt_flg /end REF_MEASUREMENT
/end GROUP
/begin GROUP S346_Subsys_VIPM_SCSLeTrnLmpSwSt_flg "AppSwcIpm/Ipm50ms/BodCAN_IN_50ms/Msg_SCS_LeSwitchSts_BOD/Subsys_VIPM_SCSLeTrnLmpSwSt_flg"
 /begin REF_CHARACTERISTIC KIPM_SCSLeTrnLmpSwStDflt_flg KIPM_SCSLeTrnLmpSwSt_flg_ovrdflg KIPM_SCSLeTrnLmpSwSt_flg_ovrdval /end REF_CHARACTERISTIC
 /begin REF_MEASUREMENT VIPM_SCSLeTrnLmpSwStVld_flg VIPM_SCSLeTrnLmpSwSt_flg /end REF_MEASUREMENT
/end GROUP
/begin GROUP S346_Subsys_VIPM_SCSLoBeamSwSt_flg "AppSwcIpm/Ipm50ms/BodCAN_IN_50ms/Msg_SCS_LeSwitchSts_BOD/Subsys_VIPM_SCSLoBeamSwSt_flg"
 /begin REF_CHARACTERISTIC KIPM_SCSLoBeamSwStDflt_flg KIPM_SCSLoBeamSwSt_flg_ovrdflg KIPM_SCSLoBeamSwSt_flg_ovrdval /end REF_CHARACTERISTIC
 /begin REF_MEASUREMENT VIPM_SCSLoBeamSwStVld_flg VIPM_SCSLoBeamSwSt_flg /end REF_MEASUREMENT
/end GROUP
/begin GROUP S346_Subsys_VIPM_SCSOvrVehBeamSwSt_flg "AppSwcIpm/Ipm50ms/BodCAN_IN_50ms/Msg_SCS_LeSwitchSts_BOD/Subsys_VIPM_SCSOvrVehBeamSwSt_flg"
 /begin REF_CHARACTERISTIC KIPM_SCSOvrVehBeamSwStDflt_flg KIPM_SCSOvrVehBeamSwSt_flg_ovrdflg KIPM_SCSOvrVehBeamSwSt_flg_ovrdval /end REF_CHARACTERISTIC
 /begin REF_MEASUREMENT VIPM_SCSOvrVehBeamSwStVld_flg VIPM_SCSOvrVehBeamSwSt_flg /end REF_MEASUREMENT
/end GROUP
/begin GROUP S346_Subsys_VIPM_SCSPstnLghtSwSt_flg "AppSwcIpm/Ipm50ms/BodCAN_IN_50ms/Msg_SCS_LeSwitchSts_BOD/Subsys_VIPM_SCSPstnLghtSwSt_flg"
 /begin REF_CHARACTERISTIC KIPM_SCSPstnLghtSwStDflt_flg KIPM_SCSPstnLghtSwSt_flg_ovrdflg KIPM_SCSPstnLghtSwSt_flg_ovrdval /end REF_CHARACTERISTIC
 /begin REF_MEASUREMENT VIPM_SCSPstnLghtSwStVld_flg VIPM_SCSPstnLghtSwSt_flg /end REF_MEASUREMENT
/end GROUP
/begin GROUP S346_Subsys_VIPM_SCSRiTrnLmpSwSt_flg "AppSwcIpm/Ipm50ms/BodCAN_IN_50ms/Msg_SCS_LeSwitchSts_BOD/Subsys_VIPM_SCSRiTrnLmpSwSt_flg"
 /begin REF_CHARACTERISTIC KIPM_SCSRiTrnLmpSwStDflt_flg KIPM_SCSRiTrnLmpSwSt_flg_ovrdflg KIPM_SCSRiTrnLmpSwSt_flg_ovrdval /end REF_CHARACTERISTIC
 /begin REF_MEASUREMENT VIPM_SCSRiTrnLmpSwStVld_flg VIPM_SCSRiTrnLmpSwSt_flg /end REF_MEASUREMENT
/end GROUP
/begin GROUP S377_Subsys_VIPM_SRSCrashOutputSts_enum "AppSwcIpm/Ipm50ms/CHACAN_IN_50ms/Msg_SRS_1_Status_CHA/Subsys_VIPM_SRSCrashOutputSts_enum"
 /begin REF_CHARACTERISTIC KIPM_SRSCrashOutputStsDflt_enum KIPM_SRSCrashOutputSts_enum_ovrdflg KIPM_SRSCrashOutputSts_enum_ovrdval /end REF_CHARACTERISTIC
 /begin REF_MEASUREMENT VIPM_SRSCrashOutputStsVld_flg VIPM_SRSCrashOutputSts_enum /end REF_MEASUREMENT
/end GROUP
/begin GROUP S377_Subsys_VIPM_SRSDrvSeatbeltBkld_flg "AppSwcIpm/Ipm50ms/CHACAN_IN_50ms/Msg_SRS_1_Status_CHA/Subsys_VIPM_SRSDrvSeatbeltBkld_flg"
 /begin REF_CHARACTERISTIC KIPM_SRSDrvSeatbeltBkldDflt_flg KIPM_SRSDrvSeatbeltBkld_flg_ovrdflg KIPM_SRSDrvSeatbeltBkld_flg_ovrdval /end REF_CHARACTERISTIC
 /begin REF_MEASUREMENT VIPM_SRSDrvSeatbeltBkldVld_flg VIPM_SRSDrvSeatbeltBkld_flg /end REF_MEASUREMENT
/end GROUP
/end MODULE
/end PROJECT
