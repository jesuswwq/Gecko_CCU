ASAP2_VERSION 1 31
/begin PROJECT ProjectName "Project Comment Goes Here"
/begin HEADER "Header Comments go here" /end HEADER
/begin MODULE ModuleName "Module Comment Goes Here"
/begin MOD_COMMON "Mod Common Comment Here" BYTE_ORDER MSB_LAST /end MOD_COMMON
/begin RECORD_LAYOUT Scalar_BOOLEAN FNC_VALUES 1 UBYTE COLUMN_DIR DIRECT /end RECORD_LAYOUT
/begin RECORD_LAYOUT Scalar_UBYTE FNC_VALUES 1 UBYTE COLUMN_DIR DIRECT /end RECORD_LAYOUT
/begin RECORD_LAYOUT Scalar_FLOAT32_IEEE FNC_VALUES 1 FLOAT32_IEEE COLUMN_DIR DIRECT /end RECORD_LAYOUT
/begin RECORD_LAYOUT Lookup1D_SLONG FNC_VALUES 1 SLONG COLUMN_DIR DIRECT /end RECORD_LAYOUT
/begin RECORD_LAYOUT Lookup1D_X_LONG AXIS_PTS_X 1 SLONG INDEX_INCR DIRECT /end RECORD_LAYOUT
/begin RECORD_LAYOUT Lookup1D_FLOAT32_IEEE FNC_VALUES 1 FLOAT32_IEEE COLUMN_DIR DIRECT /end RECORD_LAYOUT
/begin RECORD_LAYOUT Lookup1D_X_FLOAT32_IEEE AXIS_PTS_X 1 FLOAT32_IEEE INDEX_INCR DIRECT /end RECORD_LAYOUT
/begin RECORD_LAYOUT Lookup1D_FLOAT64_IEEE FNC_VALUES 1 FLOAT64_IEEE COLUMN_DIR DIRECT /end RECORD_LAYOUT
/begin RECORD_LAYOUT Lookup1D_X_FLOAT64_IEEE AXIS_PTS_X 1 FLOAT64_IEEE INDEX_INCR DIRECT /end RECORD_LAYOUT
/begin RECORD_LAYOUT Lookup2D_BOOLEAN FNC_VALUES 1 UBYTE COLUMN_DIR DIRECT /end RECORD_LAYOUT
/begin RECORD_LAYOUT Lookup2D_X_BOOLEAN AXIS_PTS_X 1 UBYTE INDEX_INCR DIRECT /end RECORD_LAYOUT
/begin RECORD_LAYOUT Lookup2D_UBYTE FNC_VALUES 1 UBYTE COLUMN_DIR DIRECT /end RECORD_LAYOUT
/begin RECORD_LAYOUT Lookup2D_X_UBYTE AXIS_PTS_X 1 UBYTE INDEX_INCR DIRECT /end RECORD_LAYOUT
/begin RECORD_LAYOUT Lookup2D_BYTE FNC_VALUES 1 SBYTE COLUMN_DIR DIRECT /end RECORD_LAYOUT
/begin CHARACTERISTIC KIPM_BMSHVBatCellTempAveDflt_C "" VALUE 0x0000 /* @ECU_Address@KIPM_BMSHVBatCellTempAveDflt_C@ */ Scalar_FLOAT32_IEEE 0 AppSwcIpm_CM_single_C -100000.0 100000.0 /end CHARACTERISTIC
/begin CHARACTERISTIC KIPM_BMSHVBatCellTempAveHi_C "" VALUE 0x0000 /* @ECU_Address@KIPM_BMSHVBatCellTempAveHi_C@ */ Scalar_FLOAT32_IEEE 0 AppSwcIpm_CM_single_C -100000.0 100000.0 /end CHARACTERISTIC
/begin CHARACTERISTIC KIPM_BMSHVBatCellTempAveLo_C "" VALUE 0x0000 /* @ECU_Address@KIPM_BMSHVBatCellTempAveLo_C@ */ Scalar_FLOAT32_IEEE 0 AppSwcIpm_CM_single_C -100000.0 100000.0 /end CHARACTERISTIC
/begin CHARACTERISTIC KIPM_BMSHVBatCellTempAve_C_ovrdval "" VALUE 0x0000 /* @ECU_Address@KIPM_BMSHVBatCellTempAve_C_ovrdval@ */ Scalar_FLOAT32_IEEE 0 AppSwcIpm_CM_single_C -100000.0 100000.0 /end CHARACTERISTIC
/begin CHARACTERISTIC KIPM_BMSHVBatCellTempMaxDflt_C "" VALUE 0x0000 /* @ECU_Address@KIPM_BMSHVBatCellTempMaxDflt_C@ */ Scalar_FLOAT32_IEEE 0 AppSwcIpm_CM_single_C -100000.0 100000.0 /end CHARACTERISTIC
/begin CHARACTERISTIC KIPM_BMSHVBatCellTempMaxHi_C "" VALUE 0x0000 /* @ECU_Address@KIPM_BMSHVBatCellTempMaxHi_C@ */ Scalar_FLOAT32_IEEE 0 AppSwcIpm_CM_single_C -100000.0 100000.0 /end CHARACTERISTIC
/begin CHARACTERISTIC KIPM_BMSHVBatCellTempMaxLo_C "" VALUE 0x0000 /* @ECU_Address@KIPM_BMSHVBatCellTempMaxLo_C@ */ Scalar_FLOAT32_IEEE 0 AppSwcIpm_CM_single_C -100000.0 100000.0 /end CHARACTERISTIC
/begin CHARACTERISTIC KIPM_BMSHVBatCellTempMax_C_ovrdval "" VALUE 0x0000 /* @ECU_Address@KIPM_BMSHVBatCellTempMax_C_ovrdval@ */ Scalar_FLOAT32_IEEE 0 AppSwcIpm_CM_single_C -100000.0 100000.0 /end CHARACTERISTIC
/begin CHARACTERISTIC KIPM_BMSHVBatCellTempMinDflt_C "" VALUE 0x0000 /* @ECU_Address@KIPM_BMSHVBatCellTempMinDflt_C@ */ Scalar_FLOAT32_IEEE 0 AppSwcIpm_CM_single_C -100000.0 100000.0 /end CHARACTERISTIC
/begin CHARACTERISTIC KIPM_BMSHVBatCellTempMinHi_C "" VALUE 0x0000 /* @ECU_Address@KIPM_BMSHVBatCellTempMinHi_C@ */ Scalar_FLOAT32_IEEE 0 AppSwcIpm_CM_single_C -100000.0 100000.0 /end CHARACTERISTIC
/begin CHARACTERISTIC KIPM_BMSHVBatCellTempMinLo_C "" VALUE 0x0000 /* @ECU_Address@KIPM_BMSHVBatCellTempMinLo_C@ */ Scalar_FLOAT32_IEEE 0 AppSwcIpm_CM_single_C -100000.0 100000.0 /end CHARACTERISTIC
/begin CHARACTERISTIC KIPM_BMSHVBatCellTempMin_C_ovrdval "" VALUE 0x0000 /* @ECU_Address@KIPM_BMSHVBatCellTempMin_C_ovrdval@ */ Scalar_FLOAT32_IEEE 0 AppSwcIpm_CM_single_C -100000.0 100000.0 /end CHARACTERISTIC
/begin CHARACTERISTIC KIPM_EHBBrkPedlValPercDflt_pct "" VALUE 0x0000 /* @ECU_Address@KIPM_EHBBrkPedlValPercDflt_pct@ */ Scalar_FLOAT32_IEEE 0 AppSwcIpm_CM_single_pct -100000.0 100000.0 /end CHARACTERISTIC
/begin CHARACTERISTIC KIPM_EHBBrkPedlValPercHi_pct "" VALUE 0x0000 /* @ECU_Address@KIPM_EHBBrkPedlValPercHi_pct@ */ Scalar_FLOAT32_IEEE 0 AppSwcIpm_CM_single_pct -100000.0 100000.0 /end CHARACTERISTIC
/begin CHARACTERISTIC KIPM_EHBBrkPedlValPercLo_pct "" VALUE 0x0000 /* @ECU_Address@KIPM_EHBBrkPedlValPercLo_pct@ */ Scalar_FLOAT32_IEEE 0 AppSwcIpm_CM_single_pct -100000.0 100000.0 /end CHARACTERISTIC
/begin CHARACTERISTIC KIPM_EHBBrkPedlValPerc_pct_ovrdval "" VALUE 0x0000 /* @ECU_Address@KIPM_EHBBrkPedlValPerc_pct_ovrdval@ */ Scalar_FLOAT32_IEEE 0 AppSwcIpm_CM_single_pct -100000.0 100000.0 /end CHARACTERISTIC
/begin CHARACTERISTIC KIPM_EHBBrkPwrRecupTarWhlTqDflt_Nm "" VALUE 0x0000 /* @ECU_Address@KIPM_EHBBrkPwrRecupTarWhlTqDflt_Nm@ */ Scalar_FLOAT32_IEEE 0 AppSwcIpm_CM_single_Nm -100000.0 100000.0 /end CHARACTERISTIC
/begin CHARACTERISTIC KIPM_EHBBrkPwrRecupTarWhlTqHi_Nm "" VALUE 0x0000 /* @ECU_Address@KIPM_EHBBrkPwrRecupTarWhlTqHi_Nm@ */ Scalar_FLOAT32_IEEE 0 AppSwcIpm_CM_single_Nm -100000.0 100000.0 /end CHARACTERISTIC
/begin CHARACTERISTIC KIPM_EHBBrkPwrRecupTarWhlTqLo_Nm "" VALUE 0x0000 /* @ECU_Address@KIPM_EHBBrkPwrRecupTarWhlTqLo_Nm@ */ Scalar_FLOAT32_IEEE 0 AppSwcIpm_CM_single_Nm -100000.0 100000.0 /end CHARACTERISTIC
/begin CHARACTERISTIC KIPM_EHBBrkPwrRecupTarWhlTq_Nm_ovrdval "" VALUE 0x0000 /* @ECU_Address@KIPM_EHBBrkPwrRecupTarWhlTq_Nm_ovrdval@ */ Scalar_FLOAT32_IEEE 0 AppSwcIpm_CM_single_Nm -100000.0 100000.0 /end CHARACTERISTIC
/begin CHARACTERISTIC KIPM_EPSRotSpdDflt_degps "" VALUE 0x0000 /* @ECU_Address@KIPM_EPSRotSpdDflt_degps@ */ Scalar_FLOAT32_IEEE 0 AppSwcIpm_CM_single_degps -100000.0 100000.0 /end CHARACTERISTIC
/begin CHARACTERISTIC KIPM_EPSRotSpdHi_degps "" VALUE 0x0000 /* @ECU_Address@KIPM_EPSRotSpdHi_degps@ */ Scalar_FLOAT32_IEEE 0 AppSwcIpm_CM_single_degps -100000.0 100000.0 /end CHARACTERISTIC
/begin CHARACTERISTIC KIPM_EPSRotSpdLo_degps "" VALUE 0x0000 /* @ECU_Address@KIPM_EPSRotSpdLo_degps@ */ Scalar_FLOAT32_IEEE 0 AppSwcIpm_CM_single_degps -100000.0 100000.0 /end CHARACTERISTIC
/begin CHARACTERISTIC KIPM_EPSRotSpd_degps_ovrdval "" VALUE 0x0000 /* @ECU_Address@KIPM_EPSRotSpd_degps_ovrdval@ */ Scalar_FLOAT32_IEEE 0 AppSwcIpm_CM_single_degps -100000.0 100000.0 /end CHARACTERISTIC
/begin CHARACTERISTIC KIPM_EPSSteerWhlAngDflt_deg "" VALUE 0x0000 /* @ECU_Address@KIPM_EPSSteerWhlAngDflt_deg@ */ Scalar_FLOAT32_IEEE 0 AppSwcIpm_CM_single_deg -100000.0 100000.0 /end CHARACTERISTIC
/begin CHARACTERISTIC KIPM_EPSSteerWhlAngHi_deg "" VALUE 0x0000 /* @ECU_Address@KIPM_EPSSteerWhlAngHi_deg@ */ Scalar_FLOAT32_IEEE 0 AppSwcIpm_CM_single_deg -100000.0 100000.0 /end CHARACTERISTIC
/begin CHARACTERISTIC KIPM_EPSSteerWhlAngLo_deg "" VALUE 0x0000 /* @ECU_Address@KIPM_EPSSteerWhlAngLo_deg@ */ Scalar_FLOAT32_IEEE 0 AppSwcIpm_CM_single_deg -100000.0 100000.0 /end CHARACTERISTIC
/begin CHARACTERISTIC KIPM_EPSSteerWhlAng_deg_ovrdval "" VALUE 0x0000 /* @ECU_Address@KIPM_EPSSteerWhlAng_deg_ovrdval@ */ Scalar_FLOAT32_IEEE 0 AppSwcIpm_CM_single_deg -100000.0 100000.0 /end CHARACTERISTIC
/begin CHARACTERISTIC KIPM_ESCLatAccSnsrValDflt_g "" VALUE 0x0000 /* @ECU_Address@KIPM_ESCLatAccSnsrValDflt_g@ */ Scalar_FLOAT32_IEEE 0 AppSwcIpm_CM_single_g -100000.0 100000.0 /end CHARACTERISTIC
/begin CHARACTERISTIC KIPM_ESCLatAccSnsrValHi_g "" VALUE 0x0000 /* @ECU_Address@KIPM_ESCLatAccSnsrValHi_g@ */ Scalar_FLOAT32_IEEE 0 AppSwcIpm_CM_single_g -100000.0 100000.0 /end CHARACTERISTIC
/begin CHARACTERISTIC KIPM_ESCLatAccSnsrValLo_g "" VALUE 0x0000 /* @ECU_Address@KIPM_ESCLatAccSnsrValLo_g@ */ Scalar_FLOAT32_IEEE 0 AppSwcIpm_CM_single_g -100000.0 100000.0 /end CHARACTERISTIC
/begin CHARACTERISTIC KIPM_ESCLatAccSnsrVal_g_ovrdval "" VALUE 0x0000 /* @ECU_Address@KIPM_ESCLatAccSnsrVal_g_ovrdval@ */ Scalar_FLOAT32_IEEE 0 AppSwcIpm_CM_single_g -100000.0 100000.0 /end CHARACTERISTIC
/begin CHARACTERISTIC KIPM_ESCLongAccSnsrValDflt_g "" VALUE 0x0000 /* @ECU_Address@KIPM_ESCLongAccSnsrValDflt_g@ */ Scalar_FLOAT32_IEEE 0 AppSwcIpm_CM_single_g -100000.0 100000.0 /end CHARACTERISTIC
/begin CHARACTERISTIC KIPM_ESCLongAccSnsrValHi_g "" VALUE 0x0000 /* @ECU_Address@KIPM_ESCLongAccSnsrValHi_g@ */ Scalar_FLOAT32_IEEE 0 AppSwcIpm_CM_single_g -100000.0 100000.0 /end CHARACTERISTIC
/begin CHARACTERISTIC KIPM_ESCLongAccSnsrValLo_g "" VALUE 0x0000 /* @ECU_Address@KIPM_ESCLongAccSnsrValLo_g@ */ Scalar_FLOAT32_IEEE 0 AppSwcIpm_CM_single_g -100000.0 100000.0 /end CHARACTERISTIC
/begin CHARACTERISTIC KIPM_ESCLongAccSnsrVal_g_ovrdval "" VALUE 0x0000 /* @ECU_Address@KIPM_ESCLongAccSnsrVal_g_ovrdval@ */ Scalar_FLOAT32_IEEE 0 AppSwcIpm_CM_single_g -100000.0 100000.0 /end CHARACTERISTIC
/begin CHARACTERISTIC KIPM_ESCMstrCylPresrDflt_bar "" VALUE 0x0000 /* @ECU_Address@KIPM_ESCMstrCylPresrDflt_bar@ */ Scalar_FLOAT32_IEEE 0 AppSwcIpm_CM_single_bar -100000.0 100000.0 /end CHARACTERISTIC
/begin CHARACTERISTIC KIPM_ESCMstrCylPresrHi_bar "" VALUE 0x0000 /* @ECU_Address@KIPM_ESCMstrCylPresrHi_bar@ */ Scalar_FLOAT32_IEEE 0 AppSwcIpm_CM_single_bar -100000.0 100000.0 /end CHARACTERISTIC
/begin CHARACTERISTIC KIPM_ESCMstrCylPresrLo_bar "" VALUE 0x0000 /* @ECU_Address@KIPM_ESCMstrCylPresrLo_bar@ */ Scalar_FLOAT32_IEEE 0 AppSwcIpm_CM_single_bar -100000.0 100000.0 /end CHARACTERISTIC
/begin CHARACTERISTIC KIPM_ESCMstrCylPresr_bar_ovrdval "" VALUE 0x0000 /* @ECU_Address@KIPM_ESCMstrCylPresr_bar_ovrdval@ */ Scalar_FLOAT32_IEEE 0 AppSwcIpm_CM_single_bar -100000.0 100000.0 /end CHARACTERISTIC
/begin CHARACTERISTIC KIPM_ESCSlopPctDflt_pct "" VALUE 0x0000 /* @ECU_Address@KIPM_ESCSlopPctDflt_pct@ */ Scalar_FLOAT32_IEEE 0 AppSwcIpm_CM_single_pct -100000.0 100000.0 /end CHARACTERISTIC
/begin CHARACTERISTIC KIPM_ESCSlopPctHi_pct "" VALUE 0x0000 /* @ECU_Address@KIPM_ESCSlopPctHi_pct@ */ Scalar_FLOAT32_IEEE 0 AppSwcIpm_CM_single_deg -100000.0 100000.0 /end CHARACTERISTIC
/begin CHARACTERISTIC KIPM_ESCSlopPctLo_pct "" VALUE 0x0000 /* @ECU_Address@KIPM_ESCSlopPctLo_pct@ */ Scalar_FLOAT32_IEEE 0 AppSwcIpm_CM_single_degps -100000.0 100000.0 /end CHARACTERISTIC
/begin CHARACTERISTIC KIPM_ESCSlopPct_pct_ovrdval "" VALUE 0x0000 /* @ECU_Address@KIPM_ESCSlopPct_pct_ovrdval@ */ Scalar_FLOAT32_IEEE 0 AppSwcIpm_CM_single_pct -100000.0 100000.0 /end CHARACTERISTIC
/begin CHARACTERISTIC KIPM_ESCVehSpdDflt_kph "" VALUE 0x0000 /* @ECU_Address@KIPM_ESCVehSpdDflt_kph@ */ Scalar_FLOAT32_IEEE 0 AppSwcIpm_CM_single_kph -100000.0 100000.0 /end CHARACTERISTIC
/begin CHARACTERISTIC KIPM_ESCVehSpdHi_kph "" VALUE 0x0000 /* @ECU_Address@KIPM_ESCVehSpdHi_kph@ */ Scalar_FLOAT32_IEEE 0 AppSwcIpm_CM_single_kph -100000.0 100000.0 /end CHARACTERISTIC
/begin CHARACTERISTIC KIPM_ESCVehSpdLo_kph "" VALUE 0x0000 /* @ECU_Address@KIPM_ESCVehSpdLo_kph@ */ Scalar_FLOAT32_IEEE 0 AppSwcIpm_CM_single_kph -100000.0 100000.0 /end CHARACTERISTIC
/begin CHARACTERISTIC KIPM_ESCVehSpd_kph_ovrdval "" VALUE 0x0000 /* @ECU_Address@KIPM_ESCVehSpd_kph_ovrdval@ */ Scalar_FLOAT32_IEEE 0 AppSwcIpm_CM_single_kph -100000.0 100000.0 /end CHARACTERISTIC
/begin CHARACTERISTIC KIPM_ESCWhlSpdKphFLDflt_kph "" VALUE 0x0000 /* @ECU_Address@KIPM_ESCWhlSpdKphFLDflt_kph@ */ Scalar_FLOAT32_IEEE 0 AppSwcIpm_CM_single_kph -100000.0 100000.0 /end CHARACTERISTIC
/begin CHARACTERISTIC KIPM_ESCWhlSpdKphFLHi_kph "" VALUE 0x0000 /* @ECU_Address@KIPM_ESCWhlSpdKphFLHi_kph@ */ Scalar_FLOAT32_IEEE 0 AppSwcIpm_CM_single_kph -100000.0 100000.0 /end CHARACTERISTIC
/begin CHARACTERISTIC KIPM_ESCWhlSpdKphFLLo_kph "" VALUE 0x0000 /* @ECU_Address@KIPM_ESCWhlSpdKphFLLo_kph@ */ Scalar_FLOAT32_IEEE 0 AppSwcIpm_CM_single_kph -100000.0 100000.0 /end CHARACTERISTIC
/begin CHARACTERISTIC KIPM_ESCWhlSpdKphFL_kph_ovrdval "" VALUE 0x0000 /* @ECU_Address@KIPM_ESCWhlSpdKphFL_kph_ovrdval@ */ Scalar_FLOAT32_IEEE 0 AppSwcIpm_CM_single_kph -100000.0 100000.0 /end CHARACTERISTIC
/begin CHARACTERISTIC KIPM_ESCWhlSpdKphFRDflt_kph "" VALUE 0x0000 /* @ECU_Address@KIPM_ESCWhlSpdKphFRDflt_kph@ */ Scalar_FLOAT32_IEEE 0 AppSwcIpm_CM_single_kph -100000.0 100000.0 /end CHARACTERISTIC
/begin CHARACTERISTIC KIPM_ESCWhlSpdKphFRHi_kph "" VALUE 0x0000 /* @ECU_Address@KIPM_ESCWhlSpdKphFRHi_kph@ */ Scalar_FLOAT32_IEEE 0 AppSwcIpm_CM_single_kph -100000.0 100000.0 /end CHARACTERISTIC
/begin CHARACTERISTIC KIPM_ESCWhlSpdKphFRLo_kph "" VALUE 0x0000 /* @ECU_Address@KIPM_ESCWhlSpdKphFRLo_kph@ */ Scalar_FLOAT32_IEEE 0 AppSwcIpm_CM_single_kph -100000.0 100000.0 /end CHARACTERISTIC
/begin CHARACTERISTIC KIPM_ESCWhlSpdKphFR_kph_ovrdval "" VALUE 0x0000 /* @ECU_Address@KIPM_ESCWhlSpdKphFR_kph_ovrdval@ */ Scalar_FLOAT32_IEEE 0 AppSwcIpm_CM_single_kph -100000.0 100000.0 /end CHARACTERISTIC
/begin CHARACTERISTIC KIPM_ESCWhlSpdKphRLDflt_kph "" VALUE 0x0000 /* @ECU_Address@KIPM_ESCWhlSpdKphRLDflt_kph@ */ Scalar_FLOAT32_IEEE 0 AppSwcIpm_CM_single_kph -100000.0 100000.0 /end CHARACTERISTIC
/begin CHARACTERISTIC KIPM_ESCWhlSpdKphRLHi_kph "" VALUE 0x0000 /* @ECU_Address@KIPM_ESCWhlSpdKphRLHi_kph@ */ Scalar_FLOAT32_IEEE 0 AppSwcIpm_CM_single_kph -100000.0 100000.0 /end CHARACTERISTIC
/begin CHARACTERISTIC KIPM_ESCWhlSpdKphRLLo_kph "" VALUE 0x0000 /* @ECU_Address@KIPM_ESCWhlSpdKphRLLo_kph@ */ Scalar_FLOAT32_IEEE 0 AppSwcIpm_CM_single_kph -100000.0 100000.0 /end CHARACTERISTIC
/begin CHARACTERISTIC KIPM_ESCWhlSpdKphRL_kph_ovrdval "" VALUE 0x0000 /* @ECU_Address@KIPM_ESCWhlSpdKphRL_kph_ovrdval@ */ Scalar_FLOAT32_IEEE 0 AppSwcIpm_CM_single_kph -100000.0 100000.0 /end CHARACTERISTIC
/begin CHARACTERISTIC KIPM_ESCWhlSpdKphRRDflt_kph "" VALUE 0x0000 /* @ECU_Address@KIPM_ESCWhlSpdKphRRDflt_kph@ */ Scalar_FLOAT32_IEEE 0 AppSwcIpm_CM_single_kph -100000.0 100000.0 /end CHARACTERISTIC
/begin CHARACTERISTIC KIPM_ESCWhlSpdKphRRHi_kph "" VALUE 0x0000 /* @ECU_Address@KIPM_ESCWhlSpdKphRRHi_kph@ */ Scalar_FLOAT32_IEEE 0 AppSwcIpm_CM_single_kph -100000.0 100000.0 /end CHARACTERISTIC
/begin CHARACTERISTIC KIPM_ESCWhlSpdKphRRLo_kph "" VALUE 0x0000 /* @ECU_Address@KIPM_ESCWhlSpdKphRRLo_kph@ */ Scalar_FLOAT32_IEEE 0 AppSwcIpm_CM_single_kph -100000.0 100000.0 /end CHARACTERISTIC
/begin CHARACTERISTIC KIPM_ESCWhlSpdKphRR_kph_ovrdval "" VALUE 0x0000 /* @ECU_Address@KIPM_ESCWhlSpdKphRR_kph_ovrdval@ */ Scalar_FLOAT32_IEEE 0 AppSwcIpm_CM_single_kph -100000.0 100000.0 /end CHARACTERISTIC
/begin CHARACTERISTIC KIPM_ESCWhlTqDecReqValDflt_Nm "" VALUE 0x0000 /* @ECU_Address@KIPM_ESCWhlTqDecReqValDflt_Nm@ */ Scalar_FLOAT32_IEEE 0 AppSwcIpm_CM_single_Nm -100000.0 100000.0 /end CHARACTERISTIC
/begin CHARACTERISTIC KIPM_ESCWhlTqDecReqValHi_Nm "" VALUE 0x0000 /* @ECU_Address@KIPM_ESCWhlTqDecReqValHi_Nm@ */ Scalar_FLOAT32_IEEE 0 AppSwcIpm_CM_single_Nm -100000.0 100000.0 /end CHARACTERISTIC
/begin CHARACTERISTIC KIPM_ESCWhlTqDecReqValLo_Nm "" VALUE 0x0000 /* @ECU_Address@KIPM_ESCWhlTqDecReqValLo_Nm@ */ Scalar_FLOAT32_IEEE 0 AppSwcIpm_CM_single_Nm -100000.0 100000.0 /end CHARACTERISTIC
/begin CHARACTERISTIC KIPM_ESCWhlTqDecReqVal_Nm_ovrdval "" VALUE 0x0000 /* @ECU_Address@KIPM_ESCWhlTqDecReqVal_Nm_ovrdval@ */ Scalar_FLOAT32_IEEE 0 AppSwcIpm_CM_single_Nm -100000.0 100000.0 /end CHARACTERISTIC
/begin CHARACTERISTIC KIPM_ESCWhlTqIncReqValDflt_Nm "" VALUE 0x0000 /* @ECU_Address@KIPM_ESCWhlTqIncReqValDflt_Nm@ */ Scalar_FLOAT32_IEEE 0 AppSwcIpm_CM_single_Nm -100000.0 100000.0 /end CHARACTERISTIC
/begin CHARACTERISTIC KIPM_ESCWhlTqIncReqValHi_Nm "" VALUE 0x0000 /* @ECU_Address@KIPM_ESCWhlTqIncReqValHi_Nm@ */ Scalar_FLOAT32_IEEE 0 AppSwcIpm_CM_single_Nm -100000.0 100000.0 /end CHARACTERISTIC
/begin CHARACTERISTIC KIPM_ESCWhlTqIncReqValLo_Nm "" VALUE 0x0000 /* @ECU_Address@KIPM_ESCWhlTqIncReqValLo_Nm@ */ Scalar_FLOAT32_IEEE 0 AppSwcIpm_CM_single_Nm -100000.0 100000.0 /end CHARACTERISTIC
/begin CHARACTERISTIC KIPM_ESCWhlTqIncReqVal_Nm_ovrdval "" VALUE 0x0000 /* @ECU_Address@KIPM_ESCWhlTqIncReqVal_Nm_ovrdval@ */ Scalar_FLOAT32_IEEE 0 AppSwcIpm_CM_single_Nm -100000.0 100000.0 /end CHARACTERISTIC
/begin CHARACTERISTIC KIPM_ESCYawRateDflt_degps "" VALUE 0x0000 /* @ECU_Address@KIPM_ESCYawRateDflt_degps@ */ Scalar_FLOAT32_IEEE 0 AppSwcIpm_CM_single_degps -100000.0 100000.0 /end CHARACTERISTIC
/begin CHARACTERISTIC KIPM_ESCYawRateHi_degps "" VALUE 0x0000 /* @ECU_Address@KIPM_ESCYawRateHi_degps@ */ Scalar_FLOAT32_IEEE 0 AppSwcIpm_CM_single_degps -100000.0 100000.0 /end CHARACTERISTIC
/begin CHARACTERISTIC KIPM_ESCYawRateLo_degps "" VALUE 0x0000 /* @ECU_Address@KIPM_ESCYawRateLo_degps@ */ Scalar_FLOAT32_IEEE 0 AppSwcIpm_CM_single_degps -100000.0 100000.0 /end CHARACTERISTIC
/begin CHARACTERISTIC KIPM_ESCYawRate_degps_ovrdval "" VALUE 0x0000 /* @ECU_Address@KIPM_ESCYawRate_degps_ovrdval@ */ Scalar_FLOAT32_IEEE 0 AppSwcIpm_CM_single_degps -100000.0 100000.0 /end CHARACTERISTIC
/begin CHARACTERISTIC KIPM_INV1ActTorqDflt_Nm "" VALUE 0x0000 /* @ECU_Address@KIPM_INV1ActTorqDflt_Nm@ */ Scalar_FLOAT32_IEEE 0 AppSwcIpm_CM_single_Nm -100000.0 100000.0 /end CHARACTERISTIC
/begin CHARACTERISTIC KIPM_INV1ActTorqHi_Nm "" VALUE 0x0000 /* @ECU_Address@KIPM_INV1ActTorqHi_Nm@ */ Scalar_FLOAT32_IEEE 0 AppSwcIpm_CM_single_Nm -100000.0 100000.0 /end CHARACTERISTIC
/begin CHARACTERISTIC KIPM_INV1ActTorqLo_Nm "" VALUE 0x0000 /* @ECU_Address@KIPM_INV1ActTorqLo_Nm@ */ Scalar_FLOAT32_IEEE 0 AppSwcIpm_CM_single_Nm -100000.0 100000.0 /end CHARACTERISTIC
/begin CHARACTERISTIC KIPM_INV1ActTorq_Nm_ovrdval "" VALUE 0x0000 /* @ECU_Address@KIPM_INV1ActTorq_Nm_ovrdval@ */ Scalar_FLOAT32_IEEE 0 AppSwcIpm_CM_single_Nm -100000.0 100000.0 /end CHARACTERISTIC
/begin CHARACTERISTIC KIPM_INV1MotSpdDflt_rpm "" VALUE 0x0000 /* @ECU_Address@KIPM_INV1MotSpdDflt_rpm@ */ Scalar_FLOAT32_IEEE 0 AppSwcIpm_CM_single_rpm -100000.0 100000.0 /end CHARACTERISTIC
/begin CHARACTERISTIC KIPM_INV1MotSpdHi_rpm "" VALUE 0x0000 /* @ECU_Address@KIPM_INV1MotSpdHi_rpm@ */ Scalar_FLOAT32_IEEE 0 AppSwcIpm_CM_single_rpm -100000.0 100000.0 /end CHARACTERISTIC
/begin CHARACTERISTIC KIPM_INV1MotSpdLo_rpm "" VALUE 0x0000 /* @ECU_Address@KIPM_INV1MotSpdLo_rpm@ */ Scalar_FLOAT32_IEEE 0 AppSwcIpm_CM_single_rpm -100000.0 100000.0 /end CHARACTERISTIC
/begin CHARACTERISTIC KIPM_INV1MotSpd_rpm_ovrdval "" VALUE 0x0000 /* @ECU_Address@KIPM_INV1MotSpd_rpm_ovrdval@ */ Scalar_FLOAT32_IEEE 0 AppSwcIpm_CM_single_rpm -100000.0 100000.0 /end CHARACTERISTIC
/begin CHARACTERISTIC KIPM_INV2IgbtMaxTempDflt_C "" VALUE 0x0000 /* @ECU_Address@KIPM_INV2IgbtMaxTempDflt_C@ */ Scalar_FLOAT32_IEEE 0 AppSwcIpm_CM_single_C -100000.0 100000.0 /end CHARACTERISTIC
/begin CHARACTERISTIC KIPM_INV2IgbtMaxTempHi_C "" VALUE 0x0000 /* @ECU_Address@KIPM_INV2IgbtMaxTempHi_C@ */ Scalar_FLOAT32_IEEE 0 AppSwcIpm_CM_single_C -100000.0 100000.0 /end CHARACTERISTIC
/begin CHARACTERISTIC KIPM_INV2IgbtMaxTempLo_C "" VALUE 0x0000 /* @ECU_Address@KIPM_INV2IgbtMaxTempLo_C@ */ Scalar_FLOAT32_IEEE 0 AppSwcIpm_CM_single_C -100000.0 100000.0 /end CHARACTERISTIC
/begin CHARACTERISTIC KIPM_INV2IgbtMaxTemp_C_ovrdval "" VALUE 0x0000 /* @ECU_Address@KIPM_INV2IgbtMaxTemp_C_ovrdval@ */ Scalar_FLOAT32_IEEE 0 AppSwcIpm_CM_single_C -100000.0 100000.0 /end CHARACTERISTIC
/begin CHARACTERISTIC KIPM_INV2InpCurntDflt_A "" VALUE 0x0000 /* @ECU_Address@KIPM_INV2InpCurntDflt_A@ */ Scalar_FLOAT32_IEEE 0 AppSwcIpm_CM_single_A -100000.0 100000.0 /end CHARACTERISTIC
/begin CHARACTERISTIC KIPM_INV2InpCurntHi_A "" VALUE 0x0000 /* @ECU_Address@KIPM_INV2InpCurntHi_A@ */ Scalar_FLOAT32_IEEE 0 AppSwcIpm_CM_single_A -100000.0 100000.0 /end CHARACTERISTIC
/begin CHARACTERISTIC KIPM_INV2InpCurntLo_A "" VALUE 0x0000 /* @ECU_Address@KIPM_INV2InpCurntLo_A@ */ Scalar_FLOAT32_IEEE 0 AppSwcIpm_CM_single_A -100000.0 100000.0 /end CHARACTERISTIC
/begin CHARACTERISTIC KIPM_INV2InpCurnt_A_ovrdval "" VALUE 0x0000 /* @ECU_Address@KIPM_INV2InpCurnt_A_ovrdval@ */ Scalar_FLOAT32_IEEE 0 AppSwcIpm_CM_single_A -100000.0 100000.0 /end CHARACTERISTIC
/begin CHARACTERISTIC KIPM_INV2InpVoltDflt_V "" VALUE 0x0000 /* @ECU_Address@KIPM_INV2InpVoltDflt_V@ */ Scalar_FLOAT32_IEEE 0 AppSwcIpm_CM_single_V -100000.0 100000.0 /end CHARACTERISTIC
/begin CHARACTERISTIC KIPM_INV2InpVoltHi_V "" VALUE 0x0000 /* @ECU_Address@KIPM_INV2InpVoltHi_V@ */ Scalar_FLOAT32_IEEE 0 AppSwcIpm_CM_single_V -100000.0 100000.0 /end CHARACTERISTIC
/begin CHARACTERISTIC KIPM_INV2InpVoltLo_V "" VALUE 0x0000 /* @ECU_Address@KIPM_INV2InpVoltLo_V@ */ Scalar_FLOAT32_IEEE 0 AppSwcIpm_CM_single_V -100000.0 100000.0 /end CHARACTERISTIC
/begin CHARACTERISTIC KIPM_INV2InpVolt_V_ovrdval "" VALUE 0x0000 /* @ECU_Address@KIPM_INV2InpVolt_V_ovrdval@ */ Scalar_FLOAT32_IEEE 0 AppSwcIpm_CM_single_V -100000.0 100000.0 /end CHARACTERISTIC
/begin CHARACTERISTIC KIPM_INV2MotorMaxTempDflt_C "" VALUE 0x0000 /* @ECU_Address@KIPM_INV2MotorMaxTempDflt_C@ */ Scalar_FLOAT32_IEEE 0 AppSwcIpm_CM_single_C -100000.0 100000.0 /end CHARACTERISTIC
/begin CHARACTERISTIC KIPM_INV2MotorMaxTempHi_C "" VALUE 0x0000 /* @ECU_Address@KIPM_INV2MotorMaxTempHi_C@ */ Scalar_FLOAT32_IEEE 0 AppSwcIpm_CM_single_C -100000.0 100000.0 /end CHARACTERISTIC
/begin CHARACTERISTIC KIPM_INV2MotorMaxTempLo_C "" VALUE 0x0000 /* @ECU_Address@KIPM_INV2MotorMaxTempLo_C@ */ Scalar_FLOAT32_IEEE 0 AppSwcIpm_CM_single_C -100000.0 100000.0 /end CHARACTERISTIC
/begin CHARACTERISTIC KIPM_INV2MotorMaxTemp_C_ovrdval "" VALUE 0x0000 /* @ECU_Address@KIPM_INV2MotorMaxTemp_C_ovrdval@ */ Scalar_FLOAT32_IEEE 0 AppSwcIpm_CM_single_C -100000.0 100000.0 /end CHARACTERISTIC
/begin CHARACTERISTIC KIPM_IPUDCCHiVoltActCurntDflt_A "" VALUE 0x0000 /* @ECU_Address@KIPM_IPUDCCHiVoltActCurntDflt_A@ */ Scalar_FLOAT32_IEEE 0 AppSwcIpm_CM_single_A -100000.0 100000.0 /end CHARACTERISTIC
/begin CHARACTERISTIC KIPM_IPUDCCHiVoltActCurntHi_A "" VALUE 0x0000 /* @ECU_Address@KIPM_IPUDCCHiVoltActCurntHi_A@ */ Scalar_FLOAT32_IEEE 0 AppSwcIpm_CM_single_A -100000.0 100000.0 /end CHARACTERISTIC
/begin CHARACTERISTIC KIPM_IPUDCCHiVoltActCurntLo_A "" VALUE 0x0000 /* @ECU_Address@KIPM_IPUDCCHiVoltActCurntLo_A@ */ Scalar_FLOAT32_IEEE 0 AppSwcIpm_CM_single_A -100000.0 100000.0 /end CHARACTERISTIC
/begin CHARACTERISTIC KIPM_IPUDCCHiVoltActCurnt_A_ovrdval "" VALUE 0x0000 /* @ECU_Address@KIPM_IPUDCCHiVoltActCurnt_A_ovrdval@ */ Scalar_FLOAT32_IEEE 0 AppSwcIpm_CM_single_A -100000.0 100000.0 /end CHARACTERISTIC
/begin CHARACTERISTIC KIPM_IPUDCCHiVoltActVoltDflt_V "" VALUE 0x0000 /* @ECU_Address@KIPM_IPUDCCHiVoltActVoltDflt_V@ */ Scalar_FLOAT32_IEEE 0 AppSwcIpm_CM_single_V -100000.0 100000.0 /end CHARACTERISTIC
/begin CHARACTERISTIC KIPM_IPUDCCHiVoltActVoltHi_V "" VALUE 0x0000 /* @ECU_Address@KIPM_IPUDCCHiVoltActVoltHi_V@ */ Scalar_FLOAT32_IEEE 0 AppSwcIpm_CM_single_V -100000.0 100000.0 /end CHARACTERISTIC
/begin CHARACTERISTIC KIPM_IPUDCCHiVoltActVoltLo_V "" VALUE 0x0000 /* @ECU_Address@KIPM_IPUDCCHiVoltActVoltLo_V@ */ Scalar_FLOAT32_IEEE 0 AppSwcIpm_CM_single_V -100000.0 100000.0 /end CHARACTERISTIC
/begin CHARACTERISTIC KIPM_IPUDCCHiVoltActVolt_V_ovrdval "" VALUE 0x0000 /* @ECU_Address@KIPM_IPUDCCHiVoltActVolt_V_ovrdval@ */ Scalar_FLOAT32_IEEE 0 AppSwcIpm_CM_single_V -100000.0 100000.0 /end CHARACTERISTIC
/begin CHARACTERISTIC KIPM_IPUDCCLoVoltActCurntDflt_A "" VALUE 0x0000 /* @ECU_Address@KIPM_IPUDCCLoVoltActCurntDflt_A@ */ Scalar_FLOAT32_IEEE 0 AppSwcIpm_CM_single_A -100000.0 100000.0 /end CHARACTERISTIC
/begin CHARACTERISTIC KIPM_IPUDCCLoVoltActCurntHi_A "" VALUE 0x0000 /* @ECU_Address@KIPM_IPUDCCLoVoltActCurntHi_A@ */ Scalar_FLOAT32_IEEE 0 AppSwcIpm_CM_single_A -100000.0 100000.0 /end CHARACTERISTIC
/begin CHARACTERISTIC KIPM_IPUDCCLoVoltActCurntLo_A "" VALUE 0x0000 /* @ECU_Address@KIPM_IPUDCCLoVoltActCurntLo_A@ */ Scalar_FLOAT32_IEEE 0 AppSwcIpm_CM_single_A -100000.0 100000.0 /end CHARACTERISTIC
/begin CHARACTERISTIC KIPM_IPUDCCLoVoltActCurnt_A_ovrdval "" VALUE 0x0000 /* @ECU_Address@KIPM_IPUDCCLoVoltActCurnt_A_ovrdval@ */ Scalar_FLOAT32_IEEE 0 AppSwcIpm_CM_single_A -100000.0 100000.0 /end CHARACTERISTIC
/begin CHARACTERISTIC KIPM_IPUDCCLoVoltActVoltDflt_V "" VALUE 0x0000 /* @ECU_Address@KIPM_IPUDCCLoVoltActVoltDflt_V@ */ Scalar_FLOAT32_IEEE 0 AppSwcIpm_CM_single_V -100000.0 100000.0 /end CHARACTERISTIC
/begin CHARACTERISTIC KIPM_IPUDCCLoVoltActVoltHi_V "" VALUE 0x0000 /* @ECU_Address@KIPM_IPUDCCLoVoltActVoltHi_V@ */ Scalar_FLOAT32_IEEE 0 AppSwcIpm_CM_single_V -100000.0 100000.0 /end CHARACTERISTIC
/begin CHARACTERISTIC KIPM_IPUDCCLoVoltActVoltLo_V "" VALUE 0x0000 /* @ECU_Address@KIPM_IPUDCCLoVoltActVoltLo_V@ */ Scalar_FLOAT32_IEEE 0 AppSwcIpm_CM_single_V -100000.0 100000.0 /end CHARACTERISTIC
/begin CHARACTERISTIC KIPM_IPUDCCLoVoltActVolt_V_ovrdval "" VALUE 0x0000 /* @ECU_Address@KIPM_IPUDCCLoVoltActVolt_V_ovrdval@ */ Scalar_FLOAT32_IEEE 0 AppSwcIpm_CM_single_V -100000.0 100000.0 /end CHARACTERISTIC
/begin CHARACTERISTIC KIPM_IPUDeviceIntTempDflt_C "" VALUE 0x0000 /* @ECU_Address@KIPM_IPUDeviceIntTempDflt_C@ */ Scalar_FLOAT32_IEEE 0 AppSwcIpm_CM_single_C -100000.0 100000.0 /end CHARACTERISTIC
/begin CHARACTERISTIC KIPM_IPUDeviceIntTempHi_C "" VALUE 0x0000 /* @ECU_Address@KIPM_IPUDeviceIntTempHi_C@ */ Scalar_FLOAT32_IEEE 0 AppSwcIpm_CM_single_C -100000.0 100000.0 /end CHARACTERISTIC
/begin CHARACTERISTIC KIPM_IPUDeviceIntTempLo_C "" VALUE 0x0000 /* @ECU_Address@KIPM_IPUDeviceIntTempLo_C@ */ Scalar_FLOAT32_IEEE 0 AppSwcIpm_CM_single_C -100000.0 100000.0 /end CHARACTERISTIC
/begin CHARACTERISTIC KIPM_IPUDeviceIntTemp_C_ovrdval "" VALUE 0x0000 /* @ECU_Address@KIPM_IPUDeviceIntTemp_C_ovrdval@ */ Scalar_FLOAT32_IEEE 0 AppSwcIpm_CM_single_C -100000.0 100000.0 /end CHARACTERISTIC
/begin CHARACTERISTIC KIPM_IPUOBCACMaxPwrAllowDflt_kW "" VALUE 0x0000 /* @ECU_Address@KIPM_IPUOBCACMaxPwrAllowDflt_kW@ */ Scalar_FLOAT32_IEEE 0 AppSwcIpm_CM_single_kW -100000.0 100000.0 /end CHARACTERISTIC
/begin CHARACTERISTIC KIPM_IPUOBCACMaxPwrAllowHi_kW "" VALUE 0x0000 /* @ECU_Address@KIPM_IPUOBCACMaxPwrAllowHi_kW@ */ Scalar_FLOAT32_IEEE 0 AppSwcIpm_CM_single_kW -100000.0 100000.0 /end CHARACTERISTIC
/begin CHARACTERISTIC KIPM_IPUOBCACMaxPwrAllowLo_kW "" VALUE 0x0000 /* @ECU_Address@KIPM_IPUOBCACMaxPwrAllowLo_kW@ */ Scalar_FLOAT32_IEEE 0 AppSwcIpm_CM_single_kW -100000.0 100000.0 /end CHARACTERISTIC
/begin CHARACTERISTIC KIPM_IPUOBCACMaxPwrAllow_kW_ovrdval "" VALUE 0x0000 /* @ECU_Address@KIPM_IPUOBCACMaxPwrAllow_kW_ovrdval@ */ Scalar_FLOAT32_IEEE 0 AppSwcIpm_CM_single_kW -100000.0 100000.0 /end CHARACTERISTIC
/begin CHARACTERISTIC KIPM_IPUOBCHVDCActCurDflt_A "" VALUE 0x0000 /* @ECU_Address@KIPM_IPUOBCHVDCActCurDflt_A@ */ Scalar_FLOAT32_IEEE 0 AppSwcIpm_CM_single_A -100000.0 100000.0 /end CHARACTERISTIC
/begin CHARACTERISTIC KIPM_IPUOBCHVDCActCurHi_A "" VALUE 0x0000 /* @ECU_Address@KIPM_IPUOBCHVDCActCurHi_A@ */ Scalar_FLOAT32_IEEE 0 AppSwcIpm_CM_single_A -100000.0 100000.0 /end CHARACTERISTIC
/begin CHARACTERISTIC KIPM_IPUOBCHVDCActCurLo_A "" VALUE 0x0000 /* @ECU_Address@KIPM_IPUOBCHVDCActCurLo_A@ */ Scalar_FLOAT32_IEEE 0 AppSwcIpm_CM_single_A -100000.0 100000.0 /end CHARACTERISTIC
/begin CHARACTERISTIC KIPM_IPUOBCHVDCActCur_A_ovrdval "" VALUE 0x0000 /* @ECU_Address@KIPM_IPUOBCHVDCActCur_A_ovrdval@ */ Scalar_FLOAT32_IEEE 0 AppSwcIpm_CM_single_A -100000.0 100000.0 /end CHARACTERISTIC
/begin CHARACTERISTIC KIPM_IPUOBCHVDCActVolDflt_V "" VALUE 0x0000 /* @ECU_Address@KIPM_IPUOBCHVDCActVolDflt_V@ */ Scalar_FLOAT32_IEEE 0 AppSwcIpm_CM_single_V -100000.0 100000.0 /end CHARACTERISTIC
/begin CHARACTERISTIC KIPM_IPUOBCHVDCActVolHi_V "" VALUE 0x0000 /* @ECU_Address@KIPM_IPUOBCHVDCActVolHi_V@ */ Scalar_FLOAT32_IEEE 0 AppSwcIpm_CM_single_V -100000.0 100000.0 /end CHARACTERISTIC
/begin CHARACTERISTIC KIPM_IPUOBCHVDCActVolLo_V "" VALUE 0x0000 /* @ECU_Address@KIPM_IPUOBCHVDCActVolLo_V@ */ Scalar_FLOAT32_IEEE 0 AppSwcIpm_CM_single_V -100000.0 100000.0 /end CHARACTERISTIC
/begin CHARACTERISTIC KIPM_IPUOBCHVDCActVol_V_ovrdval "" VALUE 0x0000 /* @ECU_Address@KIPM_IPUOBCHVDCActVol_V_ovrdval@ */ Scalar_FLOAT32_IEEE 0 AppSwcIpm_CM_single_V -100000.0 100000.0 /end CHARACTERISTIC
/begin CHARACTERISTIC KIPM_IPUOBCInletActPwrDflt_kW "" VALUE 0x0000 /* @ECU_Address@KIPM_IPUOBCInletActPwrDflt_kW@ */ Scalar_FLOAT32_IEEE 0 AppSwcIpm_CM_single_kW -100000.0 100000.0 /end CHARACTERISTIC
/begin CHARACTERISTIC KIPM_IPUOBCInletActPwrHi_kW "" VALUE 0x0000 /* @ECU_Address@KIPM_IPUOBCInletActPwrHi_kW@ */ Scalar_FLOAT32_IEEE 0 AppSwcIpm_CM_single_kW -100000.0 100000.0 /end CHARACTERISTIC
/begin CHARACTERISTIC KIPM_IPUOBCInletActPwrLo_kW "" VALUE 0x0000 /* @ECU_Address@KIPM_IPUOBCInletActPwrLo_kW@ */ Scalar_FLOAT32_IEEE 0 AppSwcIpm_CM_single_kW -100000.0 100000.0 /end CHARACTERISTIC
/begin CHARACTERISTIC KIPM_IPUOBCInletActPwr_kW_ovrdval "" VALUE 0x0000 /* @ECU_Address@KIPM_IPUOBCInletActPwr_kW_ovrdval@ */ Scalar_FLOAT32_IEEE 0 AppSwcIpm_CM_single_kW -100000.0 100000.0 /end CHARACTERISTIC
/begin CHARACTERISTIC KIPM_IPUOBCTempIntDflt_C "" VALUE 0x0000 /* @ECU_Address@KIPM_IPUOBCTempIntDflt_C@ */ Scalar_FLOAT32_IEEE 0 AppSwcIpm_CM_single_C -100000.0 100000.0 /end CHARACTERISTIC
/begin CHARACTERISTIC KIPM_IPUOBCTempIntHi_C "" VALUE 0x0000 /* @ECU_Address@KIPM_IPUOBCTempIntHi_C@ */ Scalar_FLOAT32_IEEE 0 AppSwcIpm_CM_single_C -100000.0 100000.0 /end CHARACTERISTIC
/begin CHARACTERISTIC KIPM_IPUOBCTempIntLo_C "" VALUE 0x0000 /* @ECU_Address@KIPM_IPUOBCTempIntLo_C@ */ Scalar_FLOAT32_IEEE 0 AppSwcIpm_CM_single_C -100000.0 100000.0 /end CHARACTERISTIC
/begin CHARACTERISTIC KIPM_IPUOBCTempInt_C_ovrdval "" VALUE 0x0000 /* @ECU_Address@KIPM_IPUOBCTempInt_C_ovrdval@ */ Scalar_FLOAT32_IEEE 0 AppSwcIpm_CM_single_C -100000.0 100000.0 /end CHARACTERISTIC
/begin CHARACTERISTIC KIPM_IPUDCCActOprtModeDflt_enum "" VALUE 0x0000 /* @ECU_Address@KIPM_IPUDCCActOprtModeDflt_enum@ */ Scalar_UBYTE 0 AppSwcIpm_CM_EnumDCCActMd 0 7 /end CHARACTERISTIC
/begin CHARACTERISTIC KIPM_IPUDCCActOprtMode_enum_ovrdval "" VALUE 0x0000 /* @ECU_Address@KIPM_IPUDCCActOprtMode_enum_ovrdval@ */ Scalar_UBYTE 0 AppSwcIpm_CM_EnumDCCActMd 0 7 /end CHARACTERISTIC
/begin CHARACTERISTIC KIPM_EHBEPBActuatorStRDflt_enum "" VALUE 0x0000 /* @ECU_Address@KIPM_EHBEPBActuatorStRDflt_enum@ */ Scalar_UBYTE 0 AppSwcIpm_CM_EnumEPBState 0 6 /end CHARACTERISTIC
/begin CHARACTERISTIC KIPM_EHBEPBActuatorStR_enum_ovrdval "" VALUE 0x0000 /* @ECU_Address@KIPM_EHBEPBActuatorStR_enum_ovrdval@ */ Scalar_UBYTE 0 AppSwcIpm_CM_EnumEPBState 0 6 /end CHARACTERISTIC
/begin CHARACTERISTIC KIPM_INV1ActModeDflt_enum "" VALUE 0x0000 /* @ECU_Address@KIPM_INV1ActModeDflt_enum@ */ Scalar_UBYTE 0 AppSwcIpm_CM_EnumINVActMd 0 7 /end CHARACTERISTIC
/begin CHARACTERISTIC KIPM_INV1ActMode_enum_ovrdval "" VALUE 0x0000 /* @ECU_Address@KIPM_INV1ActMode_enum_ovrdval@ */ Scalar_UBYTE 0 AppSwcIpm_CM_EnumINVActMd 0 7 /end CHARACTERISTIC
/begin CHARACTERISTIC KIPM_IPUOBCActOprtModeDflt_enum "" VALUE 0x0000 /* @ECU_Address@KIPM_IPUOBCActOprtModeDflt_enum@ */ Scalar_UBYTE 0 AppSwcIpm_CM_EnumOBCActMd 0 15 /end CHARACTERISTIC
/begin CHARACTERISTIC KIPM_IPUOBCActOprtMode_enum_ovrdval "" VALUE 0x0000 /* @ECU_Address@KIPM_IPUOBCActOprtMode_enum_ovrdval@ */ Scalar_UBYTE 0 AppSwcIpm_CM_EnumOBCActMd 0 15 /end CHARACTERISTIC
/begin CHARACTERISTIC KIPM_IPUOBCInletConnectStaDflt_enum "" VALUE 0x0000 /* @ECU_Address@KIPM_IPUOBCInletConnectStaDflt_enum@ */ Scalar_UBYTE 0 AppSwcIpm_CM_EnumOBCPlugSt 0 3 /end CHARACTERISTIC
/begin CHARACTERISTIC KIPM_IPUOBCInletConnectSta_enum_ovrdval "" VALUE 0x0000 /* @ECU_Address@KIPM_IPUOBCInletConnectSta_enum_ovrdval@ */ Scalar_UBYTE 0 AppSwcIpm_CM_EnumOBCPlugSt 0 3 /end CHARACTERISTIC
/begin CHARACTERISTIC KIPM_IPUOBCReqDflt_enum "" VALUE 0x0000 /* @ECU_Address@KIPM_IPUOBCReqDflt_enum@ */ Scalar_UBYTE 0 AppSwcIpm_CM_EnumOBCReq 0 3 /end CHARACTERISTIC
/begin CHARACTERISTIC KIPM_IPUOBCReq_enum_ovrdval "" VALUE 0x0000 /* @ECU_Address@KIPM_IPUOBCReq_enum_ovrdval@ */ Scalar_UBYTE 0 AppSwcIpm_CM_EnumOBCReq 0 3 /end CHARACTERISTIC
/begin CHARACTERISTIC KIPM_IPUOBCWakeUpModeDflt_enum "" VALUE 0x0000 /* @ECU_Address@KIPM_IPUOBCWakeUpModeDflt_enum@ */ Scalar_UBYTE 0 AppSwcIpm_CM_EnumOBCWakeUpMd 0 7 /end CHARACTERISTIC
/begin CHARACTERISTIC KIPM_IPUOBCWakeUpMode_enum_ovrdval "" VALUE 0x0000 /* @ECU_Address@KIPM_IPUOBCWakeUpMode_enum_ovrdval@ */ Scalar_UBYTE 0 AppSwcIpm_CM_EnumOBCWakeUpMd 0 7 /end CHARACTERISTIC
/begin CHARACTERISTIC KIPM_EHBBrkPwrRecupTarWhlTqStsDflt_enum "" VALUE 0x0000 /* @ECU_Address@KIPM_EHBBrkPwrRecupTarWhlTqStsDflt_enum@ */ Scalar_UBYTE 0 AppSwcIpm_CM_EnumRegenTgtTqStat 0 3 /end CHARACTERISTIC
/begin CHARACTERISTIC KIPM_EHBBrkPwrRecupTarWhlTqSts_enum_ovrdval "" VALUE 0x0000 /* @ECU_Address@KIPM_EHBBrkPwrRecupTarWhlTqSts_enum_ovrdval@ */ Scalar_UBYTE 0 AppSwcIpm_CM_EnumRegenTgtTqStat 0 3 /end CHARACTERISTIC
/begin CHARACTERISTIC KIPM_BMSBatCapcty_Ah_ovrdflg "" VALUE 0x0000 /* @ECU_Address@KIPM_BMSBatCapcty_Ah_ovrdflg@ */ Scalar_BOOLEAN 0 AppSwcIpm_CM_boolean_flg 0.0 1.0 /end CHARACTERISTIC
/begin CHARACTERISTIC KIPM_BMSHVBatCellTempAve_C_ovrdflg "" VALUE 0x0000 /* @ECU_Address@KIPM_BMSHVBatCellTempAve_C_ovrdflg@ */ Scalar_BOOLEAN 0 AppSwcIpm_CM_boolean_flg 0.0 1.0 /end CHARACTERISTIC
/begin CHARACTERISTIC KIPM_BMSHVBatCellTempMax_C_ovrdflg "" VALUE 0x0000 /* @ECU_Address@KIPM_BMSHVBatCellTempMax_C_ovrdflg@ */ Scalar_BOOLEAN 0 AppSwcIpm_CM_boolean_flg 0.0 1.0 /end CHARACTERISTIC
/begin CHARACTERISTIC KIPM_BMSHVBatCellTempMin_C_ovrdflg "" VALUE 0x0000 /* @ECU_Address@KIPM_BMSHVBatCellTempMin_C_ovrdflg@ */ Scalar_BOOLEAN 0 AppSwcIpm_CM_boolean_flg 0.0 1.0 /end CHARACTERISTIC
/begin CHARACTERISTIC KIPM_BMSPackID_enum_ovrdflg "" VALUE 0x0000 /* @ECU_Address@KIPM_BMSPackID_enum_ovrdflg@ */ Scalar_BOOLEAN 0 AppSwcIpm_CM_boolean_flg 0.0 1.0 /end CHARACTERISTIC
/begin CHARACTERISTIC KIPM_EHBBrkPedlValPerc_pct_ovrdflg "" VALUE 0x0000 /* @ECU_Address@KIPM_EHBBrkPedlValPerc_pct_ovrdflg@ */ Scalar_BOOLEAN 0 AppSwcIpm_CM_boolean_flg 0.0 1.0 /end CHARACTERISTIC
/begin CHARACTERISTIC KIPM_EHBBrkPwrRecupTarWhlTqSts_enum_ovrdflg "" VALUE 0x0000 /* @ECU_Address@KIPM_EHBBrkPwrRecupTarWhlTqSts_enum_ovrdflg@ */ Scalar_BOOLEAN 0 AppSwcIpm_CM_boolean_flg 0.0 1.0 /end CHARACTERISTIC
/begin CHARACTERISTIC KIPM_EHBBrkPwrRecupTarWhlTq_Nm_ovrdflg "" VALUE 0x0000 /* @ECU_Address@KIPM_EHBBrkPwrRecupTarWhlTq_Nm_ovrdflg@ */ Scalar_BOOLEAN 0 AppSwcIpm_CM_boolean_flg 0.0 1.0 /end CHARACTERISTIC
/begin CHARACTERISTIC KIPM_EHBCDDActvDflt_flg "" VALUE 0x0000 /* @ECU_Address@KIPM_EHBCDDActvDflt_flg@ */ Scalar_BOOLEAN 0 AppSwcIpm_CM_boolean_flg 0.0 1.0 /end CHARACTERISTIC
/begin CHARACTERISTIC KIPM_EHBCDDActv_flg_ovrdflg "" VALUE 0x0000 /* @ECU_Address@KIPM_EHBCDDActv_flg_ovrdflg@ */ Scalar_BOOLEAN 0 AppSwcIpm_CM_boolean_flg 0.0 1.0 /end CHARACTERISTIC
/begin CHARACTERISTIC KIPM_EHBCDDActv_flg_ovrdval "" VALUE 0x0000 /* @ECU_Address@KIPM_EHBCDDActv_flg_ovrdval@ */ Scalar_BOOLEAN 0 AppSwcIpm_CM_boolean_flg 0.0 1.0 /end CHARACTERISTIC
/begin CHARACTERISTIC KIPM_EHBEPBActuatorStR_enum_ovrdflg "" VALUE 0x0000 /* @ECU_Address@KIPM_EHBEPBActuatorStR_enum_ovrdflg@ */ Scalar_BOOLEAN 0 AppSwcIpm_CM_boolean_flg 0.0 1.0 /end CHARACTERISTIC
/begin CHARACTERISTIC KIPM_EHBEPBDynAppSt_enum_ovrdflg "" VALUE 0x0000 /* @ECU_Address@KIPM_EHBEPBDynAppSt_enum_ovrdflg@ */ Scalar_BOOLEAN 0 AppSwcIpm_CM_boolean_flg 0.0 1.0 /end CHARACTERISTIC
/begin CHARACTERISTIC KIPM_EHBFltLvl_enum_ovrdflg "" VALUE 0x0000 /* @ECU_Address@KIPM_EHBFltLvl_enum_ovrdflg@ */ Scalar_BOOLEAN 0 AppSwcIpm_CM_boolean_flg 0.0 1.0 /end CHARACTERISTIC
/begin CHARACTERISTIC KIPM_EHBReqBrkLiOnDflt_flg "" VALUE 0x0000 /* @ECU_Address@KIPM_EHBReqBrkLiOnDflt_flg@ */ Scalar_BOOLEAN 0 AppSwcIpm_CM_boolean_flg 0.0 1.0 /end CHARACTERISTIC
/begin CHARACTERISTIC KIPM_EHBReqBrkLiOn_flg_ovrdflg "" VALUE 0x0000 /* @ECU_Address@KIPM_EHBReqBrkLiOn_flg_ovrdflg@ */ Scalar_BOOLEAN 0 AppSwcIpm_CM_boolean_flg 0.0 1.0 /end CHARACTERISTIC
/begin CHARACTERISTIC KIPM_EHBReqBrkLiOn_flg_ovrdval "" VALUE 0x0000 /* @ECU_Address@KIPM_EHBReqBrkLiOn_flg_ovrdval@ */ Scalar_BOOLEAN 0 AppSwcIpm_CM_boolean_flg 0.0 1.0 /end CHARACTERISTIC
/begin CHARACTERISTIC KIPM_EPSRotSpd_degps_ovrdflg "" VALUE 0x0000 /* @ECU_Address@KIPM_EPSRotSpd_degps_ovrdflg@ */ Scalar_BOOLEAN 0 AppSwcIpm_CM_boolean_flg 0.0 1.0 /end CHARACTERISTIC
/begin CHARACTERISTIC KIPM_EPSSteerWhlAngCaldDflt_flg "" VALUE 0x0000 /* @ECU_Address@KIPM_EPSSteerWhlAngCaldDflt_flg@ */ Scalar_BOOLEAN 0 AppSwcIpm_CM_boolean_flg 0.0 1.0 /end CHARACTERISTIC
/begin CHARACTERISTIC KIPM_EPSSteerWhlAngCald_flg_ovrdflg "" VALUE 0x0000 /* @ECU_Address@KIPM_EPSSteerWhlAngCald_flg_ovrdflg@ */ Scalar_BOOLEAN 0 AppSwcIpm_CM_boolean_flg 0.0 1.0 /end CHARACTERISTIC
/begin CHARACTERISTIC KIPM_EPSSteerWhlAngCald_flg_ovrdval "" VALUE 0x0000 /* @ECU_Address@KIPM_EPSSteerWhlAngCald_flg_ovrdval@ */ Scalar_BOOLEAN 0 AppSwcIpm_CM_boolean_flg 0.0 1.0 /end CHARACTERISTIC
/begin CHARACTERISTIC KIPM_EPSSteerWhlAngFailrDflt_flg "" VALUE 0x0000 /* @ECU_Address@KIPM_EPSSteerWhlAngFailrDflt_flg@ */ Scalar_BOOLEAN 0 AppSwcIpm_CM_boolean_flg 0.0 1.0 /end CHARACTERISTIC
/begin CHARACTERISTIC KIPM_EPSSteerWhlAngFailr_flg_ovrdflg "" VALUE 0x0000 /* @ECU_Address@KIPM_EPSSteerWhlAngFailr_flg_ovrdflg@ */ Scalar_BOOLEAN 0 AppSwcIpm_CM_boolean_flg 0.0 1.0 /end CHARACTERISTIC
/begin CHARACTERISTIC KIPM_EPSSteerWhlAngFailr_flg_ovrdval "" VALUE 0x0000 /* @ECU_Address@KIPM_EPSSteerWhlAngFailr_flg_ovrdval@ */ Scalar_BOOLEAN 0 AppSwcIpm_CM_boolean_flg 0.0 1.0 /end CHARACTERISTIC
/begin CHARACTERISTIC KIPM_EPSSteerWhlAng_deg_ovrdflg "" VALUE 0x0000 /* @ECU_Address@KIPM_EPSSteerWhlAng_deg_ovrdflg@ */ Scalar_BOOLEAN 0 AppSwcIpm_CM_boolean_flg 0.0 1.0 /end CHARACTERISTIC
/begin CHARACTERISTIC KIPM_ESCABSActvStaDflt_flg "" VALUE 0x0000 /* @ECU_Address@KIPM_ESCABSActvStaDflt_flg@ */ Scalar_BOOLEAN 0 AppSwcIpm_CM_boolean_flg 0.0 1.0 /end CHARACTERISTIC
/begin CHARACTERISTIC KIPM_ESCABSActvSta_flg_ovrdflg "" VALUE 0x0000 /* @ECU_Address@KIPM_ESCABSActvSta_flg_ovrdflg@ */ Scalar_BOOLEAN 0 AppSwcIpm_CM_boolean_flg 0.0 1.0 /end CHARACTERISTIC
/begin CHARACTERISTIC KIPM_ESCABSActvSta_flg_ovrdval "" VALUE 0x0000 /* @ECU_Address@KIPM_ESCABSActvSta_flg_ovrdval@ */ Scalar_BOOLEAN 0 AppSwcIpm_CM_boolean_flg 0.0 1.0 /end CHARACTERISTIC
/begin CHARACTERISTIC KIPM_ESCCDPActvDflt_flg "" VALUE 0x0000 /* @ECU_Address@KIPM_ESCCDPActvDflt_flg@ */ Scalar_BOOLEAN 0 AppSwcIpm_CM_boolean_flg 0.0 1.0 /end CHARACTERISTIC
/begin CHARACTERISTIC KIPM_ESCCDPActv_flg_ovrdflg "" VALUE 0x0000 /* @ECU_Address@KIPM_ESCCDPActv_flg_ovrdflg@ */ Scalar_BOOLEAN 0 AppSwcIpm_CM_boolean_flg 0.0 1.0 /end CHARACTERISTIC
/begin CHARACTERISTIC KIPM_ESCCDPActv_flg_ovrdval "" VALUE 0x0000 /* @ECU_Address@KIPM_ESCCDPActv_flg_ovrdval@ */ Scalar_BOOLEAN 0 AppSwcIpm_CM_boolean_flg 0.0 1.0 /end CHARACTERISTIC
/begin CHARACTERISTIC KIPM_ESCEBDActvDflt_flg "" VALUE 0x0000 /* @ECU_Address@KIPM_ESCEBDActvDflt_flg@ */ Scalar_BOOLEAN 0 AppSwcIpm_CM_boolean_flg 0.0 1.0 /end CHARACTERISTIC
/begin CHARACTERISTIC KIPM_ESCEBDActv_flg_ovrdflg "" VALUE 0x0000 /* @ECU_Address@KIPM_ESCEBDActv_flg_ovrdflg@ */ Scalar_BOOLEAN 0 AppSwcIpm_CM_boolean_flg 0.0 1.0 /end CHARACTERISTIC
/begin CHARACTERISTIC KIPM_ESCEBDActv_flg_ovrdval "" VALUE 0x0000 /* @ECU_Address@KIPM_ESCEBDActv_flg_ovrdval@ */ Scalar_BOOLEAN 0 AppSwcIpm_CM_boolean_flg 0.0 1.0 /end CHARACTERISTIC
/begin CHARACTERISTIC KIPM_ESCESPActvStaDflt_flg "" VALUE 0x0000 /* @ECU_Address@KIPM_ESCESPActvStaDflt_flg@ */ Scalar_BOOLEAN 0 AppSwcIpm_CM_boolean_flg 0.0 1.0 /end CHARACTERISTIC
/begin CHARACTERISTIC KIPM_ESCESPActvSta_flg_ovrdflg "" VALUE 0x0000 /* @ECU_Address@KIPM_ESCESPActvSta_flg_ovrdflg@ */ Scalar_BOOLEAN 0 AppSwcIpm_CM_boolean_flg 0.0 1.0 /end CHARACTERISTIC
/begin CHARACTERISTIC KIPM_ESCESPActvSta_flg_ovrdval "" VALUE 0x0000 /* @ECU_Address@KIPM_ESCESPActvSta_flg_ovrdval@ */ Scalar_BOOLEAN 0 AppSwcIpm_CM_boolean_flg 0.0 1.0 /end CHARACTERISTIC
/begin CHARACTERISTIC KIPM_ESCESSActvDflt_flg "" VALUE 0x0000 /* @ECU_Address@KIPM_ESCESSActvDflt_flg@ */ Scalar_BOOLEAN 0 AppSwcIpm_CM_boolean_flg 0.0 1.0 /end CHARACTERISTIC
/begin CHARACTERISTIC KIPM_ESCESSActv_flg_ovrdflg "" VALUE 0x0000 /* @ECU_Address@KIPM_ESCESSActv_flg_ovrdflg@ */ Scalar_BOOLEAN 0 AppSwcIpm_CM_boolean_flg 0.0 1.0 /end CHARACTERISTIC
/begin CHARACTERISTIC KIPM_ESCESSActv_flg_ovrdval "" VALUE 0x0000 /* @ECU_Address@KIPM_ESCESSActv_flg_ovrdval@ */ Scalar_BOOLEAN 0 AppSwcIpm_CM_boolean_flg 0.0 1.0 /end CHARACTERISTIC
/begin CHARACTERISTIC KIPM_ESCFltLvl_enum_ovrdflg "" VALUE 0x0000 /* @ECU_Address@KIPM_ESCFltLvl_enum_ovrdflg@ */ Scalar_BOOLEAN 0 AppSwcIpm_CM_boolean_flg 0.0 1.0 /end CHARACTERISTIC
/begin CHARACTERISTIC KIPM_ESCLatAccSnsrVal_g_ovrdflg "" VALUE 0x0000 /* @ECU_Address@KIPM_ESCLatAccSnsrVal_g_ovrdflg@ */ Scalar_BOOLEAN 0 AppSwcIpm_CM_boolean_flg 0.0 1.0 /end CHARACTERISTIC
/begin CHARACTERISTIC KIPM_ESCLongAccSnsrVal_g_ovrdflg "" VALUE 0x0000 /* @ECU_Address@KIPM_ESCLongAccSnsrVal_g_ovrdflg@ */ Scalar_BOOLEAN 0 AppSwcIpm_CM_boolean_flg 0.0 1.0 /end CHARACTERISTIC
/begin CHARACTERISTIC KIPM_ESCMstrCylPresr_bar_ovrdflg "" VALUE 0x0000 /* @ECU_Address@KIPM_ESCMstrCylPresr_bar_ovrdflg@ */ Scalar_BOOLEAN 0 AppSwcIpm_CM_boolean_flg 0.0 1.0 /end CHARACTERISTIC
/begin CHARACTERISTIC KIPM_ESCReqBrkLghtOnDflt_flg "" VALUE 0x0000 /* @ECU_Address@KIPM_ESCReqBrkLghtOnDflt_flg@ */ Scalar_BOOLEAN 0 AppSwcIpm_CM_boolean_flg 0.0 1.0 /end CHARACTERISTIC
/begin CHARACTERISTIC KIPM_ESCReqBrkLghtOn_flg_ovrdflg "" VALUE 0x0000 /* @ECU_Address@KIPM_ESCReqBrkLghtOn_flg_ovrdflg@ */ Scalar_BOOLEAN 0 AppSwcIpm_CM_boolean_flg 0.0 1.0 /end CHARACTERISTIC
/begin CHARACTERISTIC KIPM_ESCReqBrkLghtOn_flg_ovrdval "" VALUE 0x0000 /* @ECU_Address@KIPM_ESCReqBrkLghtOn_flg_ovrdval@ */ Scalar_BOOLEAN 0 AppSwcIpm_CM_boolean_flg 0.0 1.0 /end CHARACTERISTIC
/begin CHARACTERISTIC KIPM_ESCSlopPct_pct_ovrdflg "" VALUE 0x0000 /* @ECU_Address@KIPM_ESCSlopPct_pct_ovrdflg@ */ Scalar_BOOLEAN 0 AppSwcIpm_CM_boolean_flg 0.0 1.0 /end CHARACTERISTIC
/begin CHARACTERISTIC KIPM_ESCTCSActvStaDflt_flg "" VALUE 0x0000 /* @ECU_Address@KIPM_ESCTCSActvStaDflt_flg@ */ Scalar_BOOLEAN 0 AppSwcIpm_CM_boolean_flg 0.0 1.0 /end CHARACTERISTIC
/begin CHARACTERISTIC KIPM_ESCTCSActvSta_flg_ovrdflg "" VALUE 0x0000 /* @ECU_Address@KIPM_ESCTCSActvSta_flg_ovrdflg@ */ Scalar_BOOLEAN 0 AppSwcIpm_CM_boolean_flg 0.0 1.0 /end CHARACTERISTIC
/begin CHARACTERISTIC KIPM_ESCTCSActvSta_flg_ovrdval "" VALUE 0x0000 /* @ECU_Address@KIPM_ESCTCSActvSta_flg_ovrdval@ */ Scalar_BOOLEAN 0 AppSwcIpm_CM_boolean_flg 0.0 1.0 /end CHARACTERISTIC
/begin CHARACTERISTIC KIPM_ESCVehSpd_kph_ovrdflg "" VALUE 0x0000 /* @ECU_Address@KIPM_ESCVehSpd_kph_ovrdflg@ */ Scalar_BOOLEAN 0 AppSwcIpm_CM_boolean_flg 0.0 1.0 /end CHARACTERISTIC
/begin CHARACTERISTIC KIPM_ESCVehStandStillSta_enum_ovrdflg "" VALUE 0x0000 /* @ECU_Address@KIPM_ESCVehStandStillSta_enum_ovrdflg@ */ Scalar_BOOLEAN 0 AppSwcIpm_CM_boolean_flg 0.0 1.0 /end CHARACTERISTIC
/begin CHARACTERISTIC KIPM_ESCWhlDirctnFL_enum_ovrdflg "" VALUE 0x0000 /* @ECU_Address@KIPM_ESCWhlDirctnFL_enum_ovrdflg@ */ Scalar_BOOLEAN 0 AppSwcIpm_CM_boolean_flg 0.0 1.0 /end CHARACTERISTIC
/begin CHARACTERISTIC KIPM_ESCWhlDirctnFR_enum_ovrdflg "" VALUE 0x0000 /* @ECU_Address@KIPM_ESCWhlDirctnFR_enum_ovrdflg@ */ Scalar_BOOLEAN 0 AppSwcIpm_CM_boolean_flg 0.0 1.0 /end CHARACTERISTIC
/begin CHARACTERISTIC KIPM_ESCWhlDirctnRL_enum_ovrdflg "" VALUE 0x0000 /* @ECU_Address@KIPM_ESCWhlDirctnRL_enum_ovrdflg@ */ Scalar_BOOLEAN 0 AppSwcIpm_CM_boolean_flg 0.0 1.0 /end CHARACTERISTIC
/begin CHARACTERISTIC KIPM_ESCWhlDirctnRR_enum_ovrdflg "" VALUE 0x0000 /* @ECU_Address@KIPM_ESCWhlDirctnRR_enum_ovrdflg@ */ Scalar_BOOLEAN 0 AppSwcIpm_CM_boolean_flg 0.0 1.0 /end CHARACTERISTIC
/begin CHARACTERISTIC KIPM_ESCWhlSpdKphFL_kph_ovrdflg "" VALUE 0x0000 /* @ECU_Address@KIPM_ESCWhlSpdKphFL_kph_ovrdflg@ */ Scalar_BOOLEAN 0 AppSwcIpm_CM_boolean_flg 0.0 1.0 /end CHARACTERISTIC
/begin CHARACTERISTIC KIPM_ESCWhlSpdKphFR_kph_ovrdflg "" VALUE 0x0000 /* @ECU_Address@KIPM_ESCWhlSpdKphFR_kph_ovrdflg@ */ Scalar_BOOLEAN 0 AppSwcIpm_CM_boolean_flg 0.0 1.0 /end CHARACTERISTIC
/begin CHARACTERISTIC KIPM_ESCWhlSpdKphRL_kph_ovrdflg "" VALUE 0x0000 /* @ECU_Address@KIPM_ESCWhlSpdKphRL_kph_ovrdflg@ */ Scalar_BOOLEAN 0 AppSwcIpm_CM_boolean_flg 0.0 1.0 /end CHARACTERISTIC
/begin CHARACTERISTIC KIPM_ESCWhlSpdKphRR_kph_ovrdflg "" VALUE 0x0000 /* @ECU_Address@KIPM_ESCWhlSpdKphRR_kph_ovrdflg@ */ Scalar_BOOLEAN 0 AppSwcIpm_CM_boolean_flg 0.0 1.0 /end CHARACTERISTIC
/begin CHARACTERISTIC KIPM_ESCWhlTqDecReqActvDflt_flg "" VALUE 0x0000 /* @ECU_Address@KIPM_ESCWhlTqDecReqActvDflt_flg@ */ Scalar_BOOLEAN 0 AppSwcIpm_CM_boolean_flg 0.0 1.0 /end CHARACTERISTIC
/begin CHARACTERISTIC KIPM_ESCWhlTqDecReqActv_flg_ovrdflg "" VALUE 0x0000 /* @ECU_Address@KIPM_ESCWhlTqDecReqActv_flg_ovrdflg@ */ Scalar_BOOLEAN 0 AppSwcIpm_CM_boolean_flg 0.0 1.0 /end CHARACTERISTIC
/begin CHARACTERISTIC KIPM_ESCWhlTqDecReqActv_flg_ovrdval "" VALUE 0x0000 /* @ECU_Address@KIPM_ESCWhlTqDecReqActv_flg_ovrdval@ */ Scalar_BOOLEAN 0 AppSwcIpm_CM_boolean_flg 0.0 1.0 /end CHARACTERISTIC
/begin CHARACTERISTIC KIPM_ESCWhlTqDecReqVal_Nm_ovrdflg "" VALUE 0x0000 /* @ECU_Address@KIPM_ESCWhlTqDecReqVal_Nm_ovrdflg@ */ Scalar_BOOLEAN 0 AppSwcIpm_CM_boolean_flg 0.0 1.0 /end CHARACTERISTIC
/begin CHARACTERISTIC KIPM_ESCWhlTqIncReqActvDflt_flg "" VALUE 0x0000 /* @ECU_Address@KIPM_ESCWhlTqIncReqActvDflt_flg@ */ Scalar_BOOLEAN 0 AppSwcIpm_CM_boolean_flg 0.0 1.0 /end CHARACTERISTIC
/begin CHARACTERISTIC KIPM_ESCWhlTqIncReqActv_flg_ovrdflg "" VALUE 0x0000 /* @ECU_Address@KIPM_ESCWhlTqIncReqActv_flg_ovrdflg@ */ Scalar_BOOLEAN 0 AppSwcIpm_CM_boolean_flg 0.0 1.0 /end CHARACTERISTIC
/begin CHARACTERISTIC KIPM_ESCWhlTqIncReqActv_flg_ovrdval "" VALUE 0x0000 /* @ECU_Address@KIPM_ESCWhlTqIncReqActv_flg_ovrdval@ */ Scalar_BOOLEAN 0 AppSwcIpm_CM_boolean_flg 0.0 1.0 /end CHARACTERISTIC
/begin CHARACTERISTIC KIPM_ESCWhlTqIncReqVal_Nm_ovrdflg "" VALUE 0x0000 /* @ECU_Address@KIPM_ESCWhlTqIncReqVal_Nm_ovrdflg@ */ Scalar_BOOLEAN 0 AppSwcIpm_CM_boolean_flg 0.0 1.0 /end CHARACTERISTIC
/begin CHARACTERISTIC KIPM_ESCYawRate_degps_ovrdflg "" VALUE 0x0000 /* @ECU_Address@KIPM_ESCYawRate_degps_ovrdflg@ */ Scalar_BOOLEAN 0 AppSwcIpm_CM_boolean_flg 0.0 1.0 /end CHARACTERISTIC
/begin CHARACTERISTIC KIPM_INV1ActMode_enum_ovrdflg "" VALUE 0x0000 /* @ECU_Address@KIPM_INV1ActMode_enum_ovrdflg@ */ Scalar_BOOLEAN 0 AppSwcIpm_CM_boolean_flg 0.0 1.0 /end CHARACTERISTIC
/begin CHARACTERISTIC KIPM_INV1ActTorq_Nm_ovrdflg "" VALUE 0x0000 /* @ECU_Address@KIPM_INV1ActTorq_Nm_ovrdflg@ */ Scalar_BOOLEAN 0 AppSwcIpm_CM_boolean_flg 0.0 1.0 /end CHARACTERISTIC
/begin CHARACTERISTIC KIPM_INV1AntithftAuthRslt_enum_ovrdflg "" VALUE 0x0000 /* @ECU_Address@KIPM_INV1AntithftAuthRslt_enum_ovrdflg@ */ Scalar_BOOLEAN 0 AppSwcIpm_CM_boolean_flg 0.0 1.0 /end CHARACTERISTIC
/begin CHARACTERISTIC KIPM_INV1MotSpd_rpm_ovrdflg "" VALUE 0x0000 /* @ECU_Address@KIPM_INV1MotSpd_rpm_ovrdflg@ */ Scalar_BOOLEAN 0 AppSwcIpm_CM_boolean_flg 0.0 1.0 /end CHARACTERISTIC
/begin CHARACTERISTIC KIPM_INV1PreChrgAllwd_enum_ovrdflg "" VALUE 0x0000 /* @ECU_Address@KIPM_INV1PreChrgAllwd_enum_ovrdflg@ */ Scalar_BOOLEAN 0 AppSwcIpm_CM_boolean_flg 0.0 1.0 /end CHARACTERISTIC
/begin CHARACTERISTIC KIPM_INV1PreprogmFlgDflt_flg "" VALUE 0x0000 /* @ECU_Address@KIPM_INV1PreprogmFlgDflt_flg@ */ Scalar_BOOLEAN 0 AppSwcIpm_CM_boolean_flg 0.0 1.0 /end CHARACTERISTIC
/begin CHARACTERISTIC KIPM_INV1PreprogmFlg_flg_ovrdflg "" VALUE 0x0000 /* @ECU_Address@KIPM_INV1PreprogmFlg_flg_ovrdflg@ */ Scalar_BOOLEAN 0 AppSwcIpm_CM_boolean_flg 0.0 1.0 /end CHARACTERISTIC
/begin CHARACTERISTIC KIPM_INV1PreprogmFlg_flg_ovrdval "" VALUE 0x0000 /* @ECU_Address@KIPM_INV1PreprogmFlg_flg_ovrdval@ */ Scalar_BOOLEAN 0 AppSwcIpm_CM_boolean_flg 0.0 1.0 /end CHARACTERISTIC
/begin CHARACTERISTIC KIPM_INV1ShutdownAllwd_enum_ovrdflg "" VALUE 0x0000 /* @ECU_Address@KIPM_INV1ShutdownAllwd_enum_ovrdflg@ */ Scalar_BOOLEAN 0 AppSwcIpm_CM_boolean_flg 0.0 1.0 /end CHARACTERISTIC
/begin CHARACTERISTIC KIPM_INV2IgbtMaxTemp_C_ovrdflg "" VALUE 0x0000 /* @ECU_Address@KIPM_INV2IgbtMaxTemp_C_ovrdflg@ */ Scalar_BOOLEAN 0 AppSwcIpm_CM_boolean_flg 0.0 1.0 /end CHARACTERISTIC
/begin CHARACTERISTIC KIPM_INV2InpCurnt_A_ovrdflg "" VALUE 0x0000 /* @ECU_Address@KIPM_INV2InpCurnt_A_ovrdflg@ */ Scalar_BOOLEAN 0 AppSwcIpm_CM_boolean_flg 0.0 1.0 /end CHARACTERISTIC
/begin CHARACTERISTIC KIPM_INV2InpVolt_V_ovrdflg "" VALUE 0x0000 /* @ECU_Address@KIPM_INV2InpVolt_V_ovrdflg@ */ Scalar_BOOLEAN 0 AppSwcIpm_CM_boolean_flg 0.0 1.0 /end CHARACTERISTIC
/begin CHARACTERISTIC KIPM_INV2MotorMaxTemp_C_ovrdflg "" VALUE 0x0000 /* @ECU_Address@KIPM_INV2MotorMaxTemp_C_ovrdflg@ */ Scalar_BOOLEAN 0 AppSwcIpm_CM_boolean_flg 0.0 1.0 /end CHARACTERISTIC
/begin CHARACTERISTIC KIPM_INVLrngData02_nu_ovrdflg "" VALUE 0x0000 /* @ECU_Address@KIPM_INVLrngData02_nu_ovrdflg@ */ Scalar_BOOLEAN 0 AppSwcIpm_CM_boolean_flg 0.0 1.0 /end CHARACTERISTIC
/begin CHARACTERISTIC KIPM_INVLrngData03_nu_ovrdflg "" VALUE 0x0000 /* @ECU_Address@KIPM_INVLrngData03_nu_ovrdflg@ */ Scalar_BOOLEAN 0 AppSwcIpm_CM_boolean_flg 0.0 1.0 /end CHARACTERISTIC
/begin CHARACTERISTIC KIPM_INVLrngData04_nu_ovrdflg "" VALUE 0x0000 /* @ECU_Address@KIPM_INVLrngData04_nu_ovrdflg@ */ Scalar_BOOLEAN 0 AppSwcIpm_CM_boolean_flg 0.0 1.0 /end CHARACTERISTIC
/begin CHARACTERISTIC KIPM_INVLrngData05_nu_ovrdflg "" VALUE 0x0000 /* @ECU_Address@KIPM_INVLrngData05_nu_ovrdflg@ */ Scalar_BOOLEAN 0 AppSwcIpm_CM_boolean_flg 0.0 1.0 /end CHARACTERISTIC
/begin CHARACTERISTIC KIPM_INVLrngData06_nu_ovrdflg "" VALUE 0x0000 /* @ECU_Address@KIPM_INVLrngData06_nu_ovrdflg@ */ Scalar_BOOLEAN 0 AppSwcIpm_CM_boolean_flg 0.0 1.0 /end CHARACTERISTIC
/begin CHARACTERISTIC KIPM_INVLrngData07_nu_ovrdflg "" VALUE 0x0000 /* @ECU_Address@KIPM_INVLrngData07_nu_ovrdflg@ */ Scalar_BOOLEAN 0 AppSwcIpm_CM_boolean_flg 0.0 1.0 /end CHARACTERISTIC
/begin CHARACTERISTIC KIPM_INVLrngSts_enum_ovrdflg "" VALUE 0x0000 /* @ECU_Address@KIPM_INVLrngSts_enum_ovrdflg@ */ Scalar_BOOLEAN 0 AppSwcIpm_CM_boolean_flg 0.0 1.0 /end CHARACTERISTIC
/begin CHARACTERISTIC KIPM_INVLrngSubID_cnt_ovrdflg "" VALUE 0x0000 /* @ECU_Address@KIPM_INVLrngSubID_cnt_ovrdflg@ */ Scalar_BOOLEAN 0 AppSwcIpm_CM_boolean_flg 0.0 1.0 /end CHARACTERISTIC
/begin CHARACTERISTIC KIPM_IPUDCCActOprtMode_enum_ovrdflg "" VALUE 0x0000 /* @ECU_Address@KIPM_IPUDCCActOprtMode_enum_ovrdflg@ */ Scalar_BOOLEAN 0 AppSwcIpm_CM_boolean_flg 0.0 1.0 /end CHARACTERISTIC
/begin CHARACTERISTIC KIPM_IPUDCCHiVoltActCurnt_A_ovrdflg "" VALUE 0x0000 /* @ECU_Address@KIPM_IPUDCCHiVoltActCurnt_A_ovrdflg@ */ Scalar_BOOLEAN 0 AppSwcIpm_CM_boolean_flg 0.0 1.0 /end CHARACTERISTIC
/begin CHARACTERISTIC KIPM_IPUDCCHiVoltActVolt_V_ovrdflg "" VALUE 0x0000 /* @ECU_Address@KIPM_IPUDCCHiVoltActVolt_V_ovrdflg@ */ Scalar_BOOLEAN 0 AppSwcIpm_CM_boolean_flg 0.0 1.0 /end CHARACTERISTIC
/begin CHARACTERISTIC KIPM_IPUDCCLoVoltActCurnt_A_ovrdflg "" VALUE 0x0000 /* @ECU_Address@KIPM_IPUDCCLoVoltActCurnt_A_ovrdflg@ */ Scalar_BOOLEAN 0 AppSwcIpm_CM_boolean_flg 0.0 1.0 /end CHARACTERISTIC
/begin CHARACTERISTIC KIPM_IPUDCCLoVoltActVolt_V_ovrdflg "" VALUE 0x0000 /* @ECU_Address@KIPM_IPUDCCLoVoltActVolt_V_ovrdflg@ */ Scalar_BOOLEAN 0 AppSwcIpm_CM_boolean_flg 0.0 1.0 /end CHARACTERISTIC
/begin CHARACTERISTIC KIPM_IPUDCCSysFailSta_enum_ovrdflg "" VALUE 0x0000 /* @ECU_Address@KIPM_IPUDCCSysFailSta_enum_ovrdflg@ */ Scalar_BOOLEAN 0 AppSwcIpm_CM_boolean_flg 0.0 1.0 /end CHARACTERISTIC
/begin CHARACTERISTIC KIPM_IPUDeviceIntTemp_C_ovrdflg "" VALUE 0x0000 /* @ECU_Address@KIPM_IPUDeviceIntTemp_C_ovrdflg@ */ Scalar_BOOLEAN 0 AppSwcIpm_CM_boolean_flg 0.0 1.0 /end CHARACTERISTIC
/begin CHARACTERISTIC KIPM_IPUHVILFailStDflt_flg "" VALUE 0x0000 /* @ECU_Address@KIPM_IPUHVILFailStDflt_flg@ */ Scalar_BOOLEAN 0 AppSwcIpm_CM_boolean_flg 0.0 1.0 /end CHARACTERISTIC
/begin CHARACTERISTIC KIPM_IPUHVILFailSt_flg_ovrdflg "" VALUE 0x0000 /* @ECU_Address@KIPM_IPUHVILFailSt_flg_ovrdflg@ */ Scalar_BOOLEAN 0 AppSwcIpm_CM_boolean_flg 0.0 1.0 /end CHARACTERISTIC
/begin CHARACTERISTIC KIPM_IPUHVILFailSt_flg_ovrdval "" VALUE 0x0000 /* @ECU_Address@KIPM_IPUHVILFailSt_flg_ovrdval@ */ Scalar_BOOLEAN 0 AppSwcIpm_CM_boolean_flg 0.0 1.0 /end CHARACTERISTIC
/begin CHARACTERISTIC KIPM_IPUOBCACMaxPwrAllow_kW_ovrdflg "" VALUE 0x0000 /* @ECU_Address@KIPM_IPUOBCACMaxPwrAllow_kW_ovrdflg@ */ Scalar_BOOLEAN 0 AppSwcIpm_CM_boolean_flg 0.0 1.0 /end CHARACTERISTIC
/begin CHARACTERISTIC KIPM_IPUOBCActOprtMode_enum_ovrdflg "" VALUE 0x0000 /* @ECU_Address@KIPM_IPUOBCActOprtMode_enum_ovrdflg@ */ Scalar_BOOLEAN 0 AppSwcIpm_CM_boolean_flg 0.0 1.0 /end CHARACTERISTIC
/begin CHARACTERISTIC KIPM_IPUOBCConnectMainStaDflt_flg "" VALUE 0x0000 /* @ECU_Address@KIPM_IPUOBCConnectMainStaDflt_flg@ */ Scalar_BOOLEAN 0 AppSwcIpm_CM_boolean_flg 0.0 1.0 /end CHARACTERISTIC
/begin CHARACTERISTIC KIPM_IPUOBCConnectMainSta_flg_ovrdflg "" VALUE 0x0000 /* @ECU_Address@KIPM_IPUOBCConnectMainSta_flg_ovrdflg@ */ Scalar_BOOLEAN 0 AppSwcIpm_CM_boolean_flg 0.0 1.0 /end CHARACTERISTIC
/begin CHARACTERISTIC KIPM_IPUOBCConnectMainSta_flg_ovrdval "" VALUE 0x0000 /* @ECU_Address@KIPM_IPUOBCConnectMainSta_flg_ovrdval@ */ Scalar_BOOLEAN 0 AppSwcIpm_CM_boolean_flg 0.0 1.0 /end CHARACTERISTIC
/begin CHARACTERISTIC KIPM_IPUOBCHVDCActCur_A_ovrdflg "" VALUE 0x0000 /* @ECU_Address@KIPM_IPUOBCHVDCActCur_A_ovrdflg@ */ Scalar_BOOLEAN 0 AppSwcIpm_CM_boolean_flg 0.0 1.0 /end CHARACTERISTIC
/begin CHARACTERISTIC KIPM_IPUOBCHVDCActVol_V_ovrdflg "" VALUE 0x0000 /* @ECU_Address@KIPM_IPUOBCHVDCActVol_V_ovrdflg@ */ Scalar_BOOLEAN 0 AppSwcIpm_CM_boolean_flg 0.0 1.0 /end CHARACTERISTIC
/begin CHARACTERISTIC KIPM_IPUOBCInletActPwr_kW_ovrdflg "" VALUE 0x0000 /* @ECU_Address@KIPM_IPUOBCInletActPwr_kW_ovrdflg@ */ Scalar_BOOLEAN 0 AppSwcIpm_CM_boolean_flg 0.0 1.0 /end CHARACTERISTIC
/begin CHARACTERISTIC KIPM_IPUOBCInletConnectSta_enum_ovrdflg "" VALUE 0x0000 /* @ECU_Address@KIPM_IPUOBCInletConnectSta_enum_ovrdflg@ */ Scalar_BOOLEAN 0 AppSwcIpm_CM_boolean_flg 0.0 1.0 /end CHARACTERISTIC
/begin CHARACTERISTIC KIPM_IPUOBCReq_enum_ovrdflg "" VALUE 0x0000 /* @ECU_Address@KIPM_IPUOBCReq_enum_ovrdflg@ */ Scalar_BOOLEAN 0 AppSwcIpm_CM_boolean_flg 0.0 1.0 /end CHARACTERISTIC
/begin CHARACTERISTIC KIPM_IPUOBCS2StateDflt_flg "" VALUE 0x0000 /* @ECU_Address@KIPM_IPUOBCS2StateDflt_flg@ */ Scalar_BOOLEAN 0 AppSwcIpm_CM_boolean_flg 0.0 1.0 /end CHARACTERISTIC
/begin CHARACTERISTIC KIPM_IPUOBCS2State_flg_ovrdflg "" VALUE 0x0000 /* @ECU_Address@KIPM_IPUOBCS2State_flg_ovrdflg@ */ Scalar_BOOLEAN 0 AppSwcIpm_CM_boolean_flg 0.0 1.0 /end CHARACTERISTIC
/begin CHARACTERISTIC KIPM_IPUOBCS2State_flg_ovrdval "" VALUE 0x0000 /* @ECU_Address@KIPM_IPUOBCS2State_flg_ovrdval@ */ Scalar_BOOLEAN 0 AppSwcIpm_CM_boolean_flg 0.0 1.0 /end CHARACTERISTIC
/begin CHARACTERISTIC KIPM_IPUOBCSysFailSta_enum_ovrdflg "" VALUE 0x0000 /* @ECU_Address@KIPM_IPUOBCSysFailSta_enum_ovrdflg@ */ Scalar_BOOLEAN 0 AppSwcIpm_CM_boolean_flg 0.0 1.0 /end CHARACTERISTIC
/begin CHARACTERISTIC KIPM_IPUOBCTempInt_C_ovrdflg "" VALUE 0x0000 /* @ECU_Address@KIPM_IPUOBCTempInt_C_ovrdflg@ */ Scalar_BOOLEAN 0 AppSwcIpm_CM_boolean_flg 0.0 1.0 /end CHARACTERISTIC
/begin CHARACTERISTIC KIPM_IPUOBCWakeUpMode_enum_ovrdflg "" VALUE 0x0000 /* @ECU_Address@KIPM_IPUOBCWakeUpMode_enum_ovrdflg@ */ Scalar_BOOLEAN 0 AppSwcIpm_CM_boolean_flg 0.0 1.0 /end CHARACTERISTIC
/begin CHARACTERISTIC KIPM_TBOXACTempSet_enum_ovrdflg "" VALUE 0x0000 /* @ECU_Address@KIPM_TBOXACTempSet_enum_ovrdflg@ */ Scalar_BOOLEAN 0 AppSwcIpm_CM_boolean_flg 0.0 1.0 /end CHARACTERISTIC
/begin CHARACTERISTIC KIPM_TBOXRmtPwrLck_enum_ovrdflg "" VALUE 0x0000 /* @ECU_Address@KIPM_TBOXRmtPwrLck_enum_ovrdflg@ */ Scalar_BOOLEAN 0 AppSwcIpm_CM_boolean_flg 0.0 1.0 /end CHARACTERISTIC
/begin CHARACTERISTIC KIPM_TBOXVCUCCMSpdLimLvl_enum_ovrdflg "" VALUE 0x0000 /* @ECU_Address@KIPM_TBOXVCUCCMSpdLimLvl_enum_ovrdflg@ */ Scalar_BOOLEAN 0 AppSwcIpm_CM_boolean_flg 0.0 1.0 /end CHARACTERISTIC
/begin CHARACTERISTIC KIPM_TBOXVCUChrgngCondsDflt_flg "" VALUE 0x0000 /* @ECU_Address@KIPM_TBOXVCUChrgngCondsDflt_flg@ */ Scalar_BOOLEAN 0 AppSwcIpm_CM_boolean_flg 0.0 1.0 /end CHARACTERISTIC
/begin CHARACTERISTIC KIPM_TBOXVCUChrgngConds_flg_ovrdflg "" VALUE 0x0000 /* @ECU_Address@KIPM_TBOXVCUChrgngConds_flg_ovrdflg@ */ Scalar_BOOLEAN 0 AppSwcIpm_CM_boolean_flg 0.0 1.0 /end CHARACTERISTIC
/begin CHARACTERISTIC KIPM_TBOXVCUChrgngConds_flg_ovrdval "" VALUE 0x0000 /* @ECU_Address@KIPM_TBOXVCUChrgngConds_flg_ovrdval@ */ Scalar_BOOLEAN 0 AppSwcIpm_CM_boolean_flg 0.0 1.0 /end CHARACTERISTIC
/begin CHARACTERISTIC KIPM_TBOXVCUOprtLicDflt_flg "" VALUE 0x0000 /* @ECU_Address@KIPM_TBOXVCUOprtLicDflt_flg@ */ Scalar_BOOLEAN 0 AppSwcIpm_CM_boolean_flg 0.0 1.0 /end CHARACTERISTIC
/begin CHARACTERISTIC KIPM_TBOXVCUOprtLic_flg_ovrdflg "" VALUE 0x0000 /* @ECU_Address@KIPM_TBOXVCUOprtLic_flg_ovrdflg@ */ Scalar_BOOLEAN 0 AppSwcIpm_CM_boolean_flg 0.0 1.0 /end CHARACTERISTIC
/begin CHARACTERISTIC KIPM_TBOXVCUOprtLic_flg_ovrdval "" VALUE 0x0000 /* @ECU_Address@KIPM_TBOXVCUOprtLic_flg_ovrdval@ */ Scalar_BOOLEAN 0 AppSwcIpm_CM_boolean_flg 0.0 1.0 /end CHARACTERISTIC
/begin CHARACTERISTIC KIPM_TBOXVCUVerDflt_flg "" VALUE 0x0000 /* @ECU_Address@KIPM_TBOXVCUVerDflt_flg@ */ Scalar_BOOLEAN 0 AppSwcIpm_CM_boolean_flg 0.0 1.0 /end CHARACTERISTIC
/begin CHARACTERISTIC KIPM_TBOXVCUVer_flg_ovrdflg "" VALUE 0x0000 /* @ECU_Address@KIPM_TBOXVCUVer_flg_ovrdflg@ */ Scalar_BOOLEAN 0 AppSwcIpm_CM_boolean_flg 0.0 1.0 /end CHARACTERISTIC
/begin CHARACTERISTIC KIPM_TBOXVCUVer_flg_ovrdval "" VALUE 0x0000 /* @ECU_Address@KIPM_TBOXVCUVer_flg_ovrdval@ */ Scalar_BOOLEAN 0 AppSwcIpm_CM_boolean_flg 0.0 1.0 /end CHARACTERISTIC
/begin CHARACTERISTIC KIPM_TBoxOpenVentn_enum_ovrdflg "" VALUE 0x0000 /* @ECU_Address@KIPM_TBoxOpenVentn_enum_ovrdflg@ */ Scalar_BOOLEAN 0 AppSwcIpm_CM_boolean_flg 0.0 1.0 /end CHARACTERISTIC
/begin CHARACTERISTIC KIPM_TBoxRmtCarSearch_enum_ovrdflg "" VALUE 0x0000 /* @ECU_Address@KIPM_TBoxRmtCarSearch_enum_ovrdflg@ */ Scalar_BOOLEAN 0 AppSwcIpm_CM_boolean_flg 0.0 1.0 /end CHARACTERISTIC
/begin CHARACTERISTIC KIPM_TBoxRmtLck_enum_ovrdflg "" VALUE 0x0000 /* @ECU_Address@KIPM_TBoxRmtLck_enum_ovrdflg@ */ Scalar_BOOLEAN 0 AppSwcIpm_CM_boolean_flg 0.0 1.0 /end CHARACTERISTIC
/begin CHARACTERISTIC KIPM_TboxRmtDefrstCtl_enum_ovrdflg "" VALUE 0x0000 /* @ECU_Address@KIPM_TboxRmtDefrstCtl_enum_ovrdflg@ */ Scalar_BOOLEAN 0 AppSwcIpm_CM_boolean_flg 0.0 1.0 /end CHARACTERISTIC
/begin CHARACTERISTIC KIPM_BMSBatCapctyDflt_Ah "" VALUE 0x0000 /* @ECU_Address@KIPM_BMSBatCapctyDflt_Ah@ */ Scalar_UBYTE 0 AppSwcIpm_CM_uint8_Ah 0.0 255.0 /end CHARACTERISTIC
/begin CHARACTERISTIC KIPM_BMSBatCapcty_Ah_ovrdval "" VALUE 0x0000 /* @ECU_Address@KIPM_BMSBatCapcty_Ah_ovrdval@ */ Scalar_UBYTE 0 AppSwcIpm_CM_uint8_Ah 0.0 255.0 /end CHARACTERISTIC
/begin CHARACTERISTIC KIPM_BMSPackIDDflt_enum "" VALUE 0x0000 /* @ECU_Address@KIPM_BMSPackIDDflt_enum@ */ Scalar_UBYTE 0 AppSwcIpm_CM_uint8_enum 0.0 255.0 /end CHARACTERISTIC
/begin CHARACTERISTIC KIPM_BMSPackID_enum_ovrdval "" VALUE 0x0000 /* @ECU_Address@KIPM_BMSPackID_enum_ovrdval@ */ Scalar_UBYTE 0 AppSwcIpm_CM_uint8_enum 0.0 255.0 /end CHARACTERISTIC
/begin CHARACTERISTIC KIPM_EHBEPBDynAppStDflt_enum "" VALUE 0x0000 /* @ECU_Address@KIPM_EHBEPBDynAppStDflt_enum@ */ Scalar_UBYTE 0 AppSwcIpm_CM_uint8_enum 0.0 255.0 /end CHARACTERISTIC
/begin CHARACTERISTIC KIPM_EHBEPBDynAppSt_enum_ovrdval "" VALUE 0x0000 /* @ECU_Address@KIPM_EHBEPBDynAppSt_enum_ovrdval@ */ Scalar_UBYTE 0 AppSwcIpm_CM_uint8_enum 0.0 255.0 /end CHARACTERISTIC
/begin CHARACTERISTIC KIPM_EHBFltLvlDflt_enum "" VALUE 0x0000 /* @ECU_Address@KIPM_EHBFltLvlDflt_enum@ */ Scalar_UBYTE 0 AppSwcIpm_CM_uint8_enum 0.0 255.0 /end CHARACTERISTIC
/begin CHARACTERISTIC KIPM_EHBFltLvl_enum_ovrdval "" VALUE 0x0000 /* @ECU_Address@KIPM_EHBFltLvl_enum_ovrdval@ */ Scalar_UBYTE 0 AppSwcIpm_CM_uint8_enum 0.0 255.0 /end CHARACTERISTIC
/begin CHARACTERISTIC KIPM_ESCFltLvlDflt_enum "" VALUE 0x0000 /* @ECU_Address@KIPM_ESCFltLvlDflt_enum@ */ Scalar_UBYTE 0 AppSwcIpm_CM_uint8_enum 0.0 255.0 /end CHARACTERISTIC
/begin CHARACTERISTIC KIPM_ESCFltLvl_enum_ovrdval "" VALUE 0x0000 /* @ECU_Address@KIPM_ESCFltLvl_enum_ovrdval@ */ Scalar_UBYTE 0 AppSwcIpm_CM_uint8_enum 0.0 255.0 /end CHARACTERISTIC
/begin CHARACTERISTIC KIPM_ESCVehStandStillStaDflt_enum "" VALUE 0x0000 /* @ECU_Address@KIPM_ESCVehStandStillStaDflt_enum@ */ Scalar_UBYTE 0 AppSwcIpm_CM_uint8_enum 0.0 255.0 /end CHARACTERISTIC
/begin CHARACTERISTIC KIPM_ESCVehStandStillSta_enum_ovrdval "" VALUE 0x0000 /* @ECU_Address@KIPM_ESCVehStandStillSta_enum_ovrdval@ */ Scalar_UBYTE 0 AppSwcIpm_CM_uint8_enum 0.0 255.0 /end CHARACTERISTIC
/begin CHARACTERISTIC KIPM_ESCWhlDirctnFLDflt_enum "" VALUE 0x0000 /* @ECU_Address@KIPM_ESCWhlDirctnFLDflt_enum@ */ Scalar_UBYTE 0 AppSwcIpm_CM_uint8_enum 0.0 255.0 /end CHARACTERISTIC
/begin CHARACTERISTIC KIPM_ESCWhlDirctnFL_enum_ovrdval "" VALUE 0x0000 /* @ECU_Address@KIPM_ESCWhlDirctnFL_enum_ovrdval@ */ Scalar_UBYTE 0 AppSwcIpm_CM_uint8_enum 0.0 255.0 /end CHARACTERISTIC
/begin CHARACTERISTIC KIPM_ESCWhlDirctnFRDflt_enum "" VALUE 0x0000 /* @ECU_Address@KIPM_ESCWhlDirctnFRDflt_enum@ */ Scalar_UBYTE 0 AppSwcIpm_CM_uint8_enum 0.0 255.0 /end CHARACTERISTIC
/begin CHARACTERISTIC KIPM_ESCWhlDirctnFR_enum_ovrdval "" VALUE 0x0000 /* @ECU_Address@KIPM_ESCWhlDirctnFR_enum_ovrdval@ */ Scalar_UBYTE 0 AppSwcIpm_CM_uint8_enum 0.0 255.0 /end CHARACTERISTIC
/begin CHARACTERISTIC KIPM_ESCWhlDirctnRLDflt_enum "" VALUE 0x0000 /* @ECU_Address@KIPM_ESCWhlDirctnRLDflt_enum@ */ Scalar_UBYTE 0 AppSwcIpm_CM_uint8_enum 0.0 255.0 /end CHARACTERISTIC
/begin CHARACTERISTIC KIPM_ESCWhlDirctnRL_enum_ovrdval "" VALUE 0x0000 /* @ECU_Address@KIPM_ESCWhlDirctnRL_enum_ovrdval@ */ Scalar_UBYTE 0 AppSwcIpm_CM_uint8_enum 0.0 255.0 /end CHARACTERISTIC
/begin CHARACTERISTIC KIPM_ESCWhlDirctnRRDflt_enum "" VALUE 0x0000 /* @ECU_Address@KIPM_ESCWhlDirctnRRDflt_enum@ */ Scalar_UBYTE 0 AppSwcIpm_CM_uint8_enum 0.0 255.0 /end CHARACTERISTIC
/begin CHARACTERISTIC KIPM_ESCWhlDirctnRR_enum_ovrdval "" VALUE 0x0000 /* @ECU_Address@KIPM_ESCWhlDirctnRR_enum_ovrdval@ */ Scalar_UBYTE 0 AppSwcIpm_CM_uint8_enum 0.0 255.0 /end CHARACTERISTIC
/begin CHARACTERISTIC KIPM_INV1AntithftAuthRsltDflt_enum "" VALUE 0x0000 /* @ECU_Address@KIPM_INV1AntithftAuthRsltDflt_enum@ */ Scalar_UBYTE 0 AppSwcIpm_CM_uint8_enum 0.0 255.0 /end CHARACTERISTIC
/begin CHARACTERISTIC KIPM_INV1AntithftAuthRslt_enum_ovrdval "" VALUE 0x0000 /* @ECU_Address@KIPM_INV1AntithftAuthRslt_enum_ovrdval@ */ Scalar_UBYTE 0 AppSwcIpm_CM_uint8_enum 0.0 255.0 /end CHARACTERISTIC
/begin CHARACTERISTIC KIPM_INV1PreChrgAllwdDflt_enum "" VALUE 0x0000 /* @ECU_Address@KIPM_INV1PreChrgAllwdDflt_enum@ */ Scalar_UBYTE 0 AppSwcIpm_CM_uint8_enum 0.0 255.0 /end CHARACTERISTIC
/begin CHARACTERISTIC KIPM_INV1PreChrgAllwd_enum_ovrdval "" VALUE 0x0000 /* @ECU_Address@KIPM_INV1PreChrgAllwd_enum_ovrdval@ */ Scalar_UBYTE 0 AppSwcIpm_CM_uint8_enum 0.0 255.0 /end CHARACTERISTIC
/begin CHARACTERISTIC KIPM_INV1ShutdownAllwdDflt_enum "" VALUE 0x0000 /* @ECU_Address@KIPM_INV1ShutdownAllwdDflt_enum@ */ Scalar_UBYTE 0 AppSwcIpm_CM_uint8_enum 0.0 255.0 /end CHARACTERISTIC
/begin CHARACTERISTIC KIPM_INV1ShutdownAllwd_enum_ovrdval "" VALUE 0x0000 /* @ECU_Address@KIPM_INV1ShutdownAllwd_enum_ovrdval@ */ Scalar_UBYTE 0 AppSwcIpm_CM_uint8_enum 0.0 255.0 /end CHARACTERISTIC
/begin CHARACTERISTIC KIPM_INVLrngData02Dflt_nu "" VALUE 0x0000 /* @ECU_Address@KIPM_INVLrngData02Dflt_nu@ */ Scalar_UBYTE 0 AppSwcIpm_CM_uint8_nu 0.0 255.0 /end CHARACTERISTIC
/begin CHARACTERISTIC KIPM_INVLrngData02_nu_ovrdval "" VALUE 0x0000 /* @ECU_Address@KIPM_INVLrngData02_nu_ovrdval@ */ Scalar_UBYTE 0 AppSwcIpm_CM_uint8_nu 0.0 255.0 /end CHARACTERISTIC
/begin CHARACTERISTIC KIPM_INVLrngData03Dflt_nu "" VALUE 0x0000 /* @ECU_Address@KIPM_INVLrngData03Dflt_nu@ */ Scalar_UBYTE 0 AppSwcIpm_CM_uint8_nu 0.0 255.0 /end CHARACTERISTIC
/begin CHARACTERISTIC KIPM_INVLrngData03_nu_ovrdval "" VALUE 0x0000 /* @ECU_Address@KIPM_INVLrngData03_nu_ovrdval@ */ Scalar_UBYTE 0 AppSwcIpm_CM_uint8_nu 0.0 255.0 /end CHARACTERISTIC
/begin CHARACTERISTIC KIPM_INVLrngData04Dflt_nu "" VALUE 0x0000 /* @ECU_Address@KIPM_INVLrngData04Dflt_nu@ */ Scalar_UBYTE 0 AppSwcIpm_CM_uint8_nu 0.0 255.0 /end CHARACTERISTIC
/begin CHARACTERISTIC KIPM_INVLrngData04_nu_ovrdval "" VALUE 0x0000 /* @ECU_Address@KIPM_INVLrngData04_nu_ovrdval@ */ Scalar_UBYTE 0 AppSwcIpm_CM_uint8_nu 0.0 255.0 /end CHARACTERISTIC
/begin CHARACTERISTIC KIPM_INVLrngData05Dflt_nu "" VALUE 0x0000 /* @ECU_Address@KIPM_INVLrngData05Dflt_nu@ */ Scalar_UBYTE 0 AppSwcIpm_CM_uint8_nu 0.0 255.0 /end CHARACTERISTIC
/begin CHARACTERISTIC KIPM_INVLrngData05_nu_ovrdval "" VALUE 0x0000 /* @ECU_Address@KIPM_INVLrngData05_nu_ovrdval@ */ Scalar_UBYTE 0 AppSwcIpm_CM_uint8_nu 0.0 255.0 /end CHARACTERISTIC
/begin CHARACTERISTIC KIPM_INVLrngData06Dflt_nu "" VALUE 0x0000 /* @ECU_Address@KIPM_INVLrngData06Dflt_nu@ */ Scalar_UBYTE 0 AppSwcIpm_CM_uint8_nu 0.0 255.0 /end CHARACTERISTIC
/begin CHARACTERISTIC KIPM_INVLrngData06_nu_ovrdval "" VALUE 0x0000 /* @ECU_Address@KIPM_INVLrngData06_nu_ovrdval@ */ Scalar_UBYTE 0 AppSwcIpm_CM_uint8_nu 0.0 255.0 /end CHARACTERISTIC
/begin CHARACTERISTIC KIPM_INVLrngData07Dflt_nu "" VALUE 0x0000 /* @ECU_Address@KIPM_INVLrngData07Dflt_nu@ */ Scalar_UBYTE 0 AppSwcIpm_CM_uint8_nu 0.0 255.0 /end CHARACTERISTIC
/begin CHARACTERISTIC KIPM_INVLrngData07_nu_ovrdval "" VALUE 0x0000 /* @ECU_Address@KIPM_INVLrngData07_nu_ovrdval@ */ Scalar_UBYTE 0 AppSwcIpm_CM_uint8_nu 0.0 255.0 /end CHARACTERISTIC
/begin CHARACTERISTIC KIPM_INVLrngStsDflt_enum "" VALUE 0x0000 /* @ECU_Address@KIPM_INVLrngStsDflt_enum@ */ Scalar_UBYTE 0 AppSwcIpm_CM_uint8_enum 0.0 255.0 /end CHARACTERISTIC
/begin CHARACTERISTIC KIPM_INVLrngSts_enum_ovrdval "" VALUE 0x0000 /* @ECU_Address@KIPM_INVLrngSts_enum_ovrdval@ */ Scalar_UBYTE 0 AppSwcIpm_CM_uint8_enum 0.0 255.0 /end CHARACTERISTIC
/begin CHARACTERISTIC KIPM_INVLrngSubIDDflt_cnt "" VALUE 0x0000 /* @ECU_Address@KIPM_INVLrngSubIDDflt_cnt@ */ Scalar_UBYTE 0 AppSwcIpm_CM_uint8_cnt 0.0 255.0 /end CHARACTERISTIC
/begin CHARACTERISTIC KIPM_INVLrngSubID_cnt_ovrdval "" VALUE 0x0000 /* @ECU_Address@KIPM_INVLrngSubID_cnt_ovrdval@ */ Scalar_UBYTE 0 AppSwcIpm_CM_uint8_cnt 0.0 255.0 /end CHARACTERISTIC
/begin CHARACTERISTIC KIPM_IPUDCCSysFailStaDflt_enum "" VALUE 0x0000 /* @ECU_Address@KIPM_IPUDCCSysFailStaDflt_enum@ */ Scalar_UBYTE 0 AppSwcIpm_CM_uint8_enum 0.0 255.0 /end CHARACTERISTIC
/begin CHARACTERISTIC KIPM_IPUDCCSysFailSta_enum_ovrdval "" VALUE 0x0000 /* @ECU_Address@KIPM_IPUDCCSysFailSta_enum_ovrdval@ */ Scalar_UBYTE 0 AppSwcIpm_CM_uint8_enum 0.0 255.0 /end CHARACTERISTIC
/begin CHARACTERISTIC KIPM_IPUOBCSysFailStaDflt_enum "" VALUE 0x0000 /* @ECU_Address@KIPM_IPUOBCSysFailStaDflt_enum@ */ Scalar_UBYTE 0 AppSwcIpm_CM_uint8_enum 0.0 255.0 /end CHARACTERISTIC
/begin CHARACTERISTIC KIPM_IPUOBCSysFailSta_enum_ovrdval "" VALUE 0x0000 /* @ECU_Address@KIPM_IPUOBCSysFailSta_enum_ovrdval@ */ Scalar_UBYTE 0 AppSwcIpm_CM_uint8_enum 0.0 255.0 /end CHARACTERISTIC
/begin CHARACTERISTIC KIPM_TBOXACTempSetDflt_enum "" VALUE 0x0000 /* @ECU_Address@KIPM_TBOXACTempSetDflt_enum@ */ Scalar_UBYTE 0 AppSwcIpm_CM_uint8_enum 0.0 255.0 /end CHARACTERISTIC
/begin CHARACTERISTIC KIPM_TBOXACTempSet_enum_ovrdval "" VALUE 0x0000 /* @ECU_Address@KIPM_TBOXACTempSet_enum_ovrdval@ */ Scalar_UBYTE 0 AppSwcIpm_CM_uint8_enum 0.0 255.0 /end CHARACTERISTIC
/begin CHARACTERISTIC KIPM_TBOXRmtPwrLckDflt_enum "" VALUE 0x0000 /* @ECU_Address@KIPM_TBOXRmtPwrLckDflt_enum@ */ Scalar_UBYTE 0 AppSwcIpm_CM_uint8_enum 0.0 255.0 /end CHARACTERISTIC
/begin CHARACTERISTIC KIPM_TBOXRmtPwrLck_enum_ovrdval "" VALUE 0x0000 /* @ECU_Address@KIPM_TBOXRmtPwrLck_enum_ovrdval@ */ Scalar_UBYTE 0 AppSwcIpm_CM_uint8_enum 0.0 255.0 /end CHARACTERISTIC
/begin CHARACTERISTIC KIPM_TBOXVCUCCMSpdLimLvlDflt_enum "" VALUE 0x0000 /* @ECU_Address@KIPM_TBOXVCUCCMSpdLimLvlDflt_enum@ */ Scalar_UBYTE 0 AppSwcIpm_CM_uint8_enum 0.0 255.0 /end CHARACTERISTIC
/begin CHARACTERISTIC KIPM_TBOXVCUCCMSpdLimLvl_enum_ovrdval "" VALUE 0x0000 /* @ECU_Address@KIPM_TBOXVCUCCMSpdLimLvl_enum_ovrdval@ */ Scalar_UBYTE 0 AppSwcIpm_CM_uint8_enum 0.0 255.0 /end CHARACTERISTIC
/begin CHARACTERISTIC KIPM_TBoxOpenVentnDflt_enum "" VALUE 0x0000 /* @ECU_Address@KIPM_TBoxOpenVentnDflt_enum@ */ Scalar_UBYTE 0 AppSwcIpm_CM_uint8_enum 0.0 255.0 /end CHARACTERISTIC
/begin CHARACTERISTIC KIPM_TBoxOpenVentn_enum_ovrdval "" VALUE 0x0000 /* @ECU_Address@KIPM_TBoxOpenVentn_enum_ovrdval@ */ Scalar_UBYTE 0 AppSwcIpm_CM_uint8_enum 0.0 255.0 /end CHARACTERISTIC
/begin CHARACTERISTIC KIPM_TBoxRmtCarSearchDflt_enum "" VALUE 0x0000 /* @ECU_Address@KIPM_TBoxRmtCarSearchDflt_enum@ */ Scalar_UBYTE 0 AppSwcIpm_CM_uint8_enum 0.0 255.0 /end CHARACTERISTIC
/begin CHARACTERISTIC KIPM_TBoxRmtCarSearch_enum_ovrdval "" VALUE 0x0000 /* @ECU_Address@KIPM_TBoxRmtCarSearch_enum_ovrdval@ */ Scalar_UBYTE 0 AppSwcIpm_CM_uint8_enum 0.0 255.0 /end CHARACTERISTIC
/begin CHARACTERISTIC KIPM_TBoxRmtLckDflt_enum "" VALUE 0x0000 /* @ECU_Address@KIPM_TBoxRmtLckDflt_enum@ */ Scalar_UBYTE 0 AppSwcIpm_CM_uint8_enum 0.0 255.0 /end CHARACTERISTIC
/begin CHARACTERISTIC KIPM_TBoxRmtLck_enum_ovrdval "" VALUE 0x0000 /* @ECU_Address@KIPM_TBoxRmtLck_enum_ovrdval@ */ Scalar_UBYTE 0 AppSwcIpm_CM_uint8_enum 0.0 255.0 /end CHARACTERISTIC
/begin CHARACTERISTIC KIPM_TboxRmtDefrstCtlDflt_enum "" VALUE 0x0000 /* @ECU_Address@KIPM_TboxRmtDefrstCtlDflt_enum@ */ Scalar_UBYTE 0 AppSwcIpm_CM_uint8_enum 0.0 255.0 /end CHARACTERISTIC
/begin CHARACTERISTIC KIPM_TboxRmtDefrstCtl_enum_ovrdval "" VALUE 0x0000 /* @ECU_Address@KIPM_TboxRmtDefrstCtl_enum_ovrdval@ */ Scalar_UBYTE 0 AppSwcIpm_CM_uint8_enum 0.0 255.0 /end CHARACTERISTIC
/begin MEASUREMENT VIPM_INV2MotorMaxTemp_C "" FLOAT32_IEEE AppSwcIpm_CM_single_C 0 0 -100000.0 100000.0 ECU_ADDRESS 0x0000 /* @ECU_Address@VIPM_INV2MotorMaxTemp_C@ */ /end MEASUREMENT
/begin MEASUREMENT VIPM_INV2InpVolt_V "" FLOAT32_IEEE AppSwcIpm_CM_single_V 0 0 -100000.0 100000.0 ECU_ADDRESS 0x0000 /* @ECU_Address@VIPM_INV2InpVolt_V@ */ /end MEASUREMENT
/begin MEASUREMENT VIPM_INV2InpCurnt_A "" FLOAT32_IEEE AppSwcIpm_CM_single_A 0 0 -100000.0 100000.0 ECU_ADDRESS 0x0000 /* @ECU_Address@VIPM_INV2InpCurnt_A@ */ /end MEASUREMENT
/begin MEASUREMENT VIPM_INV2IgbtMaxTemp_C "" FLOAT32_IEEE AppSwcIpm_CM_single_C 0 0 -100000.0 100000.0 ECU_ADDRESS 0x0000 /* @ECU_Address@VIPM_INV2IgbtMaxTemp_C@ */ /end MEASUREMENT
/begin MEASUREMENT VIPM_INV1MotSpd_rpm "" FLOAT32_IEEE AppSwcIpm_CM_single_rpm 0 0 -100000.0 100000.0 ECU_ADDRESS 0x0000 /* @ECU_Address@VIPM_INV1MotSpd_rpm@ */ /end MEASUREMENT
/begin MEASUREMENT VIPM_INV1ActTorq_Nm "" FLOAT32_IEEE AppSwcIpm_CM_single_Nm 0 0 -100000.0 100000.0 ECU_ADDRESS 0x0000 /* @ECU_Address@VIPM_INV1ActTorq_Nm@ */ /end MEASUREMENT
/begin MEASUREMENT VIPM_ESCYawRate_degps "" FLOAT32_IEEE AppSwcIpm_CM_single_degps 0 0 -100000.0 100000.0 ECU_ADDRESS 0x0000 /* @ECU_Address@VIPM_ESCYawRate_degps@ */ /end MEASUREMENT
/begin MEASUREMENT VIPM_ESCWhlTqIncReqVal_Nm "" FLOAT32_IEEE AppSwcIpm_CM_single_Nm 0 0 -100000.0 100000.0 ECU_ADDRESS 0x0000 /* @ECU_Address@VIPM_ESCWhlTqIncReqVal_Nm@ */ /end MEASUREMENT
/begin MEASUREMENT VIPM_ESCWhlTqDecReqVal_Nm "" FLOAT32_IEEE AppSwcIpm_CM_single_Nm 0 0 -100000.0 100000.0 ECU_ADDRESS 0x0000 /* @ECU_Address@VIPM_ESCWhlTqDecReqVal_Nm@ */ /end MEASUREMENT
/begin MEASUREMENT VIPM_ESCWhlSpdKphRR_kph "" FLOAT32_IEEE AppSwcIpm_CM_single_kph 0 0 -100000.0 100000.0 ECU_ADDRESS 0x0000 /* @ECU_Address@VIPM_ESCWhlSpdKphRR_kph@ */ /end MEASUREMENT
/begin MEASUREMENT VIPM_ESCWhlSpdKphRL_kph "" FLOAT32_IEEE AppSwcIpm_CM_single_kph 0 0 -100000.0 100000.0 ECU_ADDRESS 0x0000 /* @ECU_Address@VIPM_ESCWhlSpdKphRL_kph@ */ /end MEASUREMENT
/begin MEASUREMENT VIPM_ESCWhlSpdKphFR_kph "" FLOAT32_IEEE AppSwcIpm_CM_single_kph 0 0 -100000.0 100000.0 ECU_ADDRESS 0x0000 /* @ECU_Address@VIPM_ESCWhlSpdKphFR_kph@ */ /end MEASUREMENT
/begin MEASUREMENT VIPM_ESCWhlSpdKphFL_kph "" FLOAT32_IEEE AppSwcIpm_CM_single_kph 0 0 -100000.0 100000.0 ECU_ADDRESS 0x0000 /* @ECU_Address@VIPM_ESCWhlSpdKphFL_kph@ */ /end MEASUREMENT
/begin MEASUREMENT VIPM_ESCMstrCylPresr_bar "" FLOAT32_IEEE AppSwcIpm_CM_single_bar 0 0 -100000.0 100000.0 ECU_ADDRESS 0x0000 /* @ECU_Address@VIPM_ESCMstrCylPresr_bar@ */ /end MEASUREMENT
/begin MEASUREMENT VIPM_ESCLongAccSnsrVal_g "" FLOAT32_IEEE AppSwcIpm_CM_single_g 0 0 -100000.0 100000.0 ECU_ADDRESS 0x0000 /* @ECU_Address@VIPM_ESCLongAccSnsrVal_g@ */ /end MEASUREMENT
/begin MEASUREMENT VIPM_ESCLatAccSnsrVal_g "" FLOAT32_IEEE AppSwcIpm_CM_single_g 0 0 -100000.0 100000.0 ECU_ADDRESS 0x0000 /* @ECU_Address@VIPM_ESCLatAccSnsrVal_g@ */ /end MEASUREMENT
/begin MEASUREMENT VIPM_ESCVehSpd_kph "" FLOAT32_IEEE AppSwcIpm_CM_single_kph 0 0 -100000.0 100000.0 ECU_ADDRESS 0x0000 /* @ECU_Address@VIPM_ESCVehSpd_kph@ */ /end MEASUREMENT
/begin MEASUREMENT VIPM_ESCSlopPct_pct "" FLOAT32_IEEE AppSwcIpm_CM_single_pct 0 0 -100000.0 100000.0 ECU_ADDRESS 0x0000 /* @ECU_Address@VIPM_ESCSlopPct_pct@ */ /end MEASUREMENT
/begin MEASUREMENT VIPM_EPSSteerWhlAng_deg "" FLOAT32_IEEE AppSwcIpm_CM_single_deg 0 0 -100000.0 100000.0 ECU_ADDRESS 0x0000 /* @ECU_Address@VIPM_EPSSteerWhlAng_deg@ */ /end MEASUREMENT
/begin MEASUREMENT VIPM_EPSRotSpd_degps "" FLOAT32_IEEE AppSwcIpm_CM_single_degps 0 0 -100000.0 100000.0 ECU_ADDRESS 0x0000 /* @ECU_Address@VIPM_EPSRotSpd_degps@ */ /end MEASUREMENT
/begin MEASUREMENT VIPM_EHBBrkPwrRecupTarWhlTq_Nm "" FLOAT32_IEEE AppSwcIpm_CM_single_Nm 0 0 -100000.0 100000.0 ECU_ADDRESS 0x0000 /* @ECU_Address@VIPM_EHBBrkPwrRecupTarWhlTq_Nm@ */ /end MEASUREMENT
/begin MEASUREMENT VIPM_EHBBrkPedlValPerc_pct "" FLOAT32_IEEE AppSwcIpm_CM_single_pct 0 0 -100000.0 100000.0 ECU_ADDRESS 0x0000 /* @ECU_Address@VIPM_EHBBrkPedlValPerc_pct@ */ /end MEASUREMENT
/begin MEASUREMENT VIPM_IPUOBCTempInt_C "" FLOAT32_IEEE AppSwcIpm_CM_single_C 0 0 -100000.0 100000.0 ECU_ADDRESS 0x0000 /* @ECU_Address@VIPM_IPUOBCTempInt_C@ */ /end MEASUREMENT
/begin MEASUREMENT VIPM_IPUOBCACMaxPwrAllow_kW "" FLOAT32_IEEE AppSwcIpm_CM_single_kW 0 0 -100000.0 100000.0 ECU_ADDRESS 0x0000 /* @ECU_Address@VIPM_IPUOBCACMaxPwrAllow_kW@ */ /end MEASUREMENT
/begin MEASUREMENT VIPM_IPUDeviceIntTemp_C "" FLOAT32_IEEE AppSwcIpm_CM_single_C 0 0 -100000.0 100000.0 ECU_ADDRESS 0x0000 /* @ECU_Address@VIPM_IPUDeviceIntTemp_C@ */ /end MEASUREMENT
/begin MEASUREMENT VIPM_IPUOBCInletActPwr_kW "" FLOAT32_IEEE AppSwcIpm_CM_single_kW 0 0 -100000.0 100000.0 ECU_ADDRESS 0x0000 /* @ECU_Address@VIPM_IPUOBCInletActPwr_kW@ */ /end MEASUREMENT
/begin MEASUREMENT VIPM_IPUOBCHVDCActVol_V "" FLOAT32_IEEE AppSwcIpm_CM_single_V 0 0 -100000.0 100000.0 ECU_ADDRESS 0x0000 /* @ECU_Address@VIPM_IPUOBCHVDCActVol_V@ */ /end MEASUREMENT
/begin MEASUREMENT VIPM_IPUOBCHVDCActCur_A "" FLOAT32_IEEE AppSwcIpm_CM_single_A 0 0 -100000.0 100000.0 ECU_ADDRESS 0x0000 /* @ECU_Address@VIPM_IPUOBCHVDCActCur_A@ */ /end MEASUREMENT
/begin MEASUREMENT VIPM_IPUDCCHiVoltActVolt_V "" FLOAT32_IEEE AppSwcIpm_CM_single_V 0 0 -100000.0 100000.0 ECU_ADDRESS 0x0000 /* @ECU_Address@VIPM_IPUDCCHiVoltActVolt_V@ */ /end MEASUREMENT
/begin MEASUREMENT VIPM_IPUDCCHiVoltActCurnt_A "" FLOAT32_IEEE AppSwcIpm_CM_single_A 0 0 -100000.0 100000.0 ECU_ADDRESS 0x0000 /* @ECU_Address@VIPM_IPUDCCHiVoltActCurnt_A@ */ /end MEASUREMENT
/begin MEASUREMENT VIPM_IPUDCCLoVoltActVolt_V "" FLOAT32_IEEE AppSwcIpm_CM_single_V 0 0 -100000.0 100000.0 ECU_ADDRESS 0x0000 /* @ECU_Address@VIPM_IPUDCCLoVoltActVolt_V@ */ /end MEASUREMENT
/begin MEASUREMENT VIPM_IPUDCCLoVoltActCurnt_A "" FLOAT32_IEEE AppSwcIpm_CM_single_A 0 0 -100000.0 100000.0 ECU_ADDRESS 0x0000 /* @ECU_Address@VIPM_IPUDCCLoVoltActCurnt_A@ */ /end MEASUREMENT
/begin MEASUREMENT VIPM_BMSHVBatCellTempMin_C "" FLOAT32_IEEE AppSwcIpm_CM_single_C 0 0 -100000.0 100000.0 ECU_ADDRESS 0x0000 /* @ECU_Address@VIPM_BMSHVBatCellTempMin_C@ */ /end MEASUREMENT
/begin MEASUREMENT VIPM_BMSHVBatCellTempMax_C "" FLOAT32_IEEE AppSwcIpm_CM_single_C 0 0 -100000.0 100000.0 ECU_ADDRESS 0x0000 /* @ECU_Address@VIPM_BMSHVBatCellTempMax_C@ */ /end MEASUREMENT
/begin MEASUREMENT VIPM_BMSHVBatCellTempAve_C "" FLOAT32_IEEE AppSwcIpm_CM_single_C 0 0 -100000.0 100000.0 ECU_ADDRESS 0x0000 /* @ECU_Address@VIPM_BMSHVBatCellTempAve_C@ */ /end MEASUREMENT
/begin MEASUREMENT VIPM_INV1ShutdownAllwd_enum "" UBYTE AppSwcIpm_CM_uint8_enum 0 0 0.0 255.0 ECU_ADDRESS 0x0000 /* @ECU_Address@VIPM_INV1ShutdownAllwd_enum@ */ /end MEASUREMENT
/begin MEASUREMENT VIPM_INV1PreChrgAllwd_enum "" UBYTE AppSwcIpm_CM_uint8_enum 0 0 0.0 255.0 ECU_ADDRESS 0x0000 /* @ECU_Address@VIPM_INV1PreChrgAllwd_enum@ */ /end MEASUREMENT
/begin MEASUREMENT VIPM_INV1AntithftAuthRslt_enum "" UBYTE AppSwcIpm_CM_uint8_enum 0 0 0.0 255.0 ECU_ADDRESS 0x0000 /* @ECU_Address@VIPM_INV1AntithftAuthRslt_enum@ */ /end MEASUREMENT
/begin MEASUREMENT VIPM_ESCWhlDirctnRR_enum "" UBYTE AppSwcIpm_CM_uint8_enum 0 0 0.0 255.0 ECU_ADDRESS 0x0000 /* @ECU_Address@VIPM_ESCWhlDirctnRR_enum@ */ /end MEASUREMENT
/begin MEASUREMENT VIPM_ESCWhlDirctnRL_enum "" UBYTE AppSwcIpm_CM_uint8_enum 0 0 0.0 255.0 ECU_ADDRESS 0x0000 /* @ECU_Address@VIPM_ESCWhlDirctnRL_enum@ */ /end MEASUREMENT
/begin MEASUREMENT VIPM_ESCWhlDirctnFR_enum "" UBYTE AppSwcIpm_CM_uint8_enum 0 0 0.0 255.0 ECU_ADDRESS 0x0000 /* @ECU_Address@VIPM_ESCWhlDirctnFR_enum@ */ /end MEASUREMENT
/begin MEASUREMENT VIPM_ESCWhlDirctnFL_enum "" UBYTE AppSwcIpm_CM_uint8_enum 0 0 0.0 255.0 ECU_ADDRESS 0x0000 /* @ECU_Address@VIPM_ESCWhlDirctnFL_enum@ */ /end MEASUREMENT
/begin MEASUREMENT VIPM_ESCVehStandStillSta_enum "" UBYTE AppSwcIpm_CM_uint8_enum 0 0 0.0 255.0 ECU_ADDRESS 0x0000 /* @ECU_Address@VIPM_ESCVehStandStillSta_enum@ */ /end MEASUREMENT
/begin MEASUREMENT VIPM_ESCFltLvl_enum "" UBYTE AppSwcIpm_CM_uint8_enum 0 0 0.0 255.0 ECU_ADDRESS 0x0000 /* @ECU_Address@VIPM_ESCFltLvl_enum@ */ /end MEASUREMENT
/begin MEASUREMENT VIPM_EHBFltLvl_enum "" UBYTE AppSwcIpm_CM_uint8_enum 0 0 0.0 255.0 ECU_ADDRESS 0x0000 /* @ECU_Address@VIPM_EHBFltLvl_enum@ */ /end MEASUREMENT
/begin MEASUREMENT VIPM_EHBEPBDynAppSt_enum "" UBYTE AppSwcIpm_CM_uint8_enum 0 0 0.0 255.0 ECU_ADDRESS 0x0000 /* @ECU_Address@VIPM_EHBEPBDynAppSt_enum@ */ /end MEASUREMENT
/begin MEASUREMENT VIPM_BMSPackID_enum "" UBYTE AppSwcIpm_CM_uint8_enum 0 0 0.0 255.0 ECU_ADDRESS 0x0000 /* @ECU_Address@VIPM_BMSPackID_enum@ */ /end MEASUREMENT
/begin MEASUREMENT VIPM_BMSBatCapcty_Ah "" UBYTE AppSwcIpm_CM_uint8_Ah 0 0 0.0 255.0 ECU_ADDRESS 0x0000 /* @ECU_Address@VIPM_BMSBatCapcty_Ah@ */ /end MEASUREMENT
/begin MEASUREMENT VIPM_IPUOBCSysFailSta_enum "" UBYTE AppSwcIpm_CM_uint8_enum 0 0 0.0 255.0 ECU_ADDRESS 0x0000 /* @ECU_Address@VIPM_IPUOBCSysFailSta_enum@ */ /end MEASUREMENT
/begin MEASUREMENT VIPM_IPUDCCSysFailSta_enum "" UBYTE AppSwcIpm_CM_uint8_enum 0 0 0.0 255.0 ECU_ADDRESS 0x0000 /* @ECU_Address@VIPM_IPUDCCSysFailSta_enum@ */ /end MEASUREMENT
/begin MEASUREMENT VIPM_INVLrngSubID_cnt "" UBYTE AppSwcIpm_CM_uint8_cnt 0 0 0.0 255.0 ECU_ADDRESS 0x0000 /* @ECU_Address@VIPM_INVLrngSubID_cnt@ */ /end MEASUREMENT
/begin MEASUREMENT VIPM_INVLrngSts_enum "" UBYTE AppSwcIpm_CM_uint8_enum 0 0 0.0 255.0 ECU_ADDRESS 0x0000 /* @ECU_Address@VIPM_INVLrngSts_enum@ */ /end MEASUREMENT
/begin MEASUREMENT VIPM_INVLrngData07_nu "" UBYTE AppSwcIpm_CM_uint8_nu 0 0 0.0 255.0 ECU_ADDRESS 0x0000 /* @ECU_Address@VIPM_INVLrngData07_nu@ */ /end MEASUREMENT
/begin MEASUREMENT VIPM_INVLrngData06_nu "" UBYTE AppSwcIpm_CM_uint8_nu 0 0 0.0 255.0 ECU_ADDRESS 0x0000 /* @ECU_Address@VIPM_INVLrngData06_nu@ */ /end MEASUREMENT
/begin MEASUREMENT VIPM_INVLrngData05_nu "" UBYTE AppSwcIpm_CM_uint8_nu 0 0 0.0 255.0 ECU_ADDRESS 0x0000 /* @ECU_Address@VIPM_INVLrngData05_nu@ */ /end MEASUREMENT
/begin MEASUREMENT VIPM_INVLrngData04_nu "" UBYTE AppSwcIpm_CM_uint8_nu 0 0 0.0 255.0 ECU_ADDRESS 0x0000 /* @ECU_Address@VIPM_INVLrngData04_nu@ */ /end MEASUREMENT
/begin MEASUREMENT VIPM_INVLrngData03_nu "" UBYTE AppSwcIpm_CM_uint8_nu 0 0 0.0 255.0 ECU_ADDRESS 0x0000 /* @ECU_Address@VIPM_INVLrngData03_nu@ */ /end MEASUREMENT
/begin MEASUREMENT VIPM_INVLrngData02_nu "" UBYTE AppSwcIpm_CM_uint8_nu 0 0 0.0 255.0 ECU_ADDRESS 0x0000 /* @ECU_Address@VIPM_INVLrngData02_nu@ */ /end MEASUREMENT
/begin MEASUREMENT VIPM_TboxRmtDefrstCtl_enum "" UBYTE AppSwcIpm_CM_uint8_enum 0 0 0.0 255.0 ECU_ADDRESS 0x0000 /* @ECU_Address@VIPM_TboxRmtDefrstCtl_enum@ */ /end MEASUREMENT
/begin MEASUREMENT VIPM_TBoxRmtLck_enum "" UBYTE AppSwcIpm_CM_uint8_enum 0 0 0.0 255.0 ECU_ADDRESS 0x0000 /* @ECU_Address@VIPM_TBoxRmtLck_enum@ */ /end MEASUREMENT
/begin MEASUREMENT VIPM_TBoxRmtCarSearch_enum "" UBYTE AppSwcIpm_CM_uint8_enum 0 0 0.0 255.0 ECU_ADDRESS 0x0000 /* @ECU_Address@VIPM_TBoxRmtCarSearch_enum@ */ /end MEASUREMENT
/begin MEASUREMENT VIPM_TBoxOpenVentn_enum "" UBYTE AppSwcIpm_CM_uint8_enum 0 0 0.0 255.0 ECU_ADDRESS 0x0000 /* @ECU_Address@VIPM_TBoxOpenVentn_enum@ */ /end MEASUREMENT
/begin MEASUREMENT VIPM_TBOXVCUCCMSpdLimLvl_enum "" UBYTE AppSwcIpm_CM_uint8_enum 0 0 0.0 255.0 ECU_ADDRESS 0x0000 /* @ECU_Address@VIPM_TBOXVCUCCMSpdLimLvl_enum@ */ /end MEASUREMENT
/begin MEASUREMENT VIPM_TBOXRmtPwrLck_enum "" UBYTE AppSwcIpm_CM_uint8_enum 0 0 0.0 255.0 ECU_ADDRESS 0x0000 /* @ECU_Address@VIPM_TBOXRmtPwrLck_enum@ */ /end MEASUREMENT
/begin MEASUREMENT VIPM_TBOXACTempSet_enum "" UBYTE AppSwcIpm_CM_uint8_enum 0 0 0.0 255.0 ECU_ADDRESS 0x0000 /* @ECU_Address@VIPM_TBOXACTempSet_enum@ */ /end MEASUREMENT
/begin MEASUREMENT VIPM_INV2MotorMaxTempVld_flg "" UBYTE AppSwcIpm_CM_boolean_flg 0 0 0.0 1.0 ECU_ADDRESS 0x0000 /* @ECU_Address@VIPM_INV2MotorMaxTempVld_flg@ */ /end MEASUREMENT
/begin MEASUREMENT VIPM_INV2InpVoltVld_flg "" UBYTE AppSwcIpm_CM_boolean_flg 0 0 0.0 1.0 ECU_ADDRESS 0x0000 /* @ECU_Address@VIPM_INV2InpVoltVld_flg@ */ /end MEASUREMENT
/begin MEASUREMENT VIPM_INV2InpCurntVld_flg "" UBYTE AppSwcIpm_CM_boolean_flg 0 0 0.0 1.0 ECU_ADDRESS 0x0000 /* @ECU_Address@VIPM_INV2InpCurntVld_flg@ */ /end MEASUREMENT
/begin MEASUREMENT VIPM_INV2IgbtMaxTempVld_flg "" UBYTE AppSwcIpm_CM_boolean_flg 0 0 0.0 1.0 ECU_ADDRESS 0x0000 /* @ECU_Address@VIPM_INV2IgbtMaxTempVld_flg@ */ /end MEASUREMENT
/begin MEASUREMENT VIPM_INV1ShutdownAllwdVld_flg "" UBYTE AppSwcIpm_CM_boolean_flg 0 0 0.0 1.0 ECU_ADDRESS 0x0000 /* @ECU_Address@VIPM_INV1ShutdownAllwdVld_flg@ */ /end MEASUREMENT
/begin MEASUREMENT VIPM_INV1PreprogmFlgVld_flg "" UBYTE AppSwcIpm_CM_boolean_flg 0 0 0.0 1.0 ECU_ADDRESS 0x0000 /* @ECU_Address@VIPM_INV1PreprogmFlgVld_flg@ */ /end MEASUREMENT
/begin MEASUREMENT VIPM_INV1PreprogmFlg_flg "" UBYTE AppSwcIpm_CM_boolean_flg 0 0 0.0 1.0 ECU_ADDRESS 0x0000 /* @ECU_Address@VIPM_INV1PreprogmFlg_flg@ */ /end MEASUREMENT
/begin MEASUREMENT VIPM_INV1PreChrgAllwdVld_flg "" UBYTE AppSwcIpm_CM_boolean_flg 0 0 0.0 1.0 ECU_ADDRESS 0x0000 /* @ECU_Address@VIPM_INV1PreChrgAllwdVld_flg@ */ /end MEASUREMENT
/begin MEASUREMENT VIPM_INV1MotSpdVld_flg "" UBYTE AppSwcIpm_CM_boolean_flg 0 0 0.0 1.0 ECU_ADDRESS 0x0000 /* @ECU_Address@VIPM_INV1MotSpdVld_flg@ */ /end MEASUREMENT
/begin MEASUREMENT VIPM_INV1AntithftAuthRsltVld_flg "" UBYTE AppSwcIpm_CM_boolean_flg 0 0 0.0 1.0 ECU_ADDRESS 0x0000 /* @ECU_Address@VIPM_INV1AntithftAuthRsltVld_flg@ */ /end MEASUREMENT
/begin MEASUREMENT VIPM_INV1ActTorqVld_flg "" UBYTE AppSwcIpm_CM_boolean_flg 0 0 0.0 1.0 ECU_ADDRESS 0x0000 /* @ECU_Address@VIPM_INV1ActTorqVld_flg@ */ /end MEASUREMENT
/begin MEASUREMENT VIPM_INV1ActModeVld_flg "" UBYTE AppSwcIpm_CM_boolean_flg 0 0 0.0 1.0 ECU_ADDRESS 0x0000 /* @ECU_Address@VIPM_INV1ActModeVld_flg@ */ /end MEASUREMENT
/begin MEASUREMENT VIPM_ESCYawRateVld_flg "" UBYTE AppSwcIpm_CM_boolean_flg 0 0 0.0 1.0 ECU_ADDRESS 0x0000 /* @ECU_Address@VIPM_ESCYawRateVld_flg@ */ /end MEASUREMENT
/begin MEASUREMENT VIPM_ESCWhlTqIncReqValVld_flg "" UBYTE AppSwcIpm_CM_boolean_flg 0 0 0.0 1.0 ECU_ADDRESS 0x0000 /* @ECU_Address@VIPM_ESCWhlTqIncReqValVld_flg@ */ /end MEASUREMENT
/begin MEASUREMENT VIPM_ESCWhlTqIncReqActvVld_flg "" UBYTE AppSwcIpm_CM_boolean_flg 0 0 0.0 1.0 ECU_ADDRESS 0x0000 /* @ECU_Address@VIPM_ESCWhlTqIncReqActvVld_flg@ */ /end MEASUREMENT
/begin MEASUREMENT VIPM_ESCWhlTqIncReqActv_flg "" UBYTE AppSwcIpm_CM_boolean_flg 0 0 0.0 1.0 ECU_ADDRESS 0x0000 /* @ECU_Address@VIPM_ESCWhlTqIncReqActv_flg@ */ /end MEASUREMENT
/begin MEASUREMENT VIPM_ESCWhlTqDecReqValVld_flg "" UBYTE AppSwcIpm_CM_boolean_flg 0 0 0.0 1.0 ECU_ADDRESS 0x0000 /* @ECU_Address@VIPM_ESCWhlTqDecReqValVld_flg@ */ /end MEASUREMENT
/begin MEASUREMENT VIPM_ESCWhlTqDecReqActvVld_flg "" UBYTE AppSwcIpm_CM_boolean_flg 0 0 0.0 1.0 ECU_ADDRESS 0x0000 /* @ECU_Address@VIPM_ESCWhlTqDecReqActvVld_flg@ */ /end MEASUREMENT
/begin MEASUREMENT VIPM_ESCWhlTqDecReqActv_flg "" UBYTE AppSwcIpm_CM_boolean_flg 0 0 0.0 1.0 ECU_ADDRESS 0x0000 /* @ECU_Address@VIPM_ESCWhlTqDecReqActv_flg@ */ /end MEASUREMENT
/begin MEASUREMENT VIPM_ESCWhlSpdKphRRVld_flg "" UBYTE AppSwcIpm_CM_boolean_flg 0 0 0.0 1.0 ECU_ADDRESS 0x0000 /* @ECU_Address@VIPM_ESCWhlSpdKphRRVld_flg@ */ /end MEASUREMENT
/begin MEASUREMENT VIPM_ESCWhlSpdKphRLVld_flg "" UBYTE AppSwcIpm_CM_boolean_flg 0 0 0.0 1.0 ECU_ADDRESS 0x0000 /* @ECU_Address@VIPM_ESCWhlSpdKphRLVld_flg@ */ /end MEASUREMENT
/begin MEASUREMENT VIPM_ESCWhlSpdKphFRVld_flg "" UBYTE AppSwcIpm_CM_boolean_flg 0 0 0.0 1.0 ECU_ADDRESS 0x0000 /* @ECU_Address@VIPM_ESCWhlSpdKphFRVld_flg@ */ /end MEASUREMENT
/begin MEASUREMENT VIPM_ESCWhlSpdKphFLVld_flg "" UBYTE AppSwcIpm_CM_boolean_flg 0 0 0.0 1.0 ECU_ADDRESS 0x0000 /* @ECU_Address@VIPM_ESCWhlSpdKphFLVld_flg@ */ /end MEASUREMENT
/begin MEASUREMENT VIPM_ESCWhlDirctnRRVld_flg "" UBYTE AppSwcIpm_CM_boolean_flg 0 0 0.0 1.0 ECU_ADDRESS 0x0000 /* @ECU_Address@VIPM_ESCWhlDirctnRRVld_flg@ */ /end MEASUREMENT
/begin MEASUREMENT VIPM_ESCWhlDirctnRLVld_flg "" UBYTE AppSwcIpm_CM_boolean_flg 0 0 0.0 1.0 ECU_ADDRESS 0x0000 /* @ECU_Address@VIPM_ESCWhlDirctnRLVld_flg@ */ /end MEASUREMENT
/begin MEASUREMENT VIPM_ESCWhlDirctnFRVld_flg "" UBYTE AppSwcIpm_CM_boolean_flg 0 0 0.0 1.0 ECU_ADDRESS 0x0000 /* @ECU_Address@VIPM_ESCWhlDirctnFRVld_flg@ */ /end MEASUREMENT
/begin MEASUREMENT VIPM_ESCWhlDirctnFLVld_flg "" UBYTE AppSwcIpm_CM_boolean_flg 0 0 0.0 1.0 ECU_ADDRESS 0x0000 /* @ECU_Address@VIPM_ESCWhlDirctnFLVld_flg@ */ /end MEASUREMENT
/begin MEASUREMENT VIPM_ESCVehStandStillStaVld_flg "" UBYTE AppSwcIpm_CM_boolean_flg 0 0 0.0 1.0 ECU_ADDRESS 0x0000 /* @ECU_Address@VIPM_ESCVehStandStillStaVld_flg@ */ /end MEASUREMENT
/begin MEASUREMENT VIPM_ESCMstrCylPresrVld_flg "" UBYTE AppSwcIpm_CM_boolean_flg 0 0 0.0 1.0 ECU_ADDRESS 0x0000 /* @ECU_Address@VIPM_ESCMstrCylPresrVld_flg@ */ /end MEASUREMENT
/begin MEASUREMENT VIPM_ESCLongAccSnsrValVld_flg "" UBYTE AppSwcIpm_CM_boolean_flg 0 0 0.0 1.0 ECU_ADDRESS 0x0000 /* @ECU_Address@VIPM_ESCLongAccSnsrValVld_flg@ */ /end MEASUREMENT
/begin MEASUREMENT VIPM_ESCLatAccSnsrValVld_flg "" UBYTE AppSwcIpm_CM_boolean_flg 0 0 0.0 1.0 ECU_ADDRESS 0x0000 /* @ECU_Address@VIPM_ESCLatAccSnsrValVld_flg@ */ /end MEASUREMENT
/begin MEASUREMENT VIPM_ESCVehSpdVld_flg "" UBYTE AppSwcIpm_CM_boolean_flg 0 0 0.0 1.0 ECU_ADDRESS 0x0000 /* @ECU_Address@VIPM_ESCVehSpdVld_flg@ */ /end MEASUREMENT
/begin MEASUREMENT VIPM_ESCTCSActvStaVld_flg "" UBYTE AppSwcIpm_CM_boolean_flg 0 0 0.0 1.0 ECU_ADDRESS 0x0000 /* @ECU_Address@VIPM_ESCTCSActvStaVld_flg@ */ /end MEASUREMENT
/begin MEASUREMENT VIPM_ESCTCSActvSta_flg "" UBYTE AppSwcIpm_CM_boolean_flg 0 0 0.0 1.0 ECU_ADDRESS 0x0000 /* @ECU_Address@VIPM_ESCTCSActvSta_flg@ */ /end MEASUREMENT
/begin MEASUREMENT VIPM_ESCSlopPctVld_flg "" UBYTE AppSwcIpm_CM_boolean_flg 0 0 0.0 1.0 ECU_ADDRESS 0x0000 /* @ECU_Address@VIPM_ESCSlopPctVld_flg@ */ /end MEASUREMENT
/begin MEASUREMENT VIPM_ESCReqBrkLghtOnVld_flg "" UBYTE AppSwcIpm_CM_boolean_flg 0 0 0.0 1.0 ECU_ADDRESS 0x0000 /* @ECU_Address@VIPM_ESCReqBrkLghtOnVld_flg@ */ /end MEASUREMENT
/begin MEASUREMENT VIPM_ESCReqBrkLghtOn_flg "" UBYTE AppSwcIpm_CM_boolean_flg 0 0 0.0 1.0 ECU_ADDRESS 0x0000 /* @ECU_Address@VIPM_ESCReqBrkLghtOn_flg@ */ /end MEASUREMENT
/begin MEASUREMENT VIPM_ESCFltLvlVld_flg "" UBYTE AppSwcIpm_CM_boolean_flg 0 0 0.0 1.0 ECU_ADDRESS 0x0000 /* @ECU_Address@VIPM_ESCFltLvlVld_flg@ */ /end MEASUREMENT
/begin MEASUREMENT VIPM_ESCESSActvVld_flg "" UBYTE AppSwcIpm_CM_boolean_flg 0 0 0.0 1.0 ECU_ADDRESS 0x0000 /* @ECU_Address@VIPM_ESCESSActvVld_flg@ */ /end MEASUREMENT
/begin MEASUREMENT VIPM_ESCESSActv_flg "" UBYTE AppSwcIpm_CM_boolean_flg 0 0 0.0 1.0 ECU_ADDRESS 0x0000 /* @ECU_Address@VIPM_ESCESSActv_flg@ */ /end MEASUREMENT
/begin MEASUREMENT VIPM_ESCESPActvStaVld_flg "" UBYTE AppSwcIpm_CM_boolean_flg 0 0 0.0 1.0 ECU_ADDRESS 0x0000 /* @ECU_Address@VIPM_ESCESPActvStaVld_flg@ */ /end MEASUREMENT
/begin MEASUREMENT VIPM_ESCESPActvSta_flg "" UBYTE AppSwcIpm_CM_boolean_flg 0 0 0.0 1.0 ECU_ADDRESS 0x0000 /* @ECU_Address@VIPM_ESCESPActvSta_flg@ */ /end MEASUREMENT
/begin MEASUREMENT VIPM_ESCEBDActvVld_flg "" UBYTE AppSwcIpm_CM_boolean_flg 0 0 0.0 1.0 ECU_ADDRESS 0x0000 /* @ECU_Address@VIPM_ESCEBDActvVld_flg@ */ /end MEASUREMENT
/begin MEASUREMENT VIPM_ESCEBDActv_flg "" UBYTE AppSwcIpm_CM_boolean_flg 0 0 0.0 1.0 ECU_ADDRESS 0x0000 /* @ECU_Address@VIPM_ESCEBDActv_flg@ */ /end MEASUREMENT
/begin MEASUREMENT VIPM_ESCCDPActvVld_flg "" UBYTE AppSwcIpm_CM_boolean_flg 0 0 0.0 1.0 ECU_ADDRESS 0x0000 /* @ECU_Address@VIPM_ESCCDPActvVld_flg@ */ /end MEASUREMENT
/begin MEASUREMENT VIPM_ESCCDPActv_flg "" UBYTE AppSwcIpm_CM_boolean_flg 0 0 0.0 1.0 ECU_ADDRESS 0x0000 /* @ECU_Address@VIPM_ESCCDPActv_flg@ */ /end MEASUREMENT
/begin MEASUREMENT VIPM_ESCABSActvStaVld_flg "" UBYTE AppSwcIpm_CM_boolean_flg 0 0 0.0 1.0 ECU_ADDRESS 0x0000 /* @ECU_Address@VIPM_ESCABSActvStaVld_flg@ */ /end MEASUREMENT
/begin MEASUREMENT VIPM_ESCABSActvSta_flg "" UBYTE AppSwcIpm_CM_boolean_flg 0 0 0.0 1.0 ECU_ADDRESS 0x0000 /* @ECU_Address@VIPM_ESCABSActvSta_flg@ */ /end MEASUREMENT
/begin MEASUREMENT VIPM_EPSSteerWhlAngVld_flg "" UBYTE AppSwcIpm_CM_boolean_flg 0 0 0.0 1.0 ECU_ADDRESS 0x0000 /* @ECU_Address@VIPM_EPSSteerWhlAngVld_flg@ */ /end MEASUREMENT
/begin MEASUREMENT VIPM_EPSSteerWhlAngFailrVld_flg "" UBYTE AppSwcIpm_CM_boolean_flg 0 0 0.0 1.0 ECU_ADDRESS 0x0000 /* @ECU_Address@VIPM_EPSSteerWhlAngFailrVld_flg@ */ /end MEASUREMENT
/begin MEASUREMENT VIPM_EPSSteerWhlAngFailr_flg "" UBYTE AppSwcIpm_CM_boolean_flg 0 0 0.0 1.0 ECU_ADDRESS 0x0000 /* @ECU_Address@VIPM_EPSSteerWhlAngFailr_flg@ */ /end MEASUREMENT
/begin MEASUREMENT VIPM_EPSSteerWhlAngCaldVld_flg "" UBYTE AppSwcIpm_CM_boolean_flg 0 0 0.0 1.0 ECU_ADDRESS 0x0000 /* @ECU_Address@VIPM_EPSSteerWhlAngCaldVld_flg@ */ /end MEASUREMENT
/begin MEASUREMENT VIPM_EPSSteerWhlAngCald_flg "" UBYTE AppSwcIpm_CM_boolean_flg 0 0 0.0 1.0 ECU_ADDRESS 0x0000 /* @ECU_Address@VIPM_EPSSteerWhlAngCald_flg@ */ /end MEASUREMENT
/begin MEASUREMENT VIPM_EPSRotSpdVld_flg "" UBYTE AppSwcIpm_CM_boolean_flg 0 0 0.0 1.0 ECU_ADDRESS 0x0000 /* @ECU_Address@VIPM_EPSRotSpdVld_flg@ */ /end MEASUREMENT
/begin MEASUREMENT VIPM_EHBReqBrkLiOnVld_flg "" UBYTE AppSwcIpm_CM_boolean_flg 0 0 0.0 1.0 ECU_ADDRESS 0x0000 /* @ECU_Address@VIPM_EHBReqBrkLiOnVld_flg@ */ /end MEASUREMENT
/begin MEASUREMENT VIPM_EHBReqBrkLiOn_flg "" UBYTE AppSwcIpm_CM_boolean_flg 0 0 0.0 1.0 ECU_ADDRESS 0x0000 /* @ECU_Address@VIPM_EHBReqBrkLiOn_flg@ */ /end MEASUREMENT
/begin MEASUREMENT VIPM_EHBFltLvlVld_flg "" UBYTE AppSwcIpm_CM_boolean_flg 0 0 0.0 1.0 ECU_ADDRESS 0x0000 /* @ECU_Address@VIPM_EHBFltLvlVld_flg@ */ /end MEASUREMENT
/begin MEASUREMENT VIPM_EHBEPBDynAppStVld_flg "" UBYTE AppSwcIpm_CM_boolean_flg 0 0 0.0 1.0 ECU_ADDRESS 0x0000 /* @ECU_Address@VIPM_EHBEPBDynAppStVld_flg@ */ /end MEASUREMENT
/begin MEASUREMENT VIPM_EHBEPBActuatorStRVld_flg "" UBYTE AppSwcIpm_CM_boolean_flg 0 0 0.0 1.0 ECU_ADDRESS 0x0000 /* @ECU_Address@VIPM_EHBEPBActuatorStRVld_flg@ */ /end MEASUREMENT
/begin MEASUREMENT VIPM_EHBCDDActvVld_flg "" UBYTE AppSwcIpm_CM_boolean_flg 0 0 0.0 1.0 ECU_ADDRESS 0x0000 /* @ECU_Address@VIPM_EHBCDDActvVld_flg@ */ /end MEASUREMENT
/begin MEASUREMENT VIPM_EHBCDDActv_flg "" UBYTE AppSwcIpm_CM_boolean_flg 0 0 0.0 1.0 ECU_ADDRESS 0x0000 /* @ECU_Address@VIPM_EHBCDDActv_flg@ */ /end MEASUREMENT
/begin MEASUREMENT VIPM_EHBBrkPwrRecupTarWhlTqVld_flg "" UBYTE AppSwcIpm_CM_boolean_flg 0 0 0.0 1.0 ECU_ADDRESS 0x0000 /* @ECU_Address@VIPM_EHBBrkPwrRecupTarWhlTqVld_flg@ */ /end MEASUREMENT
/begin MEASUREMENT VIPM_EHBBrkPwrRecupTarWhlTqStsVld_flg "" UBYTE AppSwcIpm_CM_boolean_flg 0 0 0.0 1.0 ECU_ADDRESS 0x0000 /* @ECU_Address@VIPM_EHBBrkPwrRecupTarWhlTqStsVld_flg@ */ /end MEASUREMENT
/begin MEASUREMENT VIPM_EHBBrkPedlValPercVld_flg "" UBYTE AppSwcIpm_CM_boolean_flg 0 0 0.0 1.0 ECU_ADDRESS 0x0000 /* @ECU_Address@VIPM_EHBBrkPedlValPercVld_flg@ */ /end MEASUREMENT
/begin MEASUREMENT VIPM_BMSPackIDVld_flg "" UBYTE AppSwcIpm_CM_boolean_flg 0 0 0.0 1.0 ECU_ADDRESS 0x0000 /* @ECU_Address@VIPM_BMSPackIDVld_flg@ */ /end MEASUREMENT
/begin MEASUREMENT VIPM_BMSBatCapctyVld_flg "" UBYTE AppSwcIpm_CM_boolean_flg 0 0 0.0 1.0 ECU_ADDRESS 0x0000 /* @ECU_Address@VIPM_BMSBatCapctyVld_flg@ */ /end MEASUREMENT
/begin MEASUREMENT VIPM_IPUOBCWakeUpModeVld_flg "" UBYTE AppSwcIpm_CM_boolean_flg 0 0 0.0 1.0 ECU_ADDRESS 0x0000 /* @ECU_Address@VIPM_IPUOBCWakeUpModeVld_flg@ */ /end MEASUREMENT
/begin MEASUREMENT VIPM_IPUOBCTempIntVld_flg "" UBYTE AppSwcIpm_CM_boolean_flg 0 0 0.0 1.0 ECU_ADDRESS 0x0000 /* @ECU_Address@VIPM_IPUOBCTempIntVld_flg@ */ /end MEASUREMENT
/begin MEASUREMENT VIPM_IPUOBCS2StateVld_flg "" UBYTE AppSwcIpm_CM_boolean_flg 0 0 0.0 1.0 ECU_ADDRESS 0x0000 /* @ECU_Address@VIPM_IPUOBCS2StateVld_flg@ */ /end MEASUREMENT
/begin MEASUREMENT VIPM_IPUOBCS2State_flg "" UBYTE AppSwcIpm_CM_boolean_flg 0 0 0.0 1.0 ECU_ADDRESS 0x0000 /* @ECU_Address@VIPM_IPUOBCS2State_flg@ */ /end MEASUREMENT
/begin MEASUREMENT VIPM_IPUOBCACMaxPwrAllowVld_flg "" UBYTE AppSwcIpm_CM_boolean_flg 0 0 0.0 1.0 ECU_ADDRESS 0x0000 /* @ECU_Address@VIPM_IPUOBCACMaxPwrAllowVld_flg@ */ /end MEASUREMENT
/begin MEASUREMENT VIPM_IPUDeviceIntTempVld_flg "" UBYTE AppSwcIpm_CM_boolean_flg 0 0 0.0 1.0 ECU_ADDRESS 0x0000 /* @ECU_Address@VIPM_IPUDeviceIntTempVld_flg@ */ /end MEASUREMENT
/begin MEASUREMENT VIPM_IPUOBCSysFailStaVld_flg "" UBYTE AppSwcIpm_CM_boolean_flg 0 0 0.0 1.0 ECU_ADDRESS 0x0000 /* @ECU_Address@VIPM_IPUOBCSysFailStaVld_flg@ */ /end MEASUREMENT
/begin MEASUREMENT VIPM_IPUOBCReqVld_flg "" UBYTE AppSwcIpm_CM_boolean_flg 0 0 0.0 1.0 ECU_ADDRESS 0x0000 /* @ECU_Address@VIPM_IPUOBCReqVld_flg@ */ /end MEASUREMENT
/begin MEASUREMENT VIPM_IPUOBCInletConnectStaVld_flg "" UBYTE AppSwcIpm_CM_boolean_flg 0 0 0.0 1.0 ECU_ADDRESS 0x0000 /* @ECU_Address@VIPM_IPUOBCInletConnectStaVld_flg@ */ /end MEASUREMENT
/begin MEASUREMENT VIPM_IPUOBCInletActPwrVld_flg "" UBYTE AppSwcIpm_CM_boolean_flg 0 0 0.0 1.0 ECU_ADDRESS 0x0000 /* @ECU_Address@VIPM_IPUOBCInletActPwrVld_flg@ */ /end MEASUREMENT
/begin MEASUREMENT VIPM_IPUOBCHVDCActVolVld_flg "" UBYTE AppSwcIpm_CM_boolean_flg 0 0 0.0 1.0 ECU_ADDRESS 0x0000 /* @ECU_Address@VIPM_IPUOBCHVDCActVolVld_flg@ */ /end MEASUREMENT
/begin MEASUREMENT VIPM_IPUOBCHVDCActCurVld_flg "" UBYTE AppSwcIpm_CM_boolean_flg 0 0 0.0 1.0 ECU_ADDRESS 0x0000 /* @ECU_Address@VIPM_IPUOBCHVDCActCurVld_flg@ */ /end MEASUREMENT
/begin MEASUREMENT VIPM_IPUOBCConnectMainStaVld_flg "" UBYTE AppSwcIpm_CM_boolean_flg 0 0 0.0 1.0 ECU_ADDRESS 0x0000 /* @ECU_Address@VIPM_IPUOBCConnectMainStaVld_flg@ */ /end MEASUREMENT
/begin MEASUREMENT VIPM_IPUOBCConnectMainSta_flg "" UBYTE AppSwcIpm_CM_boolean_flg 0 0 0.0 1.0 ECU_ADDRESS 0x0000 /* @ECU_Address@VIPM_IPUOBCConnectMainSta_flg@ */ /end MEASUREMENT
/begin MEASUREMENT VIPM_IPUOBCActOprtModeVld_flg "" UBYTE AppSwcIpm_CM_boolean_flg 0 0 0.0 1.0 ECU_ADDRESS 0x0000 /* @ECU_Address@VIPM_IPUOBCActOprtModeVld_flg@ */ /end MEASUREMENT
/begin MEASUREMENT VIPM_IPUDCCHiVoltActVoltVld_flg "" UBYTE AppSwcIpm_CM_boolean_flg 0 0 0.0 1.0 ECU_ADDRESS 0x0000 /* @ECU_Address@VIPM_IPUDCCHiVoltActVoltVld_flg@ */ /end MEASUREMENT
/begin MEASUREMENT VIPM_IPUDCCHiVoltActCurntVld_flg "" UBYTE AppSwcIpm_CM_boolean_flg 0 0 0.0 1.0 ECU_ADDRESS 0x0000 /* @ECU_Address@VIPM_IPUDCCHiVoltActCurntVld_flg@ */ /end MEASUREMENT
/begin MEASUREMENT VIPM_IPUHVILFailStVld_flg "" UBYTE AppSwcIpm_CM_boolean_flg 0 0 0.0 1.0 ECU_ADDRESS 0x0000 /* @ECU_Address@VIPM_IPUHVILFailStVld_flg@ */ /end MEASUREMENT
/begin MEASUREMENT VIPM_IPUHVILFailSt_flg "" UBYTE AppSwcIpm_CM_boolean_flg 0 0 0.0 1.0 ECU_ADDRESS 0x0000 /* @ECU_Address@VIPM_IPUHVILFailSt_flg@ */ /end MEASUREMENT
/begin MEASUREMENT VIPM_IPUDCCSysFailStaVld_flg "" UBYTE AppSwcIpm_CM_boolean_flg 0 0 0.0 1.0 ECU_ADDRESS 0x0000 /* @ECU_Address@VIPM_IPUDCCSysFailStaVld_flg@ */ /end MEASUREMENT
/begin MEASUREMENT VIPM_IPUDCCLoVoltActVoltVld_flg "" UBYTE AppSwcIpm_CM_boolean_flg 0 0 0.0 1.0 ECU_ADDRESS 0x0000 /* @ECU_Address@VIPM_IPUDCCLoVoltActVoltVld_flg@ */ /end MEASUREMENT
/begin MEASUREMENT VIPM_IPUDCCLoVoltActCurntVld_flg "" UBYTE AppSwcIpm_CM_boolean_flg 0 0 0.0 1.0 ECU_ADDRESS 0x0000 /* @ECU_Address@VIPM_IPUDCCLoVoltActCurntVld_flg@ */ /end MEASUREMENT
/begin MEASUREMENT VIPM_IPUDCCActOprtModeVld_flg "" UBYTE AppSwcIpm_CM_boolean_flg 0 0 0.0 1.0 ECU_ADDRESS 0x0000 /* @ECU_Address@VIPM_IPUDCCActOprtModeVld_flg@ */ /end MEASUREMENT
/begin MEASUREMENT VIPM_INVLrngSubIDVld_flg "" UBYTE AppSwcIpm_CM_boolean_flg 0 0 0.0 1.0 ECU_ADDRESS 0x0000 /* @ECU_Address@VIPM_INVLrngSubIDVld_flg@ */ /end MEASUREMENT
/begin MEASUREMENT VIPM_INVLrngStsVld_flg "" UBYTE AppSwcIpm_CM_boolean_flg 0 0 0.0 1.0 ECU_ADDRESS 0x0000 /* @ECU_Address@VIPM_INVLrngStsVld_flg@ */ /end MEASUREMENT
/begin MEASUREMENT VIPM_INVLrngData07Vld_flg "" UBYTE AppSwcIpm_CM_boolean_flg 0 0 0.0 1.0 ECU_ADDRESS 0x0000 /* @ECU_Address@VIPM_INVLrngData07Vld_flg@ */ /end MEASUREMENT
/begin MEASUREMENT VIPM_INVLrngData06Vld_flg "" UBYTE AppSwcIpm_CM_boolean_flg 0 0 0.0 1.0 ECU_ADDRESS 0x0000 /* @ECU_Address@VIPM_INVLrngData06Vld_flg@ */ /end MEASUREMENT
/begin MEASUREMENT VIPM_INVLrngData05Vld_flg "" UBYTE AppSwcIpm_CM_boolean_flg 0 0 0.0 1.0 ECU_ADDRESS 0x0000 /* @ECU_Address@VIPM_INVLrngData05Vld_flg@ */ /end MEASUREMENT
/begin MEASUREMENT VIPM_INVLrngData04Vld_flg "" UBYTE AppSwcIpm_CM_boolean_flg 0 0 0.0 1.0 ECU_ADDRESS 0x0000 /* @ECU_Address@VIPM_INVLrngData04Vld_flg@ */ /end MEASUREMENT
/begin MEASUREMENT VIPM_INVLrngData03Vld_flg "" UBYTE AppSwcIpm_CM_boolean_flg 0 0 0.0 1.0 ECU_ADDRESS 0x0000 /* @ECU_Address@VIPM_INVLrngData03Vld_flg@ */ /end MEASUREMENT
/begin MEASUREMENT VIPM_INVLrngData02Vld_flg "" UBYTE AppSwcIpm_CM_boolean_flg 0 0 0.0 1.0 ECU_ADDRESS 0x0000 /* @ECU_Address@VIPM_INVLrngData02Vld_flg@ */ /end MEASUREMENT
/begin MEASUREMENT VIPM_BMSHVBatCellTempMinVld_flg "" UBYTE AppSwcIpm_CM_boolean_flg 0 0 0.0 1.0 ECU_ADDRESS 0x0000 /* @ECU_Address@VIPM_BMSHVBatCellTempMinVld_flg@ */ /end MEASUREMENT
/begin MEASUREMENT VIPM_BMSHVBatCellTempMaxVld_flg "" UBYTE AppSwcIpm_CM_boolean_flg 0 0 0.0 1.0 ECU_ADDRESS 0x0000 /* @ECU_Address@VIPM_BMSHVBatCellTempMaxVld_flg@ */ /end MEASUREMENT
/begin MEASUREMENT VIPM_BMSHVBatCellTempAveVld_flg "" UBYTE AppSwcIpm_CM_boolean_flg 0 0 0.0 1.0 ECU_ADDRESS 0x0000 /* @ECU_Address@VIPM_BMSHVBatCellTempAveVld_flg@ */ /end MEASUREMENT
/begin MEASUREMENT VIPM_TboxRmtDefrstCtlVld_flg "" UBYTE AppSwcIpm_CM_boolean_flg 0 0 0.0 1.0 ECU_ADDRESS 0x0000 /* @ECU_Address@VIPM_TboxRmtDefrstCtlVld_flg@ */ /end MEASUREMENT
/begin MEASUREMENT VIPM_TBoxRmtLckVld_flg "" UBYTE AppSwcIpm_CM_boolean_flg 0 0 0.0 1.0 ECU_ADDRESS 0x0000 /* @ECU_Address@VIPM_TBoxRmtLckVld_flg@ */ /end MEASUREMENT
/begin MEASUREMENT VIPM_TBoxRmtCarSearchVld_flg "" UBYTE AppSwcIpm_CM_boolean_flg 0 0 0.0 1.0 ECU_ADDRESS 0x0000 /* @ECU_Address@VIPM_TBoxRmtCarSearchVld_flg@ */ /end MEASUREMENT
/begin MEASUREMENT VIPM_TBoxOpenVentnVld_flg "" UBYTE AppSwcIpm_CM_boolean_flg 0 0 0.0 1.0 ECU_ADDRESS 0x0000 /* @ECU_Address@VIPM_TBoxOpenVentnVld_flg@ */ /end MEASUREMENT
/begin MEASUREMENT VIPM_TBOXVCUVerVld_flg "" UBYTE AppSwcIpm_CM_boolean_flg 0 0 0.0 1.0 ECU_ADDRESS 0x0000 /* @ECU_Address@VIPM_TBOXVCUVerVld_flg@ */ /end MEASUREMENT
/begin MEASUREMENT VIPM_TBOXVCUVer_flg "" UBYTE AppSwcIpm_CM_boolean_flg 0 0 0.0 1.0 ECU_ADDRESS 0x0000 /* @ECU_Address@VIPM_TBOXVCUVer_flg@ */ /end MEASUREMENT
/begin MEASUREMENT VIPM_TBOXVCUOprtLicVld_flg "" UBYTE AppSwcIpm_CM_boolean_flg 0 0 0.0 1.0 ECU_ADDRESS 0x0000 /* @ECU_Address@VIPM_TBOXVCUOprtLicVld_flg@ */ /end MEASUREMENT
/begin MEASUREMENT VIPM_TBOXVCUOprtLic_flg "" UBYTE AppSwcIpm_CM_boolean_flg 0 0 0.0 1.0 ECU_ADDRESS 0x0000 /* @ECU_Address@VIPM_TBOXVCUOprtLic_flg@ */ /end MEASUREMENT
/begin MEASUREMENT VIPM_TBOXVCUChrgngCondsVld_flg "" UBYTE AppSwcIpm_CM_boolean_flg 0 0 0.0 1.0 ECU_ADDRESS 0x0000 /* @ECU_Address@VIPM_TBOXVCUChrgngCondsVld_flg@ */ /end MEASUREMENT
/begin MEASUREMENT VIPM_TBOXVCUChrgngConds_flg "" UBYTE AppSwcIpm_CM_boolean_flg 0 0 0.0 1.0 ECU_ADDRESS 0x0000 /* @ECU_Address@VIPM_TBOXVCUChrgngConds_flg@ */ /end MEASUREMENT
/begin MEASUREMENT VIPM_TBOXVCUCCMSpdLimLvlVld_flg "" UBYTE AppSwcIpm_CM_boolean_flg 0 0 0.0 1.0 ECU_ADDRESS 0x0000 /* @ECU_Address@VIPM_TBOXVCUCCMSpdLimLvlVld_flg@ */ /end MEASUREMENT
/begin MEASUREMENT VIPM_TBOXRmtPwrLckVld_flg "" UBYTE AppSwcIpm_CM_boolean_flg 0 0 0.0 1.0 ECU_ADDRESS 0x0000 /* @ECU_Address@VIPM_TBOXRmtPwrLckVld_flg@ */ /end MEASUREMENT
/begin MEASUREMENT VIPM_TBOXACTempSetVld_flg "" UBYTE AppSwcIpm_CM_boolean_flg 0 0 0.0 1.0 ECU_ADDRESS 0x0000 /* @ECU_Address@VIPM_TBOXACTempSetVld_flg@ */ /end MEASUREMENT
/begin MEASUREMENT VIPM_EHBBrkPwrRecupTarWhlTqSts_enum "" UBYTE AppSwcIpm_CM_EnumRegenTgtTqStat 0 0 0 3 ECU_ADDRESS 0x0000 /* @ECU_Address@VIPM_EHBBrkPwrRecupTarWhlTqSts_enum@ */ /end MEASUREMENT
/begin MEASUREMENT VIPM_IPUOBCWakeUpMode_enum "" UBYTE AppSwcIpm_CM_EnumOBCWakeUpMd 0 0 0 7 ECU_ADDRESS 0x0000 /* @ECU_Address@VIPM_IPUOBCWakeUpMode_enum@ */ /end MEASUREMENT
/begin MEASUREMENT VIPM_IPUOBCReq_enum "" UBYTE AppSwcIpm_CM_EnumOBCReq 0 0 0 3 ECU_ADDRESS 0x0000 /* @ECU_Address@VIPM_IPUOBCReq_enum@ */ /end MEASUREMENT
/begin MEASUREMENT VIPM_IPUOBCInletConnectSta_enum "" UBYTE AppSwcIpm_CM_EnumOBCPlugSt 0 0 0 3 ECU_ADDRESS 0x0000 /* @ECU_Address@VIPM_IPUOBCInletConnectSta_enum@ */ /end MEASUREMENT
/begin MEASUREMENT VIPM_IPUOBCActOprtMode_enum "" UBYTE AppSwcIpm_CM_EnumOBCActMd 0 0 0 15 ECU_ADDRESS 0x0000 /* @ECU_Address@VIPM_IPUOBCActOprtMode_enum@ */ /end MEASUREMENT
/begin MEASUREMENT VIPM_INV1ActMode_enum "" UBYTE AppSwcIpm_CM_EnumINVActMd 0 0 0 7 ECU_ADDRESS 0x0000 /* @ECU_Address@VIPM_INV1ActMode_enum@ */ /end MEASUREMENT
/begin MEASUREMENT VIPM_EHBEPBActuatorStR_enum "" UBYTE AppSwcIpm_CM_EnumEPBState 0 0 0 6 ECU_ADDRESS 0x0000 /* @ECU_Address@VIPM_EHBEPBActuatorStR_enum@ */ /end MEASUREMENT
/begin MEASUREMENT VIPM_IPUDCCActOprtMode_enum "" UBYTE AppSwcIpm_CM_EnumDCCActMd 0 0 0 7 ECU_ADDRESS 0x0000 /* @ECU_Address@VIPM_IPUDCCActOprtMode_enum@ */ /end MEASUREMENT
/begin COMPU_METHOD AppSwcIpm_CM_single_A "Q = V" RAT_FUNC "%8.6" "A" COEFFS 0 1 0 0 0 1 /end COMPU_METHOD
/begin COMPU_METHOD AppSwcIpm_CM_single_pct "Q = V" RAT_FUNC "%8.6" "pct" COEFFS 0 1 0 0 0 1 /end COMPU_METHOD
/begin COMPU_METHOD AppSwcIpm_CM_single_V "Q = V" RAT_FUNC "%8.6" "V" COEFFS 0 1 0 0 0 1 /end COMPU_METHOD
/begin COMPU_METHOD AppSwcIpm_CM_single_C "Q = V" RAT_FUNC "%8.6" "C" COEFFS 0 1 0 0 0 1 /end COMPU_METHOD
/begin COMPU_METHOD AppSwcIpm_CM_single_rpm "Q = V" RAT_FUNC "%8.6" "rpm" COEFFS 0 1 0 0 0 1 /end COMPU_METHOD
/begin COMPU_METHOD AppSwcIpm_CM_single_Nm "Q = V" RAT_FUNC "%8.6" "Nm" COEFFS 0 1 0 0 0 1 /end COMPU_METHOD
/begin COMPU_METHOD AppSwcIpm_CM_single_degps "Q = V" RAT_FUNC "%8.6" "degps" COEFFS 0 1 0 0 0 1 /end COMPU_METHOD
/begin COMPU_METHOD AppSwcIpm_CM_single_deg "Q = V" RAT_FUNC "%8.6" "deg" COEFFS 0 1 0 0 0 1 /end COMPU_METHOD
/begin COMPU_METHOD AppSwcIpm_CM_single_g "Q = V" RAT_FUNC "%8.6" "g" COEFFS 0 1 0 0 0 1 /end COMPU_METHOD
/begin COMPU_METHOD AppSwcIpm_CM_single_bar "Q = V" RAT_FUNC "%8.6" "bar" COEFFS 0 1 0 0 0 1 /end COMPU_METHOD
/begin COMPU_METHOD AppSwcIpm_CM_single_kph "Q = V" RAT_FUNC "%8.6" "kph" COEFFS 0 1 0 0 0 1 /end COMPU_METHOD
/begin COMPU_METHOD AppSwcIpm_CM_single_kW "Q = V" RAT_FUNC "%8.6" "kW" COEFFS 0 1 0 0 0 1 /end COMPU_METHOD
/begin COMPU_METHOD AppSwcIpm_CM_EnumDCCActMd "Enumerated data type: EnumDCCActMd" TAB_VERB "%0.6" "" COMPU_TAB_REF VTAB_FOR_AppSwcIpm_CM_EnumDCCActMd /end COMPU_METHOD
/begin COMPU_VTAB VTAB_FOR_AppSwcIpm_CM_EnumDCCActMd "Enumerated data type: EnumDCCActMd" TAB_VERB 8 0 "EnumDCCActMd_Init" 1 "EnumDCCActMd_Standby" 2 "EnumDCCActMd_Prechrg" 3 "EnumDCCActMd_Buck" 4 "EnumDCCActMd_Boost" 5 "EnumDCCActMd_Fault" 6 "EnumDCCActMd_OFF" 7 "EnumDCCActMd_Rsrvd" /end COMPU_VTAB
/begin COMPU_METHOD AppSwcIpm_CM_EnumEPBState "Enumerated data type: EnumEPBState" TAB_VERB "%0.6" "" COMPU_TAB_REF VTAB_FOR_AppSwcIpm_CM_EnumEPBState /end COMPU_METHOD
/begin COMPU_VTAB VTAB_FOR_AppSwcIpm_CM_EnumEPBState "Enumerated data type: EnumEPBState" TAB_VERB 7 0 "EnumEPBState_Releasing" 1 "EnumEPBState_Applied" 2 "EnumEPBState_Released" 3 "EnumEPBState_Applying" 4 "EnumEPBState_CmpltReleased" 5 "EnumEPBState_Unknown" 6 "EnumEPBState_Hold" /end COMPU_VTAB
/begin COMPU_METHOD AppSwcIpm_CM_EnumINVActMd "Enumerated data type: EnumINVActMd" TAB_VERB "%0.6" "" COMPU_TAB_REF VTAB_FOR_AppSwcIpm_CM_EnumINVActMd /end COMPU_METHOD
/begin COMPU_VTAB VTAB_FOR_AppSwcIpm_CM_EnumINVActMd "Enumerated data type: EnumINVActMd" TAB_VERB 8 0 "EnumINVActMd_Invld" 1 "EnumINVActMd_IniCmpld" 2 "EnumINVActMd_IniUncmplt" 3 "EnumINVActMd_Standby" 4 "EnumINVActMd_Run" 5 "EnumINVActMd_OFF" 6 "EnumINVActMd_Rsrvd1" 7 "EnumINVActMd_Rsrvd2" /end COMPU_VTAB
/begin COMPU_METHOD AppSwcIpm_CM_EnumOBCActMd "Enumerated data type: EnumOBCActMd" TAB_VERB "%0.6" "" COMPU_TAB_REF VTAB_FOR_AppSwcIpm_CM_EnumOBCActMd /end COMPU_METHOD
/begin COMPU_VTAB VTAB_FOR_AppSwcIpm_CM_EnumOBCActMd "Enumerated data type: EnumOBCActMd" TAB_VERB 16 0 "EnumOBCActMd_Init" 1 "EnumOBCActMd_ChrgStrt" 2 "EnumOBCActMd_Charging" 3 "EnumOBCActMd_ChrgStop" 4 "EnumOBCActMd_V2VDchaStrtg" 5 "EnumOBCActMd_V2LDchaStrtg" 6 "EnumOBCActMd_DchaStrt" 7 "EnumOBCActMd_V2VDischrging" 8 "EnumOBCActMd_V2LDischrging" 9 "EnumOBCActMd_Dischrging" 10 "EnumOBCActMd_DchaStop" 11 "EnumOBCActMd_PreSleep" 12 "EnumOBCActMd_Sleep" 13 "EnumOBCActMd_Rsrvd1" 14 "EnumOBCActMd_Rsrvd2" 15 "EnumOBCActMd_Rsrvd3" /end COMPU_VTAB
/begin COMPU_METHOD AppSwcIpm_CM_EnumOBCPlugSt "Enumerated data type: EnumOBCPlugSt" TAB_VERB "%0.6" "" COMPU_TAB_REF VTAB_FOR_AppSwcIpm_CM_EnumOBCPlugSt /end COMPU_METHOD
/begin COMPU_VTAB VTAB_FOR_AppSwcIpm_CM_EnumOBCPlugSt "Enumerated data type: EnumOBCPlugSt" TAB_VERB 4 0 "EnumOBCPlugSt_NoPlug" 1 "EnumOBCPlugSt_HalfPlug" 2 "EnumOBCPlugSt_Plug" 3 "EnumOBCPlugSt_Rsrvd" /end COMPU_VTAB
/begin COMPU_METHOD AppSwcIpm_CM_EnumOBCReq "Enumerated data type: EnumOBCReq" TAB_VERB "%0.6" "" COMPU_TAB_REF VTAB_FOR_AppSwcIpm_CM_EnumOBCReq /end COMPU_METHOD
/begin COMPU_VTAB VTAB_FOR_AppSwcIpm_CM_EnumOBCReq "Enumerated data type: EnumOBCReq" TAB_VERB 4 0 "EnumOBCReq_NoReq" 1 "EnumOBCReq_Charge" 2 "EnumOBCReq_DisChrg" 3 "EnumOBCReq_Rsrvd" /end COMPU_VTAB
/begin COMPU_METHOD AppSwcIpm_CM_EnumOBCWakeUpMd "Enumerated data type: EnumOBCWakeUpMd" TAB_VERB "%0.6" "" COMPU_TAB_REF VTAB_FOR_AppSwcIpm_CM_EnumOBCWakeUpMd /end COMPU_METHOD
/begin COMPU_VTAB VTAB_FOR_AppSwcIpm_CM_EnumOBCWakeUpMd "Enumerated data type: EnumOBCWakeUpMd" TAB_VERB 8 0 "EnumOBCWakeUpMd_Invld" 1 "EnumOBCWakeUpMd_ACChrg" 2 "EnumOBCWakeUpMd_V2VDcha" 3 "EnumOBCWakeUpMd_V2LDcha" 4 "EnumOBCWakeUpMd_InDcha" 5 "EnumOBCWakeUpMd_Rsrvd1" 6 "EnumOBCWakeUpMd_Rsrvd2" 7 "EnumOBCWakeUpMd_Rsrvd3" /end COMPU_VTAB
/begin COMPU_METHOD AppSwcIpm_CM_EnumRegenTgtTqStat "Enumerated data type: EnumRegenTgtTqStat" TAB_VERB "%0.6" "" COMPU_TAB_REF VTAB_FOR_AppSwcIpm_CM_EnumRegenTgtTqStat /end COMPU_METHOD
/begin COMPU_VTAB VTAB_FOR_AppSwcIpm_CM_EnumRegenTgtTqStat "Enumerated data type: EnumRegenTgtTqStat" TAB_VERB 4 0 "EnumRegenTgtTqStat_NotInit" 1 "EnumRegenTgtTqStat_Inactive" 2 "EnumRegenTgtTqStat_Active" 3 "EnumRegenTgtTqStat_Fault" /end COMPU_VTAB
/begin COMPU_METHOD AppSwcIpm_CM_boolean_flg "Q = V" RAT_FUNC "%1.0" "flg" COEFFS 0 1 0 0 0 1 /end COMPU_METHOD
/begin COMPU_METHOD AppSwcIpm_CM_uint8_enum "Q = V" RAT_FUNC "%3.0" "enum" COEFFS 0 1 0 0 0 1 /end COMPU_METHOD
/begin COMPU_METHOD AppSwcIpm_CM_uint8_Ah "Q = V" RAT_FUNC "%3.0" "Ah" COEFFS 0 1 0 0 0 1 /end COMPU_METHOD
/begin COMPU_METHOD AppSwcIpm_CM_uint8_cnt "Q = V" RAT_FUNC "%3.0" "cnt" COEFFS 0 1 0 0 0 1 /end COMPU_METHOD
/begin COMPU_METHOD AppSwcIpm_CM_uint8_nu "Q = V" RAT_FUNC "%3.0" "nu" COEFFS 0 1 0 0 0 1 /end COMPU_METHOD
/begin GROUP S71_Subsys_VIPM_TBOXACTempSet_enum "AppSwcIpm/Ipm100ms/BacCAN_IN_100ms/Msg_HU_B_BAC/Subsys_VIPM_TBOXACTempSet_enum"
 /begin REF_CHARACTERISTIC KIPM_TBOXACTempSetDflt_enum KIPM_TBOXACTempSet_enum_ovrdflg KIPM_TBOXACTempSet_enum_ovrdval /end REF_CHARACTERISTIC
 /begin REF_MEASUREMENT VIPM_TBOXACTempSetVld_flg VIPM_TBOXACTempSet_enum /end REF_MEASUREMENT
/end GROUP
/begin GROUP S71_Subsys_VIPM_TBOXRmtPwrLck_enum "AppSwcIpm/Ipm100ms/BacCAN_IN_100ms/Msg_HU_B_BAC/Subsys_VIPM_TBOXRmtPwrLck_enum"
 /begin REF_CHARACTERISTIC KIPM_TBOXRmtPwrLckDflt_enum KIPM_TBOXRmtPwrLck_enum_ovrdflg KIPM_TBOXRmtPwrLck_enum_ovrdval /end REF_CHARACTERISTIC
 /begin REF_MEASUREMENT VIPM_TBOXRmtPwrLckVld_flg VIPM_TBOXRmtPwrLck_enum /end REF_MEASUREMENT
/end GROUP
/begin GROUP S71_Subsys_VIPM_TBOXVCUCCMSpdLimLvl_enum "AppSwcIpm/Ipm100ms/BacCAN_IN_100ms/Msg_HU_B_BAC/Subsys_VIPM_TBOXVCUCCMSpdLimLvl_enum"
 /begin REF_CHARACTERISTIC KIPM_TBOXVCUCCMSpdLimLvlDflt_enum KIPM_TBOXVCUCCMSpdLimLvl_enum_ovrdflg KIPM_TBOXVCUCCMSpdLimLvl_enum_ovrdval /end REF_CHARACTERISTIC
 /begin REF_MEASUREMENT VIPM_TBOXVCUCCMSpdLimLvlVld_flg VIPM_TBOXVCUCCMSpdLimLvl_enum /end REF_MEASUREMENT
/end GROUP
/begin GROUP S71_Subsys_VIPM_TBOXVCUChrgngConds_flg "AppSwcIpm/Ipm100ms/BacCAN_IN_100ms/Msg_HU_B_BAC/Subsys_VIPM_TBOXVCUChrgngConds_flg"
 /begin REF_CHARACTERISTIC KIPM_TBOXVCUChrgngCondsDflt_flg KIPM_TBOXVCUChrgngConds_flg_ovrdflg KIPM_TBOXVCUChrgngConds_flg_ovrdval /end REF_CHARACTERISTIC
 /begin REF_MEASUREMENT VIPM_TBOXVCUChrgngCondsVld_flg VIPM_TBOXVCUChrgngConds_flg /end REF_MEASUREMENT
/end GROUP
/begin GROUP S71_Subsys_VIPM_TBOXVCUOprtLic_flg "AppSwcIpm/Ipm100ms/BacCAN_IN_100ms/Msg_HU_B_BAC/Subsys_VIPM_TBOXVCUOprtLic_flg"
 /begin REF_CHARACTERISTIC KIPM_TBOXVCUOprtLicDflt_flg KIPM_TBOXVCUOprtLic_flg_ovrdflg KIPM_TBOXVCUOprtLic_flg_ovrdval /end REF_CHARACTERISTIC
 /begin REF_MEASUREMENT VIPM_TBOXVCUOprtLicVld_flg VIPM_TBOXVCUOprtLic_flg /end REF_MEASUREMENT
/end GROUP
/begin GROUP S71_Subsys_VIPM_TBOXVCUVer_flg "AppSwcIpm/Ipm100ms/BacCAN_IN_100ms/Msg_HU_B_BAC/Subsys_VIPM_TBOXVCUVer_flg"
 /begin REF_CHARACTERISTIC KIPM_TBOXVCUVerDflt_flg KIPM_TBOXVCUVer_flg_ovrdflg KIPM_TBOXVCUVer_flg_ovrdval /end REF_CHARACTERISTIC
 /begin REF_MEASUREMENT VIPM_TBOXVCUVerVld_flg VIPM_TBOXVCUVer_flg /end REF_MEASUREMENT
/end GROUP
/begin GROUP S71_Subsys_VIPM_TBoxOpenVentn_enum "AppSwcIpm/Ipm100ms/BacCAN_IN_100ms/Msg_HU_B_BAC/Subsys_VIPM_TBoxOpenVentn_enum"
 /begin REF_CHARACTERISTIC KIPM_TBoxOpenVentnDflt_enum KIPM_TBoxOpenVentn_enum_ovrdflg KIPM_TBoxOpenVentn_enum_ovrdval /end REF_CHARACTERISTIC
 /begin REF_MEASUREMENT VIPM_TBoxOpenVentnVld_flg VIPM_TBoxOpenVentn_enum /end REF_MEASUREMENT
/end GROUP
/begin GROUP S71_Subsys_VIPM_TBoxRmtCarSearch_enum "AppSwcIpm/Ipm100ms/BacCAN_IN_100ms/Msg_HU_B_BAC/Subsys_VIPM_TBoxRmtCarSearch_enum"
 /begin REF_CHARACTERISTIC KIPM_TBoxRmtCarSearchDflt_enum KIPM_TBoxRmtCarSearch_enum_ovrdflg KIPM_TBoxRmtCarSearch_enum_ovrdval /end REF_CHARACTERISTIC
 /begin REF_MEASUREMENT VIPM_TBoxRmtCarSearchVld_flg VIPM_TBoxRmtCarSearch_enum /end REF_MEASUREMENT
/end GROUP
/begin GROUP S71_Subsys_VIPM_TBoxRmtLck_enum "AppSwcIpm/Ipm100ms/BacCAN_IN_100ms/Msg_HU_B_BAC/Subsys_VIPM_TBoxRmtLck_enum"
 /begin REF_CHARACTERISTIC KIPM_TBoxRmtLckDflt_enum KIPM_TBoxRmtLck_enum_ovrdflg KIPM_TBoxRmtLck_enum_ovrdval /end REF_CHARACTERISTIC
 /begin REF_MEASUREMENT VIPM_TBoxRmtLckVld_flg VIPM_TBoxRmtLck_enum /end REF_MEASUREMENT
/end GROUP
/begin GROUP S71_Subsys_VIPM_TboxRmtDefrstCtl_enum "AppSwcIpm/Ipm100ms/BacCAN_IN_100ms/Msg_HU_B_BAC/Subsys_VIPM_TboxRmtDefrstCtl_enum"
 /begin REF_CHARACTERISTIC KIPM_TboxRmtDefrstCtlDflt_enum KIPM_TboxRmtDefrstCtl_enum_ovrdflg KIPM_TboxRmtDefrstCtl_enum_ovrdval /end REF_CHARACTERISTIC
 /begin REF_MEASUREMENT VIPM_TboxRmtDefrstCtlVld_flg VIPM_TboxRmtDefrstCtl_enum /end REF_MEASUREMENT
/end GROUP
/begin GROUP S116_Subsys_VIPM_BMSHVBatCellTempAve_C "AppSwcIpm/Ipm100ms/EptCAN_IN_100ms/Msg_BMS_5_BatTemp_EPT/Subsys_VIPM_BMSHVBatCellTempAve_C"
 /begin REF_CHARACTERISTIC KIPM_BMSHVBatCellTempAveDflt_C KIPM_BMSHVBatCellTempAveHi_C KIPM_BMSHVBatCellTempAveLo_C KIPM_BMSHVBatCellTempAve_C_ovrdflg KIPM_BMSHVBatCellTempAve_C_ovrdval /end REF_CHARACTERISTIC
 /begin REF_MEASUREMENT VIPM_BMSHVBatCellTempAveVld_flg VIPM_BMSHVBatCellTempAve_C /end REF_MEASUREMENT
/end GROUP
/begin GROUP S116_Subsys_VIPM_BMSHVBatCellTempMax_C "AppSwcIpm/Ipm100ms/EptCAN_IN_100ms/Msg_BMS_5_BatTemp_EPT/Subsys_VIPM_BMSHVBatCellTempMax_C"
 /begin REF_CHARACTERISTIC KIPM_BMSHVBatCellTempMaxDflt_C KIPM_BMSHVBatCellTempMaxHi_C KIPM_BMSHVBatCellTempMaxLo_C KIPM_BMSHVBatCellTempMax_C_ovrdflg KIPM_BMSHVBatCellTempMax_C_ovrdval /end REF_CHARACTERISTIC
 /begin REF_MEASUREMENT VIPM_BMSHVBatCellTempMaxVld_flg VIPM_BMSHVBatCellTempMax_C /end REF_MEASUREMENT
/end GROUP
/begin GROUP S116_Subsys_VIPM_BMSHVBatCellTempMin_C "AppSwcIpm/Ipm100ms/EptCAN_IN_100ms/Msg_BMS_5_BatTemp_EPT/Subsys_VIPM_BMSHVBatCellTempMin_C"
 /begin REF_CHARACTERISTIC KIPM_BMSHVBatCellTempMinDflt_C KIPM_BMSHVBatCellTempMinHi_C KIPM_BMSHVBatCellTempMinLo_C KIPM_BMSHVBatCellTempMin_C_ovrdflg KIPM_BMSHVBatCellTempMin_C_ovrdval /end REF_CHARACTERISTIC
 /begin REF_MEASUREMENT VIPM_BMSHVBatCellTempMinVld_flg VIPM_BMSHVBatCellTempMin_C /end REF_MEASUREMENT
/end GROUP
/begin GROUP S117_Subsys_VIPM_INVLrngData02_nu "AppSwcIpm/Ipm100ms/EptCAN_IN_100ms/Msg_INV_IMMO_Req_EPT/Subsys_VIPM_INVLrngData02_nu"
 /begin REF_CHARACTERISTIC KIPM_INVLrngData02Dflt_nu KIPM_INVLrngData02_nu_ovrdflg KIPM_INVLrngData02_nu_ovrdval /end REF_CHARACTERISTIC
 /begin REF_MEASUREMENT VIPM_INVLrngData02Vld_flg VIPM_INVLrngData02_nu /end REF_MEASUREMENT
/end GROUP
/begin GROUP S117_Subsys_VIPM_INVLrngData03_nu "AppSwcIpm/Ipm100ms/EptCAN_IN_100ms/Msg_INV_IMMO_Req_EPT/Subsys_VIPM_INVLrngData03_nu"
 /begin REF_CHARACTERISTIC KIPM_INVLrngData03Dflt_nu KIPM_INVLrngData03_nu_ovrdflg KIPM_INVLrngData03_nu_ovrdval /end REF_CHARACTERISTIC
 /begin REF_MEASUREMENT VIPM_INVLrngData03Vld_flg VIPM_INVLrngData03_nu /end REF_MEASUREMENT
/end GROUP
/begin GROUP S117_Subsys_VIPM_INVLrngData04_nu "AppSwcIpm/Ipm100ms/EptCAN_IN_100ms/Msg_INV_IMMO_Req_EPT/Subsys_VIPM_INVLrngData04_nu"
 /begin REF_CHARACTERISTIC KIPM_INVLrngData04Dflt_nu KIPM_INVLrngData04_nu_ovrdflg KIPM_INVLrngData04_nu_ovrdval /end REF_CHARACTERISTIC
 /begin REF_MEASUREMENT VIPM_INVLrngData04Vld_flg VIPM_INVLrngData04_nu /end REF_MEASUREMENT
/end GROUP
/begin GROUP S117_Subsys_VIPM_INVLrngData05_nu "AppSwcIpm/Ipm100ms/EptCAN_IN_100ms/Msg_INV_IMMO_Req_EPT/Subsys_VIPM_INVLrngData05_nu"
 /begin REF_CHARACTERISTIC KIPM_INVLrngData05Dflt_nu KIPM_INVLrngData05_nu_ovrdflg KIPM_INVLrngData05_nu_ovrdval /end REF_CHARACTERISTIC
 /begin REF_MEASUREMENT VIPM_INVLrngData05Vld_flg VIPM_INVLrngData05_nu /end REF_MEASUREMENT
/end GROUP
/begin GROUP S117_Subsys_VIPM_INVLrngData06_nu "AppSwcIpm/Ipm100ms/EptCAN_IN_100ms/Msg_INV_IMMO_Req_EPT/Subsys_VIPM_INVLrngData06_nu"
 /begin REF_CHARACTERISTIC KIPM_INVLrngData06Dflt_nu KIPM_INVLrngData06_nu_ovrdflg KIPM_INVLrngData06_nu_ovrdval /end REF_CHARACTERISTIC
 /begin REF_MEASUREMENT VIPM_INVLrngData06Vld_flg VIPM_INVLrngData06_nu /end REF_MEASUREMENT
/end GROUP
/begin GROUP S117_Subsys_VIPM_INVLrngData07_nu "AppSwcIpm/Ipm100ms/EptCAN_IN_100ms/Msg_INV_IMMO_Req_EPT/Subsys_VIPM_INVLrngData07_nu"
 /begin REF_CHARACTERISTIC KIPM_INVLrngData07Dflt_nu KIPM_INVLrngData07_nu_ovrdflg KIPM_INVLrngData07_nu_ovrdval /end REF_CHARACTERISTIC
 /begin REF_MEASUREMENT VIPM_INVLrngData07Vld_flg VIPM_INVLrngData07_nu /end REF_MEASUREMENT
/end GROUP
/begin GROUP S117_Subsys_VIPM_INVLrngSts_enum "AppSwcIpm/Ipm100ms/EptCAN_IN_100ms/Msg_INV_IMMO_Req_EPT/Subsys_VIPM_INVLrngSts_enum"
 /begin REF_CHARACTERISTIC KIPM_INVLrngStsDflt_enum KIPM_INVLrngSts_enum_ovrdflg KIPM_INVLrngSts_enum_ovrdval /end REF_CHARACTERISTIC
 /begin REF_MEASUREMENT VIPM_INVLrngStsVld_flg VIPM_INVLrngSts_enum /end REF_MEASUREMENT
/end GROUP
/begin GROUP S117_Subsys_VIPM_INVLrngSubID_cnt "AppSwcIpm/Ipm100ms/EptCAN_IN_100ms/Msg_INV_IMMO_Req_EPT/Subsys_VIPM_INVLrngSubID_cnt"
 /begin REF_CHARACTERISTIC KIPM_INVLrngSubIDDflt_cnt KIPM_INVLrngSubID_cnt_ovrdflg KIPM_INVLrngSubID_cnt_ovrdval /end REF_CHARACTERISTIC
 /begin REF_MEASUREMENT VIPM_INVLrngSubIDVld_flg VIPM_INVLrngSubID_cnt /end REF_MEASUREMENT
/end GROUP
/begin GROUP S118_Subsys_VIPM_IPUDCCActOprtMode_enum "AppSwcIpm/Ipm100ms/EptCAN_IN_100ms/Msg_IPU_DCC_1_State_EPT/Subsys_VIPM_IPUDCCActOprtMode_enum"
 /begin REF_CHARACTERISTIC KIPM_IPUDCCActOprtModeDflt_enum KIPM_IPUDCCActOprtMode_enum_ovrdflg KIPM_IPUDCCActOprtMode_enum_ovrdval /end REF_CHARACTERISTIC
 /begin REF_MEASUREMENT VIPM_IPUDCCActOprtModeVld_flg VIPM_IPUDCCActOprtMode_enum /end REF_MEASUREMENT
/end GROUP
/begin GROUP S118_Subsys_VIPM_IPUDCCLoVoltActCurnt_A "AppSwcIpm/Ipm100ms/EptCAN_IN_100ms/Msg_IPU_DCC_1_State_EPT/Subsys_VIPM_IPUDCCLoVoltActCurnt_A"
 /begin REF_CHARACTERISTIC KIPM_IPUDCCLoVoltActCurntDflt_A KIPM_IPUDCCLoVoltActCurntHi_A KIPM_IPUDCCLoVoltActCurntLo_A KIPM_IPUDCCLoVoltActCurnt_A_ovrdflg KIPM_IPUDCCLoVoltActCurnt_A_ovrdval /end REF_CHARACTERISTIC
 /begin REF_MEASUREMENT VIPM_IPUDCCLoVoltActCurntVld_flg VIPM_IPUDCCLoVoltActCurnt_A /end REF_MEASUREMENT
/end GROUP
/begin GROUP S118_Subsys_VIPM_IPUDCCLoVoltActVolt_V "AppSwcIpm/Ipm100ms/EptCAN_IN_100ms/Msg_IPU_DCC_1_State_EPT/Subsys_VIPM_IPUDCCLoVoltActVolt_V"
 /begin REF_CHARACTERISTIC KIPM_IPUDCCLoVoltActVoltDflt_V KIPM_IPUDCCLoVoltActVoltHi_V KIPM_IPUDCCLoVoltActVoltLo_V KIPM_IPUDCCLoVoltActVolt_V_ovrdflg KIPM_IPUDCCLoVoltActVolt_V_ovrdval /end REF_CHARACTERISTIC
 /begin REF_MEASUREMENT VIPM_IPUDCCLoVoltActVoltVld_flg VIPM_IPUDCCLoVoltActVolt_V /end REF_MEASUREMENT
/end GROUP
/begin GROUP S118_Subsys_VIPM_IPUDCCSysFailSta_enum "AppSwcIpm/Ipm100ms/EptCAN_IN_100ms/Msg_IPU_DCC_1_State_EPT/Subsys_VIPM_IPUDCCSysFailSta_enum"
 /begin REF_CHARACTERISTIC KIPM_IPUDCCSysFailStaDflt_enum KIPM_IPUDCCSysFailSta_enum_ovrdflg KIPM_IPUDCCSysFailSta_enum_ovrdval /end REF_CHARACTERISTIC
 /begin REF_MEASUREMENT VIPM_IPUDCCSysFailStaVld_flg VIPM_IPUDCCSysFailSta_enum /end REF_MEASUREMENT
/end GROUP
/begin GROUP S118_Subsys_VIPM_IPUHVILFailSt_flg "AppSwcIpm/Ipm100ms/EptCAN_IN_100ms/Msg_IPU_DCC_1_State_EPT/Subsys_VIPM_IPUHVILFailSt_flg"
 /begin REF_CHARACTERISTIC KIPM_IPUHVILFailStDflt_flg KIPM_IPUHVILFailSt_flg_ovrdflg KIPM_IPUHVILFailSt_flg_ovrdval /end REF_CHARACTERISTIC
 /begin REF_MEASUREMENT VIPM_IPUHVILFailStVld_flg VIPM_IPUHVILFailSt_flg /end REF_MEASUREMENT
/end GROUP
/begin GROUP S119_Subsys_VIPM_IPUDCCHiVoltActCurnt_A "AppSwcIpm/Ipm100ms/EptCAN_IN_100ms/Msg_IPU_DCC_2_ChrgInValue_EPT/Subsys_VIPM_IPUDCCHiVoltActCurnt_A"
 /begin REF_CHARACTERISTIC KIPM_IPUDCCHiVoltActCurntDflt_A KIPM_IPUDCCHiVoltActCurntHi_A KIPM_IPUDCCHiVoltActCurntLo_A KIPM_IPUDCCHiVoltActCurnt_A_ovrdflg KIPM_IPUDCCHiVoltActCurnt_A_ovrdval /end REF_CHARACTERISTIC
 /begin REF_MEASUREMENT VIPM_IPUDCCHiVoltActCurntVld_flg VIPM_IPUDCCHiVoltActCurnt_A /end REF_MEASUREMENT
/end GROUP
/begin GROUP S119_Subsys_VIPM_IPUDCCHiVoltActVolt_V "AppSwcIpm/Ipm100ms/EptCAN_IN_100ms/Msg_IPU_DCC_2_ChrgInValue_EPT/Subsys_VIPM_IPUDCCHiVoltActVolt_V"
 /begin REF_CHARACTERISTIC KIPM_IPUDCCHiVoltActVoltDflt_V KIPM_IPUDCCHiVoltActVoltHi_V KIPM_IPUDCCHiVoltActVoltLo_V KIPM_IPUDCCHiVoltActVolt_V_ovrdflg KIPM_IPUDCCHiVoltActVolt_V_ovrdval /end REF_CHARACTERISTIC
 /begin REF_MEASUREMENT VIPM_IPUDCCHiVoltActVoltVld_flg VIPM_IPUDCCHiVoltActVolt_V /end REF_MEASUREMENT
/end GROUP
/begin GROUP S120_Subsys_VIPM_IPUOBCActOprtMode_enum "AppSwcIpm/Ipm100ms/EptCAN_IN_100ms/Msg_IPU_OBC_1_State_EPT/Subsys_VIPM_IPUOBCActOprtMode_enum"
 /begin REF_CHARACTERISTIC KIPM_IPUOBCActOprtModeDflt_enum KIPM_IPUOBCActOprtMode_enum_ovrdflg KIPM_IPUOBCActOprtMode_enum_ovrdval /end REF_CHARACTERISTIC
 /begin REF_MEASUREMENT VIPM_IPUOBCActOprtModeVld_flg VIPM_IPUOBCActOprtMode_enum /end REF_MEASUREMENT
/end GROUP
/begin GROUP S120_Subsys_VIPM_IPUOBCConnectMainSta_flg "AppSwcIpm/Ipm100ms/EptCAN_IN_100ms/Msg_IPU_OBC_1_State_EPT/Subsys_VIPM_IPUOBCConnectMainSta_flg"
 /begin REF_CHARACTERISTIC KIPM_IPUOBCConnectMainStaDflt_flg KIPM_IPUOBCConnectMainSta_flg_ovrdflg KIPM_IPUOBCConnectMainSta_flg_ovrdval /end REF_CHARACTERISTIC
 /begin REF_MEASUREMENT VIPM_IPUOBCConnectMainStaVld_flg VIPM_IPUOBCConnectMainSta_flg /end REF_MEASUREMENT
/end GROUP
/begin GROUP S120_Subsys_VIPM_IPUOBCHVDCActCur_A "AppSwcIpm/Ipm100ms/EptCAN_IN_100ms/Msg_IPU_OBC_1_State_EPT/Subsys_VIPM_IPUOBCHVDCActCur_A"
 /begin REF_CHARACTERISTIC KIPM_IPUOBCHVDCActCurDflt_A KIPM_IPUOBCHVDCActCurHi_A KIPM_IPUOBCHVDCActCurLo_A KIPM_IPUOBCHVDCActCur_A_ovrdflg KIPM_IPUOBCHVDCActCur_A_ovrdval /end REF_CHARACTERISTIC
 /begin REF_MEASUREMENT VIPM_IPUOBCHVDCActCurVld_flg VIPM_IPUOBCHVDCActCur_A /end REF_MEASUREMENT
/end GROUP
/begin GROUP S120_Subsys_VIPM_IPUOBCHVDCActVol_V "AppSwcIpm/Ipm100ms/EptCAN_IN_100ms/Msg_IPU_OBC_1_State_EPT/Subsys_VIPM_IPUOBCHVDCActVol_V"
 /begin REF_CHARACTERISTIC KIPM_IPUOBCHVDCActVolDflt_V KIPM_IPUOBCHVDCActVolHi_V KIPM_IPUOBCHVDCActVolLo_V KIPM_IPUOBCHVDCActVol_V_ovrdflg KIPM_IPUOBCHVDCActVol_V_ovrdval /end REF_CHARACTERISTIC
 /begin REF_MEASUREMENT VIPM_IPUOBCHVDCActVolVld_flg VIPM_IPUOBCHVDCActVol_V /end REF_MEASUREMENT
/end GROUP
/begin GROUP S120_Subsys_VIPM_IPUOBCInletActPwr_kW "AppSwcIpm/Ipm100ms/EptCAN_IN_100ms/Msg_IPU_OBC_1_State_EPT/Subsys_VIPM_IPUOBCInletActPwr_kW"
 /begin REF_CHARACTERISTIC KIPM_IPUOBCInletActPwrDflt_kW KIPM_IPUOBCInletActPwrHi_kW KIPM_IPUOBCInletActPwrLo_kW KIPM_IPUOBCInletActPwr_kW_ovrdflg KIPM_IPUOBCInletActPwr_kW_ovrdval /end REF_CHARACTERISTIC
 /begin REF_MEASUREMENT VIPM_IPUOBCInletActPwrVld_flg VIPM_IPUOBCInletActPwr_kW /end REF_MEASUREMENT
/end GROUP
/begin GROUP S120_Subsys_VIPM_IPUOBCInletConnectSta_enum "AppSwcIpm/Ipm100ms/EptCAN_IN_100ms/Msg_IPU_OBC_1_State_EPT/Subsys_VIPM_IPUOBCInletConnectSta_enum"
 /begin REF_CHARACTERISTIC KIPM_IPUOBCInletConnectStaDflt_enum KIPM_IPUOBCInletConnectSta_enum_ovrdflg KIPM_IPUOBCInletConnectSta_enum_ovrdval /end REF_CHARACTERISTIC
 /begin REF_MEASUREMENT VIPM_IPUOBCInletConnectStaVld_flg VIPM_IPUOBCInletConnectSta_enum /end REF_MEASUREMENT
/end GROUP
/begin GROUP S120_Subsys_VIPM_IPUOBCReq_enum "AppSwcIpm/Ipm100ms/EptCAN_IN_100ms/Msg_IPU_OBC_1_State_EPT/Subsys_VIPM_IPUOBCReq_enum"
 /begin REF_CHARACTERISTIC KIPM_IPUOBCReqDflt_enum KIPM_IPUOBCReq_enum_ovrdflg KIPM_IPUOBCReq_enum_ovrdval /end REF_CHARACTERISTIC
 /begin REF_MEASUREMENT VIPM_IPUOBCReqVld_flg VIPM_IPUOBCReq_enum /end REF_MEASUREMENT
/end GROUP
/begin GROUP S120_Subsys_VIPM_IPUOBCSysFailSta_enum "AppSwcIpm/Ipm100ms/EptCAN_IN_100ms/Msg_IPU_OBC_1_State_EPT/Subsys_VIPM_IPUOBCSysFailSta_enum"
 /begin REF_CHARACTERISTIC KIPM_IPUOBCSysFailStaDflt_enum KIPM_IPUOBCSysFailSta_enum_ovrdflg KIPM_IPUOBCSysFailSta_enum_ovrdval /end REF_CHARACTERISTIC
 /begin REF_MEASUREMENT VIPM_IPUOBCSysFailStaVld_flg VIPM_IPUOBCSysFailSta_enum /end REF_MEASUREMENT
/end GROUP
/begin GROUP S156_Subsys_VIPM_IPUDeviceIntTemp_C "AppSwcIpm/Ipm100ms/EptCAN_IN_200ms/Msg_IPU_OBC_2_Inlet_EPT/Subsys_VIPM_IPUDeviceIntTemp_C"
 /begin REF_CHARACTERISTIC KIPM_IPUDeviceIntTempDflt_C KIPM_IPUDeviceIntTempHi_C KIPM_IPUDeviceIntTempLo_C KIPM_IPUDeviceIntTemp_C_ovrdflg KIPM_IPUDeviceIntTemp_C_ovrdval /end REF_CHARACTERISTIC
 /begin REF_MEASUREMENT VIPM_IPUDeviceIntTempVld_flg VIPM_IPUDeviceIntTemp_C /end REF_MEASUREMENT
/end GROUP
/begin GROUP S156_Subsys_VIPM_IPUOBCACMaxPwrAllow_kW "AppSwcIpm/Ipm100ms/EptCAN_IN_200ms/Msg_IPU_OBC_2_Inlet_EPT/Subsys_VIPM_IPUOBCACMaxPwrAllow_kW"
 /begin REF_CHARACTERISTIC KIPM_IPUOBCACMaxPwrAllowDflt_kW KIPM_IPUOBCACMaxPwrAllowHi_kW KIPM_IPUOBCACMaxPwrAllowLo_kW KIPM_IPUOBCACMaxPwrAllow_kW_ovrdflg KIPM_IPUOBCACMaxPwrAllow_kW_ovrdval /end REF_CHARACTERISTIC
 /begin REF_MEASUREMENT VIPM_IPUOBCACMaxPwrAllowVld_flg VIPM_IPUOBCACMaxPwrAllow_kW /end REF_MEASUREMENT
/end GROUP
/begin GROUP S156_Subsys_VIPM_IPUOBCS2State_flg "AppSwcIpm/Ipm100ms/EptCAN_IN_200ms/Msg_IPU_OBC_2_Inlet_EPT/Subsys_VIPM_IPUOBCS2State_flg"
 /begin REF_CHARACTERISTIC KIPM_IPUOBCS2StateDflt_flg KIPM_IPUOBCS2State_flg_ovrdflg KIPM_IPUOBCS2State_flg_ovrdval /end REF_CHARACTERISTIC
 /begin REF_MEASUREMENT VIPM_IPUOBCS2StateVld_flg VIPM_IPUOBCS2State_flg /end REF_MEASUREMENT
/end GROUP
/begin GROUP S156_Subsys_VIPM_IPUOBCTempInt_C "AppSwcIpm/Ipm100ms/EptCAN_IN_200ms/Msg_IPU_OBC_2_Inlet_EPT/Subsys_VIPM_IPUOBCTempInt_C"
 /begin REF_CHARACTERISTIC KIPM_IPUOBCTempIntDflt_C KIPM_IPUOBCTempIntHi_C KIPM_IPUOBCTempIntLo_C KIPM_IPUOBCTempInt_C_ovrdflg KIPM_IPUOBCTempInt_C_ovrdval /end REF_CHARACTERISTIC
 /begin REF_MEASUREMENT VIPM_IPUOBCTempIntVld_flg VIPM_IPUOBCTempInt_C /end REF_MEASUREMENT
/end GROUP
/begin GROUP S156_Subsys_VIPM_IPUOBCWakeUpMode_enum "AppSwcIpm/Ipm100ms/EptCAN_IN_200ms/Msg_IPU_OBC_2_Inlet_EPT/Subsys_VIPM_IPUOBCWakeUpMode_enum"
 /begin REF_CHARACTERISTIC KIPM_IPUOBCWakeUpModeDflt_enum KIPM_IPUOBCWakeUpMode_enum_ovrdflg KIPM_IPUOBCWakeUpMode_enum_ovrdval /end REF_CHARACTERISTIC
 /begin REF_MEASUREMENT VIPM_IPUOBCWakeUpModeVld_flg VIPM_IPUOBCWakeUpMode_enum /end REF_MEASUREMENT
/end GROUP
/begin GROUP S165_Subsys_VIPM_BMSBatCapcty_Ah "AppSwcIpm/Ipm100ms/EptCAN_IN_500ms/Msg_BMS_9_BattInfo_EPT/Subsys_VIPM_BMSBatCapcty_Ah"
 /begin REF_CHARACTERISTIC KIPM_BMSBatCapctyDflt_Ah KIPM_BMSBatCapcty_Ah_ovrdflg KIPM_BMSBatCapcty_Ah_ovrdval /end REF_CHARACTERISTIC
 /begin REF_MEASUREMENT VIPM_BMSBatCapctyVld_flg VIPM_BMSBatCapcty_Ah /end REF_MEASUREMENT
/end GROUP
/begin GROUP S165_Subsys_VIPM_BMSPackID_enum "AppSwcIpm/Ipm100ms/EptCAN_IN_500ms/Msg_BMS_9_BattInfo_EPT/Subsys_VIPM_BMSPackID_enum"
 /begin REF_CHARACTERISTIC KIPM_BMSPackIDDflt_enum KIPM_BMSPackID_enum_ovrdflg KIPM_BMSPackID_enum_ovrdval /end REF_CHARACTERISTIC
 /begin REF_MEASUREMENT VIPM_BMSPackIDVld_flg VIPM_BMSPackID_enum /end REF_MEASUREMENT
/end GROUP
/begin GROUP S170_Subsys_VIPM_EHBBrkPedlValPerc_pct "AppSwcIpm/Ipm10ms/CHACAN_IN_10ms/Msg_EHB_B_CHA/Subsys_VIPM_EHBBrkPedlValPerc_pct"
 /begin REF_CHARACTERISTIC KIPM_EHBBrkPedlValPercDflt_pct KIPM_EHBBrkPedlValPercHi_pct KIPM_EHBBrkPedlValPercLo_pct KIPM_EHBBrkPedlValPerc_pct_ovrdflg KIPM_EHBBrkPedlValPerc_pct_ovrdval /end REF_CHARACTERISTIC
 /begin REF_MEASUREMENT VIPM_EHBBrkPedlValPercVld_flg VIPM_EHBBrkPedlValPerc_pct /end REF_MEASUREMENT
/end GROUP
/begin GROUP S170_Subsys_VIPM_EHBBrkPwrRecupTarWhlTqSts_enum "AppSwcIpm/Ipm10ms/CHACAN_IN_10ms/Msg_EHB_B_CHA/Subsys_VIPM_EHBBrkPwrRecupTarWhlTqSts_enum"
 /begin REF_CHARACTERISTIC KIPM_EHBBrkPwrRecupTarWhlTqStsDflt_enum KIPM_EHBBrkPwrRecupTarWhlTqSts_enum_ovrdflg KIPM_EHBBrkPwrRecupTarWhlTqSts_enum_ovrdval /end REF_CHARACTERISTIC
 /begin REF_MEASUREMENT VIPM_EHBBrkPwrRecupTarWhlTqStsVld_flg VIPM_EHBBrkPwrRecupTarWhlTqSts_enum /end REF_MEASUREMENT
/end GROUP
/begin GROUP S170_Subsys_VIPM_EHBBrkPwrRecupTarWhlTq_Nm "AppSwcIpm/Ipm10ms/CHACAN_IN_10ms/Msg_EHB_B_CHA/Subsys_VIPM_EHBBrkPwrRecupTarWhlTq_Nm"
 /begin REF_CHARACTERISTIC KIPM_EHBBrkPwrRecupTarWhlTqDflt_Nm KIPM_EHBBrkPwrRecupTarWhlTqHi_Nm KIPM_EHBBrkPwrRecupTarWhlTqLo_Nm KIPM_EHBBrkPwrRecupTarWhlTq_Nm_ovrdflg KIPM_EHBBrkPwrRecupTarWhlTq_Nm_ovrdval /end REF_CHARACTERISTIC
 /begin REF_MEASUREMENT VIPM_EHBBrkPwrRecupTarWhlTqVld_flg VIPM_EHBBrkPwrRecupTarWhlTq_Nm /end REF_MEASUREMENT
/end GROUP
/begin GROUP S170_Subsys_VIPM_EHBCDDActv_flg "AppSwcIpm/Ipm10ms/CHACAN_IN_10ms/Msg_EHB_B_CHA/Subsys_VIPM_EHBCDDActv_flg"
 /begin REF_CHARACTERISTIC KIPM_EHBCDDActvDflt_flg KIPM_EHBCDDActv_flg_ovrdflg KIPM_EHBCDDActv_flg_ovrdval /end REF_CHARACTERISTIC
 /begin REF_MEASUREMENT VIPM_EHBCDDActvVld_flg VIPM_EHBCDDActv_flg /end REF_MEASUREMENT
/end GROUP
/begin GROUP S170_Subsys_VIPM_EHBEPBActuatorStR_enum "AppSwcIpm/Ipm10ms/CHACAN_IN_10ms/Msg_EHB_B_CHA/Subsys_VIPM_EHBEPBActuatorStR_enum"
 /begin REF_CHARACTERISTIC KIPM_EHBEPBActuatorStRDflt_enum KIPM_EHBEPBActuatorStR_enum_ovrdflg KIPM_EHBEPBActuatorStR_enum_ovrdval /end REF_CHARACTERISTIC
 /begin REF_MEASUREMENT VIPM_EHBEPBActuatorStRVld_flg VIPM_EHBEPBActuatorStR_enum /end REF_MEASUREMENT
/end GROUP
/begin GROUP S170_Subsys_VIPM_EHBEPBDynAppSt_enum "AppSwcIpm/Ipm10ms/CHACAN_IN_10ms/Msg_EHB_B_CHA/Subsys_VIPM_EHBEPBDynAppSt_enum"
 /begin REF_CHARACTERISTIC KIPM_EHBEPBDynAppStDflt_enum KIPM_EHBEPBDynAppSt_enum_ovrdflg KIPM_EHBEPBDynAppSt_enum_ovrdval /end REF_CHARACTERISTIC
 /begin REF_MEASUREMENT VIPM_EHBEPBDynAppStVld_flg VIPM_EHBEPBDynAppSt_enum /end REF_MEASUREMENT
/end GROUP
/begin GROUP S170_Subsys_VIPM_EHBFltLvl_enum "AppSwcIpm/Ipm10ms/CHACAN_IN_10ms/Msg_EHB_B_CHA/Subsys_VIPM_EHBFltLvl_enum"
 /begin REF_CHARACTERISTIC KIPM_EHBFltLvlDflt_enum KIPM_EHBFltLvl_enum_ovrdflg KIPM_EHBFltLvl_enum_ovrdval /end REF_CHARACTERISTIC
 /begin REF_MEASUREMENT VIPM_EHBFltLvlVld_flg VIPM_EHBFltLvl_enum /end REF_MEASUREMENT
/end GROUP
/begin GROUP S170_Subsys_VIPM_EHBReqBrkLiOn_flg "AppSwcIpm/Ipm10ms/CHACAN_IN_10ms/Msg_EHB_B_CHA/Subsys_VIPM_EHBReqBrkLiOn_flg"
 /begin REF_CHARACTERISTIC KIPM_EHBReqBrkLiOnDflt_flg KIPM_EHBReqBrkLiOn_flg_ovrdflg KIPM_EHBReqBrkLiOn_flg_ovrdval /end REF_CHARACTERISTIC
 /begin REF_MEASUREMENT VIPM_EHBReqBrkLiOnVld_flg VIPM_EHBReqBrkLiOn_flg /end REF_MEASUREMENT
/end GROUP
/begin GROUP S171_Subsys_VIPM_EPSRotSpd_degps "AppSwcIpm/Ipm10ms/CHACAN_IN_10ms/Msg_EPS_2_StrWhlAng_CHA/Subsys_VIPM_EPSRotSpd_degps"
 /begin REF_CHARACTERISTIC KIPM_EPSRotSpdDflt_degps KIPM_EPSRotSpdHi_degps KIPM_EPSRotSpdLo_degps KIPM_EPSRotSpd_degps_ovrdflg KIPM_EPSRotSpd_degps_ovrdval /end REF_CHARACTERISTIC
 /begin REF_MEASUREMENT VIPM_EPSRotSpdVld_flg VIPM_EPSRotSpd_degps /end REF_MEASUREMENT
/end GROUP
/begin GROUP S171_Subsys_VIPM_EPSSteerWhlAngCald_flg "AppSwcIpm/Ipm10ms/CHACAN_IN_10ms/Msg_EPS_2_StrWhlAng_CHA/Subsys_VIPM_EPSSteerWhlAngCald_flg"
 /begin REF_CHARACTERISTIC KIPM_EPSSteerWhlAngCaldDflt_flg KIPM_EPSSteerWhlAngCald_flg_ovrdflg KIPM_EPSSteerWhlAngCald_flg_ovrdval /end REF_CHARACTERISTIC
 /begin REF_MEASUREMENT VIPM_EPSSteerWhlAngCaldVld_flg VIPM_EPSSteerWhlAngCald_flg /end REF_MEASUREMENT
/end GROUP
/begin GROUP S171_Subsys_VIPM_EPSSteerWhlAngFailr_flg "AppSwcIpm/Ipm10ms/CHACAN_IN_10ms/Msg_EPS_2_StrWhlAng_CHA/Subsys_VIPM_EPSSteerWhlAngFailr_flg"
 /begin REF_CHARACTERISTIC KIPM_EPSSteerWhlAngFailrDflt_flg KIPM_EPSSteerWhlAngFailr_flg_ovrdflg KIPM_EPSSteerWhlAngFailr_flg_ovrdval /end REF_CHARACTERISTIC
 /begin REF_MEASUREMENT VIPM_EPSSteerWhlAngFailrVld_flg VIPM_EPSSteerWhlAngFailr_flg /end REF_MEASUREMENT
/end GROUP
/begin GROUP S171_Subsys_VIPM_EPSSteerWhlAng_deg "AppSwcIpm/Ipm10ms/CHACAN_IN_10ms/Msg_EPS_2_StrWhlAng_CHA/Subsys_VIPM_EPSSteerWhlAng_deg"
 /begin REF_CHARACTERISTIC KIPM_EPSSteerWhlAngDflt_deg KIPM_EPSSteerWhlAngHi_deg KIPM_EPSSteerWhlAngLo_deg KIPM_EPSSteerWhlAng_deg_ovrdflg KIPM_EPSSteerWhlAng_deg_ovrdval /end REF_CHARACTERISTIC
 /begin REF_MEASUREMENT VIPM_EPSSteerWhlAngVld_flg VIPM_EPSSteerWhlAng_deg /end REF_MEASUREMENT
/end GROUP
/begin GROUP S172_Subsys_VIPM_ESCABSActvSta_flg "AppSwcIpm/Ipm10ms/CHACAN_IN_10ms/Msg_ESC_7_FuncStatus_CHA/Subsys_VIPM_ESCABSActvSta_flg"
 /begin REF_CHARACTERISTIC KIPM_ESCABSActvStaDflt_flg KIPM_ESCABSActvSta_flg_ovrdflg KIPM_ESCABSActvSta_flg_ovrdval /end REF_CHARACTERISTIC
 /begin REF_MEASUREMENT VIPM_ESCABSActvStaVld_flg VIPM_ESCABSActvSta_flg /end REF_MEASUREMENT
/end GROUP
/begin GROUP S172_Subsys_VIPM_ESCCDPActv_flg "AppSwcIpm/Ipm10ms/CHACAN_IN_10ms/Msg_ESC_7_FuncStatus_CHA/Subsys_VIPM_ESCCDPActv_flg"
 /begin REF_CHARACTERISTIC KIPM_ESCCDPActvDflt_flg KIPM_ESCCDPActv_flg_ovrdflg KIPM_ESCCDPActv_flg_ovrdval /end REF_CHARACTERISTIC
 /begin REF_MEASUREMENT VIPM_ESCCDPActvVld_flg VIPM_ESCCDPActv_flg /end REF_MEASUREMENT
/end GROUP
/begin GROUP S172_Subsys_VIPM_ESCEBDActv_flg "AppSwcIpm/Ipm10ms/CHACAN_IN_10ms/Msg_ESC_7_FuncStatus_CHA/Subsys_VIPM_ESCEBDActv_flg"
 /begin REF_CHARACTERISTIC KIPM_ESCEBDActvDflt_flg KIPM_ESCEBDActv_flg_ovrdflg KIPM_ESCEBDActv_flg_ovrdval /end REF_CHARACTERISTIC
 /begin REF_MEASUREMENT VIPM_ESCEBDActvVld_flg VIPM_ESCEBDActv_flg /end REF_MEASUREMENT
/end GROUP
/begin GROUP S172_Subsys_VIPM_ESCESPActvSta_flg "AppSwcIpm/Ipm10ms/CHACAN_IN_10ms/Msg_ESC_7_FuncStatus_CHA/Subsys_VIPM_ESCESPActvSta_flg"
 /begin REF_CHARACTERISTIC KIPM_ESCESPActvStaDflt_flg KIPM_ESCESPActvSta_flg_ovrdflg KIPM_ESCESPActvSta_flg_ovrdval /end REF_CHARACTERISTIC
 /begin REF_MEASUREMENT VIPM_ESCESPActvStaVld_flg VIPM_ESCESPActvSta_flg /end REF_MEASUREMENT
/end GROUP
/begin GROUP S172_Subsys_VIPM_ESCESSActv_flg "AppSwcIpm/Ipm10ms/CHACAN_IN_10ms/Msg_ESC_7_FuncStatus_CHA/Subsys_VIPM_ESCESSActv_flg"
 /begin REF_CHARACTERISTIC KIPM_ESCESSActvDflt_flg KIPM_ESCESSActv_flg_ovrdflg KIPM_ESCESSActv_flg_ovrdval /end REF_CHARACTERISTIC
 /begin REF_MEASUREMENT VIPM_ESCESSActvVld_flg VIPM_ESCESSActv_flg /end REF_MEASUREMENT
/end GROUP
/begin GROUP S172_Subsys_VIPM_ESCFltLvl_enum "AppSwcIpm/Ipm10ms/CHACAN_IN_10ms/Msg_ESC_7_FuncStatus_CHA/Subsys_VIPM_ESCFltLvl_enum"
 /begin REF_CHARACTERISTIC KIPM_ESCFltLvlDflt_enum KIPM_ESCFltLvl_enum_ovrdflg KIPM_ESCFltLvl_enum_ovrdval /end REF_CHARACTERISTIC
 /begin REF_MEASUREMENT VIPM_ESCFltLvlVld_flg VIPM_ESCFltLvl_enum /end REF_MEASUREMENT
/end GROUP
/begin GROUP S172_Subsys_VIPM_ESCReqBrkLghtOn_flg "AppSwcIpm/Ipm10ms/CHACAN_IN_10ms/Msg_ESC_7_FuncStatus_CHA/Subsys_VIPM_ESCReqBrkLghtOn_flg"
 /begin REF_CHARACTERISTIC KIPM_ESCReqBrkLghtOnDflt_flg KIPM_ESCReqBrkLghtOn_flg_ovrdflg KIPM_ESCReqBrkLghtOn_flg_ovrdval /end REF_CHARACTERISTIC
 /begin REF_MEASUREMENT VIPM_ESCReqBrkLghtOnVld_flg VIPM_ESCReqBrkLghtOn_flg /end REF_MEASUREMENT
/end GROUP
/begin GROUP S172_Subsys_VIPM_ESCSlopPct_pct "AppSwcIpm/Ipm10ms/CHACAN_IN_10ms/Msg_ESC_7_FuncStatus_CHA/Subsys_VIPM_ESCSlopPct_pct"
 /begin REF_CHARACTERISTIC KIPM_ESCSlopPctDflt_pct KIPM_ESCSlopPctHi_pct KIPM_ESCSlopPctLo_pct KIPM_ESCSlopPct_pct_ovrdflg KIPM_ESCSlopPct_pct_ovrdval /end REF_CHARACTERISTIC
 /begin REF_MEASUREMENT VIPM_ESCSlopPctVld_flg VIPM_ESCSlopPct_pct /end REF_MEASUREMENT
/end GROUP
/begin GROUP S172_Subsys_VIPM_ESCTCSActvSta_flg "AppSwcIpm/Ipm10ms/CHACAN_IN_10ms/Msg_ESC_7_FuncStatus_CHA/Subsys_VIPM_ESCTCSActvSta_flg"
 /begin REF_CHARACTERISTIC KIPM_ESCTCSActvStaDflt_flg KIPM_ESCTCSActvSta_flg_ovrdflg KIPM_ESCTCSActvSta_flg_ovrdval /end REF_CHARACTERISTIC
 /begin REF_MEASUREMENT VIPM_ESCTCSActvStaVld_flg VIPM_ESCTCSActvSta_flg /end REF_MEASUREMENT
/end GROUP
/begin GROUP S172_Subsys_VIPM_ESCVehSpd_kph "AppSwcIpm/Ipm10ms/CHACAN_IN_10ms/Msg_ESC_7_FuncStatus_CHA/Subsys_VIPM_ESCVehSpd_kph"
 /begin REF_CHARACTERISTIC KIPM_ESCVehSpdDflt_kph KIPM_ESCVehSpdHi_kph KIPM_ESCVehSpdLo_kph KIPM_ESCVehSpd_kph_ovrdflg KIPM_ESCVehSpd_kph_ovrdval /end REF_CHARACTERISTIC
 /begin REF_MEASUREMENT VIPM_ESCVehSpdVld_flg VIPM_ESCVehSpd_kph /end REF_MEASUREMENT
/end GROUP
/begin GROUP S173_Subsys_VIPM_ESCLatAccSnsrVal_g "AppSwcIpm/Ipm10ms/CHACAN_IN_10ms/Msg_ESC_A_CHA/Subsys_VIPM_ESCLatAccSnsrVal_g"
 /begin REF_CHARACTERISTIC KIPM_ESCLatAccSnsrValDflt_g KIPM_ESCLatAccSnsrValHi_g KIPM_ESCLatAccSnsrValLo_g KIPM_ESCLatAccSnsrVal_g_ovrdflg KIPM_ESCLatAccSnsrVal_g_ovrdval /end REF_CHARACTERISTIC
 /begin REF_MEASUREMENT VIPM_ESCLatAccSnsrValVld_flg VIPM_ESCLatAccSnsrVal_g /end REF_MEASUREMENT
/end GROUP
/begin GROUP S173_Subsys_VIPM_ESCLongAccSnsrVal_g "AppSwcIpm/Ipm10ms/CHACAN_IN_10ms/Msg_ESC_A_CHA/Subsys_VIPM_ESCLongAccSnsrVal_g"
 /begin REF_CHARACTERISTIC KIPM_ESCLongAccSnsrValDflt_g KIPM_ESCLongAccSnsrValHi_g KIPM_ESCLongAccSnsrValLo_g KIPM_ESCLongAccSnsrVal_g_ovrdflg KIPM_ESCLongAccSnsrVal_g_ovrdval /end REF_CHARACTERISTIC
 /begin REF_MEASUREMENT VIPM_ESCLongAccSnsrValVld_flg VIPM_ESCLongAccSnsrVal_g /end REF_MEASUREMENT
/end GROUP
/begin GROUP S173_Subsys_VIPM_ESCMstrCylPresr_bar "AppSwcIpm/Ipm10ms/CHACAN_IN_10ms/Msg_ESC_A_CHA/Subsys_VIPM_ESCMstrCylPresr_bar"
 /begin REF_CHARACTERISTIC KIPM_ESCMstrCylPresrDflt_bar KIPM_ESCMstrCylPresrHi_bar KIPM_ESCMstrCylPresrLo_bar KIPM_ESCMstrCylPresr_bar_ovrdflg KIPM_ESCMstrCylPresr_bar_ovrdval /end REF_CHARACTERISTIC
 /begin REF_MEASUREMENT VIPM_ESCMstrCylPresrVld_flg VIPM_ESCMstrCylPresr_bar /end REF_MEASUREMENT
/end GROUP
/begin GROUP S173_Subsys_VIPM_ESCVehStandStillSta_enum "AppSwcIpm/Ipm10ms/CHACAN_IN_10ms/Msg_ESC_A_CHA/Subsys_VIPM_ESCVehStandStillSta_enum"
 /begin REF_CHARACTERISTIC KIPM_ESCVehStandStillStaDflt_enum KIPM_ESCVehStandStillSta_enum_ovrdflg KIPM_ESCVehStandStillSta_enum_ovrdval /end REF_CHARACTERISTIC
 /begin REF_MEASUREMENT VIPM_ESCVehStandStillStaVld_flg VIPM_ESCVehStandStillSta_enum /end REF_MEASUREMENT
/end GROUP
/begin GROUP S173_Subsys_VIPM_ESCWhlDirctnFL_enum "AppSwcIpm/Ipm10ms/CHACAN_IN_10ms/Msg_ESC_A_CHA/Subsys_VIPM_ESCWhlDirctnFL_enum"
 /begin REF_CHARACTERISTIC KIPM_ESCWhlDirctnFLDflt_enum KIPM_ESCWhlDirctnFL_enum_ovrdflg KIPM_ESCWhlDirctnFL_enum_ovrdval /end REF_CHARACTERISTIC
 /begin REF_MEASUREMENT VIPM_ESCWhlDirctnFLVld_flg VIPM_ESCWhlDirctnFL_enum /end REF_MEASUREMENT
/end GROUP
/begin GROUP S173_Subsys_VIPM_ESCWhlDirctnFR_enum "AppSwcIpm/Ipm10ms/CHACAN_IN_10ms/Msg_ESC_A_CHA/Subsys_VIPM_ESCWhlDirctnFR_enum"
 /begin REF_CHARACTERISTIC KIPM_ESCWhlDirctnFRDflt_enum KIPM_ESCWhlDirctnFR_enum_ovrdflg KIPM_ESCWhlDirctnFR_enum_ovrdval /end REF_CHARACTERISTIC
 /begin REF_MEASUREMENT VIPM_ESCWhlDirctnFRVld_flg VIPM_ESCWhlDirctnFR_enum /end REF_MEASUREMENT
/end GROUP
/begin GROUP S173_Subsys_VIPM_ESCWhlDirctnRL_enum "AppSwcIpm/Ipm10ms/CHACAN_IN_10ms/Msg_ESC_A_CHA/Subsys_VIPM_ESCWhlDirctnRL_enum"
 /begin REF_CHARACTERISTIC KIPM_ESCWhlDirctnRLDflt_enum KIPM_ESCWhlDirctnRL_enum_ovrdflg KIPM_ESCWhlDirctnRL_enum_ovrdval /end REF_CHARACTERISTIC
 /begin REF_MEASUREMENT VIPM_ESCWhlDirctnRLVld_flg VIPM_ESCWhlDirctnRL_enum /end REF_MEASUREMENT
/end GROUP
/begin GROUP S173_Subsys_VIPM_ESCWhlDirctnRR_enum "AppSwcIpm/Ipm10ms/CHACAN_IN_10ms/Msg_ESC_A_CHA/Subsys_VIPM_ESCWhlDirctnRR_enum"
 /begin REF_CHARACTERISTIC KIPM_ESCWhlDirctnRRDflt_enum KIPM_ESCWhlDirctnRR_enum_ovrdflg KIPM_ESCWhlDirctnRR_enum_ovrdval /end REF_CHARACTERISTIC
 /begin REF_MEASUREMENT VIPM_ESCWhlDirctnRRVld_flg VIPM_ESCWhlDirctnRR_enum /end REF_MEASUREMENT
/end GROUP
/begin GROUP S173_Subsys_VIPM_ESCWhlSpdKphFL_kph "AppSwcIpm/Ipm10ms/CHACAN_IN_10ms/Msg_ESC_A_CHA/Subsys_VIPM_ESCWhlSpdKphFL_kph"
 /begin REF_CHARACTERISTIC KIPM_ESCWhlSpdKphFLDflt_kph KIPM_ESCWhlSpdKphFLHi_kph KIPM_ESCWhlSpdKphFLLo_kph KIPM_ESCWhlSpdKphFL_kph_ovrdflg KIPM_ESCWhlSpdKphFL_kph_ovrdval /end REF_CHARACTERISTIC
 /begin REF_MEASUREMENT VIPM_ESCWhlSpdKphFLVld_flg VIPM_ESCWhlSpdKphFL_kph /end REF_MEASUREMENT
/end GROUP
/begin GROUP S173_Subsys_VIPM_ESCWhlSpdKphFR_kph "AppSwcIpm/Ipm10ms/CHACAN_IN_10ms/Msg_ESC_A_CHA/Subsys_VIPM_ESCWhlSpdKphFR_kph"
 /begin REF_CHARACTERISTIC KIPM_ESCWhlSpdKphFRDflt_kph KIPM_ESCWhlSpdKphFRHi_kph KIPM_ESCWhlSpdKphFRLo_kph KIPM_ESCWhlSpdKphFR_kph_ovrdflg KIPM_ESCWhlSpdKphFR_kph_ovrdval /end REF_CHARACTERISTIC
 /begin REF_MEASUREMENT VIPM_ESCWhlSpdKphFRVld_flg VIPM_ESCWhlSpdKphFR_kph /end REF_MEASUREMENT
/end GROUP
/begin GROUP S173_Subsys_VIPM_ESCWhlSpdKphRL_kph "AppSwcIpm/Ipm10ms/CHACAN_IN_10ms/Msg_ESC_A_CHA/Subsys_VIPM_ESCWhlSpdKphRL_kph"
 /begin REF_CHARACTERISTIC KIPM_ESCWhlSpdKphRLDflt_kph KIPM_ESCWhlSpdKphRLHi_kph KIPM_ESCWhlSpdKphRLLo_kph KIPM_ESCWhlSpdKphRL_kph_ovrdflg KIPM_ESCWhlSpdKphRL_kph_ovrdval /end REF_CHARACTERISTIC
 /begin REF_MEASUREMENT VIPM_ESCWhlSpdKphRLVld_flg VIPM_ESCWhlSpdKphRL_kph /end REF_MEASUREMENT
/end GROUP
/begin GROUP S173_Subsys_VIPM_ESCWhlSpdKphRR_kph "AppSwcIpm/Ipm10ms/CHACAN_IN_10ms/Msg_ESC_A_CHA/Subsys_VIPM_ESCWhlSpdKphRR_kph"
 /begin REF_CHARACTERISTIC KIPM_ESCWhlSpdKphRRDflt_kph KIPM_ESCWhlSpdKphRRHi_kph KIPM_ESCWhlSpdKphRRLo_kph KIPM_ESCWhlSpdKphRR_kph_ovrdflg KIPM_ESCWhlSpdKphRR_kph_ovrdval /end REF_CHARACTERISTIC
 /begin REF_MEASUREMENT VIPM_ESCWhlSpdKphRRVld_flg VIPM_ESCWhlSpdKphRR_kph /end REF_MEASUREMENT
/end GROUP
/begin GROUP S173_Subsys_VIPM_ESCWhlTqDecReqActv_flg "AppSwcIpm/Ipm10ms/CHACAN_IN_10ms/Msg_ESC_A_CHA/Subsys_VIPM_ESCWhlTqDecReqActv_flg"
 /begin REF_CHARACTERISTIC KIPM_ESCWhlTqDecReqActvDflt_flg KIPM_ESCWhlTqDecReqActv_flg_ovrdflg KIPM_ESCWhlTqDecReqActv_flg_ovrdval /end REF_CHARACTERISTIC
 /begin REF_MEASUREMENT VIPM_ESCWhlTqDecReqActvVld_flg VIPM_ESCWhlTqDecReqActv_flg /end REF_MEASUREMENT
/end GROUP
/begin GROUP S173_Subsys_VIPM_ESCWhlTqDecReqVal_Nm "AppSwcIpm/Ipm10ms/CHACAN_IN_10ms/Msg_ESC_A_CHA/Subsys_VIPM_ESCWhlTqDecReqVal_Nm"
 /begin REF_CHARACTERISTIC KIPM_ESCWhlTqDecReqValDflt_Nm KIPM_ESCWhlTqDecReqValHi_Nm KIPM_ESCWhlTqDecReqValLo_Nm KIPM_ESCWhlTqDecReqVal_Nm_ovrdflg KIPM_ESCWhlTqDecReqVal_Nm_ovrdval /end REF_CHARACTERISTIC
 /begin REF_MEASUREMENT VIPM_ESCWhlTqDecReqValVld_flg VIPM_ESCWhlTqDecReqVal_Nm /end REF_MEASUREMENT
/end GROUP
/begin GROUP S173_Subsys_VIPM_ESCWhlTqIncReqActv_flg "AppSwcIpm/Ipm10ms/CHACAN_IN_10ms/Msg_ESC_A_CHA/Subsys_VIPM_ESCWhlTqIncReqActv_flg"
 /begin REF_CHARACTERISTIC KIPM_ESCWhlTqIncReqActvDflt_flg KIPM_ESCWhlTqIncReqActv_flg_ovrdflg KIPM_ESCWhlTqIncReqActv_flg_ovrdval /end REF_CHARACTERISTIC
 /begin REF_MEASUREMENT VIPM_ESCWhlTqIncReqActvVld_flg VIPM_ESCWhlTqIncReqActv_flg /end REF_MEASUREMENT
/end GROUP
/begin GROUP S173_Subsys_VIPM_ESCWhlTqIncReqVal_Nm "AppSwcIpm/Ipm10ms/CHACAN_IN_10ms/Msg_ESC_A_CHA/Subsys_VIPM_ESCWhlTqIncReqVal_Nm"
 /begin REF_CHARACTERISTIC KIPM_ESCWhlTqIncReqValDflt_Nm KIPM_ESCWhlTqIncReqValHi_Nm KIPM_ESCWhlTqIncReqValLo_Nm KIPM_ESCWhlTqIncReqVal_Nm_ovrdflg KIPM_ESCWhlTqIncReqVal_Nm_ovrdval /end REF_CHARACTERISTIC
 /begin REF_MEASUREMENT VIPM_ESCWhlTqIncReqValVld_flg VIPM_ESCWhlTqIncReqVal_Nm /end REF_MEASUREMENT
/end GROUP
/begin GROUP S173_Subsys_VIPM_ESCYawRate_degps "AppSwcIpm/Ipm10ms/CHACAN_IN_10ms/Msg_ESC_A_CHA/Subsys_VIPM_ESCYawRate_degps"
 /begin REF_CHARACTERISTIC KIPM_ESCYawRateDflt_degps KIPM_ESCYawRateHi_degps KIPM_ESCYawRateLo_degps KIPM_ESCYawRate_degps_ovrdflg KIPM_ESCYawRate_degps_ovrdval /end REF_CHARACTERISTIC
 /begin REF_MEASUREMENT VIPM_ESCYawRateVld_flg VIPM_ESCYawRate_degps /end REF_MEASUREMENT
/end GROUP
/begin GROUP S227_Subsys_VIPM_INV1ActMode_enum "AppSwcIpm/Ipm10ms/EPTCAN_IN_10ms/Msg_INV_1_Value_EPT/Subsys_VIPM_INV1ActMode_enum"
 /begin REF_CHARACTERISTIC KIPM_INV1ActModeDflt_enum KIPM_INV1ActMode_enum_ovrdflg KIPM_INV1ActMode_enum_ovrdval /end REF_CHARACTERISTIC
 /begin REF_MEASUREMENT VIPM_INV1ActModeVld_flg VIPM_INV1ActMode_enum /end REF_MEASUREMENT
/end GROUP
/begin GROUP S227_Subsys_VIPM_INV1ActTorq_Nm "AppSwcIpm/Ipm10ms/EPTCAN_IN_10ms/Msg_INV_1_Value_EPT/Subsys_VIPM_INV1ActTorq_Nm"
 /begin REF_CHARACTERISTIC KIPM_INV1ActTorqDflt_Nm KIPM_INV1ActTorqHi_Nm KIPM_INV1ActTorqLo_Nm KIPM_INV1ActTorq_Nm_ovrdflg KIPM_INV1ActTorq_Nm_ovrdval /end REF_CHARACTERISTIC
 /begin REF_MEASUREMENT VIPM_INV1ActTorqVld_flg VIPM_INV1ActTorq_Nm /end REF_MEASUREMENT
/end GROUP
/begin GROUP S227_Subsys_VIPM_INV1AntithftAuthRslt_enum "AppSwcIpm/Ipm10ms/EPTCAN_IN_10ms/Msg_INV_1_Value_EPT/Subsys_VIPM_INV1AntithftAuthRslt_enum"
 /begin REF_CHARACTERISTIC KIPM_INV1AntithftAuthRsltDflt_enum KIPM_INV1AntithftAuthRslt_enum_ovrdflg KIPM_INV1AntithftAuthRslt_enum_ovrdval /end REF_CHARACTERISTIC
 /begin REF_MEASUREMENT VIPM_INV1AntithftAuthRsltVld_flg VIPM_INV1AntithftAuthRslt_enum /end REF_MEASUREMENT
/end GROUP
/begin GROUP S227_Subsys_VIPM_INV1MotSpd_rpm "AppSwcIpm/Ipm10ms/EPTCAN_IN_10ms/Msg_INV_1_Value_EPT/Subsys_VIPM_INV1MotSpd_rpm"
 /begin REF_CHARACTERISTIC KIPM_INV1MotSpdDflt_rpm KIPM_INV1MotSpdHi_rpm KIPM_INV1MotSpdLo_rpm KIPM_INV1MotSpd_rpm_ovrdflg KIPM_INV1MotSpd_rpm_ovrdval /end REF_CHARACTERISTIC
 /begin REF_MEASUREMENT VIPM_INV1MotSpdVld_flg VIPM_INV1MotSpd_rpm /end REF_MEASUREMENT
/end GROUP
/begin GROUP S227_Subsys_VIPM_INV1PreChrgAllwd_enum "AppSwcIpm/Ipm10ms/EPTCAN_IN_10ms/Msg_INV_1_Value_EPT/Subsys_VIPM_INV1PreChrgAllwd_enum"
 /begin REF_CHARACTERISTIC KIPM_INV1PreChrgAllwdDflt_enum KIPM_INV1PreChrgAllwd_enum_ovrdflg KIPM_INV1PreChrgAllwd_enum_ovrdval /end REF_CHARACTERISTIC
 /begin REF_MEASUREMENT VIPM_INV1PreChrgAllwdVld_flg VIPM_INV1PreChrgAllwd_enum /end REF_MEASUREMENT
/end GROUP
/begin GROUP S227_Subsys_VIPM_INV1PreprogmFlg_flg "AppSwcIpm/Ipm10ms/EPTCAN_IN_10ms/Msg_INV_1_Value_EPT/Subsys_VIPM_INV1PreprogmFlg_flg"
 /begin REF_CHARACTERISTIC KIPM_INV1PreprogmFlgDflt_flg KIPM_INV1PreprogmFlg_flg_ovrdflg KIPM_INV1PreprogmFlg_flg_ovrdval /end REF_CHARACTERISTIC
 /begin REF_MEASUREMENT VIPM_INV1PreprogmFlgVld_flg VIPM_INV1PreprogmFlg_flg /end REF_MEASUREMENT
/end GROUP
/begin GROUP S227_Subsys_VIPM_INV1ShutdownAllwd_enum "AppSwcIpm/Ipm10ms/EPTCAN_IN_10ms/Msg_INV_1_Value_EPT/Subsys_VIPM_INV1ShutdownAllwd_enum"
 /begin REF_CHARACTERISTIC KIPM_INV1ShutdownAllwdDflt_enum KIPM_INV1ShutdownAllwd_enum_ovrdflg KIPM_INV1ShutdownAllwd_enum_ovrdval /end REF_CHARACTERISTIC
 /begin REF_MEASUREMENT VIPM_INV1ShutdownAllwdVld_flg VIPM_INV1ShutdownAllwd_enum /end REF_MEASUREMENT
/end GROUP
/begin GROUP S228_Subsys_VIPM_INV2IgbtMaxTemp_C "AppSwcIpm/Ipm10ms/EPTCAN_IN_10ms/Msg_INV_2_Value_EPT/Subsys_VIPM_INV2IgbtMaxTemp_C"
 /begin REF_CHARACTERISTIC KIPM_INV2IgbtMaxTempDflt_C KIPM_INV2IgbtMaxTempHi_C KIPM_INV2IgbtMaxTempLo_C KIPM_INV2IgbtMaxTemp_C_ovrdflg KIPM_INV2IgbtMaxTemp_C_ovrdval /end REF_CHARACTERISTIC
 /begin REF_MEASUREMENT VIPM_INV2IgbtMaxTempVld_flg VIPM_INV2IgbtMaxTemp_C /end REF_MEASUREMENT
/end GROUP
/begin GROUP S228_Subsys_VIPM_INV2InpCurnt_A "AppSwcIpm/Ipm10ms/EPTCAN_IN_10ms/Msg_INV_2_Value_EPT/Subsys_VIPM_INV2InpCurnt_A"
 /begin REF_CHARACTERISTIC KIPM_INV2InpCurntDflt_A KIPM_INV2InpCurntHi_A KIPM_INV2InpCurntLo_A KIPM_INV2InpCurnt_A_ovrdflg KIPM_INV2InpCurnt_A_ovrdval /end REF_CHARACTERISTIC
 /begin REF_MEASUREMENT VIPM_INV2InpCurntVld_flg VIPM_INV2InpCurnt_A /end REF_MEASUREMENT
/end GROUP
/begin GROUP S228_Subsys_VIPM_INV2InpVolt_V "AppSwcIpm/Ipm10ms/EPTCAN_IN_10ms/Msg_INV_2_Value_EPT/Subsys_VIPM_INV2InpVolt_V"
 /begin REF_CHARACTERISTIC KIPM_INV2InpVoltDflt_V KIPM_INV2InpVoltHi_V KIPM_INV2InpVoltLo_V KIPM_INV2InpVolt_V_ovrdflg KIPM_INV2InpVolt_V_ovrdval /end REF_CHARACTERISTIC
 /begin REF_MEASUREMENT VIPM_INV2InpVoltVld_flg VIPM_INV2InpVolt_V /end REF_MEASUREMENT
/end GROUP
/begin GROUP S228_Subsys_VIPM_INV2MotorMaxTemp_C "AppSwcIpm/Ipm10ms/EPTCAN_IN_10ms/Msg_INV_2_Value_EPT/Subsys_VIPM_INV2MotorMaxTemp_C"
 /begin REF_CHARACTERISTIC KIPM_INV2MotorMaxTempDflt_C KIPM_INV2MotorMaxTempHi_C KIPM_INV2MotorMaxTempLo_C KIPM_INV2MotorMaxTemp_C_ovrdflg KIPM_INV2MotorMaxTemp_C_ovrdval /end REF_CHARACTERISTIC
 /begin REF_MEASUREMENT VIPM_INV2MotorMaxTempVld_flg VIPM_INV2MotorMaxTemp_C /end REF_MEASUREMENT
/end GROUP
/end MODULE
/end PROJECT
