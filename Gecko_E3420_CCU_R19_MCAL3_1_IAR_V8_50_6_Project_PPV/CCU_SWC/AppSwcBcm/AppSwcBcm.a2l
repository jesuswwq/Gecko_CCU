/******************************************************************************
* ASAP2 file: AppSwcBcm.a2l
* Code generation for model "AppSwcBcm".
* Model version : 1.1421
* Simulink Coder version : 9.8 (R2022b) 13-May-2022
* C source code generated on : Wed Oct 9 16:23:34 2024
* Target selection: autosar.tlc
* Embedded hardware selection: NXP->Cortex-M4
* Code generation objectives: Unspecified
* Validation result: Not run
* (add additional file header information here)
******************************************************************************/ ASAP2_VERSION 1 31
/* Version 1.31 */
/begin PROJECT ProjectName "Project Comment Goes Here"
/begin HEADER "Header Comments go here" /end HEADER
/begin MODULE ModuleName "Module Comment Goes Here"
/begin MOD_PAR "MOD PAR Comment Goes Here" /end MOD_PAR
/begin MOD_COMMON "Mod Common Comment Here" BYTE_ORDER MSB_LAST /end MOD_COMMON
/begin RECORD_LAYOUT Scalar_BOOLEAN FNC_VALUES 1 UBYTE COLUMN_DIR DIRECT /end RECORD_LAYOUT
/begin RECORD_LAYOUT Scalar_UBYTE FNC_VALUES 1 UBYTE COLUMN_DIR DIRECT /end RECORD_LAYOUT
/begin RECORD_LAYOUT Scalar_BYTE FNC_VALUES 1 SBYTE COLUMN_DIR DIRECT /end RECORD_LAYOUT
/begin RECORD_LAYOUT Scalar_UWORD FNC_VALUES 1 UWORD COLUMN_DIR DIRECT /end RECORD_LAYOUT
/begin RECORD_LAYOUT Scalar_SWORD FNC_VALUES 1 SWORD COLUMN_DIR DIRECT /end RECORD_LAYOUT
/begin RECORD_LAYOUT Scalar_ULONG FNC_VALUES 1 ULONG COLUMN_DIR DIRECT /end RECORD_LAYOUT
/begin RECORD_LAYOUT Scalar_LONG FNC_VALUES 1 SLONG COLUMN_DIR DIRECT /end RECORD_LAYOUT
/begin RECORD_LAYOUT Scalar_FLOAT32_IEEE FNC_VALUES 1 FLOAT32_IEEE COLUMN_DIR DIRECT /end RECORD_LAYOUT
/begin RECORD_LAYOUT Scalar_FLOAT64_IEEE FNC_VALUES 1 FLOAT64_IEEE COLUMN_DIR DIRECT /end RECORD_LAYOUT
/begin RECORD_LAYOUT Lookup1D_BOOLEAN FNC_VALUES 1 UBYTE COLUMN_DIR DIRECT /end RECORD_LAYOUT
/begin RECORD_LAYOUT Lookup1D_X_BOOLEAN AXIS_PTS_X 1 UBYTE INDEX_INCR DIRECT /end RECORD_LAYOUT
/begin RECORD_LAYOUT Lookup1D_BYTE FNC_VALUES 1 SBYTE COLUMN_DIR DIRECT /end RECORD_LAYOUT
/begin RECORD_LAYOUT Lookup1D_X_BYTE AXIS_PTS_X 1 SBYTE INDEX_INCR DIRECT /end RECORD_LAYOUT
/begin RECORD_LAYOUT Lookup1D_UBYTE FNC_VALUES 1 UBYTE COLUMN_DIR DIRECT /end RECORD_LAYOUT
/begin RECORD_LAYOUT Lookup1D_X_UBYTE AXIS_PTS_X 1 UBYTE INDEX_INCR DIRECT /end RECORD_LAYOUT
/begin RECORD_LAYOUT Lookup1D_UWORD FNC_VALUES 1 UWORD COLUMN_DIR DIRECT /end RECORD_LAYOUT
/begin RECORD_LAYOUT Lookup1D_X_UWORD AXIS_PTS_X 1 UWORD INDEX_INCR DIRECT /end RECORD_LAYOUT
/begin RECORD_LAYOUT Lookup1D_WORD FNC_VALUES 1 SWORD COLUMN_DIR DIRECT /end RECORD_LAYOUT
/begin RECORD_LAYOUT Lookup1D_X_WORD AXIS_PTS_X 1 SWORD INDEX_INCR DIRECT /end RECORD_LAYOUT
/begin RECORD_LAYOUT Lookup1D_ULONG FNC_VALUES 1 ULONG COLUMN_DIR DIRECT /end RECORD_LAYOUT
/begin RECORD_LAYOUT Lookup1D_X_ULONG AXIS_PTS_X 1 ULONG INDEX_INCR DIRECT /end RECORD_LAYOUT
/begin RECORD_LAYOUT Lookup1D_SLONG FNC_VALUES 1 SLONG COLUMN_DIR DIRECT /end RECORD_LAYOUT
/begin RECORD_LAYOUT Lookup1D_X_LONG AXIS_PTS_X 1 SLONG INDEX_INCR DIRECT /end RECORD_LAYOUT
/begin RECORD_LAYOUT Lookup1D_FLOAT32_IEEE FNC_VALUES 1 FLOAT32_IEEE COLUMN_DIR DIRECT /end RECORD_LAYOUT
/begin RECORD_LAYOUT Lookup1D_X_FLOAT32_IEEE AXIS_PTS_X 1 FLOAT32_IEEE INDEX_INCR DIRECT /end RECORD_LAYOUT
/begin RECORD_LAYOUT Lookup1D_FLOAT64_IEEE FNC_VALUES 1 FLOAT64_IEEE COLUMN_DIR DIRECT /end RECORD_LAYOUT
/begin RECORD_LAYOUT Lookup1D_X_FLOAT64_IEEE AXIS_PTS_X 1 FLOAT64_IEEE INDEX_INCR DIRECT /end RECORD_LAYOUT
/begin RECORD_LAYOUT Lookup2D_BOOLEAN FNC_VALUES 1 UBYTE COLUMN_DIR DIRECT /end RECORD_LAYOUT
/begin RECORD_LAYOUT Lookup2D_X_BOOLEAN AXIS_PTS_X 1 UBYTE INDEX_INCR DIRECT /end RECORD_LAYOUT
/begin RECORD_LAYOUT Lookup2D_UBYTE FNC_VALUES 1 UBYTE COLUMN_DIR DIRECT /end RECORD_LAYOUT
/begin RECORD_LAYOUT Lookup2D_X_UBYTE AXIS_PTS_X 1 UBYTE INDEX_INCR DIRECT /end RECORD_LAYOUT
/begin RECORD_LAYOUT Lookup2D_BYTE FNC_VALUES 1 SBYTE COLUMN_DIR DIRECT /end RECORD_LAYOUT
/begin RECORD_LAYOUT Lookup2D_X_BYTE AXIS_PTS_X 1 SBYTE INDEX_INCR DIRECT /end RECORD_LAYOUT
/begin RECORD_LAYOUT Lookup2D_UWORD FNC_VALUES 1 UWORD COLUMN_DIR DIRECT /end RECORD_LAYOUT
/begin RECORD_LAYOUT Lookup2D_X_UWORD AXIS_PTS_X 1 UWORD INDEX_INCR DIRECT /end RECORD_LAYOUT
/begin RECORD_LAYOUT Lookup2D_WORD FNC_VALUES 1 SWORD COLUMN_DIR DIRECT /end RECORD_LAYOUT
/begin RECORD_LAYOUT Lookup2D_X_WORD AXIS_PTS_X 1 SWORD INDEX_INCR DIRECT /end RECORD_LAYOUT
/begin RECORD_LAYOUT Lookup2D_ULONG FNC_VALUES 1 ULONG COLUMN_DIR DIRECT /end RECORD_LAYOUT
/begin RECORD_LAYOUT Lookup2D_X_ULONG AXIS_PTS_X 1 ULONG INDEX_INCR DIRECT /end RECORD_LAYOUT
/begin RECORD_LAYOUT Lookup2D_LONG FNC_VALUES 1 SLONG COLUMN_DIR DIRECT /end RECORD_LAYOUT
/begin RECORD_LAYOUT Lookup2D_X_LONG AXIS_PTS_X 1 SLONG INDEX_INCR DIRECT /end RECORD_LAYOUT
/begin RECORD_LAYOUT Lookup2D_FLOAT32_IEEE FNC_VALUES 1 FLOAT32_IEEE COLUMN_DIR DIRECT /end RECORD_LAYOUT
/begin RECORD_LAYOUT Lookup2D_X_FLOAT32_IEEE AXIS_PTS_X 1 FLOAT32_IEEE INDEX_INCR DIRECT /end RECORD_LAYOUT
/begin RECORD_LAYOUT Lookup2D_FLOAT64_IEEE FNC_VALUES 1 FLOAT64_IEEE COLUMN_DIR DIRECT /end RECORD_LAYOUT
/begin RECORD_LAYOUT Lookup2D_X_FLOAT64_IEEE AXIS_PTS_X 1 FLOAT64_IEEE INDEX_INCR DIRECT /end RECORD_LAYOUT
/begin CHARACTERISTIC SeatCtl_DrvSeatTempLookUp_Y "" /* Characteristic Type */ CURVE 0x0000 /* @ECU_Address@SeatCtl_DrvSeatTempLookUp_Y@ */ Lookup1D_FLOAT32_IEEE /* Maxdiff */ 0 AppSwcBcm_CM_single -3.4E+38 3.4E+38
 /begin AXIS_DESCR /* Description of X-Axis Points */ /* Axis Type */ COM_AXIS /* Reference to Input */ NO_INPUT_QUANTITY AppSwcBcm_CM_single 24 -3.4E+38 3.4E+38 AXIS_PTS_REF SeatCtl_DrvSeatTempLookUp_X /end AXIS_DESCR
/end CHARACTERISTIC
/begin AXIS_PTS SeatCtl_DrvSeatTempLookUp_X "" 0x0000 /* @ECU_Address@SeatCtl_DrvSeatTempLookUp_X@ */ /* Input Quantity */ NO_INPUT_QUANTITY Lookup1D_X_FLOAT32_IEEE 0 AppSwcBcm_CM_single 24 -3.4E+38 3.4E+38 /end AXIS_PTS
/begin CHARACTERISTIC SteerWhlCtl_SteerWhlTempLookUp_Y "" /* Characteristic Type */ CURVE 0x0000 /* @ECU_Address@SteerWhlCtl_SteerWhlTempLookUp_Y@ */ Lookup1D_FLOAT32_IEEE /* Maxdiff */ 0 AppSwcBcm_CM_single -3.4E+38 3.4E+38
 /begin AXIS_DESCR /* Description of X-Axis Points */ /* Axis Type */ COM_AXIS /* Reference to Input */ NO_INPUT_QUANTITY AppSwcBcm_CM_single 3 -3.4E+38 3.4E+38 AXIS_PTS_REF SteerWhlCtl_SteerWhlTempLookUp_X /end AXIS_DESCR
/end CHARACTERISTIC
/begin AXIS_PTS SteerWhlCtl_SteerWhlTempLookUp_X "" 0x0000 /* @ECU_Address@SteerWhlCtl_SteerWhlTempLookUp_X@ */ /* Input Quantity */ NO_INPUT_QUANTITY Lookup1D_X_FLOAT32_IEEE 0 AppSwcBcm_CM_single 3 -3.4E+38 3.4E+38 /end AXIS_PTS
/begin CHARACTERISTIC DoorLckCtl_Ts_C "" VALUE 0x0000 /* @ECU_Address@DoorLckCtl_Ts_C@ */ Scalar_FLOAT32_IEEE 0 AppSwcBcm_CM_single_sec -3.4E+38 3.4E+38 /end CHARACTERISTIC
/begin CHARACTERISTIC HornCtl_Ts_C "" VALUE 0x0000 /* @ECU_Address@HornCtl_Ts_C@ */ Scalar_FLOAT32_IEEE 0 AppSwcBcm_CM_single -3.4E+38 3.4E+38 /end CHARACTERISTIC
/begin CHARACTERISTIC LampCtl_Ts_C "" VALUE 0x0000 /* @ECU_Address@LampCtl_Ts_C@ */ Scalar_FLOAT32_IEEE 0 AppSwcBcm_CM_single_s -3.4E+38 3.4E+38 /end CHARACTERISTIC
/begin CHARACTERISTIC PDUCtl_Ts_C "" VALUE 0x0000 /* @ECU_Address@PDUCtl_Ts_C@ */ Scalar_FLOAT32_IEEE 0 AppSwcBcm_CM_single_sec -3.4E+38 3.4E+38 /end CHARACTERISTIC
/begin CHARACTERISTIC RVMCtl_Ts_C "" VALUE 0x0000 /* @ECU_Address@RVMCtl_Ts_C@ */ Scalar_FLOAT32_IEEE 0 AppSwcBcm_CM_single -3.4E+38 3.4E+38 /end CHARACTERISTIC
/begin CHARACTERISTIC WinCtl_Ts_C "" VALUE 0x0000 /* @ECU_Address@WinCtl_Ts_C@ */ Scalar_FLOAT32_IEEE 0 AppSwcBcm_CM_single_sec -3.4E+38 3.4E+38 /end CHARACTERISTIC
/begin CHARACTERISTIC WiperCtl_Ts_C "" VALUE 0x0000 /* @ECU_Address@WiperCtl_Ts_C@ */ Scalar_FLOAT32_IEEE 0 AppSwcBcm_CM_single_sec -3.4E+38 3.4E+38 /end CHARACTERISTIC
/begin CHARACTERISTIC AlmSysCtl_AlrmTimLimit_C "" VALUE 0x0000 /* @ECU_Address@AlmSysCtl_AlrmTimLimit_C@ */ Scalar_UWORD 0 AppSwcBcm_CM_uint16_50ms 0 65535 /end CHARACTERISTIC
/begin CHARACTERISTIC BatSaveCtl_DlyTim_C "" VALUE 0x0000 /* @ECU_Address@BatSaveCtl_DlyTim_C@ */ Scalar_UWORD 0 AppSwcBcm_CM_uint16_50ms 0 65535 /end CHARACTERISTIC
/begin CHARACTERISTIC BatSaveCtl_LckDlyTim_C "" VALUE 0x0000 /* @ECU_Address@BatSaveCtl_LckDlyTim_C@ */ Scalar_UWORD 0 AppSwcBcm_CM_uint16_50ms 0 65535 /end CHARACTERISTIC
/begin CHARACTERISTIC DoorLckCtl_AntiLckProtTim_C "" VALUE 0x0000 /* @ECU_Address@DoorLckCtl_AntiLckProtTim_C@ */ Scalar_UWORD 0 AppSwcBcm_CM_uint16_50ms 0 65535 /end CHARACTERISTIC
/begin CHARACTERISTIC DoorLckCtl_AutoLckDelayTim_C "" VALUE 0x0000 /* @ECU_Address@DoorLckCtl_AutoLckDelayTim_C@ */ Scalar_UWORD 0 AppSwcBcm_CM_uint16_50ms 0 65535 /end CHARACTERISTIC
/begin CHARACTERISTIC DoorLckCtl_CntSubTim_C "" VALUE 0x0000 /* @ECU_Address@DoorLckCtl_CntSubTim_C@ */ Scalar_UWORD 0 AppSwcBcm_CM_uint16_50ms 0 65535 /end CHARACTERISTIC
/begin CHARACTERISTIC DoorLckCtl_CrshPwrOnTimInValid_C "" VALUE 0x0000 /* @ECU_Address@DoorLckCtl_CrshPwrOnTimInValid_C@ */ Scalar_UWORD 0 AppSwcBcm_CM_uint16_10ms 0 65535 /end CHARACTERISTIC
/begin CHARACTERISTIC DoorLckCtl_CrshPwrOnTimValid_C "" VALUE 0x0000 /* @ECU_Address@DoorLckCtl_CrshPwrOnTimValid_C@ */ Scalar_UWORD 0 AppSwcBcm_CM_uint16_10ms 0 65535 /end CHARACTERISTIC
/begin CHARACTERISTIC DoorLckCtl_DoorAjarFLTimInValid_C "" VALUE 0x0000 /* @ECU_Address@DoorLckCtl_DoorAjarFLTimInValid_C@ */ Scalar_UWORD 0 AppSwcBcm_CM_uint16_10ms 0 65535 /end CHARACTERISTIC
/begin CHARACTERISTIC DoorLckCtl_DoorAjarFLTimValid_C "" VALUE 0x0000 /* @ECU_Address@DoorLckCtl_DoorAjarFLTimValid_C@ */ Scalar_UWORD 0 AppSwcBcm_CM_uint16_10ms 0 65535 /end CHARACTERISTIC
/begin CHARACTERISTIC DoorLckCtl_DoorAjarFRTimInValid_C "" VALUE 0x0000 /* @ECU_Address@DoorLckCtl_DoorAjarFRTimInValid_C@ */ Scalar_UWORD 0 AppSwcBcm_CM_uint16_10ms 0 65535 /end CHARACTERISTIC
/begin CHARACTERISTIC DoorLckCtl_DoorAjarFRTimValid_C "" VALUE 0x0000 /* @ECU_Address@DoorLckCtl_DoorAjarFRTimValid_C@ */ Scalar_UWORD 0 AppSwcBcm_CM_uint16_10ms 0 65535 /end CHARACTERISTIC
/begin CHARACTERISTIC DoorLckCtl_DoorAjarRLTimInvalid_C "" VALUE 0x0000 /* @ECU_Address@DoorLckCtl_DoorAjarRLTimInvalid_C@ */ Scalar_UWORD 0 AppSwcBcm_CM_uint16_10ms 0 65535 /end CHARACTERISTIC
/begin CHARACTERISTIC DoorLckCtl_DoorAjarRLTimValid_C "" VALUE 0x0000 /* @ECU_Address@DoorLckCtl_DoorAjarRLTimValid_C@ */ Scalar_UWORD 0 AppSwcBcm_CM_uint16_10ms 0 65535 /end CHARACTERISTIC
/begin CHARACTERISTIC DoorLckCtl_DoorAjarRRTimInvalid_C "" VALUE 0x0000 /* @ECU_Address@DoorLckCtl_DoorAjarRRTimInvalid_C@ */ Scalar_UWORD 0 AppSwcBcm_CM_uint16_10ms 0 65535 /end CHARACTERISTIC
/begin CHARACTERISTIC DoorLckCtl_DoorAjarRRTimValid_C "" VALUE 0x0000 /* @ECU_Address@DoorLckCtl_DoorAjarRRTimValid_C@ */ Scalar_UWORD 0 AppSwcBcm_CM_uint16_10ms 0 65535 /end CHARACTERISTIC
/begin CHARACTERISTIC DoorLckCtl_DriverDoorLckTimInValid_C "" VALUE 0x0000 /* @ECU_Address@DoorLckCtl_DriverDoorLckTimInValid_C@ */ Scalar_UWORD 0 AppSwcBcm_CM_uint16_10ms 0 65535 /end CHARACTERISTIC
/begin CHARACTERISTIC DoorLckCtl_DriverDoorLckTimValid_C "" VALUE 0x0000 /* @ECU_Address@DoorLckCtl_DriverDoorLckTimValid_C@ */ Scalar_UWORD 0 AppSwcBcm_CM_uint16_10ms 0 65535 /end CHARACTERISTIC
/begin CHARACTERISTIC DoorLckCtl_DrvPETimInvalid_C "" VALUE 0x0000 /* @ECU_Address@DoorLckCtl_DrvPETimInvalid_C@ */ Scalar_UWORD 0 AppSwcBcm_CM_uint16 0 65535 /end CHARACTERISTIC
/begin CHARACTERISTIC DoorLckCtl_DrvPETimValid_C "" VALUE 0x0000 /* @ECU_Address@DoorLckCtl_DrvPETimValid_C@ */ Scalar_UWORD 0 AppSwcBcm_CM_uint16_10ms 0 65535 /end CHARACTERISTIC
/begin CHARACTERISTIC DoorLckCtl_DrvSeatResisMin_C "" VALUE 0x0000 /* @ECU_Address@DoorLckCtl_DrvSeatResisMin_C@ */ Scalar_UWORD 0 AppSwcBcm_CM_uint16__Ohm 0 65535 /end CHARACTERISTIC
/begin CHARACTERISTIC DoorLckCtl_DrvSeatResisVal_C "" VALUE 0x0000 /* @ECU_Address@DoorLckCtl_DrvSeatResisVal_C@ */ Scalar_UWORD 0 AppSwcBcm_CM_uint16__Ohm 0 65535 /end CHARACTERISTIC
/begin CHARACTERISTIC DoorLckCtl_DrvSeatTimInValid_C "" VALUE 0x0000 /* @ECU_Address@DoorLckCtl_DrvSeatTimInValid_C@ */ Scalar_UWORD 0 AppSwcBcm_CM_uint16_10ms 0 65535 /end CHARACTERISTIC
/begin CHARACTERISTIC DoorLckCtl_DrvSeatTimValid_C "" VALUE 0x0000 /* @ECU_Address@DoorLckCtl_DrvSeatTimValid_C@ */ Scalar_UWORD 0 AppSwcBcm_CM_uint16_10ms 0 65535 /end CHARACTERISTIC
/begin CHARACTERISTIC DoorLckCtl_DrvTim_C "" VALUE 0x0000 /* @ECU_Address@DoorLckCtl_DrvTim_C@ */ Scalar_UWORD 0 AppSwcBcm_CM_uint16_Msec 0 65535 /end CHARACTERISTIC
/begin CHARACTERISTIC DoorLckCtl_InportCalSwBit_C "" VALUE 0x0000 /* @ECU_Address@DoorLckCtl_InportCalSwBit_C@ */ Scalar_UWORD 0 AppSwcBcm_CM_uint16 0 65535 /end CHARACTERISTIC
/begin CHARACTERISTIC DoorLckCtl_MotorProtTimMax_C "" VALUE 0x0000 /* @ECU_Address@DoorLckCtl_MotorProtTimMax_C@ */ Scalar_UWORD 0 AppSwcBcm_CM_uint16_50ms 0 65535 /end CHARACTERISTIC
/begin CHARACTERISTIC DoorLckCtl_PEProtCnt_C "" VALUE 0x0000 /* @ECU_Address@DoorLckCtl_PEProtCnt_C@ */ Scalar_UWORD 0 AppSwcBcm_CM_uint16 0 65535 /end CHARACTERISTIC
/begin CHARACTERISTIC DoorLckCtl_PEProtIntvlTim_C "" VALUE 0x0000 /* @ECU_Address@DoorLckCtl_PEProtIntvlTim_C@ */ Scalar_UWORD 0 AppSwcBcm_CM_uint16_50ms 0 65535 /end CHARACTERISTIC
/begin CHARACTERISTIC DoorLckCtl_PsgPETimInvalid_C "" VALUE 0x0000 /* @ECU_Address@DoorLckCtl_PsgPETimInvalid_C@ */ Scalar_UWORD 0 AppSwcBcm_CM_uint16_10ms 0 65535 /end CHARACTERISTIC
/begin CHARACTERISTIC DoorLckCtl_PsgPETimValid_C "" VALUE 0x0000 /* @ECU_Address@DoorLckCtl_PsgPETimValid_C@ */ Scalar_UWORD 0 AppSwcBcm_CM_uint16_10ms 0 65535 /end CHARACTERISTIC
/begin CHARACTERISTIC DoorLckCtl_SpdLckTimInValid_C "" VALUE 0x0000 /* @ECU_Address@DoorLckCtl_SpdLckTimInValid_C@ */ Scalar_UWORD 0 AppSwcBcm_CM_uint16_10ms 0 65535 /end CHARACTERISTIC
/begin CHARACTERISTIC DoorLckCtl_SpdLckTimValid_C "" VALUE 0x0000 /* @ECU_Address@DoorLckCtl_SpdLckTimValid_C@ */ Scalar_UWORD 0 AppSwcBcm_CM_uint16_10ms 0 65535 /end CHARACTERISTIC
/begin CHARACTERISTIC DoorLckCtl_TrunkAjarTimInvalid_C "" VALUE 0x0000 /* @ECU_Address@DoorLckCtl_TrunkAjarTimInvalid_C@ */ Scalar_UWORD 0 AppSwcBcm_CM_uint16_10ms 0 65535 /end CHARACTERISTIC
/begin CHARACTERISTIC DoorLckCtl_TrunkAjarTimValid_C "" VALUE 0x0000 /* @ECU_Address@DoorLckCtl_TrunkAjarTimValid_C@ */ Scalar_UWORD 0 AppSwcBcm_CM_uint16_10ms 0 65535 /end CHARACTERISTIC
/begin CHARACTERISTIC DoorLckCtl_TrunkAutoLckTim_C "" VALUE 0x0000 /* @ECU_Address@DoorLckCtl_TrunkAutoLckTim_C@ */ Scalar_UWORD 0 AppSwcBcm_CM_uint16_50ms 0 65535 /end CHARACTERISTIC
/begin CHARACTERISTIC DoorLckCtl_TrunkUnlckTimInvalid_C "" VALUE 0x0000 /* @ECU_Address@DoorLckCtl_TrunkUnlckTimInvalid_C@ */ Scalar_UWORD 0 AppSwcBcm_CM_uint16_10ms 0 65535 /end CHARACTERISTIC
/begin CHARACTERISTIC DoorLckCtl_TrunkUnlckTimValid_C "" VALUE 0x0000 /* @ECU_Address@DoorLckCtl_TrunkUnlckTimValid_C@ */ Scalar_UWORD 0 AppSwcBcm_CM_uint16_10ms 0 65535 /end CHARACTERISTIC
/begin CHARACTERISTIC ESCLCtl_LckDelay_C "" VALUE 0x0000 /* @ECU_Address@ESCLCtl_LckDelay_C@ */ Scalar_UWORD 0 AppSwcBcm_CM_uint16_50ms 0 65535 /end CHARACTERISTIC
/begin CHARACTERISTIC ESCLCtl_LckTimMax_C "" VALUE 0x0000 /* @ECU_Address@ESCLCtl_LckTimMax_C@ */ Scalar_UWORD 0 AppSwcBcm_CM_uint16_50ms 0 65535 /end CHARACTERISTIC
/begin CHARACTERISTIC ESCLCtl_UnlckDelay_C "" VALUE 0x0000 /* @ECU_Address@ESCLCtl_UnlckDelay_C@ */ Scalar_UWORD 0 AppSwcBcm_CM_uint16_50ms 0 65535 /end CHARACTERISTIC
/begin CHARACTERISTIC ESCLCtl_UnlckTimMax_C "" VALUE 0x0000 /* @ECU_Address@ESCLCtl_UnlckTimMax_C@ */ Scalar_UWORD 0 AppSwcBcm_CM_uint16_50ms 0 65535 /end CHARACTERISTIC
/begin CHARACTERISTIC HornCtl_HornSwTimInvalid_C "" VALUE 0x0000 /* @ECU_Address@HornCtl_HornSwTimInvalid_C@ */ Scalar_UWORD 0 AppSwcBcm_CM_uint16_10ms 0 65535 /end CHARACTERISTIC
/begin CHARACTERISTIC HornCtl_HornSwTimValid_C "" VALUE 0x0000 /* @ECU_Address@HornCtl_HornSwTimValid_C@ */ Scalar_UWORD 0 AppSwcBcm_CM_uint16 0 65535 /end CHARACTERISTIC
/begin CHARACTERISTIC HornCtl_TrunkWarnTim_C "" VALUE 0x0000 /* @ECU_Address@HornCtl_TrunkWarnTim_C@ */ Scalar_UWORD 0 AppSwcBcm_CM_uint16_20ms 0 65535 /end CHARACTERISTIC
/begin CHARACTERISTIC LampCtl_AutoLampDayDelayTim_C "" VALUE 0x0000 /* @ECU_Address@LampCtl_AutoLampDayDelayTim_C@ */ Scalar_UWORD 0 AppSwcBcm_CM_uint16_10ms 0 65535 /end CHARACTERISTIC
/begin CHARACTERISTIC LampCtl_AutoLampNightDelayTim_C "" VALUE 0x0000 /* @ECU_Address@LampCtl_AutoLampNightDelayTim_C@ */ Scalar_UWORD 0 AppSwcBcm_CM_uint16_10ms 0 65535 /end CHARACTERISTIC
/begin CHARACTERISTIC LampCtl_AutoLampTimInValid_C "" VALUE 0x0000 /* @ECU_Address@LampCtl_AutoLampTimInValid_C@ */ Scalar_UWORD 0 AppSwcBcm_CM_uint16_10ms 0 65535 /end CHARACTERISTIC
/begin CHARACTERISTIC LampCtl_AutoLampTimValid_C "" VALUE 0x0000 /* @ECU_Address@LampCtl_AutoLampTimValid_C@ */ Scalar_UWORD 0 AppSwcBcm_CM_uint16_10ms 0 65535 /end CHARACTERISTIC
/begin CHARACTERISTIC LampCtl_BoxLampOpenTimMax_C "" VALUE 0x0000 /* @ECU_Address@LampCtl_BoxLampOpenTimMax_C@ */ Scalar_UWORD 0 AppSwcBcm_CM_uint16_20ms 0 65535 /end CHARACTERISTIC
/begin CHARACTERISTIC LampCtl_BrakeSwInValid_C "" VALUE 0x0000 /* @ECU_Address@LampCtl_BrakeSwInValid_C@ */ Scalar_UWORD 0 AppSwcBcm_CM_uint16_10ms 0 65535 /end CHARACTERISTIC
/begin CHARACTERISTIC LampCtl_BrakeSwTimValid_C "" VALUE 0x0000 /* @ECU_Address@LampCtl_BrakeSwTimValid_C@ */ Scalar_UWORD 0 AppSwcBcm_CM_uint16_10ms 0 65535 /end CHARACTERISTIC
/begin CHARACTERISTIC LampCtl_DayTimeVal_C "" VALUE 0x0000 /* @ECU_Address@LampCtl_DayTimeVal_C@ */ Scalar_UWORD 0 AppSwcBcm_CM_uint16_mV 0 65535 /end CHARACTERISTIC
/begin CHARACTERISTIC LampCtl_FlwrMeHomeTimValid_C "" VALUE 0x0000 /* @ECU_Address@LampCtl_FlwrMeHomeTimValid_C@ */ Scalar_UWORD 0 AppSwcBcm_CM_uint16_20ms 0 65535 /end CHARACTERISTIC
/begin CHARACTERISTIC LampCtl_FogLampFTimInValid_C "" VALUE 0x0000 /* @ECU_Address@LampCtl_FogLampFTimInValid_C@ */ Scalar_UWORD 0 AppSwcBcm_CM_uint16_10ms 0 65535 /end CHARACTERISTIC
/begin CHARACTERISTIC LampCtl_FogLampFTimValid_C "" VALUE 0x0000 /* @ECU_Address@LampCtl_FogLampFTimValid_C@ */ Scalar_UWORD 0 AppSwcBcm_CM_uint16_10ms 0 65535 /end CHARACTERISTIC
/begin CHARACTERISTIC LampCtl_FogLampRTimInValid_C "" VALUE 0x0000 /* @ECU_Address@LampCtl_FogLampRTimInValid_C@ */ Scalar_UWORD 0 AppSwcBcm_CM_uint16_10ms 0 65535 /end CHARACTERISTIC
/begin CHARACTERISTIC LampCtl_FogLampRTimValid_C "" VALUE 0x0000 /* @ECU_Address@LampCtl_FogLampRTimValid_C@ */ Scalar_UWORD 0 AppSwcBcm_CM_uint16_10ms 0 65535 /end CHARACTERISTIC
/begin CHARACTERISTIC LampCtl_HazardLightTimInValid_C "" VALUE 0x0000 /* @ECU_Address@LampCtl_HazardLightTimInValid_C@ */ Scalar_UWORD 0 AppSwcBcm_CM_uint16_10ms 0 65535 /end CHARACTERISTIC
/begin CHARACTERISTIC LampCtl_HazardLightTimValid_C "" VALUE 0x0000 /* @ECU_Address@LampCtl_HazardLightTimValid_C@ */ Scalar_UWORD 0 AppSwcBcm_CM_uint16_10ms 0 65535 /end CHARACTERISTIC
/begin CHARACTERISTIC LampCtl_HiBeamShortToBatTimInValid_C "" VALUE 0x0000 /* @ECU_Address@LampCtl_HiBeamShortToBatTimInValid_C@ */ Scalar_UWORD 0 AppSwcBcm_CM_uint16_20ms 0 65535 /end CHARACTERISTIC
/begin CHARACTERISTIC LampCtl_HiBeamShortToBatTimValid_C "" VALUE 0x0000 /* @ECU_Address@LampCtl_HiBeamShortToBatTimValid_C@ */ Scalar_UWORD 0 AppSwcBcm_CM_uint16_20ms 0 65535 /end CHARACTERISTIC
/begin CHARACTERISTIC LampCtl_HiBeamTimInValid_C "" VALUE 0x0000 /* @ECU_Address@LampCtl_HiBeamTimInValid_C@ */ Scalar_UWORD 0 AppSwcBcm_CM_uint16_10ms 0 65535 /end CHARACTERISTIC
/begin CHARACTERISTIC LampCtl_HiBeamTimValid_C "" VALUE 0x0000 /* @ECU_Address@LampCtl_HiBeamTimValid_C@ */ Scalar_UWORD 0 AppSwcBcm_CM_uint16_10ms 0 65535 /end CHARACTERISTIC
/begin CHARACTERISTIC LampCtl_InportCalSwBit_C "" VALUE 0x0000 /* @ECU_Address@LampCtl_InportCalSwBit_C@ */ Scalar_UWORD 0 AppSwcBcm_CM_uint16 0 65535 /end CHARACTERISTIC
/begin CHARACTERISTIC LampCtl_LampDelayTim_C "" VALUE 0x0000 /* @ECU_Address@LampCtl_LampDelayTim_C@ */ Scalar_UWORD 0 AppSwcBcm_CM_uint16_20ms 0 65535 /end CHARACTERISTIC
/begin CHARACTERISTIC LampCtl_LowBeamShortToBatTimInValid_C "" VALUE 0x0000 /* @ECU_Address@LampCtl_LowBeamShortToBatTimInValid_C@ */ Scalar_UWORD 0 AppSwcBcm_CM_uint16_20ms 0 65535 /end CHARACTERISTIC
/begin CHARACTERISTIC LampCtl_LowBeamShortToBatTimValid_C "" VALUE 0x0000 /* @ECU_Address@LampCtl_LowBeamShortToBatTimValid_C@ */ Scalar_UWORD 0 AppSwcBcm_CM_uint16_20ms 0 65535 /end CHARACTERISTIC
/begin CHARACTERISTIC LampCtl_LowBeamStaTimInValid_C "" VALUE 0x0000 /* @ECU_Address@LampCtl_LowBeamStaTimInValid_C@ */ Scalar_UWORD 0 AppSwcBcm_CM_uint16_10ms 0 65535 /end CHARACTERISTIC
/begin CHARACTERISTIC LampCtl_LowBeamStaTimValid_C "" VALUE 0x0000 /* @ECU_Address@LampCtl_LowBeamStaTimValid_C@ */ Scalar_UWORD 0 AppSwcBcm_CM_uint16_10ms 0 65535 /end CHARACTERISTIC
/begin CHARACTERISTIC LampCtl_LowBeamTimInValid_C "" VALUE 0x0000 /* @ECU_Address@LampCtl_LowBeamTimInValid_C@ */ Scalar_UWORD 0 AppSwcBcm_CM_uint16_10ms 0 65535 /end CHARACTERISTIC
/begin CHARACTERISTIC LampCtl_LowBeamTimValid_C "" VALUE 0x0000 /* @ECU_Address@LampCtl_LowBeamTimValid_C@ */ Scalar_UWORD 0 AppSwcBcm_CM_uint16_10ms 0 65535 /end CHARACTERISTIC
/begin CHARACTERISTIC LampCtl_NightVal_C "" VALUE 0x0000 /* @ECU_Address@LampCtl_NightVal_C@ */ Scalar_UWORD 0 AppSwcBcm_CM_uint16_mV 0 65535 /end CHARACTERISTIC
/begin CHARACTERISTIC LampCtl_OsUnlckDelayTim_C "" VALUE 0x0000 /* @ECU_Address@LampCtl_OsUnlckDelayTim_C@ */ Scalar_UWORD 0 AppSwcBcm_CM_uint16_10ms 0 65535 /end CHARACTERISTIC
/begin CHARACTERISTIC LampCtl_PassLightTimInValid_C "" VALUE 0x0000 /* @ECU_Address@LampCtl_PassLightTimInValid_C@ */ Scalar_UWORD 0 AppSwcBcm_CM_uint16_10ms 0 65535 /end CHARACTERISTIC
/begin CHARACTERISTIC LampCtl_PassLightTimValid_C "" VALUE 0x0000 /* @ECU_Address@LampCtl_PassLightTimValid_C@ */ Scalar_UWORD 0 AppSwcBcm_CM_uint16_10ms 0 65535 /end CHARACTERISTIC
/begin CHARACTERISTIC LampCtl_PosLampStaTimInValid_C "" VALUE 0x0000 /* @ECU_Address@LampCtl_PosLampStaTimInValid_C@ */ Scalar_UWORD 0 AppSwcBcm_CM_uint16_10ms 0 65535 /end CHARACTERISTIC
/begin CHARACTERISTIC LampCtl_PosLampStaTimValid_C "" VALUE 0x0000 /* @ECU_Address@LampCtl_PosLampStaTimValid_C@ */ Scalar_UWORD 0 AppSwcBcm_CM_uint16_10ms 0 65535 /end CHARACTERISTIC
/begin CHARACTERISTIC LampCtl_PosLampTimInValid_C "" VALUE 0x0000 /* @ECU_Address@LampCtl_PosLampTimInValid_C@ */ Scalar_UWORD 0 AppSwcBcm_CM_uint16_10ms 0 65535 /end CHARACTERISTIC
/begin CHARACTERISTIC LampCtl_PosLampTimValid_C "" VALUE 0x0000 /* @ECU_Address@LampCtl_PosLampTimValid_C@ */ Scalar_UWORD 0 AppSwcBcm_CM_uint16_10ms 0 65535 /end CHARACTERISTIC
/begin CHARACTERISTIC LampCtl_TrunkWarnTim_C "" VALUE 0x0000 /* @ECU_Address@LampCtl_TrunkWarnTim_C@ */ Scalar_UWORD 0 AppSwcBcm_CM_uint16_20ms 0 65535 /end CHARACTERISTIC
/begin CHARACTERISTIC LampCtl_TurnIndcrLOpenTimInValid_C "" VALUE 0x0000 /* @ECU_Address@LampCtl_TurnIndcrLOpenTimInValid_C@ */ Scalar_UWORD 0 AppSwcBcm_CM_uint16_10ms 0 65535 /end CHARACTERISTIC
/begin CHARACTERISTIC LampCtl_TurnIndcrLOpenTimValid_C "" VALUE 0x0000 /* @ECU_Address@LampCtl_TurnIndcrLOpenTimValid_C@ */ Scalar_UWORD 0 AppSwcBcm_CM_uint16_10ms 0 65535 /end CHARACTERISTIC
/begin CHARACTERISTIC LampCtl_TurnIndcrLShortTimInValid_C "" VALUE 0x0000 /* @ECU_Address@LampCtl_TurnIndcrLShortTimInValid_C@ */ Scalar_UWORD 0 AppSwcBcm_CM_uint16_10ms 0 65535 /end CHARACTERISTIC
/begin CHARACTERISTIC LampCtl_TurnIndcrLShortTimValid_C "" VALUE 0x0000 /* @ECU_Address@LampCtl_TurnIndcrLShortTimValid_C@ */ Scalar_UWORD 0 AppSwcBcm_CM_uint16_10ms 0 65535 /end CHARACTERISTIC
/begin CHARACTERISTIC LampCtl_TurnIndcrLTimInValid_C "" VALUE 0x0000 /* @ECU_Address@LampCtl_TurnIndcrLTimInValid_C@ */ Scalar_UWORD 0 AppSwcBcm_CM_uint16_10ms 0 65535 /end CHARACTERISTIC
/begin CHARACTERISTIC LampCtl_TurnIndcrLTimValid_C "" VALUE 0x0000 /* @ECU_Address@LampCtl_TurnIndcrLTimValid_C@ */ Scalar_UWORD 0 AppSwcBcm_CM_uint16_10ms 0 65535 /end CHARACTERISTIC
/begin CHARACTERISTIC LampCtl_TurnIndcrLaneLTimInValid_C "" VALUE 0x0000 /* @ECU_Address@LampCtl_TurnIndcrLaneLTimInValid_C@ */ Scalar_UWORD 0 AppSwcBcm_CM_uint16_10ms 0 65535 /end CHARACTERISTIC
/begin CHARACTERISTIC LampCtl_TurnIndcrLaneLTimValid_C "" VALUE 0x0000 /* @ECU_Address@LampCtl_TurnIndcrLaneLTimValid_C@ */ Scalar_UWORD 0 AppSwcBcm_CM_uint16_10ms 0 65535 /end CHARACTERISTIC
/begin CHARACTERISTIC LampCtl_TurnIndcrLaneRTimInValid_C "" VALUE 0x0000 /* @ECU_Address@LampCtl_TurnIndcrLaneRTimInValid_C@ */ Scalar_UWORD 0 AppSwcBcm_CM_uint16_10ms 0 65535 /end CHARACTERISTIC
/begin CHARACTERISTIC LampCtl_TurnIndcrLaneRTimValid_C "" VALUE 0x0000 /* @ECU_Address@LampCtl_TurnIndcrLaneRTimValid_C@ */ Scalar_UWORD 0 AppSwcBcm_CM_uint16_10ms 0 65535 /end CHARACTERISTIC
/begin CHARACTERISTIC LampCtl_TurnIndcrOpenCur_C "" VALUE 0x0000 /* @ECU_Address@LampCtl_TurnIndcrOpenCur_C@ */ Scalar_UWORD 0 AppSwcBcm_CM_uint16_mA 0 65535 /end CHARACTERISTIC
/begin CHARACTERISTIC LampCtl_TurnIndcrROpenTimInValid_C "" VALUE 0x0000 /* @ECU_Address@LampCtl_TurnIndcrROpenTimInValid_C@ */ Scalar_UWORD 0 AppSwcBcm_CM_uint16_10ms 0 65535 /end CHARACTERISTIC
/begin CHARACTERISTIC LampCtl_TurnIndcrROpenTimValid_C "" VALUE 0x0000 /* @ECU_Address@LampCtl_TurnIndcrROpenTimValid_C@ */ Scalar_UWORD 0 AppSwcBcm_CM_uint16_10ms 0 65535 /end CHARACTERISTIC
/begin CHARACTERISTIC LampCtl_TurnIndcrRShortTimInValid_C "" VALUE 0x0000 /* @ECU_Address@LampCtl_TurnIndcrRShortTimInValid_C@ */ Scalar_UWORD 0 AppSwcBcm_CM_uint16_10ms 0 65535 /end CHARACTERISTIC
/begin CHARACTERISTIC LampCtl_TurnIndcrRShortTimValid_C "" VALUE 0x0000 /* @ECU_Address@LampCtl_TurnIndcrRShortTimValid_C@ */ Scalar_UWORD 0 AppSwcBcm_CM_uint16_10ms 0 65535 /end CHARACTERISTIC
/begin CHARACTERISTIC LampCtl_TurnIndcrRTimInValid_C "" VALUE 0x0000 /* @ECU_Address@LampCtl_TurnIndcrRTimInValid_C@ */ Scalar_UWORD 0 AppSwcBcm_CM_uint16_10ms 0 65535 /end CHARACTERISTIC
/begin CHARACTERISTIC LampCtl_TurnIndcrRTimValid_C "" VALUE 0x0000 /* @ECU_Address@LampCtl_TurnIndcrRTimValid_C@ */ Scalar_UWORD 0 AppSwcBcm_CM_uint16_10ms 0 65535 /end CHARACTERISTIC
/begin CHARACTERISTIC LampCtl_TurnIndcrShortCur_C "" VALUE 0x0000 /* @ECU_Address@LampCtl_TurnIndcrShortCur_C@ */ Scalar_UWORD 0 AppSwcBcm_CM_uint16_mA 0 65535 /end CHARACTERISTIC
/begin CHARACTERISTIC LampCtl_WelcomeLampTimMax_C "" VALUE 0x0000 /* @ECU_Address@LampCtl_WelcomeLampTimMax_C@ */ Scalar_UWORD 0 AppSwcBcm_CM_uint16_20ms 0 65535 /end CHARACTERISTIC
/begin CHARACTERISTIC PDUCtl_OpenDoorPwrOnTimValid "" VALUE 0x0000 /* @ECU_Address@PDUCtl_OpenDoorPwrOnTimValid@ */ Scalar_UWORD 0 AppSwcBcm_CM_uint16_50ms 0 65535 /end CHARACTERISTIC
/begin CHARACTERISTIC PDUCtl_PwrOnPSTimValid_C "" VALUE 0x0000 /* @ECU_Address@PDUCtl_PwrOnPSTimValid_C@ */ Scalar_UWORD 0 AppSwcBcm_CM_uint16_50ms 0 65535 /end CHARACTERISTIC
/begin CHARACTERISTIC PDUCtl_StartReqOverTimValid_C "" VALUE 0x0000 /* @ECU_Address@PDUCtl_StartReqOverTimValid_C@ */ Scalar_UWORD 0 AppSwcBcm_CM_uint16_50ms 0 65535 /end CHARACTERISTIC
/begin CHARACTERISTIC PDUCtl_StartReqTimValid_C "" VALUE 0x0000 /* @ECU_Address@PDUCtl_StartReqTimValid_C@ */ Scalar_UWORD 0 AppSwcBcm_CM_uint16_50ms 0 65535 /end CHARACTERISTIC
/begin CHARACTERISTIC WakeUpCtl_CANSleepDelayTim_C "" VALUE 0x0000 /* @ECU_Address@WakeUpCtl_CANSleepDelayTim_C@ */ Scalar_UWORD 0 AppSwcBcm_CM_uint16_50ms 0 65535 /end CHARACTERISTIC
/begin CHARACTERISTIC WakeUpCtl_LocalSleepDelayTim_C "" VALUE 0x0000 /* @ECU_Address@WakeUpCtl_LocalSleepDelayTim_C@ */ Scalar_UWORD 0 AppSwcBcm_CM_uint16_50ms 0 65535 /end CHARACTERISTIC
/begin CHARACTERISTIC WinCtl_DrvPsgWinAutoDnMaxResis_C "" VALUE 0x0000 /* @ECU_Address@WinCtl_DrvPsgWinAutoDnMaxResis_C@ */ Scalar_UWORD 0 AppSwcBcm_CM_uint16_10ms 0 65535 /end CHARACTERISTIC
/begin CHARACTERISTIC WinCtl_DrvPsgWinAutoDnMinResis_C "" VALUE 0x0000 /* @ECU_Address@WinCtl_DrvPsgWinAutoDnMinResis_C@ */ Scalar_UWORD 0 AppSwcBcm_CM_uint16_Ohm 0 65535 /end CHARACTERISTIC
/begin CHARACTERISTIC WinCtl_DrvPsgWinAutoDnTimInValid_C "" VALUE 0x0000 /* @ECU_Address@WinCtl_DrvPsgWinAutoDnTimInValid_C@ */ Scalar_UWORD 0 AppSwcBcm_CM_uint16_10ms 0 65535 /end CHARACTERISTIC
/begin CHARACTERISTIC WinCtl_DrvPsgWinAutoDnTimValid_C "" VALUE 0x0000 /* @ECU_Address@WinCtl_DrvPsgWinAutoDnTimValid_C@ */ Scalar_UWORD 0 AppSwcBcm_CM_uint16_10ms 0 65535 /end CHARACTERISTIC
/begin CHARACTERISTIC WinCtl_DrvPsgWinDnMaxResis_C "" VALUE 0x0000 /* @ECU_Address@WinCtl_DrvPsgWinDnMaxResis_C@ */ Scalar_UWORD 0 AppSwcBcm_CM_uint16_Ohm 0 65535 /end CHARACTERISTIC
/begin CHARACTERISTIC WinCtl_DrvPsgWinDnMinResis_C "" VALUE 0x0000 /* @ECU_Address@WinCtl_DrvPsgWinDnMinResis_C@ */ Scalar_UWORD 0 AppSwcBcm_CM_uint16_Ohm 0 65535 /end CHARACTERISTIC
/begin CHARACTERISTIC WinCtl_DrvPsgWinDnTimInValid_C "" VALUE 0x0000 /* @ECU_Address@WinCtl_DrvPsgWinDnTimInValid_C@ */ Scalar_UWORD 0 AppSwcBcm_CM_uint16_10ms 0 65535 /end CHARACTERISTIC
/begin CHARACTERISTIC WinCtl_DrvPsgWinDnTimValid_C "" VALUE 0x0000 /* @ECU_Address@WinCtl_DrvPsgWinDnTimValid_C@ */ Scalar_UWORD 0 AppSwcBcm_CM_uint16_10ms 0 65535 /end CHARACTERISTIC
/begin CHARACTERISTIC WinCtl_DrvPsgWinSwResis_C "" VALUE 0x0000 /* @ECU_Address@WinCtl_DrvPsgWinSwResis_C@ */ Scalar_UWORD 0 AppSwcBcm_CM_uint16_Ohm 0 65535 /end CHARACTERISTIC
/begin CHARACTERISTIC WinCtl_DrvPsgWinUpMaxResis_C "" VALUE 0x0000 /* @ECU_Address@WinCtl_DrvPsgWinUpMaxResis_C@ */ Scalar_UWORD 0 AppSwcBcm_CM_uint16 0 65535 /end CHARACTERISTIC
/begin CHARACTERISTIC WinCtl_DrvPsgWinUpMinResis_C "" VALUE 0x0000 /* @ECU_Address@WinCtl_DrvPsgWinUpMinResis_C@ */ Scalar_UWORD 0 AppSwcBcm_CM_uint16_10ms 0 65535 /end CHARACTERISTIC
/begin CHARACTERISTIC WinCtl_DrvPsgWinUpTimInValid_C "" VALUE 0x0000 /* @ECU_Address@WinCtl_DrvPsgWinUpTimInValid_C@ */ Scalar_UWORD 0 AppSwcBcm_CM_uint16_10ms 0 65535 /end CHARACTERISTIC
/begin CHARACTERISTIC WinCtl_DrvPsgWinUpTimValid_C "" VALUE 0x0000 /* @ECU_Address@WinCtl_DrvPsgWinUpTimValid_C@ */ Scalar_UWORD 0 AppSwcBcm_CM_uint16_10ms 0 65535 /end CHARACTERISTIC
/begin CHARACTERISTIC WinCtl_DrvWinAutoDnMaxResis_C "" VALUE 0x0000 /* @ECU_Address@WinCtl_DrvWinAutoDnMaxResis_C@ */ Scalar_UWORD 0 AppSwcBcm_CM_uint16_Ohm 0 65535 /end CHARACTERISTIC
/begin CHARACTERISTIC WinCtl_DrvWinAutoDnMinResis_C "" VALUE 0x0000 /* @ECU_Address@WinCtl_DrvWinAutoDnMinResis_C@ */ Scalar_UWORD 0 AppSwcBcm_CM_uint16_Ohm 0 65535 /end CHARACTERISTIC
/begin CHARACTERISTIC WinCtl_DrvWinAutoDnTimInValid_C "" VALUE 0x0000 /* @ECU_Address@WinCtl_DrvWinAutoDnTimInValid_C@ */ Scalar_UWORD 0 AppSwcBcm_CM_uint16_10ms 0 65535 /end CHARACTERISTIC
/begin CHARACTERISTIC WinCtl_DrvWinAutoDnTimValid_C "" VALUE 0x0000 /* @ECU_Address@WinCtl_DrvWinAutoDnTimValid_C@ */ Scalar_UWORD 0 AppSwcBcm_CM_uint16_10ms 0 65535 /end CHARACTERISTIC
/begin CHARACTERISTIC WinCtl_DrvWinDnMaxResis_C "" VALUE 0x0000 /* @ECU_Address@WinCtl_DrvWinDnMaxResis_C@ */ Scalar_UWORD 0 AppSwcBcm_CM_uint16_Ohm 0 65535 /end CHARACTERISTIC
/begin CHARACTERISTIC WinCtl_DrvWinDnMinResis_C "" VALUE 0x0000 /* @ECU_Address@WinCtl_DrvWinDnMinResis_C@ */ Scalar_UWORD 0 AppSwcBcm_CM_uint16_Ohm 0 65535 /end CHARACTERISTIC
/begin CHARACTERISTIC WinCtl_DrvWinDnTimInValid_C "" VALUE 0x0000 /* @ECU_Address@WinCtl_DrvWinDnTimInValid_C@ */ Scalar_UWORD 0 AppSwcBcm_CM_uint16_10ms 0 65535 /end CHARACTERISTIC
/begin CHARACTERISTIC WinCtl_DrvWinDnTimValid_C "" VALUE 0x0000 /* @ECU_Address@WinCtl_DrvWinDnTimValid_C@ */ Scalar_UWORD 0 AppSwcBcm_CM_uint16_10ms 0 65535 /end CHARACTERISTIC
/begin CHARACTERISTIC WinCtl_DrvWinSwResis_C "" VALUE 0x0000 /* @ECU_Address@WinCtl_DrvWinSwResis_C@ */ Scalar_UWORD 0 AppSwcBcm_CM_uint16_Ohm 0 65535 /end CHARACTERISTIC
/begin CHARACTERISTIC WinCtl_DrvWinUpMaxResis_C "" VALUE 0x0000 /* @ECU_Address@WinCtl_DrvWinUpMaxResis_C@ */ Scalar_UWORD 0 AppSwcBcm_CM_uint16_Ohm 0 65535 /end CHARACTERISTIC
/begin CHARACTERISTIC WinCtl_DrvWinUpMinResis_C "" VALUE 0x0000 /* @ECU_Address@WinCtl_DrvWinUpMinResis_C@ */ Scalar_UWORD 0 AppSwcBcm_CM_uint16_Ohm 0 65535 /end CHARACTERISTIC
/begin CHARACTERISTIC WinCtl_DrvWinUpTimInValid_C "" VALUE 0x0000 /* @ECU_Address@WinCtl_DrvWinUpTimInValid_C@ */ Scalar_UWORD 0 AppSwcBcm_CM_uint16_10ms 0 65535 /end CHARACTERISTIC
/begin CHARACTERISTIC WinCtl_DrvWinUpTimValid_C "" VALUE 0x0000 /* @ECU_Address@WinCtl_DrvWinUpTimValid_C@ */ Scalar_UWORD 0 AppSwcBcm_CM_uint16_10ms 0 65535 /end CHARACTERISTIC
/begin CHARACTERISTIC WinCtl_InportCalSwBit_C "" VALUE 0x0000 /* @ECU_Address@WinCtl_InportCalSwBit_C@ */ Scalar_UWORD 0 AppSwcBcm_CM_uint16_Bit 0 65535 /end CHARACTERISTIC
/begin CHARACTERISTIC WinCtl_PsgWinAutoDnMaxResis_C "" VALUE 0x0000 /* @ECU_Address@WinCtl_PsgWinAutoDnMaxResis_C@ */ Scalar_UWORD 0 AppSwcBcm_CM_uint16_10ms 0 65535 /end CHARACTERISTIC
/begin CHARACTERISTIC WinCtl_PsgWinAutoDnMinResis_C "" VALUE 0x0000 /* @ECU_Address@WinCtl_PsgWinAutoDnMinResis_C@ */ Scalar_UWORD 0 AppSwcBcm_CM_uint16 0 65535 /end CHARACTERISTIC
/begin CHARACTERISTIC WinCtl_PsgWinAutoDnTimInValid_C "" VALUE 0x0000 /* @ECU_Address@WinCtl_PsgWinAutoDnTimInValid_C@ */ Scalar_UWORD 0 AppSwcBcm_CM_uint16_10ms 0 65535 /end CHARACTERISTIC
/begin CHARACTERISTIC WinCtl_PsgWinAutoDnTimValid_C "" VALUE 0x0000 /* @ECU_Address@WinCtl_PsgWinAutoDnTimValid_C@ */ Scalar_UWORD 0 AppSwcBcm_CM_uint16_10ms 0 65535 /end CHARACTERISTIC
/begin CHARACTERISTIC WinCtl_PsgWinDnMaxResis_C "" VALUE 0x0000 /* @ECU_Address@WinCtl_PsgWinDnMaxResis_C@ */ Scalar_UWORD 0 AppSwcBcm_CM_uint16_Ohm 0 65535 /end CHARACTERISTIC
/begin CHARACTERISTIC WinCtl_PsgWinDnMinResis_C "" VALUE 0x0000 /* @ECU_Address@WinCtl_PsgWinDnMinResis_C@ */ Scalar_UWORD 0 AppSwcBcm_CM_uint16_10ms 0 65535 /end CHARACTERISTIC
/begin CHARACTERISTIC WinCtl_PsgWinDnTimInValid_C "" VALUE 0x0000 /* @ECU_Address@WinCtl_PsgWinDnTimInValid_C@ */ Scalar_UWORD 0 AppSwcBcm_CM_uint16_10ms 0 65535 /end CHARACTERISTIC
/begin CHARACTERISTIC WinCtl_PsgWinDnTimValid_C "" VALUE 0x0000 /* @ECU_Address@WinCtl_PsgWinDnTimValid_C@ */ Scalar_UWORD 0 AppSwcBcm_CM_uint16_10ms 0 65535 /end CHARACTERISTIC
/begin CHARACTERISTIC WinCtl_PsgWinSwResis_C "" VALUE 0x0000 /* @ECU_Address@WinCtl_PsgWinSwResis_C@ */ Scalar_UWORD 0 AppSwcBcm_CM_uint16_Ohm 0 65535 /end CHARACTERISTIC
/begin CHARACTERISTIC WinCtl_PsgWinUpMaxResis_C "" VALUE 0x0000 /* @ECU_Address@WinCtl_PsgWinUpMaxResis_C@ */ Scalar_UWORD 0 AppSwcBcm_CM_uint16_Ohm 0 65535 /end CHARACTERISTIC
/begin CHARACTERISTIC WinCtl_PsgWinUpMinResis_C "" VALUE 0x0000 /* @ECU_Address@WinCtl_PsgWinUpMinResis_C@ */ Scalar_UWORD 0 AppSwcBcm_CM_uint16_Ohm 0 65535 /end CHARACTERISTIC
/begin CHARACTERISTIC WinCtl_PsgWinUpTimInValid_C "" VALUE 0x0000 /* @ECU_Address@WinCtl_PsgWinUpTimInValid_C@ */ Scalar_UWORD 0 AppSwcBcm_CM_uint16_10ms 0 65535 /end CHARACTERISTIC
/begin CHARACTERISTIC WinCtl_PsgWinUpTimValid_C "" VALUE 0x0000 /* @ECU_Address@WinCtl_PsgWinUpTimValid_C@ */ Scalar_UWORD 0 AppSwcBcm_CM_uint16_10ms 0 65535 /end CHARACTERISTIC
/begin CHARACTERISTIC WinCtl_PwrOffWinValidTimMax_C "" VALUE 0x0000 /* @ECU_Address@WinCtl_PwrOffWinValidTimMax_C@ */ Scalar_UWORD 0 AppSwcBcm_CM_uint16_100ms 0 65535 /end CHARACTERISTIC
/begin CHARACTERISTIC WinCtl_WinMotorCurMax_C "" VALUE 0x0000 /* @ECU_Address@WinCtl_WinMotorCurMax_C@ */ Scalar_UWORD 0 AppSwcBcm_CM_uint16_mA 0 65535 /end CHARACTERISTIC
/begin CHARACTERISTIC WinCtl_WinMotorCurTimInValid_C "" VALUE 0x0000 /* @ECU_Address@WinCtl_WinMotorCurTimInValid_C@ */ Scalar_UWORD 0 AppSwcBcm_CM_uint16_10ms 0 65535 /end CHARACTERISTIC
/begin CHARACTERISTIC WinCtl_WinMotorCurTimValid_C "" VALUE 0x0000 /* @ECU_Address@WinCtl_WinMotorCurTimValid_C@ */ Scalar_UWORD 0 AppSwcBcm_CM_uint16_10ms 0 65535 /end CHARACTERISTIC
/begin CHARACTERISTIC WinCtl_WinProtNum_C "" VALUE 0x0000 /* @ECU_Address@WinCtl_WinProtNum_C@ */ Scalar_UWORD 0 AppSwcBcm_CM_uint16 0 65535 /end CHARACTERISTIC
/begin CHARACTERISTIC WinCtl_WinProtTim_C "" VALUE 0x0000 /* @ECU_Address@WinCtl_WinProtTim_C@ */ Scalar_UWORD 0 AppSwcBcm_CM_uint16_10ms 0 65535 /end CHARACTERISTIC
/begin CHARACTERISTIC WinCtl_WinRunTimMax_C "" VALUE 0x0000 /* @ECU_Address@WinCtl_WinRunTimMax_C@ */ Scalar_UWORD 0 AppSwcBcm_CM_uint16_100ms 0 65535 /end CHARACTERISTIC
/begin CHARACTERISTIC WiperCtl_HiSpdTimInValid_C "" VALUE 0x0000 /* @ECU_Address@WiperCtl_HiSpdTimInValid_C@ */ Scalar_UWORD 0 AppSwcBcm_CM_uint16_10ms 0 65535 /end CHARACTERISTIC
/begin CHARACTERISTIC WiperCtl_HiSpdTimValid_C "" VALUE 0x0000 /* @ECU_Address@WiperCtl_HiSpdTimValid_C@ */ Scalar_UWORD 0 AppSwcBcm_CM_uint16_10ms 0 65535 /end CHARACTERISTIC
/begin CHARACTERISTIC WiperCtl_InportCalSwBit_C "" VALUE 0x0000 /* @ECU_Address@WiperCtl_InportCalSwBit_C@ */ Scalar_UWORD 0 AppSwcBcm_CM_uint16_Bit 0 65535 /end CHARACTERISTIC
/begin CHARACTERISTIC WiperCtl_InrLvl1Tim_C "" VALUE 0x0000 /* @ECU_Address@WiperCtl_InrLvl1Tim_C@ */ Scalar_UWORD 0 AppSwcBcm_CM_uint16_20ms 0 65535 /end CHARACTERISTIC
/begin CHARACTERISTIC WiperCtl_InrLvl2Tim_C "" VALUE 0x0000 /* @ECU_Address@WiperCtl_InrLvl2Tim_C@ */ Scalar_UWORD 0 AppSwcBcm_CM_uint16_20ms 0 65535 /end CHARACTERISTIC
/begin CHARACTERISTIC WiperCtl_InrLvl3Tim_C "" VALUE 0x0000 /* @ECU_Address@WiperCtl_InrLvl3Tim_C@ */ Scalar_UWORD 0 AppSwcBcm_CM_uint16_20ms 0 65535 /end CHARACTERISTIC
/begin CHARACTERISTIC WiperCtl_InrLvl4Tim_C "" VALUE 0x0000 /* @ECU_Address@WiperCtl_InrLvl4Tim_C@ */ Scalar_UWORD 0 AppSwcBcm_CM_uint16_20ms 0 65535 /end CHARACTERISTIC
/begin CHARACTERISTIC WiperCtl_InrLvl5Tim_C "" VALUE 0x0000 /* @ECU_Address@WiperCtl_InrLvl5Tim_C@ */ Scalar_UWORD 0 AppSwcBcm_CM_uint16_20ms 0 65535 /end CHARACTERISTIC
/begin CHARACTERISTIC WiperCtl_InrLvl6Tim_C "" VALUE 0x0000 /* @ECU_Address@WiperCtl_InrLvl6Tim_C@ */ Scalar_UWORD 0 AppSwcBcm_CM_uint16_10ms 0 65535 /end CHARACTERISTIC
/begin CHARACTERISTIC WiperCtl_InrLvl7Tim_C "" VALUE 0x0000 /* @ECU_Address@WiperCtl_InrLvl7Tim_C@ */ Scalar_UWORD 0 AppSwcBcm_CM_uint16_10ms 0 65535 /end CHARACTERISTIC
/begin CHARACTERISTIC WiperCtl_InrTimInValid_C "" VALUE 0x0000 /* @ECU_Address@WiperCtl_InrTimInValid_C@ */ Scalar_UWORD 0 AppSwcBcm_CM_uint16_10ms 0 65535 /end CHARACTERISTIC
/begin CHARACTERISTIC WiperCtl_InrTimValid_C "" VALUE 0x0000 /* @ECU_Address@WiperCtl_InrTimValid_C@ */ Scalar_UWORD 0 AppSwcBcm_CM_uint16_10ms 0 65535 /end CHARACTERISTIC
/begin CHARACTERISTIC WiperCtl_LockedRotorTimDef_C "" VALUE 0x0000 /* @ECU_Address@WiperCtl_LockedRotorTimDef_C@ */ Scalar_UWORD 0 AppSwcBcm_CM_uint16_20ms 0 65535 /end CHARACTERISTIC
/begin CHARACTERISTIC WiperCtl_LockedRotorTimOk_C "" VALUE 0x0000 /* @ECU_Address@WiperCtl_LockedRotorTimOk_C@ */ Scalar_UWORD 0 AppSwcBcm_CM_uint16_20ms 0 65535 /end CHARACTERISTIC
/begin CHARACTERISTIC WiperCtl_LockedRotorTimParkDef_C "" VALUE 0x0000 /* @ECU_Address@WiperCtl_LockedRotorTimParkDef_C@ */ Scalar_UWORD 0 AppSwcBcm_CM_uint16_20ms 0 65535 /end CHARACTERISTIC
/begin CHARACTERISTIC WiperCtl_LockedRotorTimParkOk_C "" VALUE 0x0000 /* @ECU_Address@WiperCtl_LockedRotorTimParkOk_C@ */ Scalar_UWORD 0 AppSwcBcm_CM_uint16_20ms 0 65535 /end CHARACTERISTIC
/begin CHARACTERISTIC WiperCtl_LowSpdTimInValid_C "" VALUE 0x0000 /* @ECU_Address@WiperCtl_LowSpdTimInValid_C@ */ Scalar_UWORD 0 AppSwcBcm_CM_uint16_10ms 0 65535 /end CHARACTERISTIC
/begin CHARACTERISTIC WiperCtl_LowSpdTimValid_C "" VALUE 0x0000 /* @ECU_Address@WiperCtl_LowSpdTimValid_C@ */ Scalar_UWORD 0 AppSwcBcm_CM_uint16_10ms 0 65535 /end CHARACTERISTIC
/begin CHARACTERISTIC WiperCtl_MaintWiperRunTim_C "" VALUE 0x0000 /* @ECU_Address@WiperCtl_MaintWiperRunTim_C@ */ Scalar_UWORD 0 AppSwcBcm_CM_uint16_20ms 0 65535 /end CHARACTERISTIC
/begin CHARACTERISTIC WiperCtl_MistTimInValid_C "" VALUE 0x0000 /* @ECU_Address@WiperCtl_MistTimInValid_C@ */ Scalar_UWORD 0 AppSwcBcm_CM_uint16_Ohm 0 65535 /end CHARACTERISTIC
/begin CHARACTERISTIC WiperCtl_MistTimValid_C "" VALUE 0x0000 /* @ECU_Address@WiperCtl_MistTimValid_C@ */ Scalar_UWORD 0 AppSwcBcm_CM_uint16_10ms 0 65535 /end CHARACTERISTIC
/begin CHARACTERISTIC WiperCtl_OffTimInValid_C "" VALUE 0x0000 /* @ECU_Address@WiperCtl_OffTimInValid_C@ */ Scalar_UWORD 0 AppSwcBcm_CM_uint16_10ms 0 65535 /end CHARACTERISTIC
/begin CHARACTERISTIC WiperCtl_OffTimValid_C "" VALUE 0x0000 /* @ECU_Address@WiperCtl_OffTimValid_C@ */ Scalar_UWORD 0 AppSwcBcm_CM_uint16_10ms 0 65535 /end CHARACTERISTIC
/begin CHARACTERISTIC WiperCtl_WashAfterTim_C "" VALUE 0x0000 /* @ECU_Address@WiperCtl_WashAfterTim_C@ */ Scalar_UWORD 0 AppSwcBcm_CM_uint16_20ms 0 65535 /end CHARACTERISTIC
/begin CHARACTERISTIC WiperCtl_WashMaxTim_C "" VALUE 0x0000 /* @ECU_Address@WiperCtl_WashMaxTim_C@ */ Scalar_UWORD 0 AppSwcBcm_CM_uint16_20ms 0 65535 /end CHARACTERISTIC
/begin CHARACTERISTIC WiperCtl_WashMinTim_C "" VALUE 0x0000 /* @ECU_Address@WiperCtl_WashMinTim_C@ */ Scalar_UWORD 0 AppSwcBcm_CM_uint16_10ms 0 65535 /end CHARACTERISTIC
/begin CHARACTERISTIC WiperCtl_WashTimInValid_C "" VALUE 0x0000 /* @ECU_Address@WiperCtl_WashTimInValid_C@ */ Scalar_UWORD 0 AppSwcBcm_CM_uint16_10ms 0 65535 /end CHARACTERISTIC
/begin CHARACTERISTIC WiperCtl_WashTimValid_C "" VALUE 0x0000 /* @ECU_Address@WiperCtl_WashTimValid_C@ */ Scalar_UWORD 0 AppSwcBcm_CM_uint16_10ms 0 65535 /end CHARACTERISTIC
/begin CHARACTERISTIC WiperCtl_WiperParkPosTimValid_C "" VALUE 0x0000 /* @ECU_Address@WiperCtl_WiperParkPosTimValid_C@ */ Scalar_UWORD 0 AppSwcBcm_CM_uint16_10ms 0 65535 /end CHARACTERISTIC
/begin CHARACTERISTIC WiperCtl_WiperPosTimInValid_C "" VALUE 0x0000 /* @ECU_Address@WiperCtl_WiperPosTimInValid_C@ */ Scalar_UWORD 0 AppSwcBcm_CM_uint16_10ms 0 65535 /end CHARACTERISTIC
/begin CHARACTERISTIC BatSaveCtl_J64SavePwrOvrdFlg_C "" VALUE 0x0000 /* @ECU_Address@BatSaveCtl_J64SavePwrOvrdFlg_C@ */ Scalar_BOOLEAN 0 AppSwcBcm_CM_boolean 0 1 /end CHARACTERISTIC
/begin CHARACTERISTIC BatSaveCtl_J64SavePwrOvrdVal_C "" VALUE 0x0000 /* @ECU_Address@BatSaveCtl_J64SavePwrOvrdVal_C@ */ Scalar_BOOLEAN 0 AppSwcBcm_CM_boolean 0 1 /end CHARACTERISTIC
/begin CHARACTERISTIC DoorLckCtl_DoorAjarFLVal_C "" VALUE 0x0000 /* @ECU_Address@DoorLckCtl_DoorAjarFLVal_C@ */ Scalar_BOOLEAN 0 AppSwcBcm_CM_boolean 0 1 /end CHARACTERISTIC
/begin CHARACTERISTIC DoorLckCtl_DoorAjarFRVal_C "" VALUE 0x0000 /* @ECU_Address@DoorLckCtl_DoorAjarFRVal_C@ */ Scalar_BOOLEAN 0 AppSwcBcm_CM_boolean 0 1 /end CHARACTERISTIC
/begin CHARACTERISTIC DoorLckCtl_DoorAjarRLVal_C "" VALUE 0x0000 /* @ECU_Address@DoorLckCtl_DoorAjarRLVal_C@ */ Scalar_BOOLEAN 0 AppSwcBcm_CM_boolean 0 1 /end CHARACTERISTIC
/begin CHARACTERISTIC DoorLckCtl_DoorAjarRRVal_C "" VALUE 0x0000 /* @ECU_Address@DoorLckCtl_DoorAjarRRVal_C@ */ Scalar_BOOLEAN 0 AppSwcBcm_CM_boolean 0 1 /end CHARACTERISTIC
/begin CHARACTERISTIC DoorLckCtl_DriverDoorLckVal_C "" VALUE 0x0000 /* @ECU_Address@DoorLckCtl_DriverDoorLckVal_C@ */ Scalar_BOOLEAN 0 AppSwcBcm_CM_boolean 0 1 /end CHARACTERISTIC
/begin CHARACTERISTIC DoorLckCtl_DrvPEVal_C "" VALUE 0x0000 /* @ECU_Address@DoorLckCtl_DrvPEVal_C@ */ Scalar_BOOLEAN 0 AppSwcBcm_CM_boolean 0 1 /end CHARACTERISTIC
/begin CHARACTERISTIC DoorLckCtl_J511TrunkUnlckOvrdFlg_C "" VALUE 0x0000 /* @ECU_Address@DoorLckCtl_J511TrunkUnlckOvrdFlg_C@ */ Scalar_BOOLEAN 0 AppSwcBcm_CM_boolean 0 1 /end CHARACTERISTIC
/begin CHARACTERISTIC DoorLckCtl_J511TrunkUnlckOvrdVal_C "" VALUE 0x0000 /* @ECU_Address@DoorLckCtl_J511TrunkUnlckOvrdVal_C@ */ Scalar_BOOLEAN 0 AppSwcBcm_CM_boolean 0 1 /end CHARACTERISTIC
/begin CHARACTERISTIC DoorLckCtl_J54DoorLckOvrdFlg_C "" VALUE 0x0000 /* @ECU_Address@DoorLckCtl_J54DoorLckOvrdFlg_C@ */ Scalar_BOOLEAN 0 AppSwcBcm_CM_boolean 0 1 /end CHARACTERISTIC
/begin CHARACTERISTIC DoorLckCtl_J54DoorLckOvrdVal_C "" VALUE 0x0000 /* @ECU_Address@DoorLckCtl_J54DoorLckOvrdVal_C@ */ Scalar_BOOLEAN 0 AppSwcBcm_CM_boolean 0 1 /end CHARACTERISTIC
/begin CHARACTERISTIC DoorLckCtl_J56DoorUnlckOvrdFlg_C "" VALUE 0x0000 /* @ECU_Address@DoorLckCtl_J56DoorUnlckOvrdFlg_C@ */ Scalar_BOOLEAN 0 AppSwcBcm_CM_boolean 0 1 /end CHARACTERISTIC
/begin CHARACTERISTIC DoorLckCtl_J56DoorUnlckOvrdVal_C "" VALUE 0x0000 /* @ECU_Address@DoorLckCtl_J56DoorUnlckOvrdVal_C@ */ Scalar_BOOLEAN 0 AppSwcBcm_CM_boolean 0 1 /end CHARACTERISTIC
/begin CHARACTERISTIC DoorLckCtl_PsgPEVal_C "" VALUE 0x0000 /* @ECU_Address@DoorLckCtl_PsgPEVal_C@ */ Scalar_BOOLEAN 0 AppSwcBcm_CM_boolean 0 1 /end CHARACTERISTIC
/begin CHARACTERISTIC DoorLckCtl_TrunkAjarVal_C "" VALUE 0x0000 /* @ECU_Address@DoorLckCtl_TrunkAjarVal_C@ */ Scalar_BOOLEAN 0 AppSwcBcm_CM_boolean 0 1 /end CHARACTERISTIC
/begin CHARACTERISTIC DoorLckCtl_TrunkSwVal_C "" VALUE 0x0000 /* @ECU_Address@DoorLckCtl_TrunkSwVal_C@ */ Scalar_BOOLEAN 0 AppSwcBcm_CM_boolean 0 1 /end CHARACTERISTIC
/begin CHARACTERISTIC EEWriteCtl_ImmOvrdFlg_C "" VALUE 0x0000 /* @ECU_Address@EEWriteCtl_ImmOvrdFlg_C@ */ Scalar_BOOLEAN 0 AppSwcBcm_CM_boolean 0 1 /end CHARACTERISTIC
/begin CHARACTERISTIC ESCLCtl_J436PwrSupOvrdFlg_C "" VALUE 0x0000 /* @ECU_Address@ESCLCtl_J436PwrSupOvrdFlg_C@ */ Scalar_BOOLEAN 0 AppSwcBcm_CM_boolean 0 1 /end CHARACTERISTIC
/begin CHARACTERISTIC ESCLCtl_J436PwrSupOvrdVal_C "" VALUE 0x0000 /* @ECU_Address@ESCLCtl_J436PwrSupOvrdVal_C@ */ Scalar_BOOLEAN 0 AppSwcBcm_CM_boolean 0 1 /end CHARACTERISTIC
/begin CHARACTERISTIC HornCtl_J430HornDrvOvrdFlg_C "" VALUE 0x0000 /* @ECU_Address@HornCtl_J430HornDrvOvrdFlg_C@ */ Scalar_BOOLEAN 0 AppSwcBcm_CM_boolean 0 1 /end CHARACTERISTIC
/begin CHARACTERISTIC HornCtl_J430HornDrvOvrdVal_C "" VALUE 0x0000 /* @ECU_Address@HornCtl_J430HornDrvOvrdVal_C@ */ Scalar_BOOLEAN 0 AppSwcBcm_CM_boolean 0 1 /end CHARACTERISTIC
/begin CHARACTERISTIC LampCtl_AutoLampVal_C "" VALUE 0x0000 /* @ECU_Address@LampCtl_AutoLampVal_C@ */ Scalar_BOOLEAN 0 AppSwcBcm_CM_boolean 0 1 /end CHARACTERISTIC
/begin CHARACTERISTIC LampCtl_BrakeLightStaOvrdFlg_C "" VALUE 0x0000 /* @ECU_Address@LampCtl_BrakeLightStaOvrdFlg_C@ */ Scalar_BOOLEAN 0 AppSwcBcm_CM_boolean 0 1 /end CHARACTERISTIC
/begin CHARACTERISTIC LampCtl_BrakeLightStaOvrdVal_C "" VALUE 0x0000 /* @ECU_Address@LampCtl_BrakeLightStaOvrdVal_C@ */ Scalar_BOOLEAN 0 AppSwcBcm_CM_boolean 0 1 /end CHARACTERISTIC
/begin CHARACTERISTIC LampCtl_BrakeLightVal_C "" VALUE 0x0000 /* @ECU_Address@LampCtl_BrakeLightVal_C@ */ Scalar_BOOLEAN 0 AppSwcBcm_CM_boolean 0 1 /end CHARACTERISTIC
/begin CHARACTERISTIC LampCtl_DayRunLightStaOvrdFlg_C "" VALUE 0x0000 /* @ECU_Address@LampCtl_DayRunLightStaOvrdFlg_C@ */ Scalar_BOOLEAN 0 AppSwcBcm_CM_boolean 0 1 /end CHARACTERISTIC
/begin CHARACTERISTIC LampCtl_DayRunLightStaOvrdVal_C "" VALUE 0x0000 /* @ECU_Address@LampCtl_DayRunLightStaOvrdVal_C@ */ Scalar_BOOLEAN 0 AppSwcBcm_CM_boolean 0 1 /end CHARACTERISTIC
/begin CHARACTERISTIC LampCtl_DomeLampPwmDutyOvrdFlg_C "" VALUE 0x0000 /* @ECU_Address@LampCtl_DomeLampPwmDutyOvrdFlg_C@ */ Scalar_BOOLEAN 0 AppSwcBcm_CM_boolean 0 1 /end CHARACTERISTIC
/begin CHARACTERISTIC LampCtl_FogLampFStaOvrdFlg_C "" VALUE 0x0000 /* @ECU_Address@LampCtl_FogLampFStaOvrdFlg_C@ */ Scalar_BOOLEAN 0 AppSwcBcm_CM_boolean 0 1 /end CHARACTERISTIC
/begin CHARACTERISTIC LampCtl_FogLampFStaOvrdVal_C "" VALUE 0x0000 /* @ECU_Address@LampCtl_FogLampFStaOvrdVal_C@ */ Scalar_BOOLEAN 0 AppSwcBcm_CM_boolean 0 1 /end CHARACTERISTIC
/begin CHARACTERISTIC LampCtl_FogLampFVal_C "" VALUE 0x0000 /* @ECU_Address@LampCtl_FogLampFVal_C@ */ Scalar_BOOLEAN 0 AppSwcBcm_CM_boolean 0 1 /end CHARACTERISTIC
/begin CHARACTERISTIC LampCtl_FogLampRStaOvrdFlg_C "" VALUE 0x0000 /* @ECU_Address@LampCtl_FogLampRStaOvrdFlg_C@ */ Scalar_BOOLEAN 0 AppSwcBcm_CM_boolean 0 1 /end CHARACTERISTIC
/begin CHARACTERISTIC LampCtl_FogLampRStaOvrdVal_C "" VALUE 0x0000 /* @ECU_Address@LampCtl_FogLampRStaOvrdVal_C@ */ Scalar_BOOLEAN 0 AppSwcBcm_CM_boolean 0 1 /end CHARACTERISTIC
/begin CHARACTERISTIC LampCtl_FogLampRVal_C "" VALUE 0x0000 /* @ECU_Address@LampCtl_FogLampRVal_C@ */ Scalar_BOOLEAN 0 AppSwcBcm_CM_boolean 0 1 /end CHARACTERISTIC
/begin CHARACTERISTIC LampCtl_HazardLightVal_C "" VALUE 0x0000 /* @ECU_Address@LampCtl_HazardLightVal_C@ */ Scalar_BOOLEAN 0 AppSwcBcm_CM_boolean 0 1 /end CHARACTERISTIC
/begin CHARACTERISTIC LampCtl_HiBeamStaOvrdFlg_C "" VALUE 0x0000 /* @ECU_Address@LampCtl_HiBeamStaOvrdFlg_C@ */ Scalar_BOOLEAN 0 AppSwcBcm_CM_boolean 0 1 /end CHARACTERISTIC
/begin CHARACTERISTIC LampCtl_HiBeamStaOvrdVal_C "" VALUE 0x0000 /* @ECU_Address@LampCtl_HiBeamStaOvrdVal_C@ */ Scalar_BOOLEAN 0 AppSwcBcm_CM_boolean 0 1 /end CHARACTERISTIC
/begin CHARACTERISTIC LampCtl_HiBeamVal_C "" VALUE 0x0000 /* @ECU_Address@LampCtl_HiBeamVal_C@ */ Scalar_BOOLEAN 0 AppSwcBcm_CM_boolean 0 1 /end CHARACTERISTIC
/begin CHARACTERISTIC LampCtl_J408BackLampPWMOvrdFlg_C "" VALUE 0x0000 /* @ECU_Address@LampCtl_J408BackLampPWMOvrdFlg_C@ */ Scalar_BOOLEAN 0 AppSwcBcm_CM_boolean 0 1 /end CHARACTERISTIC
/begin CHARACTERISTIC LampCtl_J420BSDRightCtlOvrdFlg_C "" VALUE 0x0000 /* @ECU_Address@LampCtl_J420BSDRightCtlOvrdFlg_C@ */ Scalar_BOOLEAN 0 AppSwcBcm_CM_boolean 0 1 /end CHARACTERISTIC
/begin CHARACTERISTIC LampCtl_J420BSDRightCtlOvrdVal_C "" VALUE 0x0000 /* @ECU_Address@LampCtl_J420BSDRightCtlOvrdVal_C@ */ Scalar_BOOLEAN 0 AppSwcBcm_CM_boolean 0 1 /end CHARACTERISTIC
/begin CHARACTERISTIC LampCtl_J422BSDLeftCtlOvrdFlg_C "" VALUE 0x0000 /* @ECU_Address@LampCtl_J422BSDLeftCtlOvrdFlg_C@ */ Scalar_BOOLEAN 0 AppSwcBcm_CM_boolean 0 1 /end CHARACTERISTIC
/begin CHARACTERISTIC LampCtl_J422BSDLeftCtlOvrdVal_C "" VALUE 0x0000 /* @ECU_Address@LampCtl_J422BSDLeftCtlOvrdVal_C@ */ Scalar_BOOLEAN 0 AppSwcBcm_CM_boolean 0 1 /end CHARACTERISTIC
/begin CHARACTERISTIC LampCtl_J449BoxLampOvrdFlg_C "" VALUE 0x0000 /* @ECU_Address@LampCtl_J449BoxLampOvrdFlg_C@ */ Scalar_BOOLEAN 0 AppSwcBcm_CM_boolean 0 1 /end CHARACTERISTIC
/begin CHARACTERISTIC LampCtl_J449BoxLampOvrdVal_C "" VALUE 0x0000 /* @ECU_Address@LampCtl_J449BoxLampOvrdVal_C@ */ Scalar_BOOLEAN 0 AppSwcBcm_CM_boolean 0 1 /end CHARACTERISTIC
/begin CHARACTERISTIC LampCtl_LowBeamStaOvrdFlg_C "" VALUE 0x0000 /* @ECU_Address@LampCtl_LowBeamStaOvrdFlg_C@ */ Scalar_BOOLEAN 0 AppSwcBcm_CM_boolean 0 1 /end CHARACTERISTIC
/begin CHARACTERISTIC LampCtl_LowBeamStaOvrdVal_C "" VALUE 0x0000 /* @ECU_Address@LampCtl_LowBeamStaOvrdVal_C@ */ Scalar_BOOLEAN 0 AppSwcBcm_CM_boolean 0 1 /end CHARACTERISTIC
/begin CHARACTERISTIC LampCtl_LowBeamVal_C "" VALUE 0x0000 /* @ECU_Address@LampCtl_LowBeamVal_C@ */ Scalar_BOOLEAN 0 AppSwcBcm_CM_boolean 0 1 /end CHARACTERISTIC
/begin CHARACTERISTIC LampCtl_PassLightVal_C "" VALUE 0x0000 /* @ECU_Address@LampCtl_PassLightVal_C@ */ Scalar_BOOLEAN 0 AppSwcBcm_CM_boolean 0 1 /end CHARACTERISTIC
/begin CHARACTERISTIC LampCtl_PosLampStaOvrdFlg_C "" VALUE 0x0000 /* @ECU_Address@LampCtl_PosLampStaOvrdFlg_C@ */ Scalar_BOOLEAN 0 AppSwcBcm_CM_boolean 0 1 /end CHARACTERISTIC
/begin CHARACTERISTIC LampCtl_PosLampStaOvrdVal_C "" VALUE 0x0000 /* @ECU_Address@LampCtl_PosLampStaOvrdVal_C@ */ Scalar_BOOLEAN 0 AppSwcBcm_CM_boolean 0 1 /end CHARACTERISTIC
/begin CHARACTERISTIC LampCtl_PosLampVal_C "" VALUE 0x0000 /* @ECU_Address@LampCtl_PosLampVal_C@ */ Scalar_BOOLEAN 0 AppSwcBcm_CM_boolean 0 1 /end CHARACTERISTIC
/begin CHARACTERISTIC LampCtl_ReverseLampStaOvrdFlg_C "" VALUE 0x0000 /* @ECU_Address@LampCtl_ReverseLampStaOvrdFlg_C@ */ Scalar_BOOLEAN 0 AppSwcBcm_CM_boolean 0 1 /end CHARACTERISTIC
/begin CHARACTERISTIC LampCtl_ReverseLampStaOvrdVal_C "" VALUE 0x0000 /* @ECU_Address@LampCtl_ReverseLampStaOvrdVal_C@ */ Scalar_BOOLEAN 0 AppSwcBcm_CM_boolean 0 1 /end CHARACTERISTIC
/begin CHARACTERISTIC LampCtl_TurnIndcrLStaOvrdFlg_C "" VALUE 0x0000 /* @ECU_Address@LampCtl_TurnIndcrLStaOvrdFlg_C@ */ Scalar_BOOLEAN 0 AppSwcBcm_CM_boolean 0 1 /end CHARACTERISTIC
/begin CHARACTERISTIC LampCtl_TurnIndcrLStaOvrdVal_C "" VALUE 0x0000 /* @ECU_Address@LampCtl_TurnIndcrLStaOvrdVal_C@ */ Scalar_BOOLEAN 0 AppSwcBcm_CM_boolean 0 1 /end CHARACTERISTIC
/begin CHARACTERISTIC LampCtl_TurnIndcrLVal_C "" VALUE 0x0000 /* @ECU_Address@LampCtl_TurnIndcrLVal_C@ */ Scalar_BOOLEAN 0 AppSwcBcm_CM_boolean 0 1 /end CHARACTERISTIC
/begin CHARACTERISTIC LampCtl_TurnIndcrRStaOvrdFlg_C "" VALUE 0x0000 /* @ECU_Address@LampCtl_TurnIndcrRStaOvrdFlg_C@ */ Scalar_BOOLEAN 0 AppSwcBcm_CM_boolean 0 1 /end CHARACTERISTIC
/begin CHARACTERISTIC LampCtl_TurnIndcrRStaOvrdVal_C "" VALUE 0x0000 /* @ECU_Address@LampCtl_TurnIndcrRStaOvrdVal_C@ */ Scalar_BOOLEAN 0 AppSwcBcm_CM_boolean 0 1 /end CHARACTERISTIC
/begin CHARACTERISTIC LampCtl_TurnIndcrRVal_C "" VALUE 0x0000 /* @ECU_Address@LampCtl_TurnIndcrRVal_C@ */ Scalar_BOOLEAN 0 AppSwcBcm_CM_boolean 0 1 /end CHARACTERISTIC
/begin CHARACTERISTIC PDUCtl_J421IG1RlyCtlOvrdFlg_C "" VALUE 0x0000 /* @ECU_Address@PDUCtl_J421IG1RlyCtlOvrdFlg_C@ */ Scalar_BOOLEAN 0 AppSwcBcm_CM_boolean 0 1 /end CHARACTERISTIC
/begin CHARACTERISTIC PDUCtl_J421IG1RlyCtlOvrdVal_C "" VALUE 0x0000 /* @ECU_Address@PDUCtl_J421IG1RlyCtlOvrdVal_C@ */ Scalar_BOOLEAN 0 AppSwcBcm_CM_boolean 0 1 /end CHARACTERISTIC
/begin CHARACTERISTIC PDUCtl_J437IG2RlyCtlOvrdFlg_C "" VALUE 0x0000 /* @ECU_Address@PDUCtl_J437IG2RlyCtlOvrdFlg_C@ */ Scalar_BOOLEAN 0 AppSwcBcm_CM_boolean 0 1 /end CHARACTERISTIC
/begin CHARACTERISTIC PDUCtl_J437IG2RlyCtlOvrdVal_C "" VALUE 0x0000 /* @ECU_Address@PDUCtl_J437IG2RlyCtlOvrdVal_C@ */ Scalar_BOOLEAN 0 AppSwcBcm_CM_boolean 0 1 /end CHARACTERISTIC
/begin CHARACTERISTIC PDUCtl_KeyValidOvrdFlg_C "" VALUE 0x0000 /* @ECU_Address@PDUCtl_KeyValidOvrdFlg_C@ */ Scalar_BOOLEAN 0 AppSwcBcm_CM_boolean 0 1 /end CHARACTERISTIC
/begin CHARACTERISTIC PDUCtl_KeyValidOvrdVal_C "" VALUE 0x0000 /* @ECU_Address@PDUCtl_KeyValidOvrdVal_C@ */ Scalar_BOOLEAN 0 AppSwcBcm_CM_boolean 0 1 /end CHARACTERISTIC
/begin CHARACTERISTIC RVMCtl_J42HeatOvrdFlg_C "" VALUE 0x0000 /* @ECU_Address@RVMCtl_J42HeatOvrdFlg_C@ */ Scalar_BOOLEAN 0 AppSwcBcm_CM_boolean 0 1 /end CHARACTERISTIC
/begin CHARACTERISTIC RVMCtl_J42HeatOvrdVal_C "" VALUE 0x0000 /* @ECU_Address@RVMCtl_J42HeatOvrdVal_C@ */ Scalar_BOOLEAN 0 AppSwcBcm_CM_boolean 0 1 /end CHARACTERISTIC
/begin CHARACTERISTIC SeatCtl_CN167DrvSeatHtPWMOvrdFlg_C "" VALUE 0x0000 /* @ECU_Address@SeatCtl_CN167DrvSeatHtPWMOvrdFlg_C@ */ Scalar_BOOLEAN 0 AppSwcBcm_CM_boolean 0 1 /end CHARACTERISTIC
/begin CHARACTERISTIC SteerWhlCtl_J447SteerWhlHtOvrdFlg_C "" VALUE 0x0000 /* @ECU_Address@SteerWhlCtl_J447SteerWhlHtOvrdFlg_C@ */ Scalar_BOOLEAN 0 AppSwcBcm_CM_boolean 0 1 /end CHARACTERISTIC
/begin CHARACTERISTIC SteerWhlCtl_J447SteerWhlHtOvrdVal_C "" VALUE 0x0000 /* @ECU_Address@SteerWhlCtl_J447SteerWhlHtOvrdVal_C@ */ Scalar_BOOLEAN 0 AppSwcBcm_CM_boolean 0 1 /end CHARACTERISTIC
/begin CHARACTERISTIC WinCtl_J51DrvWinUpOvrdFlg_C "" VALUE 0x0000 /* @ECU_Address@WinCtl_J51DrvWinUpOvrdFlg_C@ */ Scalar_BOOLEAN 0 AppSwcBcm_CM_boolean 0 1 /end CHARACTERISTIC
/begin CHARACTERISTIC WinCtl_J51DrvWinUpOvrdVal_C "" VALUE 0x0000 /* @ECU_Address@WinCtl_J51DrvWinUpOvrdVal_C@ */ Scalar_BOOLEAN 0 AppSwcBcm_CM_boolean 0 1 /end CHARACTERISTIC
/begin CHARACTERISTIC WinCtl_J53DrvWinDnOvrdFlg_C "" VALUE 0x0000 /* @ECU_Address@WinCtl_J53DrvWinDnOvrdFlg_C@ */ Scalar_BOOLEAN 0 AppSwcBcm_CM_boolean 0 1 /end CHARACTERISTIC
/begin CHARACTERISTIC WinCtl_J53DrvWinDnOvrdVal_C "" VALUE 0x0000 /* @ECU_Address@WinCtl_J53DrvWinDnOvrdVal_C@ */ Scalar_BOOLEAN 0 AppSwcBcm_CM_boolean 0 1 /end CHARACTERISTIC
/begin CHARACTERISTIC WinCtl_J55PsgWinUpOvrdFlg_C "" VALUE 0x0000 /* @ECU_Address@WinCtl_J55PsgWinUpOvrdFlg_C@ */ Scalar_BOOLEAN 0 AppSwcBcm_CM_boolean 0 1 /end CHARACTERISTIC
/begin CHARACTERISTIC WinCtl_J55PsgWinUpOvrdVal_C "" VALUE 0x0000 /* @ECU_Address@WinCtl_J55PsgWinUpOvrdVal_C@ */ Scalar_BOOLEAN 0 AppSwcBcm_CM_boolean 0 1 /end CHARACTERISTIC
/begin CHARACTERISTIC WinCtl_J57PsgWinDnOvrdFlg_C "" VALUE 0x0000 /* @ECU_Address@WinCtl_J57PsgWinDnOvrdFlg_C@ */ Scalar_BOOLEAN 0 AppSwcBcm_CM_boolean 0 1 /end CHARACTERISTIC
/begin CHARACTERISTIC WinCtl_J57PsgWinDnOvrdVal_C "" VALUE 0x0000 /* @ECU_Address@WinCtl_J57PsgWinDnOvrdVal_C@ */ Scalar_BOOLEAN 0 AppSwcBcm_CM_boolean 0 1 /end CHARACTERISTIC
/begin CHARACTERISTIC WiperCtl_HiSpdDrvOvrdFlg_C "" VALUE 0x0000 /* @ECU_Address@WiperCtl_HiSpdDrvOvrdFlg_C@ */ Scalar_BOOLEAN 0 AppSwcBcm_CM_boolean 0 1 /end CHARACTERISTIC
/begin CHARACTERISTIC WiperCtl_HiSpdDrvOvrdVal_C "" VALUE 0x0000 /* @ECU_Address@WiperCtl_HiSpdDrvOvrdVal_C@ */ Scalar_BOOLEAN 0 AppSwcBcm_CM_boolean 0 1 /end CHARACTERISTIC
/begin CHARACTERISTIC WiperCtl_LowSpdDrvOvrdFlg_C "" VALUE 0x0000 /* @ECU_Address@WiperCtl_LowSpdDrvOvrdFlg_C@ */ Scalar_BOOLEAN 0 AppSwcBcm_CM_boolean 0 1 /end CHARACTERISTIC
/begin CHARACTERISTIC WiperCtl_LowSpdDrvOvrdVal_C "" VALUE 0x0000 /* @ECU_Address@WiperCtl_LowSpdDrvOvrdVal_C@ */ Scalar_BOOLEAN 0 AppSwcBcm_CM_boolean 0 1 /end CHARACTERISTIC
/begin CHARACTERISTIC WiperCtl_WashMotorDrvOvrdFlg_C "" VALUE 0x0000 /* @ECU_Address@WiperCtl_WashMotorDrvOvrdFlg_C@ */ Scalar_BOOLEAN 0 AppSwcBcm_CM_boolean 0 1 /end CHARACTERISTIC
/begin CHARACTERISTIC WiperCtl_WashMotorDrvOvrdVal_C "" VALUE 0x0000 /* @ECU_Address@WiperCtl_WashMotorDrvOvrdVal_C@ */ Scalar_BOOLEAN 0 AppSwcBcm_CM_boolean 0 1 /end CHARACTERISTIC
/begin CHARACTERISTIC WiperCtl_WashVal_C "低有效" VALUE 0x0000 /* @ECU_Address@WiperCtl_WashVal_C@ */ Scalar_BOOLEAN 0 AppSwcBcm_CM_boolean 0 1 /end CHARACTERISTIC
/begin CHARACTERISTIC WiperCtl_WiperParkPosVal_C "低有效" VALUE 0x0000 /* @ECU_Address@WiperCtl_WiperParkPosVal_C@ */ Scalar_BOOLEAN 0 AppSwcBcm_CM_boolean 0 1 /end CHARACTERISTIC
/begin CHARACTERISTIC DoorLckCtl_EEIlluminatedEntrySys_C "" VALUE 0x0000 /* @ECU_Address@DoorLckCtl_EEIlluminatedEntrySys_C@ */ Scalar_UBYTE 0 AppSwcBcm_CM_uint8 0 255 /end CHARACTERISTIC
/begin CHARACTERISTIC DoorLckCtl_EEKeyEntry_C "" VALUE 0x0000 /* @ECU_Address@DoorLckCtl_EEKeyEntry_C@ */ Scalar_UBYTE 0 AppSwcBcm_CM_uint8 0 255 /end CHARACTERISTIC
/begin CHARACTERISTIC DoorLckCtl_IllmndSts_C "" VALUE 0x0000 /* @ECU_Address@DoorLckCtl_IllmndSts_C@ */ Scalar_UBYTE 0 AppSwcBcm_CM_uint8 0 255 /end CHARACTERISTIC
/begin CHARACTERISTIC DoorLckCtl_LckStaCfmMaxTim_C "" VALUE 0x0000 /* @ECU_Address@DoorLckCtl_LckStaCfmMaxTim_C@ */ Scalar_UBYTE 0 AppSwcBcm_CM_uint8_20ms 0 255 /end CHARACTERISTIC
/begin CHARACTERISTIC DoorLckCtl_LckStaCfmMinTim_C "" VALUE 0x0000 /* @ECU_Address@DoorLckCtl_LckStaCfmMinTim_C@ */ Scalar_UBYTE 0 AppSwcBcm_CM_uint8_20ms 0 255 /end CHARACTERISTIC
/begin CHARACTERISTIC DoorLckCtl_MotorWorkMax_C "" VALUE 0x0000 /* @ECU_Address@DoorLckCtl_MotorWorkMax_C@ */ Scalar_UBYTE 0 AppSwcBcm_CM_uint8 0 255 /end CHARACTERISTIC
/begin CHARACTERISTIC DoorLckCtl_SpdLck_C "" VALUE 0x0000 /* @ECU_Address@DoorLckCtl_SpdLck_C@ */ Scalar_UBYTE 0 AppSwcBcm_CM_uint8_km_per_h 0 255 /end CHARACTERISTIC
/begin CHARACTERISTIC EEWriteCtl_ImmOvrdVal_C "" VAL_BLK 0x0000 /* @ECU_Address@EEWriteCtl_ImmOvrdVal_C@ */ Scalar_UBYTE 0 AppSwcBcm_CM_uint8 0 255 NUMBER 128 /end CHARACTERISTIC
/begin CHARACTERISTIC LampCtl_DomeLampPwmDutyOvrdVal_C "" VALUE 0x0000 /* @ECU_Address@LampCtl_DomeLampPwmDutyOvrdVal_C@ */ Scalar_UBYTE 0 AppSwcBcm_CM_uint8 0 255 /end CHARACTERISTIC
/begin CHARACTERISTIC LampCtl_J408BackLampPWMOvrdVal_C "" VALUE 0x0000 /* @ECU_Address@LampCtl_J408BackLampPWMOvrdVal_C@ */ Scalar_UBYTE 0 AppSwcBcm_CM_uint8 0 255 /end CHARACTERISTIC
/begin CHARACTERISTIC LampCtl_LOpenCnt_C "" VALUE 0x0000 /* @ECU_Address@LampCtl_LOpenCnt_C@ */ Scalar_UBYTE 0 AppSwcBcm_CM_uint8 0 255 /end CHARACTERISTIC
/begin CHARACTERISTIC LampCtl_LShortCnt_C "" VALUE 0x0000 /* @ECU_Address@LampCtl_LShortCnt_C@ */ Scalar_UBYTE 0 AppSwcBcm_CM_uint8 0 255 /end CHARACTERISTIC
/begin CHARACTERISTIC LampCtl_ROpenCnt_C "" VALUE 0x0000 /* @ECU_Address@LampCtl_ROpenCnt_C@ */ Scalar_UBYTE 0 AppSwcBcm_CM_uint8 0 255 /end CHARACTERISTIC
/begin CHARACTERISTIC LampCtl_RShortCnt_C "" VALUE 0x0000 /* @ECU_Address@LampCtl_RShortCnt_C@ */ Scalar_UBYTE 0 AppSwcBcm_CM_uint8 0 255 /end CHARACTERISTIC
/begin CHARACTERISTIC PDUCtl_TimOutPwrOffH_C "" VALUE 0x0000 /* @ECU_Address@PDUCtl_TimOutPwrOffH_C@ */ Scalar_UBYTE 0 AppSwcBcm_CM_uint8_hour 0 255 /end CHARACTERISTIC
/begin CHARACTERISTIC PDUCtl_TimOutPwrOffM_C "" VALUE 0x0000 /* @ECU_Address@PDUCtl_TimOutPwrOffM_C@ */ Scalar_UBYTE 0 AppSwcBcm_CM_uint8 0 255 /end CHARACTERISTIC
/begin CHARACTERISTIC PDUCtl_TimOutPwrOffS_C "" VALUE 0x0000 /* @ECU_Address@PDUCtl_TimOutPwrOffS_C@ */ Scalar_UBYTE 0 AppSwcBcm_CM_uint8 0 255 /end CHARACTERISTIC
/begin CHARACTERISTIC RVMCtl_MaxHeatTimM_C "" VALUE 0x0000 /* @ECU_Address@RVMCtl_MaxHeatTimM_C@ */ Scalar_UBYTE 0 AppSwcBcm_CM_uint8 0 255 /end CHARACTERISTIC
/begin CHARACTERISTIC SeatCtl_CN167DrvSeatHtPWMOvrdVal_C "" VALUE 0x0000 /* @ECU_Address@SeatCtl_CN167DrvSeatHtPWMOvrdVal_C@ */ Scalar_UBYTE 0 AppSwcBcm_CM_uint8 0 255 /end CHARACTERISTIC
/begin CHARACTERISTIC SeatCtl_DrvTempLvl0_C "" VALUE 0x0000 /* @ECU_Address@SeatCtl_DrvTempLvl0_C@ */ Scalar_UBYTE 0 AppSwcBcm_CM_uint8 0 255 /end CHARACTERISTIC
/begin CHARACTERISTIC SeatCtl_DrvTempLvl1_C "" VALUE 0x0000 /* @ECU_Address@SeatCtl_DrvTempLvl1_C@ */ Scalar_UBYTE 0 AppSwcBcm_CM_uint8 0 255 /end CHARACTERISTIC
/begin CHARACTERISTIC SeatCtl_DrvTempLvl2_C "" VALUE 0x0000 /* @ECU_Address@SeatCtl_DrvTempLvl2_C@ */ Scalar_UBYTE 0 AppSwcBcm_CM_uint8 0 255 /end CHARACTERISTIC
/begin CHARACTERISTIC SeatCtl_DrvTempLvl3_C "" VALUE 0x0000 /* @ECU_Address@SeatCtl_DrvTempLvl3_C@ */ Scalar_UBYTE 0 AppSwcBcm_CM_uint8 0 255 /end CHARACTERISTIC
/begin CHARACTERISTIC SeatCtl_HtDiffTemp_C "" VALUE 0x0000 /* @ECU_Address@SeatCtl_HtDiffTemp_C@ */ Scalar_UBYTE 0 AppSwcBcm_CM_uint8 0 255 /end CHARACTERISTIC
/begin CHARACTERISTIC SteerWhlCtl_DiffTemp_C "" VALUE 0x0000 /* @ECU_Address@SteerWhlCtl_DiffTemp_C@ */ Scalar_UBYTE 0 AppSwcBcm_CM_uint8__degC 0 255 /end CHARACTERISTIC
/begin CHARACTERISTIC SteerWhlCtl_TrgtTemp_C "" VALUE 0x0000 /* @ECU_Address@SteerWhlCtl_TrgtTemp_C@ */ Scalar_UBYTE 0 AppSwcBcm_CM_uint8_degC 0 255 /end CHARACTERISTIC
/begin CHARACTERISTIC WiperCtl_WashAfterNum_C "" VALUE 0x0000 /* @ECU_Address@WiperCtl_WashAfterNum_C@ */ Scalar_UBYTE 0 AppSwcBcm_CM_uint8 0 255 /end CHARACTERISTIC
/begin CHARACTERISTIC WiperCtl_WiperSwVal_C "" VALUE 0x0000 /* @ECU_Address@WiperCtl_WiperSwVal_C@ */ Scalar_UBYTE 0 AppSwcBcm_CM_uint8 0 255 /end CHARACTERISTIC
/begin MEASUREMENT DoorLckCtl_VehSpd "" FLOAT32_IEEE AppSwcBcm_CM_single 0 0 -3.4E+38 3.4E+38 ECU_ADDRESS 0x0000 /* @ECU_Address@DoorLckCtl_VehSpd@ */ /end MEASUREMENT
/begin MEASUREMENT BSW_J112DrvSeatResis "" UWORD AppSwcBcm_CM_uint16 0 0 0 65535 ECU_ADDRESS 0x0000 /* @ECU_Address@BSW_J112DrvSeatResis@ */ /end MEASUREMENT
/begin MEASUREMENT BSW_J125LightIntst "" UWORD AppSwcBcm_CM_uint16 0 0 0 65535 ECU_ADDRESS 0x0000 /* @ECU_Address@BSW_J125LightIntst@ */ /end MEASUREMENT
/begin MEASUREMENT WiperCtl_InrTim "" UWORD AppSwcBcm_CM_uint16 0 0 0 65535 ECU_ADDRESS 0x0000 /* @ECU_Address@WiperCtl_InrTim@ */ /end MEASUREMENT
/begin MEASUREMENT LampCtl_FlwrMeHomeTim "" UWORD AppSwcBcm_CM_uint16 0 0 0 65535 ECU_ADDRESS 0x0000 /* @ECU_Address@LampCtl_FlwrMeHomeTim@ */ /end MEASUREMENT
/begin MEASUREMENT LampCtl_PrdSucCntR "" UWORD AppSwcBcm_CM_uint16 0 0 0 65535 ECU_ADDRESS 0x0000 /* @ECU_Address@LampCtl_PrdSucCntR@ */ /end MEASUREMENT
/begin MEASUREMENT LampCtl_PrdSucCntL "" UWORD AppSwcBcm_CM_uint16 0 0 0 65535 ECU_ADDRESS 0x0000 /* @ECU_Address@LampCtl_PrdSucCntL@ */ /end MEASUREMENT
/begin MEASUREMENT LampCtl_TurnIndcrLVol "" UWORD AppSwcBcm_CM_uint16 0 0 0 65535 ECU_ADDRESS 0x0000 /* @ECU_Address@LampCtl_TurnIndcrLVol@ */ /end MEASUREMENT
/begin MEASUREMENT LampCtl_TurnIndcrRVol "" UWORD AppSwcBcm_CM_uint16 0 0 0 65535 ECU_ADDRESS 0x0000 /* @ECU_Address@LampCtl_TurnIndcrRVol@ */ /end MEASUREMENT
/begin MEASUREMENT LampCtl_TurnIndcrLFlashCnt "" UWORD AppSwcBcm_CM_uint16 0 0 0 65535 ECU_ADDRESS 0x0000 /* @ECU_Address@LampCtl_TurnIndcrLFlashCnt@ */ /end MEASUREMENT
/begin MEASUREMENT LampCtl_TurnIndcrPrd "" UWORD AppSwcBcm_CM_uint16 0 0 0 65535 ECU_ADDRESS 0x0000 /* @ECU_Address@LampCtl_TurnIndcrPrd@ */ /end MEASUREMENT
/begin MEASUREMENT LampCtl_TurnIndcrRFlashCnt "" UWORD AppSwcBcm_CM_uint16 0 0 0 65535 ECU_ADDRESS 0x0000 /* @ECU_Address@LampCtl_TurnIndcrRFlashCnt@ */ /end MEASUREMENT
/begin MEASUREMENT LampCtl_TurnIndcrWdt "" UWORD AppSwcBcm_CM_uint16 0 0 0 65535 ECU_ADDRESS 0x0000 /* @ECU_Address@LampCtl_TurnIndcrWdt@ */ /end MEASUREMENT
/begin MEASUREMENT LampCtl_LightIntstVal "" UWORD AppSwcBcm_CM_uint16 0 0 0 65535 ECU_ADDRESS 0x0000 /* @ECU_Address@LampCtl_LightIntstVal@ */ /end MEASUREMENT
/begin MEASUREMENT BSW_DrvWinMotorCur "" UWORD AppSwcBcm_CM_uint16 0 0 0 65535 ECU_ADDRESS 0x0000 /* @ECU_Address@BSW_DrvWinMotorCur@ */ /end MEASUREMENT
/begin MEASUREMENT BSW_J113DrvWinSwResis "" UWORD AppSwcBcm_CM_uint16_Ohm 0 0 0 65535 ECU_ADDRESS 0x0000 /* @ECU_Address@BSW_J113DrvWinSwResis@ */ /end MEASUREMENT
/begin MEASUREMENT BSW_J126DrvPsgWinSwResis "" UWORD AppSwcBcm_CM_uint16_Ohm 0 0 0 65535 ECU_ADDRESS 0x0000 /* @ECU_Address@BSW_J126DrvPsgWinSwResis@ */ /end MEASUREMENT
/begin MEASUREMENT BSW_J26PsgWinSwResis "" UWORD AppSwcBcm_CM_uint16_Ohm 0 0 0 65535 ECU_ADDRESS 0x0000 /* @ECU_Address@BSW_J26PsgWinSwResis@ */ /end MEASUREMENT
/begin MEASUREMENT BSW_PsgWinMotorCur "" UWORD AppSwcBcm_CM_uint16 0 0 0 65535 ECU_ADDRESS 0x0000 /* @ECU_Address@BSW_PsgWinMotorCur@ */ /end MEASUREMENT
/begin MEASUREMENT BSW_CN744DrvSeatResis "" UWORD AppSwcBcm_CM_uint16 0 0 0 65535 ECU_ADDRESS 0x0000 /* @ECU_Address@BSW_CN744DrvSeatResis@ */ /end MEASUREMENT
/begin MEASUREMENT BSW_J134SteerWhlResis "" UWORD AppSwcBcm_CM_uint16 0 0 0 65535 ECU_ADDRESS 0x0000 /* @ECU_Address@BSW_J134SteerWhlResis@ */ /end MEASUREMENT
/begin MEASUREMENT BSW_EEIlluminatedEntrySys "" UBYTE AppSwcBcm_CM_uint8 0 0 0 255 ECU_ADDRESS 0x0000 /* @ECU_Address@BSW_EEIlluminatedEntrySys@ */ /end MEASUREMENT
/begin MEASUREMENT BSW_EEKeyEntry "" UBYTE AppSwcBcm_CM_uint8 0 0 0 255 ECU_ADDRESS 0x0000 /* @ECU_Address@BSW_EEKeyEntry@ */ /end MEASUREMENT
/begin MEASUREMENT BSW_J310DoorAjarFR "" UBYTE AppSwcBcm_CM_uint8 0 0 0 255 ECU_ADDRESS 0x0000 /* @ECU_Address@BSW_J310DoorAjarFR@ */ /end MEASUREMENT
/begin MEASUREMENT BSW_J320DoorAjarRL "" UBYTE AppSwcBcm_CM_uint8 0 0 0 255 ECU_ADDRESS 0x0000 /* @ECU_Address@BSW_J320DoorAjarRL@ */ /end MEASUREMENT
/begin MEASUREMENT BSW_J321DoorAjarFL "" UBYTE AppSwcBcm_CM_uint8 0 0 0 255 ECU_ADDRESS 0x0000 /* @ECU_Address@BSW_J321DoorAjarFL@ */ /end MEASUREMENT
/begin MEASUREMENT BSW_J335DriverDoorLck "" UBYTE AppSwcBcm_CM_uint8 0 0 0 255 ECU_ADDRESS 0x0000 /* @ECU_Address@BSW_J335DriverDoorLck@ */ /end MEASUREMENT
/begin MEASUREMENT BSW_J336Trunk "" UBYTE AppSwcBcm_CM_uint8 0 0 0 255 ECU_ADDRESS 0x0000 /* @ECU_Address@BSW_J336Trunk@ */ /end MEASUREMENT
/begin MEASUREMENT BSW_J337PsgPE "" UBYTE AppSwcBcm_CM_uint8 0 0 0 255 ECU_ADDRESS 0x0000 /* @ECU_Address@BSW_J337PsgPE@ */ /end MEASUREMENT
/begin MEASUREMENT BSW_J338DrvPE "" UBYTE AppSwcBcm_CM_uint8 0 0 0 255 ECU_ADDRESS 0x0000 /* @ECU_Address@BSW_J338DrvPE@ */ /end MEASUREMENT
/begin MEASUREMENT BSW_J36DoorAjarRR "" UBYTE AppSwcBcm_CM_uint8 0 0 0 255 ECU_ADDRESS 0x0000 /* @ECU_Address@BSW_J36DoorAjarRR@ */ /end MEASUREMENT
/begin MEASUREMENT BSW_J37TrunkAjar "" UBYTE AppSwcBcm_CM_uint8 0 0 0 255 ECU_ADDRESS 0x0000 /* @ECU_Address@BSW_J37TrunkAjar@ */ /end MEASUREMENT
/begin MEASUREMENT DynDID_0xF22CAntitheftSta "" UBYTE AppSwcBcm_CM_uint8 0 0 0 255 ECU_ADDRESS 0x0000 /* @ECU_Address@DynDID_0xF22CAntitheftSta@ */ /end MEASUREMENT
/begin MEASUREMENT DynDID_0xF237PwrModeSta "" UBYTE AppSwcBcm_CM_uint8 0 0 0 255 ECU_ADDRESS 0x0000 /* @ECU_Address@DynDID_0xF237PwrModeSta@ */ /end MEASUREMENT
/begin MEASUREMENT BSW_J349TrunkLck "" UBYTE AppSwcBcm_CM_uint8 0 0 0 255 ECU_ADDRESS 0x0000 /* @ECU_Address@BSW_J349TrunkLck@ */ /end MEASUREMENT
/begin MEASUREMENT BSW_J38HoodAjar "" UBYTE AppSwcBcm_CM_uint8 0 0 0 255 ECU_ADDRESS 0x0000 /* @ECU_Address@BSW_J38HoodAjar@ */ /end MEASUREMENT
/begin MEASUREMENT BSW_IllmndSts "" UBYTE AppSwcBcm_CM_uint8 0 0 0 255 ECU_ADDRESS 0x0000 /* @ECU_Address@BSW_IllmndSts@ */ /end MEASUREMENT
/begin MEASUREMENT BSW_WakeupReas "" UBYTE AppSwcBcm_CM_uint8 0 0 0 255 ECU_ADDRESS 0x0000 /* @ECU_Address@BSW_WakeupReas@ */ /end MEASUREMENT
/begin MEASUREMENT PDUCtl_SysPwrMode "" UBYTE AppSwcBcm_CM_uint8 0 0 0 255 ECU_ADDRESS 0x0000 /* @ECU_Address@PDUCtl_SysPwrMode@ */ /end MEASUREMENT
/begin MEASUREMENT PDUCtl_SysPwrModeAct "" UBYTE AppSwcBcm_CM_uint8 0 0 0 255 ECU_ADDRESS 0x0000 /* @ECU_Address@PDUCtl_SysPwrModeAct@ */ /end MEASUREMENT
/begin MEASUREMENT PDUCtl_J437IG2RlyCtl "" UBYTE AppSwcBcm_CM_uint8 0 0 0 255 ECU_ADDRESS 0x0000 /* @ECU_Address@PDUCtl_J437IG2RlyCtl@ */ /end MEASUREMENT
/begin MEASUREMENT PDUCtl_J421IG1RlyCtl "" UBYTE AppSwcBcm_CM_uint8 0 0 0 255 ECU_ADDRESS 0x0000 /* @ECU_Address@PDUCtl_J421IG1RlyCtl@ */ /end MEASUREMENT
/begin MEASUREMENT PDUCtl_SysPowerSts "" UBYTE AppSwcBcm_CM_uint8 0 0 0 255 ECU_ADDRESS 0x0000 /* @ECU_Address@PDUCtl_SysPowerSts@ */ /end MEASUREMENT
/begin MEASUREMENT IMMOCtl_INVRandom "" UBYTE AppSwcBcm_CM_uint8 0 0 0 255 ARRAY_SIZE 8 ECU_ADDRESS 0x0000 /* @ECU_Address@IMMOCtl_INVRandom@ */ /end MEASUREMENT
/begin MEASUREMENT IMMOCtl_SKRead "" UBYTE AppSwcBcm_CM_uint8 0 0 0 255 ARRAY_SIZE 16 ECU_ADDRESS 0x0000 /* @ECU_Address@IMMOCtl_SKRead@ */ /end MEASUREMENT
/begin MEASUREMENT IMMOCtl_AuthResp "" UBYTE AppSwcBcm_CM_uint8 0 0 0 255 ARRAY_SIZE 8 ECU_ADDRESS 0x0000 /* @ECU_Address@IMMOCtl_AuthResp@ */ /end MEASUREMENT
/begin MEASUREMENT IMMOCtl_SKSta "" UBYTE AppSwcBcm_CM_uint8 0 0 0 255 ECU_ADDRESS 0x0000 /* @ECU_Address@IMMOCtl_SKSta@ */ /end MEASUREMENT
/begin MEASUREMENT ESCLCtl_UnOrLockCrtl "" UBYTE AppSwcBcm_CM_uint8 0 0 0 255 ECU_ADDRESS 0x0000 /* @ECU_Address@ESCLCtl_UnOrLockCrtl@ */ /end MEASUREMENT
/begin MEASUREMENT ESCLCtl_Unlck "" UBYTE AppSwcBcm_CM_uint8 0 0 0 255 ECU_ADDRESS 0x0000 /* @ECU_Address@ESCLCtl_Unlck@ */ /end MEASUREMENT
/begin MEASUREMENT ESCLCtl_Lck "" UBYTE AppSwcBcm_CM_uint8 0 0 0 255 ECU_ADDRESS 0x0000 /* @ECU_Address@ESCLCtl_Lck@ */ /end MEASUREMENT
/begin MEASUREMENT DynDID_0xF236DigtOutSampleValue "" UBYTE AppSwcBcm_CM_uint8 0 0 0 255 ARRAY_SIZE 5 ECU_ADDRESS 0x0000 /* @ECU_Address@DynDID_0xF236DigtOutSampleValue@ */ /end MEASUREMENT
/begin MEASUREMENT DynDID_0xF235DigtInSampleValue "" UBYTE AppSwcBcm_CM_uint8 0 0 0 255 ARRAY_SIZE 5 ECU_ADDRESS 0x0000 /* @ECU_Address@DynDID_0xF235DigtInSampleValue@ */ /end MEASUREMENT
/begin MEASUREMENT DynDID_0xF234ADSampleValue "" UBYTE AppSwcBcm_CM_uint8 0 0 0 255 ARRAY_SIZE 23 ECU_ADDRESS 0x0000 /* @ECU_Address@DynDID_0xF234ADSampleValue@ */ /end MEASUREMENT
/begin MEASUREMENT DynDID_0xF233RemoteStartUpFailRecord "" UBYTE AppSwcBcm_CM_uint8 0 0 0.0 9.0 ARRAY_SIZE 10 ECU_ADDRESS 0x0000 /* @ECU_Address@DynDID_0xF233RemoteStartUpFailRecord@ */ /end MEASUREMENT
/begin MEASUREMENT DynDID_0xF232LocalStartUpFailRecord "" UBYTE AppSwcBcm_CM_uint8 0 0 0.0 9.0 ARRAY_SIZE 10 ECU_ADDRESS 0x0000 /* @ECU_Address@DynDID_0xF232LocalStartUpFailRecord@ */ /end MEASUREMENT
/begin MEASUREMENT DynDID_0xF231TrunkOpRecord "" UBYTE AppSwcBcm_CM_uint8 0 0 0.0 9.0 ARRAY_SIZE 10 ECU_ADDRESS 0x0000 /* @ECU_Address@DynDID_0xF231TrunkOpRecord@ */ /end MEASUREMENT
/begin MEASUREMENT DynDID_0xF230DoorOpRecord "" UBYTE AppSwcBcm_CM_uint8 0 0 0.0 9.0 ARRAY_SIZE 10 ECU_ADDRESS 0x0000 /* @ECU_Address@DynDID_0xF230DoorOpRecord@ */ /end MEASUREMENT
/begin MEASUREMENT DoorLckCtl_EEKeyEntry "" UBYTE AppSwcBcm_CM_uint8 0 0 0 255 ECU_ADDRESS 0x0000 /* @ECU_Address@DoorLckCtl_EEKeyEntry@ */ /end MEASUREMENT
/begin MEASUREMENT DoorLckCtl_EEIlluminatedEntrySys "" UBYTE AppSwcBcm_CM_uint8 0 0 0 255 ECU_ADDRESS 0x0000 /* @ECU_Address@DoorLckCtl_EEIlluminatedEntrySys@ */ /end MEASUREMENT
/begin MEASUREMENT DoorLckCtl_IllmndSts "" UBYTE AppSwcBcm_CM_uint8 0 0 0 255 ECU_ADDRESS 0x0000 /* @ECU_Address@DoorLckCtl_IllmndSts@ */ /end MEASUREMENT
/begin MEASUREMENT DoorLckCtl_IllmndLckSts "" UBYTE AppSwcBcm_CM_uint8 0 0 0 255 ECU_ADDRESS 0x0000 /* @ECU_Address@DoorLckCtl_IllmndLckSts@ */ /end MEASUREMENT
/begin MEASUREMENT DoorLckCtl_IllmndLckStsFb "" UBYTE AppSwcBcm_CM_uint8 0 0 0 255 ECU_ADDRESS 0x0000 /* @ECU_Address@DoorLckCtl_IllmndLckStsFb@ */ /end MEASUREMENT
/begin MEASUREMENT DoorLckCtl_ParkAutoUnlockSetFb "" UBYTE AppSwcBcm_CM_uint8 0 0 0 255 ECU_ADDRESS 0x0000 /* @ECU_Address@DoorLckCtl_ParkAutoUnlockSetFb@ */ /end MEASUREMENT
/begin MEASUREMENT DoorLckCtl_IllmndUnlockSts "" UBYTE AppSwcBcm_CM_uint8 0 0 0 255 ECU_ADDRESS 0x0000 /* @ECU_Address@DoorLckCtl_IllmndUnlockSts@ */ /end MEASUREMENT
/begin MEASUREMENT DoorLckCtl_IllmndUnlockStsFb "" UBYTE AppSwcBcm_CM_uint8 0 0 0 255 ECU_ADDRESS 0x0000 /* @ECU_Address@DoorLckCtl_IllmndUnlockStsFb@ */ /end MEASUREMENT
/begin MEASUREMENT DoorLckCtl_SpdCtlLckSet "" UBYTE AppSwcBcm_CM_uint8 0 0 0 255 ECU_ADDRESS 0x0000 /* @ECU_Address@DoorLckCtl_SpdCtlLckSet@ */ /end MEASUREMENT
/begin MEASUREMENT DoorLckCtl_SpdCtlLckSetFb "" UBYTE AppSwcBcm_CM_uint8 0 0 0 255 ECU_ADDRESS 0x0000 /* @ECU_Address@DoorLckCtl_SpdCtlLckSetFb@ */ /end MEASUREMENT
/begin MEASUREMENT DoorLckCtl_TrunkLckSta "" UBYTE AppSwcBcm_CM_uint8 0 0 0 255 ECU_ADDRESS 0x0000 /* @ECU_Address@DoorLckCtl_TrunkLckSta@ */ /end MEASUREMENT
/begin MEASUREMENT DoorLckCtl_InsLckSta "" UBYTE AppSwcBcm_CM_uint8 0 0 0 255 ECU_ADDRESS 0x0000 /* @ECU_Address@DoorLckCtl_InsLckSta@ */ /end MEASUREMENT
/begin MEASUREMENT DoorLckCtl_OsLckSta "" UBYTE AppSwcBcm_CM_uint8 0 0 0 255 ECU_ADDRESS 0x0000 /* @ECU_Address@DoorLckCtl_OsLckSta@ */ /end MEASUREMENT
/begin MEASUREMENT AlmSysCtl_BodyWarnSts "" UBYTE AppSwcBcm_CM_uint8 0 0 0 255 ECU_ADDRESS 0x0000 /* @ECU_Address@AlmSysCtl_BodyWarnSts@ */ /end MEASUREMENT
/begin MEASUREMENT BSW_J319HornSw "" UBYTE AppSwcBcm_CM_uint8 0 0 0 255 ECU_ADDRESS 0x0000 /* @ECU_Address@BSW_J319HornSw@ */ /end MEASUREMENT
/begin MEASUREMENT BSW_FogLampFCfg "" UBYTE AppSwcBcm_CM_uint8 0 0 0 255 ECU_ADDRESS 0x0000 /* @ECU_Address@BSW_FogLampFCfg@ */ /end MEASUREMENT
/begin MEASUREMENT BSW_J313BrakeLoSw "" UBYTE AppSwcBcm_CM_uint8 0 0 0 255 ECU_ADDRESS 0x0000 /* @ECU_Address@BSW_J313BrakeLoSw@ */ /end MEASUREMENT
/begin MEASUREMENT BSW_J322FogLampF "" UBYTE AppSwcBcm_CM_uint8 0 0 0 255 ECU_ADDRESS 0x0000 /* @ECU_Address@BSW_J322FogLampF@ */ /end MEASUREMENT
/begin MEASUREMENT BSW_J339BrakeHiSw "" UBYTE AppSwcBcm_CM_uint8 0 0 0 255 ECU_ADDRESS 0x0000 /* @ECU_Address@BSW_J339BrakeHiSw@ */ /end MEASUREMENT
/begin MEASUREMENT BSW_J346FogLampR "" UBYTE AppSwcBcm_CM_uint8 0 0 0 255 ECU_ADDRESS 0x0000 /* @ECU_Address@BSW_J346FogLampR@ */ /end MEASUREMENT
/begin MEASUREMENT BSW_RKEReq "" UBYTE AppSwcBcm_CM_uint8 0 0 0 255 ECU_ADDRESS 0x0000 /* @ECU_Address@BSW_RKEReq@ */ /end MEASUREMENT
/begin MEASUREMENT BSW_J334WiperParkPos "" UBYTE AppSwcBcm_CM_uint8 0 0 0 255 ECU_ADDRESS 0x0000 /* @ECU_Address@BSW_J334WiperParkPos@ */ /end MEASUREMENT
/begin MEASUREMENT SCS_FrntWiprSwtSt "" UBYTE AppSwcBcm_CM_uint8 0 0 0 255 ECU_ADDRESS 0x0000 /* @ECU_Address@SCS_FrntWiprSwtSt@ */ /end MEASUREMENT
/begin MEASUREMENT WiperCtl_WiprIntlTimeSetFb "" UBYTE AppSwcBcm_CM_uint8 0 0 0 255 ECU_ADDRESS 0x0000 /* @ECU_Address@WiperCtl_WiprIntlTimeSetFb@ */ /end MEASUREMENT
/begin MEASUREMENT WiperCtl_WiperSta "" UBYTE AppSwcBcm_CM_uint8 0 0 0 255 ECU_ADDRESS 0x0000 /* @ECU_Address@WiperCtl_WiperSta@ */ /end MEASUREMENT
/begin MEASUREMENT LampCtl_FlwrMeHomeCtlFb "" UBYTE AppSwcBcm_CM_uint8 0 0 0 255 ECU_ADDRESS 0x0000 /* @ECU_Address@LampCtl_FlwrMeHomeCtlFb@ */ /end MEASUREMENT
/begin MEASUREMENT LampCtl_VehModeSta "" UBYTE AppSwcBcm_CM_uint8 0 0 0 255 ECU_ADDRESS 0x0000 /* @ECU_Address@LampCtl_VehModeSta@ */ /end MEASUREMENT
/begin MEASUREMENT LampCtl_TurnIndcrMod "" UBYTE AppSwcBcm_CM_uint8 0 0 0 255 ECU_ADDRESS 0x0000 /* @ECU_Address@LampCtl_TurnIndcrMod@ */ /end MEASUREMENT
/begin MEASUREMENT LampCtl_PartArmedSta "" UBYTE AppSwcBcm_CM_uint8 0 0 0 255 ECU_ADDRESS 0x0000 /* @ECU_Address@LampCtl_PartArmedSta@ */ /end MEASUREMENT
/begin MEASUREMENT LampCtl_RKEReq "" UBYTE AppSwcBcm_CM_uint8 0 0 0 255 ECU_ADDRESS 0x0000 /* @ECU_Address@LampCtl_RKEReq@ */ /end MEASUREMENT
/begin MEASUREMENT LampCtl_J408BackLampPWM "" UBYTE AppSwcBcm_CM_uint8 0 0 0 255 ECU_ADDRESS 0x0000 /* @ECU_Address@LampCtl_J408BackLampPWM@ */ /end MEASUREMENT
/begin MEASUREMENT LampCtl_DomeLampPwmDuty "" UBYTE AppSwcBcm_CM_uint8 0 0 0 255 ECU_ADDRESS 0x0000 /* @ECU_Address@LampCtl_DomeLampPwmDuty@ */ /end MEASUREMENT
/begin MEASUREMENT BSW_LowBeamDigSts "" UBYTE AppSwcBcm_CM_uint8 0 0 0 255 ECU_ADDRESS 0x0000 /* @ECU_Address@BSW_LowBeamDigSts@ */ /end MEASUREMENT
/begin MEASUREMENT LampCtl_LightIntstSta "" UBYTE AppSwcBcm_CM_uint8 0 0 0 255 ECU_ADDRESS 0x0000 /* @ECU_Address@LampCtl_LightIntstSta@ */ /end MEASUREMENT
/begin MEASUREMENT BSW_HiBeamDigSts "" UBYTE AppSwcBcm_CM_uint8 0 0 0 255 ECU_ADDRESS 0x0000 /* @ECU_Address@BSW_HiBeamDigSts@ */ /end MEASUREMENT
/begin MEASUREMENT LampCtl_BackLadjvalFb "" UBYTE AppSwcBcm_CM_uint8 0 0 0 255 ECU_ADDRESS 0x0000 /* @ECU_Address@LampCtl_BackLadjvalFb@ */ /end MEASUREMENT
/begin MEASUREMENT HornCtl_LockHoornOnSt "" UBYTE AppSwcBcm_CM_uint8 0 0 0 255 ECU_ADDRESS 0x0000 /* @ECU_Address@HornCtl_LockHoornOnSt@ */ /end MEASUREMENT
/begin MEASUREMENT HornCtl_LockHoornOnStFb "" UBYTE AppSwcBcm_CM_uint8 0 0 0 255 ECU_ADDRESS 0x0000 /* @ECU_Address@HornCtl_LockHoornOnStFb@ */ /end MEASUREMENT
/begin MEASUREMENT HornCtl_TrunkWarnSta "" UBYTE AppSwcBcm_CM_uint8 0 0 0 255 ECU_ADDRESS 0x0000 /* @ECU_Address@HornCtl_TrunkWarnSta@ */ /end MEASUREMENT
/begin MEASUREMENT HornCtl_SeekSta "" UBYTE AppSwcBcm_CM_uint8 0 0 0 255 ECU_ADDRESS 0x0000 /* @ECU_Address@HornCtl_SeekSta@ */ /end MEASUREMENT
/begin MEASUREMENT HornCtl_PartArmedSta "" UBYTE AppSwcBcm_CM_uint8 0 0 0 255 ECU_ADDRESS 0x0000 /* @ECU_Address@HornCtl_PartArmedSta@ */ /end MEASUREMENT
/begin MEASUREMENT HornCtl_ArmedSta "" UBYTE AppSwcBcm_CM_uint8 0 0 0 255 ECU_ADDRESS 0x0000 /* @ECU_Address@HornCtl_ArmedSta@ */ /end MEASUREMENT
/begin MEASUREMENT HornCtl_AntiLckSta "" UBYTE AppSwcBcm_CM_uint8 0 0 0 255 ECU_ADDRESS 0x0000 /* @ECU_Address@HornCtl_AntiLckSta@ */ /end MEASUREMENT
/begin MEASUREMENT HornCtl_AlarmSta "" UBYTE AppSwcBcm_CM_uint8 0 0 0 255 ECU_ADDRESS 0x0000 /* @ECU_Address@HornCtl_AlarmSta@ */ /end MEASUREMENT
/begin MEASUREMENT EEReadCtl_BodyWarnSts "" UBYTE AppSwcBcm_CM_uint8 0 0 0 255 ECU_ADDRESS 0x0000 /* @ECU_Address@EEReadCtl_BodyWarnSts@ */ /end MEASUREMENT
/begin MEASUREMENT EEReadCtl_FlwrMeHomeCtlFb "" UBYTE AppSwcBcm_CM_uint8 0 0 0 255 ECU_ADDRESS 0x0000 /* @ECU_Address@EEReadCtl_FlwrMeHomeCtlFb@ */ /end MEASUREMENT
/begin MEASUREMENT EEReadCtl_BackLadjvalFb "" UBYTE AppSwcBcm_CM_uint8 0 0 0 255 ECU_ADDRESS 0x0000 /* @ECU_Address@EEReadCtl_BackLadjvalFb@ */ /end MEASUREMENT
/begin MEASUREMENT EEReadCtl_HazardLightSta "" UBYTE AppSwcBcm_CM_uint8 0 0 0 255 ECU_ADDRESS 0x0000 /* @ECU_Address@EEReadCtl_HazardLightSta@ */ /end MEASUREMENT
/begin MEASUREMENT EEReadCtl_IllmndLckSts "" UBYTE AppSwcBcm_CM_uint8 0 0 0 255 ECU_ADDRESS 0x0000 /* @ECU_Address@EEReadCtl_IllmndLckSts@ */ /end MEASUREMENT
/begin MEASUREMENT EEReadCtl_SpdCtlLckSet "" UBYTE AppSwcBcm_CM_uint8 0 0 0 255 ECU_ADDRESS 0x0000 /* @ECU_Address@EEReadCtl_SpdCtlLckSet@ */ /end MEASUREMENT
/begin MEASUREMENT EEReadCtl_ParkAutoUnlockSetFb "" UBYTE AppSwcBcm_CM_uint8 0 0 0 255 ECU_ADDRESS 0x0000 /* @ECU_Address@EEReadCtl_ParkAutoUnlockSetFb@ */ /end MEASUREMENT
/begin MEASUREMENT EEReadCtl_LockHoornOnSts "" UBYTE AppSwcBcm_CM_uint8 0 0 0 255 ECU_ADDRESS 0x0000 /* @ECU_Address@EEReadCtl_LockHoornOnSts@ */ /end MEASUREMENT
/begin MEASUREMENT EEReadCtl_CrashSta "" UBYTE AppSwcBcm_CM_uint8 0 0 0 255 ECU_ADDRESS 0x0000 /* @ECU_Address@EEReadCtl_CrashSta@ */ /end MEASUREMENT
/begin MEASUREMENT EEReadCtl_IllmndUnlckSts "" UBYTE AppSwcBcm_CM_uint8 0 0 0 255 ECU_ADDRESS 0x0000 /* @ECU_Address@EEReadCtl_IllmndUnlckSts@ */ /end MEASUREMENT
/begin MEASUREMENT EEReadCtl_InrTim "" UBYTE AppSwcBcm_CM_uint8 0 0 0 255 ECU_ADDRESS 0x0000 /* @ECU_Address@EEReadCtl_InrTim@ */ /end MEASUREMENT
/begin MEASUREMENT EEReadCtl_WiprIntlTimeSetFb "" UBYTE AppSwcBcm_CM_uint8 0 0 0 255 ECU_ADDRESS 0x0000 /* @ECU_Address@EEReadCtl_WiprIntlTimeSetFb@ */ /end MEASUREMENT
/begin MEASUREMENT EEReadCtl_DoorOpRecord "" UBYTE AppSwcBcm_CM_uint8 0 0 0 255 ARRAY_SIZE 10 ECU_ADDRESS 0x0000 /* @ECU_Address@EEReadCtl_DoorOpRecord@ */ /end MEASUREMENT
/begin MEASUREMENT EEReadCtl_LocalStartFailOpRecord "" UBYTE AppSwcBcm_CM_uint8 0 0 0 255 ARRAY_SIZE 10 ECU_ADDRESS 0x0000 /* @ECU_Address@EEReadCtl_LocalStartFailOpRecord@ */ /end MEASUREMENT
/begin MEASUREMENT EEReadCtl_RemoteStartFailRecord "" UBYTE AppSwcBcm_CM_uint8 0 0 0 255 ARRAY_SIZE 10 ECU_ADDRESS 0x0000 /* @ECU_Address@EEReadCtl_RemoteStartFailRecord@ */ /end MEASUREMENT
/begin MEASUREMENT EEReadCtl_TrunkOpRecord "" UBYTE AppSwcBcm_CM_uint8 0 0 0 255 ARRAY_SIZE 10 ECU_ADDRESS 0x0000 /* @ECU_Address@EEReadCtl_TrunkOpRecord@ */ /end MEASUREMENT
/begin MEASUREMENT EEReadCtl_TrunkLckSw "" UBYTE AppSwcBcm_CM_uint8 0 0 0 255 ECU_ADDRESS 0x0000 /* @ECU_Address@EEReadCtl_TrunkLckSw@ */ /end MEASUREMENT
/begin MEASUREMENT PEPSCtl_UnlckWlcmReq "" UBYTE AppSwcBcm_CM_uint8 0 0 0 255 ECU_ADDRESS 0x0000 /* @ECU_Address@PEPSCtl_UnlckWlcmReq@ */ /end MEASUREMENT
/begin MEASUREMENT PEPSCtl_LckWlcmReq "" UBYTE AppSwcBcm_CM_uint8 0 0 0 255 ECU_ADDRESS 0x0000 /* @ECU_Address@PEPSCtl_LckWlcmReq@ */ /end MEASUREMENT
/begin MEASUREMENT PEPSCtl_IMMOKey "" UBYTE AppSwcBcm_CM_uint8 0 0 0 255 ECU_ADDRESS 0x0000 /* @ECU_Address@PEPSCtl_IMMOKey@ */ /end MEASUREMENT
/begin MEASUREMENT PEPSCtl_IndicationKeyCloser "" UBYTE AppSwcBcm_CM_uint8 0 0 0 255 ECU_ADDRESS 0x0000 /* @ECU_Address@PEPSCtl_IndicationKeyCloser@ */ /end MEASUREMENT
/begin MEASUREMENT PEPSCtl_WarnNoKeyFound "" UBYTE AppSwcBcm_CM_uint8 0 0 0 255 ECU_ADDRESS 0x0000 /* @ECU_Address@PEPSCtl_WarnNoKeyFound@ */ /end MEASUREMENT
/begin MEASUREMENT PEPSCtl_KeySta "" UBYTE AppSwcBcm_CM_uint8 0 0 0 255 ECU_ADDRESS 0x0000 /* @ECU_Address@PEPSCtl_KeySta@ */ /end MEASUREMENT
/begin MEASUREMENT PEPSCtl_PSAuthentRes "" UBYTE AppSwcBcm_CM_uint8 0 0 0 255 ECU_ADDRESS 0x0000 /* @ECU_Address@PEPSCtl_PSAuthentRes@ */ /end MEASUREMENT
/begin MEASUREMENT PEPSCtl_PSReq "" UBYTE AppSwcBcm_CM_uint8 0 0 0 255 ECU_ADDRESS 0x0000 /* @ECU_Address@PEPSCtl_PSReq@ */ /end MEASUREMENT
/begin MEASUREMENT PEPSCtl_AvaluebleKeyInCar "" UBYTE AppSwcBcm_CM_uint8 0 0 0 255 ECU_ADDRESS 0x0000 /* @ECU_Address@PEPSCtl_AvaluebleKeyInCar@ */ /end MEASUREMENT
/begin MEASUREMENT PEPSCtl_KeyInCarSta "" UBYTE AppSwcBcm_CM_uint8 0 0 0 255 ECU_ADDRESS 0x0000 /* @ECU_Address@PEPSCtl_KeyInCarSta@ */ /end MEASUREMENT
/begin MEASUREMENT PEPSCtl_FRPEAuthentAcsd "" UBYTE AppSwcBcm_CM_uint8 0 0 0 255 ECU_ADDRESS 0x0000 /* @ECU_Address@PEPSCtl_FRPEAuthentAcsd@ */ /end MEASUREMENT
/begin MEASUREMENT PEPSCtl_DrvPEAuthentAcsd "" UBYTE AppSwcBcm_CM_uint8 0 0 0 255 ECU_ADDRESS 0x0000 /* @ECU_Address@PEPSCtl_DrvPEAuthentAcsd@ */ /end MEASUREMENT
/begin MEASUREMENT PEPSCtl_KeyLoBattLvlWarn "" UBYTE AppSwcBcm_CM_uint8 0 0 0 255 ECU_ADDRESS 0x0000 /* @ECU_Address@PEPSCtl_KeyLoBattLvlWarn@ */ /end MEASUREMENT
/begin MEASUREMENT PEPSCtl_WarnKeyOutReminder "" UBYTE AppSwcBcm_CM_uint8 0 0 0 255 ECU_ADDRESS 0x0000 /* @ECU_Address@PEPSCtl_WarnKeyOutReminder@ */ /end MEASUREMENT
/begin MEASUREMENT PEPSCtl_FrbdnKeyNr "" UBYTE AppSwcBcm_CM_uint8 0 0 0 255 ECU_ADDRESS 0x0000 /* @ECU_Address@PEPSCtl_FrbdnKeyNr@ */ /end MEASUREMENT
/begin MEASUREMENT WinCtl_DrvWinReq "" UBYTE AppSwcBcm_CM_uint8 0 0 0 255 ECU_ADDRESS 0x0000 /* @ECU_Address@WinCtl_DrvWinReq@ */ /end MEASUREMENT
/begin MEASUREMENT WinCtl_PsgWinReq "" UBYTE AppSwcBcm_CM_uint8 0 0 0 255 ECU_ADDRESS 0x0000 /* @ECU_Address@WinCtl_PsgWinReq@ */ /end MEASUREMENT
/begin MEASUREMENT WinCtl_PsgWinSta "" UBYTE AppSwcBcm_CM_uint8 0 0 0 255 ECU_ADDRESS 0x0000 /* @ECU_Address@WinCtl_PsgWinSta@ */ /end MEASUREMENT
/begin MEASUREMENT WinCtl_DrvWinSta "" UBYTE AppSwcBcm_CM_uint8 0 0 0 255 ECU_ADDRESS 0x0000 /* @ECU_Address@WinCtl_DrvWinSta@ */ /end MEASUREMENT
/begin MEASUREMENT SteerWhlCtl_SteerWhlHeatSts "" UBYTE AppSwcBcm_CM_uint8 0 0 0 255 ECU_ADDRESS 0x0000 /* @ECU_Address@SteerWhlCtl_SteerWhlHeatSts@ */ /end MEASUREMENT
/begin MEASUREMENT SeatCtl_MaiDrvSeatStFb "" UBYTE AppSwcBcm_CM_uint8 0 0 0 255 ECU_ADDRESS 0x0000 /* @ECU_Address@SeatCtl_MaiDrvSeatStFb@ */ /end MEASUREMENT
/begin MEASUREMENT SeatCtl_CN167DrvSeatHtPWM "" UBYTE AppSwcBcm_CM_uint8 0 0 0 255 ECU_ADDRESS 0x0000 /* @ECU_Address@SeatCtl_CN167DrvSeatHtPWM@ */ /end MEASUREMENT
/begin MEASUREMENT IODID_TurnIndcrLCtlFlg "" UBYTE AppSwcBcm_CM_uint8 0 0 0 255 ECU_ADDRESS 0x0000 /* @ECU_Address@IODID_TurnIndcrLCtlFlg@ */ /end MEASUREMENT
/begin MEASUREMENT IODID_TurnIndcrRCtlFlg "" UBYTE AppSwcBcm_CM_uint8 0 0 0 255 ECU_ADDRESS 0x0000 /* @ECU_Address@IODID_TurnIndcrRCtlFlg@ */ /end MEASUREMENT
/begin MEASUREMENT IODID_LowBeamCtlFlg "" UBYTE AppSwcBcm_CM_uint8 0 0 0 255 ECU_ADDRESS 0x0000 /* @ECU_Address@IODID_LowBeamCtlFlg@ */ /end MEASUREMENT
/begin MEASUREMENT IODID_HiBeamCtlFlg "" UBYTE AppSwcBcm_CM_uint8 0 0 0 255 ECU_ADDRESS 0x0000 /* @ECU_Address@IODID_HiBeamCtlFlg@ */ /end MEASUREMENT
/begin MEASUREMENT IODID_FogLampFCtlFlg "" UBYTE AppSwcBcm_CM_uint8 0 0 0 255 ECU_ADDRESS 0x0000 /* @ECU_Address@IODID_FogLampFCtlFlg@ */ /end MEASUREMENT
/begin MEASUREMENT IODID_FogLampRCtlFlg "" UBYTE AppSwcBcm_CM_uint8 0 0 0 255 ECU_ADDRESS 0x0000 /* @ECU_Address@IODID_FogLampRCtlFlg@ */ /end MEASUREMENT
/begin MEASUREMENT IODID_BackLampCtlFlg "" UBYTE AppSwcBcm_CM_uint8 0 0 0 255 ECU_ADDRESS 0x0000 /* @ECU_Address@IODID_BackLampCtlFlg@ */ /end MEASUREMENT
/begin MEASUREMENT IODID_BrakeLightCtlFlg "" UBYTE AppSwcBcm_CM_uint8 0 0 0 255 ECU_ADDRESS 0x0000 /* @ECU_Address@IODID_BrakeLightCtlFlg@ */ /end MEASUREMENT
/begin MEASUREMENT IODID_ReverseLampCtlFlg "" UBYTE AppSwcBcm_CM_uint8 0 0 0 255 ECU_ADDRESS 0x0000 /* @ECU_Address@IODID_ReverseLampCtlFlg@ */ /end MEASUREMENT
/begin MEASUREMENT IODID_DayRunLightCtlFlg "" UBYTE AppSwcBcm_CM_uint8 0 0 0 255 ECU_ADDRESS 0x0000 /* @ECU_Address@IODID_DayRunLightCtlFlg@ */ /end MEASUREMENT
/begin MEASUREMENT IODID_PosLampCtlFlg "" UBYTE AppSwcBcm_CM_uint8 0 0 0 255 ECU_ADDRESS 0x0000 /* @ECU_Address@IODID_PosLampCtlFlg@ */ /end MEASUREMENT
/begin MEASUREMENT IODID_DomeLampCtlFlg "" UBYTE AppSwcBcm_CM_uint8 0 0 0 255 ECU_ADDRESS 0x0000 /* @ECU_Address@IODID_DomeLampCtlFlg@ */ /end MEASUREMENT
/begin MEASUREMENT IODID_DoorUnlckCtlFlg "" UBYTE AppSwcBcm_CM_uint8 0 0 0 255 ECU_ADDRESS 0x0000 /* @ECU_Address@IODID_DoorUnlckCtlFlg@ */ /end MEASUREMENT
/begin MEASUREMENT IODID_DoorLckCtlFlg "" UBYTE AppSwcBcm_CM_uint8 0 0 0 255 ECU_ADDRESS 0x0000 /* @ECU_Address@IODID_DoorLckCtlFlg@ */ /end MEASUREMENT
/begin MEASUREMENT IODID_TrunkUnlckCtlFlg "" UBYTE AppSwcBcm_CM_uint8 0 0 0 255 ECU_ADDRESS 0x0000 /* @ECU_Address@IODID_TrunkUnlckCtlFlg@ */ /end MEASUREMENT
/begin MEASUREMENT IODID_WiperHiSpdCtlFlg "" UBYTE AppSwcBcm_CM_uint8 0 0 0 255 ECU_ADDRESS 0x0000 /* @ECU_Address@IODID_WiperHiSpdCtlFlg@ */ /end MEASUREMENT
/begin MEASUREMENT IODID_WiperLowSpdCtlFlg "" UBYTE AppSwcBcm_CM_uint8 0 0 0 255 ECU_ADDRESS 0x0000 /* @ECU_Address@IODID_WiperLowSpdCtlFlg@ */ /end MEASUREMENT
/begin MEASUREMENT IODID_WinFLCtlFlg "" UBYTE AppSwcBcm_CM_uint8 0 0 0 255 ECU_ADDRESS 0x0000 /* @ECU_Address@IODID_WinFLCtlFlg@ */ /end MEASUREMENT
/begin MEASUREMENT IODID_WinFRCtlFlg "" UBYTE AppSwcBcm_CM_uint8 0 0 0 255 ECU_ADDRESS 0x0000 /* @ECU_Address@IODID_WinFRCtlFlg@ */ /end MEASUREMENT
/begin MEASUREMENT IODID_HornCtlFlg "" UBYTE AppSwcBcm_CM_uint8 0 0 0 255 ECU_ADDRESS 0x0000 /* @ECU_Address@IODID_HornCtlFlg@ */ /end MEASUREMENT
/begin MEASUREMENT IODID_BatSaveCtlFlg "" UBYTE AppSwcBcm_CM_uint8 0 0 0 255 ECU_ADDRESS 0x0000 /* @ECU_Address@IODID_BatSaveCtlFlg@ */ /end MEASUREMENT
/begin MEASUREMENT IODID_BSDRightCtlFlg "" UBYTE AppSwcBcm_CM_uint8 0 0 0 255 ECU_ADDRESS 0x0000 /* @ECU_Address@IODID_BSDRightCtlFlg@ */ /end MEASUREMENT
/begin MEASUREMENT IODID_BSDLeftCtlFlg "" UBYTE AppSwcBcm_CM_uint8 0 0 0 255 ECU_ADDRESS 0x0000 /* @ECU_Address@IODID_BSDLeftCtlFlg@ */ /end MEASUREMENT
/begin MEASUREMENT IODID_IG1RlyCtlFlg "" UBYTE AppSwcBcm_CM_uint8 0 0 0 255 ECU_ADDRESS 0x0000 /* @ECU_Address@IODID_IG1RlyCtlFlg@ */ /end MEASUREMENT
/begin MEASUREMENT IODID_IG2RlyCtlFlg "" UBYTE AppSwcBcm_CM_uint8 0 0 0 255 ECU_ADDRESS 0x0000 /* @ECU_Address@IODID_IG2RlyCtlFlg@ */ /end MEASUREMENT
/begin MEASUREMENT SteerWhlCtl_SteerWhlTemp "" SBYTE AppSwcBcm_CM_int8 0 0 -128 127 ECU_ADDRESS 0x0000 /* @ECU_Address@SteerWhlCtl_SteerWhlTemp@ */ /end MEASUREMENT
/begin MEASUREMENT SeatCtl_DrvSeatTemp "" SBYTE AppSwcBcm_CM_int8 0 0 -128 127 ECU_ADDRESS 0x0000 /* @ECU_Address@SeatCtl_DrvSeatTemp@ */ /end MEASUREMENT
/begin MEASUREMENT WakeUpCtl_SleepAllwd "" UBYTE AppSwcBcm_CM_boolean 0 0 0 1 ECU_ADDRESS 0x0000 /* @ECU_Address@WakeUpCtl_SleepAllwd@ */ /end MEASUREMENT
/begin MEASUREMENT WakeUpCtl_NMReq "" UBYTE AppSwcBcm_CM_boolean 0 0 0 1 ECU_ADDRESS 0x0000 /* @ECU_Address@WakeUpCtl_NMReq@ */ /end MEASUREMENT
/begin MEASUREMENT PDUCtl_StartReq "" UBYTE AppSwcBcm_CM_boolean 0 0 0 1 ECU_ADDRESS 0x0000 /* @ECU_Address@PDUCtl_StartReq@ */ /end MEASUREMENT
/begin MEASUREMENT PDUCtl_SysPwrModeV "" UBYTE AppSwcBcm_CM_boolean 0 0 0 1 ECU_ADDRESS 0x0000 /* @ECU_Address@PDUCtl_SysPwrModeV@ */ /end MEASUREMENT
/begin MEASUREMENT PDUCtl_IGRlyIlgCls "" UBYTE AppSwcBcm_CM_boolean 0 0 0 1 ECU_ADDRESS 0x0000 /* @ECU_Address@PDUCtl_IGRlyIlgCls@ */ /end MEASUREMENT
/begin MEASUREMENT PDUCtl_IG1RelayFault "" UBYTE AppSwcBcm_CM_boolean 0 0 0 1 ECU_ADDRESS 0x0000 /* @ECU_Address@PDUCtl_IG1RelayFault@ */ /end MEASUREMENT
/begin MEASUREMENT PDUCtl_IG2RelayFault "" UBYTE AppSwcBcm_CM_boolean 0 0 0 1 ECU_ADDRESS 0x0000 /* @ECU_Address@PDUCtl_IG2RelayFault@ */ /end MEASUREMENT
/begin MEASUREMENT PDUCtl_PwrOn "" UBYTE AppSwcBcm_CM_boolean 0 0 0 1 ECU_ADDRESS 0x0000 /* @ECU_Address@PDUCtl_PwrOn@ */ /end MEASUREMENT
/begin MEASUREMENT PDUCtl_PwrOff "" UBYTE AppSwcBcm_CM_boolean 0 0 0 1 ECU_ADDRESS 0x0000 /* @ECU_Address@PDUCtl_PwrOff@ */ /end MEASUREMENT
/begin MEASUREMENT ESCLCtl_J436PwrSup "" UBYTE AppSwcBcm_CM_boolean 0 0 0 1 ECU_ADDRESS 0x0000 /* @ECU_Address@ESCLCtl_J436PwrSup@ */ /end MEASUREMENT
/begin MEASUREMENT ESCLCtl_J436Unlck "" UBYTE AppSwcBcm_CM_boolean 0 0 0 1 ECU_ADDRESS 0x0000 /* @ECU_Address@ESCLCtl_J436Unlck@ */ /end MEASUREMENT
/begin MEASUREMENT ESCLCtl_J436Lck "" UBYTE AppSwcBcm_CM_boolean 0 0 0 1 ECU_ADDRESS 0x0000 /* @ECU_Address@ESCLCtl_J436Lck@ */ /end MEASUREMENT
/begin MEASUREMENT DoorLckCtl_VehStop "" UBYTE AppSwcBcm_CM_boolean 0 0 0 1 ECU_ADDRESS 0x0000 /* @ECU_Address@DoorLckCtl_VehStop@ */ /end MEASUREMENT
/begin MEASUREMENT DoorLckCtl_VehRun "" UBYTE AppSwcBcm_CM_boolean 0 0 0 1 ECU_ADDRESS 0x0000 /* @ECU_Address@DoorLckCtl_VehRun@ */ /end MEASUREMENT
/begin MEASUREMENT DoorLckCtl_HoodAjarSw "" UBYTE AppSwcBcm_CM_boolean 0 0 0 1 ECU_ADDRESS 0x0000 /* @ECU_Address@DoorLckCtl_HoodAjarSw@ */ /end MEASUREMENT
/begin MEASUREMENT DoorLckCtl_TrunkAjarSw "" UBYTE AppSwcBcm_CM_boolean 0 0 0 1 ECU_ADDRESS 0x0000 /* @ECU_Address@DoorLckCtl_TrunkAjarSw@ */ /end MEASUREMENT
/begin MEASUREMENT DoorLckCtl_DoorAjarRRSw "" UBYTE AppSwcBcm_CM_boolean 0 0 0 1 ECU_ADDRESS 0x0000 /* @ECU_Address@DoorLckCtl_DoorAjarRRSw@ */ /end MEASUREMENT
/begin MEASUREMENT DoorLckCtl_DoorAjarRLSw "" UBYTE AppSwcBcm_CM_boolean 0 0 0 1 ECU_ADDRESS 0x0000 /* @ECU_Address@DoorLckCtl_DoorAjarRLSw@ */ /end MEASUREMENT
/begin MEASUREMENT DoorLckCtl_TrunkSw "" UBYTE AppSwcBcm_CM_boolean 0 0 0 1 ECU_ADDRESS 0x0000 /* @ECU_Address@DoorLckCtl_TrunkSw@ */ /end MEASUREMENT
/begin MEASUREMENT DoorLckCtl_PsgPESw "" UBYTE AppSwcBcm_CM_boolean 0 0 0 1 ECU_ADDRESS 0x0000 /* @ECU_Address@DoorLckCtl_PsgPESw@ */ /end MEASUREMENT
/begin MEASUREMENT DoorLckCtl_DrvPESw "" UBYTE AppSwcBcm_CM_boolean 0 0 0 1 ECU_ADDRESS 0x0000 /* @ECU_Address@DoorLckCtl_DrvPESw@ */ /end MEASUREMENT
/begin MEASUREMENT DoorLckCtl_DoorAjarFRSw "" UBYTE AppSwcBcm_CM_boolean 0 0 0 1 ECU_ADDRESS 0x0000 /* @ECU_Address@DoorLckCtl_DoorAjarFRSw@ */ /end MEASUREMENT
/begin MEASUREMENT DoorLckCtl_DrvSeatSw "" UBYTE AppSwcBcm_CM_boolean 0 0 0 1 ECU_ADDRESS 0x0000 /* @ECU_Address@DoorLckCtl_DrvSeatSw@ */ /end MEASUREMENT
/begin MEASUREMENT DoorLckCtl_DoorAjarFLSw "" UBYTE AppSwcBcm_CM_boolean 0 0 0 1 ECU_ADDRESS 0x0000 /* @ECU_Address@DoorLckCtl_DoorAjarFLSw@ */ /end MEASUREMENT
/begin MEASUREMENT DoorLckCtl_DriverDoorLckSw "" UBYTE AppSwcBcm_CM_boolean 0 0 0 1 ECU_ADDRESS 0x0000 /* @ECU_Address@DoorLckCtl_DriverDoorLckSw@ */ /end MEASUREMENT
/begin MEASUREMENT DoorLckCtl_J56DoorUnlck "" UBYTE AppSwcBcm_CM_boolean 0 0 0 1 ECU_ADDRESS 0x0000 /* @ECU_Address@DoorLckCtl_J56DoorUnlck@ */ /end MEASUREMENT
/begin MEASUREMENT DoorLckCtl_J511TrunkUnlck "" UBYTE AppSwcBcm_CM_boolean 0 0 0 1 ECU_ADDRESS 0x0000 /* @ECU_Address@DoorLckCtl_J511TrunkUnlck@ */ /end MEASUREMENT
/begin MEASUREMENT DoorLckCtl_J54DoorLck "" UBYTE AppSwcBcm_CM_boolean 0 0 0 1 ECU_ADDRESS 0x0000 /* @ECU_Address@DoorLckCtl_J54DoorLck@ */ /end MEASUREMENT
/begin MEASUREMENT DoorLckCtl_HULck "" UBYTE AppSwcBcm_CM_boolean 0 0 0 1 ECU_ADDRESS 0x0000 /* @ECU_Address@DoorLckCtl_HULck@ */ /end MEASUREMENT
/begin MEASUREMENT DoorLckCtl_RKEAntiLck "" UBYTE AppSwcBcm_CM_boolean 0 0 0 1 ECU_ADDRESS 0x0000 /* @ECU_Address@DoorLckCtl_RKEAntiLck@ */ /end MEASUREMENT
/begin MEASUREMENT DoorLckCtl_MechLck "" UBYTE AppSwcBcm_CM_boolean 0 0 0 1 ECU_ADDRESS 0x0000 /* @ECU_Address@DoorLckCtl_MechLck@ */ /end MEASUREMENT
/begin MEASUREMENT DoorLckCtl_MechAntiLck "" UBYTE AppSwcBcm_CM_boolean 0 0 0 1 ECU_ADDRESS 0x0000 /* @ECU_Address@DoorLckCtl_MechAntiLck@ */ /end MEASUREMENT
/begin MEASUREMENT DoorLckCtl_PELck "" UBYTE AppSwcBcm_CM_boolean 0 0 0 1 ECU_ADDRESS 0x0000 /* @ECU_Address@DoorLckCtl_PELck@ */ /end MEASUREMENT
/begin MEASUREMENT DoorLckCtl_WelcomeLck "" UBYTE AppSwcBcm_CM_boolean 0 0 0 1 ECU_ADDRESS 0x0000 /* @ECU_Address@DoorLckCtl_WelcomeLck@ */ /end MEASUREMENT
/begin MEASUREMENT DoorLckCtl_TrunkUnlck "" UBYTE AppSwcBcm_CM_boolean 0 0 0 1 ECU_ADDRESS 0x0000 /* @ECU_Address@DoorLckCtl_TrunkUnlck@ */ /end MEASUREMENT
/begin MEASUREMENT DoorLckCtl_OsLck "" UBYTE AppSwcBcm_CM_boolean 0 0 0 1 ECU_ADDRESS 0x0000 /* @ECU_Address@DoorLckCtl_OsLck@ */ /end MEASUREMENT
/begin MEASUREMENT DoorLckCtl_SpdLck "" UBYTE AppSwcBcm_CM_boolean 0 0 0 1 ECU_ADDRESS 0x0000 /* @ECU_Address@DoorLckCtl_SpdLck@ */ /end MEASUREMENT
/begin MEASUREMENT DoorLckCtl_InsLck "" UBYTE AppSwcBcm_CM_boolean 0 0 0 1 ECU_ADDRESS 0x0000 /* @ECU_Address@DoorLckCtl_InsLck@ */ /end MEASUREMENT
/begin MEASUREMENT DoorLckCtl_HUUnLck "" UBYTE AppSwcBcm_CM_boolean 0 0 0 1 ECU_ADDRESS 0x0000 /* @ECU_Address@DoorLckCtl_HUUnLck@ */ /end MEASUREMENT
/begin MEASUREMENT DoorLckCtl_ParkUnlck "" UBYTE AppSwcBcm_CM_boolean 0 0 0 1 ECU_ADDRESS 0x0000 /* @ECU_Address@DoorLckCtl_ParkUnlck@ */ /end MEASUREMENT
/begin MEASUREMENT DoorLckCtl_InsUnlck "" UBYTE AppSwcBcm_CM_boolean 0 0 0 1 ECU_ADDRESS 0x0000 /* @ECU_Address@DoorLckCtl_InsUnlck@ */ /end MEASUREMENT
/begin MEASUREMENT DoorLckCtl_PEUnlck "" UBYTE AppSwcBcm_CM_boolean 0 0 0 1 ECU_ADDRESS 0x0000 /* @ECU_Address@DoorLckCtl_PEUnlck@ */ /end MEASUREMENT
/begin MEASUREMENT DoorLckCtl_WelcomeUnlck "" UBYTE AppSwcBcm_CM_boolean 0 0 0 1 ECU_ADDRESS 0x0000 /* @ECU_Address@DoorLckCtl_WelcomeUnlck@ */ /end MEASUREMENT
/begin MEASUREMENT DoorLckCtl_MechUnlck "" UBYTE AppSwcBcm_CM_boolean 0 0 0 1 ECU_ADDRESS 0x0000 /* @ECU_Address@DoorLckCtl_MechUnlck@ */ /end MEASUREMENT
/begin MEASUREMENT DoorLckCtl_OsUnlck "" UBYTE AppSwcBcm_CM_boolean 0 0 0 1 ECU_ADDRESS 0x0000 /* @ECU_Address@DoorLckCtl_OsUnlck@ */ /end MEASUREMENT
/begin MEASUREMENT DoorLckCtl_MotorProt "" UBYTE AppSwcBcm_CM_boolean 0 0 0 1 ECU_ADDRESS 0x0000 /* @ECU_Address@DoorLckCtl_MotorProt@ */ /end MEASUREMENT
/begin MEASUREMENT DoorLckCtl_TrunkHUUnlck "" UBYTE AppSwcBcm_CM_boolean 0 0 0 1 ECU_ADDRESS 0x0000 /* @ECU_Address@DoorLckCtl_TrunkHUUnlck@ */ /end MEASUREMENT
/begin MEASUREMENT DoorLckCtl_TrunkRKEUnlck "" UBYTE AppSwcBcm_CM_boolean 0 0 0 1 ECU_ADDRESS 0x0000 /* @ECU_Address@DoorLckCtl_TrunkRKEUnlck@ */ /end MEASUREMENT
/begin MEASUREMENT DoorLckCtl_RKEUnlck "" UBYTE AppSwcBcm_CM_boolean 0 0 0 1 ECU_ADDRESS 0x0000 /* @ECU_Address@DoorLckCtl_RKEUnlck@ */ /end MEASUREMENT
/begin MEASUREMENT DoorLckCtl_TrunkAutoLck "" UBYTE AppSwcBcm_CM_boolean 0 0 0 1 ECU_ADDRESS 0x0000 /* @ECU_Address@DoorLckCtl_TrunkAutoLck@ */ /end MEASUREMENT
/begin MEASUREMENT DoorLckCtl_RKELck "" UBYTE AppSwcBcm_CM_boolean 0 0 0 1 ECU_ADDRESS 0x0000 /* @ECU_Address@DoorLckCtl_RKELck@ */ /end MEASUREMENT
/begin MEASUREMENT DoorLckCtl_AutoLckSta "" UBYTE AppSwcBcm_CM_boolean 0 0 0 1 ECU_ADDRESS 0x0000 /* @ECU_Address@DoorLckCtl_AutoLckSta@ */ /end MEASUREMENT
/begin MEASUREMENT DoorLckCtl_AutoLck "" UBYTE AppSwcBcm_CM_boolean 0 0 0 1 ECU_ADDRESS 0x0000 /* @ECU_Address@DoorLckCtl_AutoLck@ */ /end MEASUREMENT
/begin MEASUREMENT DoorLckCtl_ThermRunawayUnlck "" UBYTE AppSwcBcm_CM_boolean 0 0 0 1 ECU_ADDRESS 0x0000 /* @ECU_Address@DoorLckCtl_ThermRunawayUnlck@ */ /end MEASUREMENT
/begin MEASUREMENT DoorLckCtl_CrshUnlck "" UBYTE AppSwcBcm_CM_boolean 0 0 0 1 ECU_ADDRESS 0x0000 /* @ECU_Address@DoorLckCtl_CrshUnlck@ */ /end MEASUREMENT
/begin MEASUREMENT DoorLckCtl_DoorProtUnlck "" UBYTE AppSwcBcm_CM_boolean 0 0 0 1 ECU_ADDRESS 0x0000 /* @ECU_Address@DoorLckCtl_DoorProtUnlck@ */ /end MEASUREMENT
/begin MEASUREMENT DoorLckCtl_TrunkLckSw "" UBYTE AppSwcBcm_CM_boolean 0 0 0 1 ECU_ADDRESS 0x0000 /* @ECU_Address@DoorLckCtl_TrunkLckSw@ */ /end MEASUREMENT
/begin MEASUREMENT BatSaveCtl_PwrModeOn "" UBYTE AppSwcBcm_CM_boolean 0 0 0 1 ECU_ADDRESS 0x0000 /* @ECU_Address@BatSaveCtl_PwrModeOn@ */ /end MEASUREMENT
/begin MEASUREMENT BatSaveCtl_DoorUnlckPwrOn "" UBYTE AppSwcBcm_CM_boolean 0 0 0 1 ECU_ADDRESS 0x0000 /* @ECU_Address@BatSaveCtl_DoorUnlckPwrOn@ */ /end MEASUREMENT
/begin MEASUREMENT BatSaveCtl_DoorChgSta "" UBYTE AppSwcBcm_CM_boolean 0 0 0 1 ECU_ADDRESS 0x0000 /* @ECU_Address@BatSaveCtl_DoorChgSta@ */ /end MEASUREMENT
/begin MEASUREMENT BatSaveCtl_PwrOn "" UBYTE AppSwcBcm_CM_boolean 0 0 0 1 ECU_ADDRESS 0x0000 /* @ECU_Address@BatSaveCtl_PwrOn@ */ /end MEASUREMENT
/begin MEASUREMENT BatSaveCtl_PwrOff "" UBYTE AppSwcBcm_CM_boolean 0 0 0 1 ECU_ADDRESS 0x0000 /* @ECU_Address@BatSaveCtl_PwrOff@ */ /end MEASUREMENT
/begin MEASUREMENT BatSaveCtl_DoorLckPwrOff "" UBYTE AppSwcBcm_CM_boolean 0 0 0 1 ECU_ADDRESS 0x0000 /* @ECU_Address@BatSaveCtl_DoorLckPwrOff@ */ /end MEASUREMENT
/begin MEASUREMENT BatSaveCtl_PwrModeOff "" UBYTE AppSwcBcm_CM_boolean 0 0 0 1 ECU_ADDRESS 0x0000 /* @ECU_Address@BatSaveCtl_PwrModeOff@ */ /end MEASUREMENT
/begin MEASUREMENT BatSaveCtl_J64SavePwr "" UBYTE AppSwcBcm_CM_boolean 0 0 0 1 ECU_ADDRESS 0x0000 /* @ECU_Address@BatSaveCtl_J64SavePwr@ */ /end MEASUREMENT
/begin MEASUREMENT AlmSysCtl_AlrmWarnTimOut "" UBYTE AppSwcBcm_CM_boolean 0 0 0 1 ECU_ADDRESS 0x0000 /* @ECU_Address@AlmSysCtl_AlrmWarnTimOut@ */ /end MEASUREMENT
/begin MEASUREMENT SCS_FrntWshrSwtSt "" UBYTE AppSwcBcm_CM_boolean 0 0 0 1 ECU_ADDRESS 0x0000 /* @ECU_Address@SCS_FrntWshrSwtSt@ */ /end MEASUREMENT
/begin MEASUREMENT SCS_FrntWshrSwtStVD "" UBYTE AppSwcBcm_CM_boolean 0 0 0 1 ECU_ADDRESS 0x0000 /* @ECU_Address@SCS_FrntWshrSwtStVD@ */ /end MEASUREMENT
/begin MEASUREMENT SCS_WiprSwtStVD "" UBYTE AppSwcBcm_CM_boolean 0 0 0 1 ECU_ADDRESS 0x0000 /* @ECU_Address@SCS_WiprSwtStVD@ */ /end MEASUREMENT
/begin MEASUREMENT WiperCtl_WiperOffSta "" UBYTE AppSwcBcm_CM_boolean 0 0 0 1 ECU_ADDRESS 0x0000 /* @ECU_Address@WiperCtl_WiperOffSta@ */ /end MEASUREMENT
/begin MEASUREMENT WiperCtl_WiperMistSta "" UBYTE AppSwcBcm_CM_boolean 0 0 0 1 ECU_ADDRESS 0x0000 /* @ECU_Address@WiperCtl_WiperMistSta@ */ /end MEASUREMENT
/begin MEASUREMENT WiperCtl_WiperMaintSta "" UBYTE AppSwcBcm_CM_boolean 0 0 0 1 ECU_ADDRESS 0x0000 /* @ECU_Address@WiperCtl_WiperMaintSta@ */ /end MEASUREMENT
/begin MEASUREMENT WiperCtl_WiperLowSpdSta "" UBYTE AppSwcBcm_CM_boolean 0 0 0 1 ECU_ADDRESS 0x0000 /* @ECU_Address@WiperCtl_WiperLowSpdSta@ */ /end MEASUREMENT
/begin MEASUREMENT WiperCtl_WiperInrSta "" UBYTE AppSwcBcm_CM_boolean 0 0 0 1 ECU_ADDRESS 0x0000 /* @ECU_Address@WiperCtl_WiperInrSta@ */ /end MEASUREMENT
/begin MEASUREMENT WiperCtl_InrTimChg "" UBYTE AppSwcBcm_CM_boolean 0 0 0 1 ECU_ADDRESS 0x0000 /* @ECU_Address@WiperCtl_InrTimChg@ */ /end MEASUREMENT
/begin MEASUREMENT WiperCtl_WiperHiSpdSta "" UBYTE AppSwcBcm_CM_boolean 0 0 0 1 ECU_ADDRESS 0x0000 /* @ECU_Address@WiperCtl_WiperHiSpdSta@ */ /end MEASUREMENT
/begin MEASUREMENT WiperCtl_WashWiperSta "" UBYTE AppSwcBcm_CM_boolean 0 0 0 1 ECU_ADDRESS 0x0000 /* @ECU_Address@WiperCtl_WashWiperSta@ */ /end MEASUREMENT
/begin MEASUREMENT WiperCtl_WiperParkPosSw "" UBYTE AppSwcBcm_CM_boolean 0 0 0 1 ECU_ADDRESS 0x0000 /* @ECU_Address@WiperCtl_WiperParkPosSw@ */ /end MEASUREMENT
/begin MEASUREMENT WiperCtl_WashSw "" UBYTE AppSwcBcm_CM_boolean 0 0 0 1 ECU_ADDRESS 0x0000 /* @ECU_Address@WiperCtl_WashSw@ */ /end MEASUREMENT
/begin MEASUREMENT WiperCtl_WiperHiSpdSw "" UBYTE AppSwcBcm_CM_boolean 0 0 0 1 ECU_ADDRESS 0x0000 /* @ECU_Address@WiperCtl_WiperHiSpdSw@ */ /end MEASUREMENT
/begin MEASUREMENT WiperCtl_WiperLowSpdSw "" UBYTE AppSwcBcm_CM_boolean 0 0 0 1 ECU_ADDRESS 0x0000 /* @ECU_Address@WiperCtl_WiperLowSpdSw@ */ /end MEASUREMENT
/begin MEASUREMENT WiperCtl_WiperInrSw "" UBYTE AppSwcBcm_CM_boolean 0 0 0 1 ECU_ADDRESS 0x0000 /* @ECU_Address@WiperCtl_WiperInrSw@ */ /end MEASUREMENT
/begin MEASUREMENT WiperCtl_WiperOffSw "" UBYTE AppSwcBcm_CM_boolean 0 0 0 1 ECU_ADDRESS 0x0000 /* @ECU_Address@WiperCtl_WiperOffSw@ */ /end MEASUREMENT
/begin MEASUREMENT WiperCtl_WiperMistSw "" UBYTE AppSwcBcm_CM_boolean 0 0 0 1 ECU_ADDRESS 0x0000 /* @ECU_Address@WiperCtl_WiperMistSw@ */ /end MEASUREMENT
/begin MEASUREMENT WiperCtl_WashMotorDrv "" UBYTE AppSwcBcm_CM_boolean 0 0 0 1 ECU_ADDRESS 0x0000 /* @ECU_Address@WiperCtl_WashMotorDrv@ */ /end MEASUREMENT
/begin MEASUREMENT WiperCtl_HiSpdDrv "" UBYTE AppSwcBcm_CM_boolean 0 0 0 1 ECU_ADDRESS 0x0000 /* @ECU_Address@WiperCtl_HiSpdDrv@ */ /end MEASUREMENT
/begin MEASUREMENT WiperCtl_LowSpdDrv "" UBYTE AppSwcBcm_CM_boolean 0 0 0 1 ECU_ADDRESS 0x0000 /* @ECU_Address@WiperCtl_LowSpdDrv@ */ /end MEASUREMENT
/begin MEASUREMENT WiperCtl_LockedRotorProtSta "" UBYTE AppSwcBcm_CM_boolean 0 0 0 1 ECU_ADDRESS 0x0000 /* @ECU_Address@WiperCtl_LockedRotorProtSta@ */ /end MEASUREMENT
/begin MEASUREMENT LampCtl_FlwrMeHomeSta "" UBYTE AppSwcBcm_CM_boolean 0 0 0 1 ECU_ADDRESS 0x0000 /* @ECU_Address@LampCtl_FlwrMeHomeSta@ */ /end MEASUREMENT
/begin MEASUREMENT LampCtl_WelcomeLampSta "" UBYTE AppSwcBcm_CM_boolean 0 0 0 1 ECU_ADDRESS 0x0000 /* @ECU_Address@LampCtl_WelcomeLampSta@ */ /end MEASUREMENT
/begin MEASUREMENT LampCtl_EmerSta "" UBYTE AppSwcBcm_CM_boolean 0 0 0 1 ECU_ADDRESS 0x0000 /* @ECU_Address@LampCtl_EmerSta@ */ /end MEASUREMENT
/begin MEASUREMENT LampCtl_TurnIndcrLOpen "" UBYTE AppSwcBcm_CM_boolean 0 0 0 1 ECU_ADDRESS 0x0000 /* @ECU_Address@LampCtl_TurnIndcrLOpen@ */ /end MEASUREMENT
/begin MEASUREMENT LampCtl_TurnIndcrLShort "" UBYTE AppSwcBcm_CM_boolean 0 0 0 1 ECU_ADDRESS 0x0000 /* @ECU_Address@LampCtl_TurnIndcrLShort@ */ /end MEASUREMENT
/begin MEASUREMENT LampCtl_TurnIndcrROpen "" UBYTE AppSwcBcm_CM_boolean 0 0 0 1 ECU_ADDRESS 0x0000 /* @ECU_Address@LampCtl_TurnIndcrROpen@ */ /end MEASUREMENT
/begin MEASUREMENT LampCtl_TurnIndcrRShort "" UBYTE AppSwcBcm_CM_boolean 0 0 0 1 ECU_ADDRESS 0x0000 /* @ECU_Address@LampCtl_TurnIndcrRShort@ */ /end MEASUREMENT
/begin MEASUREMENT LampCtl_VehSeekSta "" UBYTE AppSwcBcm_CM_boolean 0 0 0 1 ECU_ADDRESS 0x0000 /* @ECU_Address@LampCtl_VehSeekSta@ */ /end MEASUREMENT
/begin MEASUREMENT LampCtl_TurnIndcrRst "" UBYTE AppSwcBcm_CM_boolean 0 0 0 1 ECU_ADDRESS 0x0000 /* @ECU_Address@LampCtl_TurnIndcrRst@ */ /end MEASUREMENT
/begin MEASUREMENT LampCtl_TrunkWarnSta "" UBYTE AppSwcBcm_CM_boolean 0 0 0 1 ECU_ADDRESS 0x0000 /* @ECU_Address@LampCtl_TrunkWarnSta@ */ /end MEASUREMENT
/begin MEASUREMENT LampCtl_ThermalrunawaySta "" UBYTE AppSwcBcm_CM_boolean 0 0 0 1 ECU_ADDRESS 0x0000 /* @ECU_Address@LampCtl_ThermalrunawaySta@ */ /end MEASUREMENT
/begin MEASUREMENT LampCtl_RodBeamFaultSta "" UBYTE AppSwcBcm_CM_boolean 0 0 0 1 ECU_ADDRESS 0x0000 /* @ECU_Address@LampCtl_RodBeamFaultSta@ */ /end MEASUREMENT
/begin MEASUREMENT LampCtl_HazardLightSta "" UBYTE AppSwcBcm_CM_boolean 0 0 0 1 ECU_ADDRESS 0x0000 /* @ECU_Address@LampCtl_HazardLightSta@ */ /end MEASUREMENT
/begin MEASUREMENT LampCtl_EmerHazardLightSta "" UBYTE AppSwcBcm_CM_boolean 0 0 0 1 ECU_ADDRESS 0x0000 /* @ECU_Address@LampCtl_EmerHazardLightSta@ */ /end MEASUREMENT
/begin MEASUREMENT LampCtl_DisarmedSta "" UBYTE AppSwcBcm_CM_boolean 0 0 0 1 ECU_ADDRESS 0x0000 /* @ECU_Address@LampCtl_DisarmedSta@ */ /end MEASUREMENT
/begin MEASUREMENT LampCtl_CrashSta "" UBYTE AppSwcBcm_CM_boolean 0 0 0 1 ECU_ADDRESS 0x0000 /* @ECU_Address@LampCtl_CrashSta@ */ /end MEASUREMENT
/begin MEASUREMENT LampCtl_ArmedSta "" UBYTE AppSwcBcm_CM_boolean 0 0 0 1 ECU_ADDRESS 0x0000 /* @ECU_Address@LampCtl_ArmedSta@ */ /end MEASUREMENT
/begin MEASUREMENT LampCtl_AntiLckSta "" UBYTE AppSwcBcm_CM_boolean 0 0 0 1 ECU_ADDRESS 0x0000 /* @ECU_Address@LampCtl_AntiLckSta@ */ /end MEASUREMENT
/begin MEASUREMENT LampCtl_AlrmSta "" UBYTE AppSwcBcm_CM_boolean 0 0 0 1 ECU_ADDRESS 0x0000 /* @ECU_Address@LampCtl_AlrmSta@ */ /end MEASUREMENT
/begin MEASUREMENT LampCtl_BrakeLightSw "" UBYTE AppSwcBcm_CM_boolean 0 0 0 1 ECU_ADDRESS 0x0000 /* @ECU_Address@LampCtl_BrakeLightSw@ */ /end MEASUREMENT
/begin MEASUREMENT LampCtl_FogLampRSw "" UBYTE AppSwcBcm_CM_boolean 0 0 0 1 ECU_ADDRESS 0x0000 /* @ECU_Address@LampCtl_FogLampRSw@ */ /end MEASUREMENT
/begin MEASUREMENT LampCtl_AutoLampSw "" UBYTE AppSwcBcm_CM_boolean 0 0 0 1 ECU_ADDRESS 0x0000 /* @ECU_Address@LampCtl_AutoLampSw@ */ /end MEASUREMENT
/begin MEASUREMENT LampCtl_TurnIndcrLaneRSw "" UBYTE AppSwcBcm_CM_boolean 0 0 0 1 ECU_ADDRESS 0x0000 /* @ECU_Address@LampCtl_TurnIndcrLaneRSw@ */ /end MEASUREMENT
/begin MEASUREMENT LampCtl_TurnIndcrRSw "" UBYTE AppSwcBcm_CM_boolean 0 0 0 1 ECU_ADDRESS 0x0000 /* @ECU_Address@LampCtl_TurnIndcrRSw@ */ /end MEASUREMENT
/begin MEASUREMENT LampCtl_TurnIndcrLaneLSw "" UBYTE AppSwcBcm_CM_boolean 0 0 0 1 ECU_ADDRESS 0x0000 /* @ECU_Address@LampCtl_TurnIndcrLaneLSw@ */ /end MEASUREMENT
/begin MEASUREMENT LampCtl_TurnIndcrLSw "" UBYTE AppSwcBcm_CM_boolean 0 0 0 1 ECU_ADDRESS 0x0000 /* @ECU_Address@LampCtl_TurnIndcrLSw@ */ /end MEASUREMENT
/begin MEASUREMENT LampCtl_PassLightSw "" UBYTE AppSwcBcm_CM_boolean 0 0 0 1 ECU_ADDRESS 0x0000 /* @ECU_Address@LampCtl_PassLightSw@ */ /end MEASUREMENT
/begin MEASUREMENT LampCtl_HiBeamSw "" UBYTE AppSwcBcm_CM_boolean 0 0 0 1 ECU_ADDRESS 0x0000 /* @ECU_Address@LampCtl_HiBeamSw@ */ /end MEASUREMENT
/begin MEASUREMENT LampCtl_FogLampFSw "" UBYTE AppSwcBcm_CM_boolean 0 0 0 1 ECU_ADDRESS 0x0000 /* @ECU_Address@LampCtl_FogLampFSw@ */ /end MEASUREMENT
/begin MEASUREMENT LampCtl_HazardLightSw "" UBYTE AppSwcBcm_CM_boolean 0 0 0 1 ECU_ADDRESS 0x0000 /* @ECU_Address@LampCtl_HazardLightSw@ */ /end MEASUREMENT
/begin MEASUREMENT LampCtl_LowBeamSw "" UBYTE AppSwcBcm_CM_boolean 0 0 0 1 ECU_ADDRESS 0x0000 /* @ECU_Address@LampCtl_LowBeamSw@ */ /end MEASUREMENT
/begin MEASUREMENT LampCtl_PosLampSw "" UBYTE AppSwcBcm_CM_boolean 0 0 0 1 ECU_ADDRESS 0x0000 /* @ECU_Address@LampCtl_PosLampSw@ */ /end MEASUREMENT
/begin MEASUREMENT LampCtl_PassLightSta "" UBYTE AppSwcBcm_CM_boolean 0 0 0 1 ECU_ADDRESS 0x0000 /* @ECU_Address@LampCtl_PassLightSta@ */ /end MEASUREMENT
/begin MEASUREMENT LampCtl_HiBeamSta "" UBYTE AppSwcBcm_CM_boolean 0 0 0 1 ECU_ADDRESS 0x0000 /* @ECU_Address@LampCtl_HiBeamSta@ */ /end MEASUREMENT
/begin MEASUREMENT LampCtl_ReverseLampSta "" UBYTE AppSwcBcm_CM_boolean 0 0 0 1 ECU_ADDRESS 0x0000 /* @ECU_Address@LampCtl_ReverseLampSta@ */ /end MEASUREMENT
/begin MEASUREMENT LampCtl_FogLampFSta "" UBYTE AppSwcBcm_CM_boolean 0 0 0 1 ECU_ADDRESS 0x0000 /* @ECU_Address@LampCtl_FogLampFSta@ */ /end MEASUREMENT
/begin MEASUREMENT LampCtl_FogLampRSta "" UBYTE AppSwcBcm_CM_boolean 0 0 0 1 ECU_ADDRESS 0x0000 /* @ECU_Address@LampCtl_FogLampRSta@ */ /end MEASUREMENT
/begin MEASUREMENT LampCtl_LowBeamSta "" UBYTE AppSwcBcm_CM_boolean 0 0 0 1 ECU_ADDRESS 0x0000 /* @ECU_Address@LampCtl_LowBeamSta@ */ /end MEASUREMENT
/begin MEASUREMENT LampCtl_J422BSDLeftCtl "" UBYTE AppSwcBcm_CM_boolean 0 0 0 1 ECU_ADDRESS 0x0000 /* @ECU_Address@LampCtl_J422BSDLeftCtl@ */ /end MEASUREMENT
/begin MEASUREMENT LampCtl_J420BSDRightCtl "" UBYTE AppSwcBcm_CM_boolean 0 0 0 1 ECU_ADDRESS 0x0000 /* @ECU_Address@LampCtl_J420BSDRightCtl@ */ /end MEASUREMENT
/begin MEASUREMENT LampCtl_BrakeLightSta "" UBYTE AppSwcBcm_CM_boolean 0 0 0 1 ECU_ADDRESS 0x0000 /* @ECU_Address@LampCtl_BrakeLightSta@ */ /end MEASUREMENT
/begin MEASUREMENT LampCtl_J449BoxLamp "" UBYTE AppSwcBcm_CM_boolean 0 0 0 1 ECU_ADDRESS 0x0000 /* @ECU_Address@LampCtl_J449BoxLamp@ */ /end MEASUREMENT
/begin MEASUREMENT LampCtl_TurnIndcrLSta "" UBYTE AppSwcBcm_CM_boolean 0 0 0 1 ECU_ADDRESS 0x0000 /* @ECU_Address@LampCtl_TurnIndcrLSta@ */ /end MEASUREMENT
/begin MEASUREMENT LampCtl_TurnIndcrRSta "" UBYTE AppSwcBcm_CM_boolean 0 0 0 1 ECU_ADDRESS 0x0000 /* @ECU_Address@LampCtl_TurnIndcrRSta@ */ /end MEASUREMENT
/begin MEASUREMENT LampCtl_DayRunLightSta "" UBYTE AppSwcBcm_CM_boolean 0 0 0 1 ECU_ADDRESS 0x0000 /* @ECU_Address@LampCtl_DayRunLightSta@ */ /end MEASUREMENT
/begin MEASUREMENT LampCtl_PosLampSta "" UBYTE AppSwcBcm_CM_boolean 0 0 0 1 ECU_ADDRESS 0x0000 /* @ECU_Address@LampCtl_PosLampSta@ */ /end MEASUREMENT
/begin MEASUREMENT LampCtl_LowBeamShortToBat "" UBYTE AppSwcBcm_CM_boolean 0 0 0 1 ECU_ADDRESS 0x0000 /* @ECU_Address@LampCtl_LowBeamShortToBat@ */ /end MEASUREMENT
/begin MEASUREMENT LampCtl_LampDelay "" UBYTE AppSwcBcm_CM_boolean 0 0 0 1 ECU_ADDRESS 0x0000 /* @ECU_Address@LampCtl_LampDelay@ */ /end MEASUREMENT
/begin MEASUREMENT LampCtl_KnobBeamFaultSta "" UBYTE AppSwcBcm_CM_boolean 0 0 0 1 ECU_ADDRESS 0x0000 /* @ECU_Address@LampCtl_KnobBeamFaultSta@ */ /end MEASUREMENT
/begin MEASUREMENT LampCtl_HiBeamShortToBat "" UBYTE AppSwcBcm_CM_boolean 0 0 0 1 ECU_ADDRESS 0x0000 /* @ECU_Address@LampCtl_HiBeamShortToBat@ */ /end MEASUREMENT
/begin MEASUREMENT LampCtl_DomeLampLockDoor "" UBYTE AppSwcBcm_CM_boolean 0 0 0 1 ECU_ADDRESS 0x0000 /* @ECU_Address@LampCtl_DomeLampLockDoor@ */ /end MEASUREMENT
/begin MEASUREMENT LampCtl_DomeLampCloseDoor "" UBYTE AppSwcBcm_CM_boolean 0 0 0 1 ECU_ADDRESS 0x0000 /* @ECU_Address@LampCtl_DomeLampCloseDoor@ */ /end MEASUREMENT
/begin MEASUREMENT LampCtl_DomeLampOn "" UBYTE AppSwcBcm_CM_boolean 0 0 0 1 ECU_ADDRESS 0x0000 /* @ECU_Address@LampCtl_DomeLampOn@ */ /end MEASUREMENT
/begin MEASUREMENT LampCtl_DomeLampOff "" UBYTE AppSwcBcm_CM_boolean 0 0 0 1 ECU_ADDRESS 0x0000 /* @ECU_Address@LampCtl_DomeLampOff@ */ /end MEASUREMENT
/begin MEASUREMENT LampCtl_DomeLampOnGrad "" UBYTE AppSwcBcm_CM_boolean 0 0 0 1 ECU_ADDRESS 0x0000 /* @ECU_Address@LampCtl_DomeLampOnGrad@ */ /end MEASUREMENT
/begin MEASUREMENT LampCtl_DomeLampOffGrad "" UBYTE AppSwcBcm_CM_boolean 0 0 0 1 ECU_ADDRESS 0x0000 /* @ECU_Address@LampCtl_DomeLampOffGrad@ */ /end MEASUREMENT
/begin MEASUREMENT LampCtl_DomeLampCtl "" UBYTE AppSwcBcm_CM_boolean 0 0 0 1 ECU_ADDRESS 0x0000 /* @ECU_Address@LampCtl_DomeLampCtl@ */ /end MEASUREMENT
/begin MEASUREMENT LampCtl_DomeLampUnlock "" UBYTE AppSwcBcm_CM_boolean 0 0 0 1 ECU_ADDRESS 0x0000 /* @ECU_Address@LampCtl_DomeLampUnlock@ */ /end MEASUREMENT
/begin MEASUREMENT LampCtl_DomeLampPwrOff "" UBYTE AppSwcBcm_CM_boolean 0 0 0 1 ECU_ADDRESS 0x0000 /* @ECU_Address@LampCtl_DomeLampPwrOff@ */ /end MEASUREMENT
/begin MEASUREMENT LampCtl_DomeLampFROpen "" UBYTE AppSwcBcm_CM_boolean 0 0 0 1 ECU_ADDRESS 0x0000 /* @ECU_Address@LampCtl_DomeLampFROpen@ */ /end MEASUREMENT
/begin MEASUREMENT LampCtl_DomeLampFLOpen "" UBYTE AppSwcBcm_CM_boolean 0 0 0 1 ECU_ADDRESS 0x0000 /* @ECU_Address@LampCtl_DomeLampFLOpen@ */ /end MEASUREMENT
/begin MEASUREMENT LampCtl_AutoLampSta "" UBYTE AppSwcBcm_CM_boolean 0 0 0 1 ECU_ADDRESS 0x0000 /* @ECU_Address@LampCtl_AutoLampSta@ */ /end MEASUREMENT
/begin MEASUREMENT HornCtl_J430HornDrv "" UBYTE AppSwcBcm_CM_boolean 0 0 0 1 ECU_ADDRESS 0x0000 /* @ECU_Address@HornCtl_J430HornDrv@ */ /end MEASUREMENT
/begin MEASUREMENT HornCtl_HornSwCtl "" UBYTE AppSwcBcm_CM_boolean 0 0 0 1 ECU_ADDRESS 0x0000 /* @ECU_Address@HornCtl_HornSwCtl@ */ /end MEASUREMENT
/begin MEASUREMENT WinCtl_PsgWinUpReq "" UBYTE AppSwcBcm_CM_boolean 0 0 0 1 ECU_ADDRESS 0x0000 /* @ECU_Address@WinCtl_PsgWinUpReq@ */ /end MEASUREMENT
/begin MEASUREMENT WinCtl_PsgWinDnReq "" UBYTE AppSwcBcm_CM_boolean 0 0 0 1 ECU_ADDRESS 0x0000 /* @ECU_Address@WinCtl_PsgWinDnReq@ */ /end MEASUREMENT
/begin MEASUREMENT WinCtl_DrvWinUpReq "" UBYTE AppSwcBcm_CM_boolean 0 0 0 1 ECU_ADDRESS 0x0000 /* @ECU_Address@WinCtl_DrvWinUpReq@ */ /end MEASUREMENT
/begin MEASUREMENT WinCtl_DrvWinDnReq "" UBYTE AppSwcBcm_CM_boolean 0 0 0 1 ECU_ADDRESS 0x0000 /* @ECU_Address@WinCtl_DrvWinDnReq@ */ /end MEASUREMENT
/begin MEASUREMENT WinCtl_PsgWinAutoDnReq "" UBYTE AppSwcBcm_CM_boolean 0 0 0 1 ECU_ADDRESS 0x0000 /* @ECU_Address@WinCtl_PsgWinAutoDnReq@ */ /end MEASUREMENT
/begin MEASUREMENT WinCtl_DrvWinAutoDnReq "" UBYTE AppSwcBcm_CM_boolean 0 0 0 1 ECU_ADDRESS 0x0000 /* @ECU_Address@WinCtl_DrvWinAutoDnReq@ */ /end MEASUREMENT
/begin MEASUREMENT WinCtl_PsgWinDnProt "" UBYTE AppSwcBcm_CM_boolean 0 0 0 1 ECU_ADDRESS 0x0000 /* @ECU_Address@WinCtl_PsgWinDnProt@ */ /end MEASUREMENT
/begin MEASUREMENT WinCtl_PsgWinUpProt "" UBYTE AppSwcBcm_CM_boolean 0 0 0 1 ECU_ADDRESS 0x0000 /* @ECU_Address@WinCtl_PsgWinUpProt@ */ /end MEASUREMENT
/begin MEASUREMENT WinCtl_DrvWinDnProt "" UBYTE AppSwcBcm_CM_boolean 0 0 0 1 ECU_ADDRESS 0x0000 /* @ECU_Address@WinCtl_DrvWinDnProt@ */ /end MEASUREMENT
/begin MEASUREMENT WinCtl_DrvWinUpProt "" UBYTE AppSwcBcm_CM_boolean 0 0 0 1 ECU_ADDRESS 0x0000 /* @ECU_Address@WinCtl_DrvWinUpProt@ */ /end MEASUREMENT
/begin MEASUREMENT WinCtl_DrvPsgWinAutoDnSw "" UBYTE AppSwcBcm_CM_boolean 0 0 0 1 ECU_ADDRESS 0x0000 /* @ECU_Address@WinCtl_DrvPsgWinAutoDnSw@ */ /end MEASUREMENT
/begin MEASUREMENT WinCtl_DrvPsgWinDnSw "" UBYTE AppSwcBcm_CM_boolean 0 0 0 1 ECU_ADDRESS 0x0000 /* @ECU_Address@WinCtl_DrvPsgWinDnSw@ */ /end MEASUREMENT
/begin MEASUREMENT WinCtl_DrvPsgWinUpSw "" UBYTE AppSwcBcm_CM_boolean 0 0 0 1 ECU_ADDRESS 0x0000 /* @ECU_Address@WinCtl_DrvPsgWinUpSw@ */ /end MEASUREMENT
/begin MEASUREMENT WinCtl_PsgWinAutoDnSw "" UBYTE AppSwcBcm_CM_boolean 0 0 0 1 ECU_ADDRESS 0x0000 /* @ECU_Address@WinCtl_PsgWinAutoDnSw@ */ /end MEASUREMENT
/begin MEASUREMENT WinCtl_PsgWinDnSw "" UBYTE AppSwcBcm_CM_boolean 0 0 0 1 ECU_ADDRESS 0x0000 /* @ECU_Address@WinCtl_PsgWinDnSw@ */ /end MEASUREMENT
/begin MEASUREMENT WinCtl_PsgWinUpSw "" UBYTE AppSwcBcm_CM_boolean 0 0 0 1 ECU_ADDRESS 0x0000 /* @ECU_Address@WinCtl_PsgWinUpSw@ */ /end MEASUREMENT
/begin MEASUREMENT WinCtl_DrvWinUpSw "" UBYTE AppSwcBcm_CM_boolean 0 0 0 1 ECU_ADDRESS 0x0000 /* @ECU_Address@WinCtl_DrvWinUpSw@ */ /end MEASUREMENT
/begin MEASUREMENT WinCtl_DrvWinAutoDnSw "" UBYTE AppSwcBcm_CM_boolean 0 0 0 1 ECU_ADDRESS 0x0000 /* @ECU_Address@WinCtl_DrvWinAutoDnSw@ */ /end MEASUREMENT
/begin MEASUREMENT WinCtl_DrvWinDnSw "" UBYTE AppSwcBcm_CM_boolean 0 0 0 1 ECU_ADDRESS 0x0000 /* @ECU_Address@WinCtl_DrvWinDnSw@ */ /end MEASUREMENT
/begin MEASUREMENT WinCtl_J53DrvWinDn "" UBYTE AppSwcBcm_CM_boolean 0 0 0 1 ECU_ADDRESS 0x0000 /* @ECU_Address@WinCtl_J53DrvWinDn@ */ /end MEASUREMENT
/begin MEASUREMENT WinCtl_J57PsgWinDn "" UBYTE AppSwcBcm_CM_boolean 0 0 0 1 ECU_ADDRESS 0x0000 /* @ECU_Address@WinCtl_J57PsgWinDn@ */ /end MEASUREMENT
/begin MEASUREMENT WinCtl_J55PsgWinUp "" UBYTE AppSwcBcm_CM_boolean 0 0 0 1 ECU_ADDRESS 0x0000 /* @ECU_Address@WinCtl_J55PsgWinUp@ */ /end MEASUREMENT
/begin MEASUREMENT WinCtl_J51DrvWinUp "" UBYTE AppSwcBcm_CM_boolean 0 0 0 1 ECU_ADDRESS 0x0000 /* @ECU_Address@WinCtl_J51DrvWinUp@ */ /end MEASUREMENT
/begin MEASUREMENT SteerWhlCtl_J447SteerWhlHt "" UBYTE AppSwcBcm_CM_boolean 0 0 0 1 ECU_ADDRESS 0x0000 /* @ECU_Address@SteerWhlCtl_J447SteerWhlHt@ */ /end MEASUREMENT
/begin MEASUREMENT RVMCtl_J42Heat "" UBYTE AppSwcBcm_CM_boolean 0 0 0 1 ECU_ADDRESS 0x0000 /* @ECU_Address@RVMCtl_J42Heat@ */ /end MEASUREMENT
/begin MEASUREMENT AppSwcBcm_ARID_DEF.Cnt_Tick_a "" UWORD AppSwcBcm_CM_uint16 0 0 0 65535 ECU_ADDRESS 0x0000 /* @ECU_Address@AppSwcBcm_ARID_DEF.Cnt_Tick_a@ */ /end MEASUREMENT
/begin MEASUREMENT AppSwcBcm_ARID_DEF.Cnt_M_h "" UBYTE AppSwcBcm_CM_uint8 0 0 0 255 ECU_ADDRESS 0x0000 /* @ECU_Address@AppSwcBcm_ARID_DEF.Cnt_M_h@ */ /end MEASUREMENT
/begin MEASUREMENT AppSwcBcm_ARID_DEF.Cnt_S_b "" UBYTE AppSwcBcm_CM_uint8 0 0 0 255 ECU_ADDRESS 0x0000 /* @ECU_Address@AppSwcBcm_ARID_DEF.Cnt_S_b@ */ /end MEASUREMENT
/begin MEASUREMENT AppSwcBcm_ARID_DEF.WiperCtl_WashComp "" UBYTE AppSwcBcm_CM_boolean 0 0 0 1 ECU_ADDRESS 0x0000 /* @ECU_Address@AppSwcBcm_ARID_DEF.WiperCtl_WashComp@ */ /end MEASUREMENT
/begin MEASUREMENT AppSwcBcm_ARID_DEF.last_cnt "" UBYTE AppSwcBcm_CM_uint8 0 0 0 255 ECU_ADDRESS 0x0000 /* @ECU_Address@AppSwcBcm_ARID_DEF.last_cnt@ */ /end MEASUREMENT
/begin MEASUREMENT AppSwcBcm_ARID_DEF.after_cnt "" UWORD AppSwcBcm_CM_uint16 0 0 0 65535 ECU_ADDRESS 0x0000 /* @ECU_Address@AppSwcBcm_ARID_DEF.after_cnt@ */ /end MEASUREMENT
/begin MEASUREMENT AppSwcBcm_ARID_DEF.Cnt_m "" UWORD AppSwcBcm_CM_uint16 0 0 0 65535 ECU_ADDRESS 0x0000 /* @ECU_Address@AppSwcBcm_ARID_DEF.Cnt_m@ */ /end MEASUREMENT
/begin MEASUREMENT AppSwcBcm_ARID_DEF.flg_l "" UBYTE AppSwcBcm_CM_boolean 0 0 0 1 ECU_ADDRESS 0x0000 /* @ECU_Address@AppSwcBcm_ARID_DEF.flg_l@ */ /end MEASUREMENT
/begin MEASUREMENT AppSwcBcm_ARID_DEF.Cnt_j "" UWORD AppSwcBcm_CM_uint16 0 0 0 65535 ECU_ADDRESS 0x0000 /* @ECU_Address@AppSwcBcm_ARID_DEF.Cnt_j@ */ /end MEASUREMENT
/begin MEASUREMENT AppSwcBcm_ARID_DEF.Cnt2_j "" UWORD AppSwcBcm_CM_uint16 0 0 0 65535 ECU_ADDRESS 0x0000 /* @ECU_Address@AppSwcBcm_ARID_DEF.Cnt2_j@ */ /end MEASUREMENT
/begin MEASUREMENT AppSwcBcm_ARID_DEF.Cnt_dy "" UWORD AppSwcBcm_CM_uint16 0 0 0 65535 ECU_ADDRESS 0x0000 /* @ECU_Address@AppSwcBcm_ARID_DEF.Cnt_dy@ */ /end MEASUREMENT
/begin MEASUREMENT AppSwcBcm_ARID_DEF.Cnt_d "" UWORD AppSwcBcm_CM_uint16 0 0 0 65535 ECU_ADDRESS 0x0000 /* @ECU_Address@AppSwcBcm_ARID_DEF.Cnt_d@ */ /end MEASUREMENT
/begin MEASUREMENT AppSwcBcm_ARID_DEF.Cnt_pi "" UWORD AppSwcBcm_CM_uint16 0 0 0 65535 ECU_ADDRESS 0x0000 /* @ECU_Address@AppSwcBcm_ARID_DEF.Cnt_pi@ */ /end MEASUREMENT
/begin MEASUREMENT AppSwcBcm_ARID_DEF.flg_a "" UBYTE AppSwcBcm_CM_boolean 0 0 0 1 ECU_ADDRESS 0x0000 /* @ECU_Address@AppSwcBcm_ARID_DEF.flg_a@ */ /end MEASUREMENT
/begin MEASUREMENT AppSwcBcm_ARID_DEF.Cnt_nz "" UWORD AppSwcBcm_CM_uint16 0 0 0 65535 ECU_ADDRESS 0x0000 /* @ECU_Address@AppSwcBcm_ARID_DEF.Cnt_nz@ */ /end MEASUREMENT
/begin MEASUREMENT AppSwcBcm_ARID_DEF.Flg_j "" UBYTE AppSwcBcm_CM_boolean 0 0 0 1 ECU_ADDRESS 0x0000 /* @ECU_Address@AppSwcBcm_ARID_DEF.Flg_j@ */ /end MEASUREMENT
/begin MEASUREMENT AppSwcBcm_ARID_DEF.flg "" UBYTE AppSwcBcm_CM_boolean 0 0 0 1 ECU_ADDRESS 0x0000 /* @ECU_Address@AppSwcBcm_ARID_DEF.flg@ */ /end MEASUREMENT
/begin COMPU_METHOD AppSwcBcm_CM_single "Q = V" RAT_FUNC "%8.6" "" COEFFS 0 1 0 0 0 1 /end COMPU_METHOD
/begin COMPU_METHOD AppSwcBcm_CM_single_sec "Q = V" RAT_FUNC "%8.6" "sec" COEFFS 0 1 0 0 0 1 /end COMPU_METHOD
/begin COMPU_METHOD AppSwcBcm_CM_single_s "Q = V" RAT_FUNC "%8.6" "s" COEFFS 0 1 0 0 0 1 /end COMPU_METHOD
/begin COMPU_METHOD AppSwcBcm_CM_uint16_50ms "Q = V" RAT_FUNC "%5.0" "50ms" COEFFS 0 1 0 0 0 1 /end COMPU_METHOD
/begin COMPU_METHOD AppSwcBcm_CM_uint16_10ms "Q = V" RAT_FUNC "%5.0" "10ms" COEFFS 0 1 0 0 0 1 /end COMPU_METHOD
/begin COMPU_METHOD AppSwcBcm_CM_uint16 "Q = V" RAT_FUNC "%5.0" "" COEFFS 0 1 0 0 0 1 /end COMPU_METHOD
/begin COMPU_METHOD AppSwcBcm_CM_uint16__Ohm "Q = V" RAT_FUNC "%5.0" " Ohm" COEFFS 0 1 0 0 0 1 /end COMPU_METHOD
/begin COMPU_METHOD AppSwcBcm_CM_uint16_Msec "Q = V" RAT_FUNC "%5.0" "Msec" COEFFS 0 1 0 0 0 1 /end COMPU_METHOD
/begin COMPU_METHOD AppSwcBcm_CM_uint16_20ms "Q = V" RAT_FUNC "%5.0" "20ms" COEFFS 0 1 0 0 0 1 /end COMPU_METHOD
/begin COMPU_METHOD AppSwcBcm_CM_uint16_mV "Q = V" RAT_FUNC "%5.0" "mV" COEFFS 0 1 0 0 0 1 /end COMPU_METHOD
/begin COMPU_METHOD AppSwcBcm_CM_uint16_mA "Q = V" RAT_FUNC "%5.0" "mA" COEFFS 0 1 0 0 0 1 /end COMPU_METHOD
/begin COMPU_METHOD AppSwcBcm_CM_uint16_Ohm "Q = V" RAT_FUNC "%5.0" "Ohm" COEFFS 0 1 0 0 0 1 /end COMPU_METHOD
/begin COMPU_METHOD AppSwcBcm_CM_uint16_Bit "Q = V" RAT_FUNC "%5.0" "Bit" COEFFS 0 1 0 0 0 1 /end COMPU_METHOD
/begin COMPU_METHOD AppSwcBcm_CM_uint16_100ms "Q = V" RAT_FUNC "%5.0" "100ms" COEFFS 0 1 0 0 0 1 /end COMPU_METHOD
/begin COMPU_METHOD AppSwcBcm_CM_boolean "Q = V" RAT_FUNC "%1.0" "" COEFFS 0 1 0 0 0 1 /end COMPU_METHOD
/begin COMPU_METHOD AppSwcBcm_CM_uint8 "Q = V" RAT_FUNC "%3.0" "" COEFFS 0 1 0 0 0 1 /end COMPU_METHOD
/begin COMPU_METHOD AppSwcBcm_CM_uint8_20ms "Q = V" RAT_FUNC "%3.0" "20ms" COEFFS 0 1 0 0 0 1 /end COMPU_METHOD
/begin COMPU_METHOD AppSwcBcm_CM_uint8_km_per_h "Q = V" RAT_FUNC "%3.0" "km/h" COEFFS 0 1 0 0 0 1 /end COMPU_METHOD
/begin COMPU_METHOD AppSwcBcm_CM_uint8_hour "Q = V" RAT_FUNC "%3.0" "hour" COEFFS 0 1 0 0 0 1 /end COMPU_METHOD
/begin COMPU_METHOD AppSwcBcm_CM_uint8__degC "Q = V" RAT_FUNC "%3.0" " degC" COEFFS 0 1 0 0 0 1 /end COMPU_METHOD
/begin COMPU_METHOD AppSwcBcm_CM_uint8_degC "Q = V" RAT_FUNC "%3.0" "degC" COEFFS 0 1 0 0 0 1 /end COMPU_METHOD
/begin COMPU_METHOD AppSwcBcm_CM_int8 "Q = V" RAT_FUNC "%3.0" "" COEFFS 0 1 0 0 0 1 /end COMPU_METHOD
/begin GROUP AppSwcBcm "AppSwcBcm" /* Root */ ROOT
 /begin SUB_GROUP Root_AppSwcBcm_100ms Root_AppSwcBcm_10ms Root_AppSwcBcm_20ms Root_AppSwcBcm_50ms /end SUB_GROUP
/end GROUP
/begin GROUP Root_AppSwcBcm_100ms "AppSwcBcm/AppSwcBcm_100ms"
 /begin SUB_GROUP S1_EEWriteCtl S1_IODID S1_RVMCtl S1_SeatCtl S1_SteerWhlCtl S1_WinCtl /end SUB_GROUP
 /begin REF_MEASUREMENT BSW_CN744DrvSeatResis BSW_DrvWinMotorCur BSW_J113DrvWinSwResis BSW_J126DrvPsgWinSwResis BSW_J134SteerWhlResis BSW_J26PsgWinSwResis BSW_PsgWinMotorCur /end REF_MEASUREMENT
/end GROUP
/begin GROUP Root_AppSwcBcm_10ms "AppSwcBcm/AppSwcBcm_10ms" /begin SUB_GROUP S2_PEPSCtl /end SUB_GROUP /end GROUP
/begin GROUP Root_AppSwcBcm_20ms "AppSwcBcm/AppSwcBcm_20ms" /begin SUB_GROUP S3_EEReadCtl S3_HornCtl S3_LampCtl S3_WiperCtl /end SUB_GROUP
 /begin REF_MEASUREMENT BSW_FogLampFCfg BSW_J125LightIntst BSW_J313BrakeLoSw BSW_J319HornSw BSW_J322FogLampF BSW_J334WiperParkPos BSW_J339BrakeHiSw BSW_J346FogLampR BSW_RKEReq /end REF_MEASUREMENT
/end GROUP
/begin GROUP Root_AppSwcBcm_50ms "AppSwcBcm/AppSwcBcm_50ms"
 /begin SUB_GROUP S4_AlmSysCtl S4_BatSaveCtl S4_DoorLckCtl S4_DynDID S4_ESCLCtl S4_IMMOCtl S4_PDUCtl S4_WakeUpCtl /end SUB_GROUP
 /begin REF_MEASUREMENT BSW_EEIlluminatedEntrySys BSW_EEKeyEntry BSW_IllmndSts BSW_J112DrvSeatResis BSW_J310DoorAjarFR BSW_J320DoorAjarRL BSW_J321DoorAjarFL BSW_J335DriverDoorLck BSW_J336Trunk BSW_J337PsgPE BSW_J338DrvPE BSW_J349TrunkLck BSW_J36DoorAjarRR BSW_J37TrunkAjar BSW_J38HoodAjar /end REF_MEASUREMENT
/end GROUP
/begin GROUP S1_EEWriteCtl "AppSwcBcm/AppSwcBcm_100ms/EEWriteCtl" /begin REF_CHARACTERISTIC EEWriteCtl_ImmOvrdFlg_C EEWriteCtl_ImmOvrdVal_C /end REF_CHARACTERISTIC /end GROUP
/begin GROUP S1_IODID "AppSwcBcm/AppSwcBcm_100ms/IODID"
 /begin REF_MEASUREMENT IODID_BSDLeftCtlFlg IODID_BSDRightCtlFlg IODID_BackLampCtlFlg IODID_BatSaveCtlFlg IODID_BrakeLightCtlFlg IODID_DayRunLightCtlFlg IODID_DomeLampCtlFlg IODID_DoorLckCtlFlg IODID_DoorUnlckCtlFlg IODID_FogLampFCtlFlg IODID_FogLampRCtlFlg IODID_HiBeamCtlFlg IODID_HornCtlFlg IODID_IG1RlyCtlFlg IODID_IG2RlyCtlFlg IODID_LowBeamCtlFlg IODID_PosLampCtlFlg IODID_ReverseLampCtlFlg IODID_TrunkUnlckCtlFlg IODID_TurnIndcrLCtlFlg IODID_TurnIndcrRCtlFlg IODID_WinFLCtlFlg IODID_WinFRCtlFlg IODID_WiperHiSpdCtlFlg IODID_WiperLowSpdCtlFlg /end REF_MEASUREMENT
/end GROUP
/begin GROUP S1_RVMCtl "AppSwcBcm/AppSwcBcm_100ms/RVMCtl" /begin SUB_GROUP S7_Ovrd S7_RVMCtl /end SUB_GROUP /begin REF_CHARACTERISTIC RVMCtl_J42HeatOvrdFlg_C RVMCtl_J42HeatOvrdVal_C /end REF_CHARACTERISTIC /end GROUP
/begin GROUP S1_SeatCtl "AppSwcBcm/AppSwcBcm_100ms/SeatCtl" /begin SUB_GROUP S8_SeatCtl /end SUB_GROUP /end GROUP
/begin GROUP S1_SteerWhlCtl "AppSwcBcm/AppSwcBcm_100ms/SteerWhlCtl" /begin SUB_GROUP S9_SteerWhlCtl /end SUB_GROUP /end GROUP
/begin GROUP S1_WinCtl "AppSwcBcm/AppSwcBcm_100ms/WinCtl"
 /begin SUB_GROUP S10_Ovrd1 S10_Ovrd2 S10_Ovrd3 S10_Ovrd4 S10_SigProc S10_WinMotorProt S10_WinSwArb /end SUB_GROUP
 /begin REF_CHARACTERISTIC WinCtl_J51DrvWinUpOvrdFlg_C WinCtl_J51DrvWinUpOvrdVal_C WinCtl_J53DrvWinDnOvrdFlg_C WinCtl_J53DrvWinDnOvrdVal_C WinCtl_J55PsgWinUpOvrdFlg_C WinCtl_J55PsgWinUpOvrdVal_C WinCtl_J57PsgWinDnOvrdFlg_C WinCtl_J57PsgWinDnOvrdVal_C /end REF_CHARACTERISTIC
 /begin REF_MEASUREMENT WinCtl_DrvWinSta WinCtl_PsgWinSta /end REF_MEASUREMENT
/end GROUP
/begin GROUP S2_PEPSCtl "AppSwcBcm/AppSwcBcm_10ms/PEPSCtl" /begin SUB_GROUP S206_Key_FobReles S206_Others S206_PE S206_PS S206_Polling /end SUB_GROUP /end GROUP
/begin GROUP S3_EEReadCtl "AppSwcBcm/AppSwcBcm_20ms/EEReadCtl"
 /begin REF_MEASUREMENT EEReadCtl_BackLadjvalFb EEReadCtl_BodyWarnSts EEReadCtl_CrashSta EEReadCtl_DoorOpRecord EEReadCtl_FlwrMeHomeCtlFb EEReadCtl_HazardLightSta EEReadCtl_IllmndLckSts EEReadCtl_IllmndUnlckSts EEReadCtl_InrTim EEReadCtl_LocalStartFailOpRecord EEReadCtl_LockHoornOnSts EEReadCtl_ParkAutoUnlockSetFb EEReadCtl_RemoteStartFailRecord EEReadCtl_SpdCtlLckSet EEReadCtl_TrunkLckSw EEReadCtl_TrunkOpRecord EEReadCtl_WiprIntlTimeSetFb /end REF_MEASUREMENT
/end GROUP
/begin GROUP S3_HornCtl "AppSwcBcm/AppSwcBcm_20ms/HornCtl"
 /begin SUB_GROUP S232_Alarm S232_AntiLck S232_Armed S232_HornSet S232_HornSw S232_Ovrd1 S232_PartArmed S232_Seek S232_Trunk30sWarn /end SUB_GROUP
 /begin REF_CHARACTERISTIC HornCtl_J430HornDrvOvrdFlg_C HornCtl_J430HornDrvOvrdVal_C /end REF_CHARACTERISTIC
/end GROUP
/begin GROUP S3_LampCtl "AppSwcBcm/AppSwcBcm_20ms/LampCtl"
 /begin SUB_GROUP S233_AutoLampCtl S233_BackLampCtl S233_BoxLampCtl S233_DomeLampCtl S233_HiBeamCtl S233_KnobBeamDig S233_LampDelayCtl S233_LightIntstDet S233_LowBeamCtl S233_Ovrd S233_Ovrd1 S233_Ovrd10 S233_Ovrd11 S233_Ovrd12 S233_Ovrd13 S233_Ovrd14 S233_Ovrd2 S233_Ovrd3 S233_Ovrd4 S233_Ovrd5 S233_Ovrd6 S233_Ovrd7 S233_Ovrd8 S233_Ovrd9 S233_PassLampFunc S233_PosLampCtl S233_SignalProcess S233_TurnIndcrCtl S233_WelcomeLampCtl /end SUB_GROUP
 /begin REF_CHARACTERISTIC LampCtl_BrakeLightStaOvrdFlg_C LampCtl_BrakeLightStaOvrdVal_C LampCtl_DayRunLightStaOvrdFlg_C LampCtl_DayRunLightStaOvrdVal_C LampCtl_DomeLampPwmDutyOvrdFlg_C LampCtl_DomeLampPwmDutyOvrdVal_C LampCtl_FogLampFStaOvrdFlg_C LampCtl_FogLampFStaOvrdVal_C LampCtl_FogLampRStaOvrdFlg_C LampCtl_FogLampRStaOvrdVal_C LampCtl_HiBeamStaOvrdFlg_C LampCtl_HiBeamStaOvrdVal_C LampCtl_J408BackLampPWMOvrdFlg_C LampCtl_J408BackLampPWMOvrdVal_C LampCtl_J420BSDRightCtlOvrdFlg_C LampCtl_J420BSDRightCtlOvrdVal_C LampCtl_J422BSDLeftCtlOvrdFlg_C LampCtl_J422BSDLeftCtlOvrdVal_C LampCtl_J449BoxLampOvrdFlg_C LampCtl_J449BoxLampOvrdVal_C LampCtl_LowBeamStaOvrdFlg_C LampCtl_LowBeamStaOvrdVal_C LampCtl_PosLampStaOvrdFlg_C LampCtl_PosLampStaOvrdVal_C LampCtl_ReverseLampStaOvrdFlg_C LampCtl_ReverseLampStaOvrdVal_C LampCtl_TurnIndcrLStaOvrdFlg_C LampCtl_TurnIndcrLStaOvrdVal_C LampCtl_TurnIndcrRStaOvrdFlg_C LampCtl_TurnIndcrRStaOvrdVal_C /end REF_CHARACTERISTIC
/end GROUP
/begin GROUP S3_WiperCtl "AppSwcBcm/AppSwcBcm_20ms/WiperCtl"
 /begin SUB_GROUP S234_LockedRotorProt S234_Ovrd1 S234_Ovrd2 S234_Ovrd3 S234_SignalProcess S234_WashCtl S234_WiperDrv S234_WiperHiSpdCtl S234_WiperInrCtl S234_WiperLowSpdCtl S234_WiperMaintCtl S234_WiperMistCtl S234_WiperOffCtl /end SUB_GROUP
 /begin REF_CHARACTERISTIC WiperCtl_HiSpdDrvOvrdFlg_C WiperCtl_HiSpdDrvOvrdVal_C WiperCtl_LowSpdDrvOvrdFlg_C WiperCtl_LowSpdDrvOvrdVal_C WiperCtl_WashMotorDrvOvrdFlg_C WiperCtl_WashMotorDrvOvrdVal_C /end REF_CHARACTERISTIC
 /begin REF_MEASUREMENT SCS_FrntWiprSwtSt SCS_FrntWshrSwtSt SCS_FrntWshrSwtStVD SCS_WiprSwtStVD /end REF_MEASUREMENT
/end GROUP
/begin GROUP S4_AlmSysCtl "AppSwcBcm/AppSwcBcm_50ms/AlmSysCtl" /begin REF_CHARACTERISTIC AlmSysCtl_AlrmTimLimit_C /end REF_CHARACTERISTIC /begin REF_MEASUREMENT AlmSysCtl_AlrmWarnTimOut AlmSysCtl_BodyWarnSts /end REF_MEASUREMENT /end GROUP
/begin GROUP S4_BatSaveCtl "AppSwcBcm/AppSwcBcm_50ms/BatSaveCtl" /begin SUB_GROUP S621_Ovrd1 S621_PwrOff S621_PwrOn /end SUB_GROUP
 /begin REF_CHARACTERISTIC BatSaveCtl_J64SavePwrOvrdFlg_C BatSaveCtl_J64SavePwrOvrdVal_C /end REF_CHARACTERISTIC
/end GROUP
/begin GROUP S4_DoorLckCtl "AppSwcBcm/AppSwcBcm_50ms/DoorLckCtl"
 /begin SUB_GROUP S623_DoorLckCtlLogic S623_Ovrd1 S623_Ovrd2 S623_Ovrd3 S623_SignalProcess /end SUB_GROUP
 /begin REF_CHARACTERISTIC DoorLckCtl_DrvTim_C DoorLckCtl_J511TrunkUnlckOvrdFlg_C DoorLckCtl_J511TrunkUnlckOvrdVal_C DoorLckCtl_J54DoorLckOvrdFlg_C DoorLckCtl_J54DoorLckOvrdVal_C DoorLckCtl_J56DoorUnlckOvrdFlg_C DoorLckCtl_J56DoorUnlckOvrdVal_C DoorLckCtl_LckStaCfmMaxTim_C DoorLckCtl_LckStaCfmMinTim_C /end REF_CHARACTERISTIC
 /begin REF_MEASUREMENT DoorLckCtl_InsLckSta DoorLckCtl_OsLckSta DoorLckCtl_TrunkLckSta DoorLckCtl_TrunkLckSw /end REF_MEASUREMENT
/end GROUP
/begin GROUP S4_DynDID "AppSwcBcm/AppSwcBcm_50ms/DynDID"
 /begin SUB_GROUP S624_0xF230DoorOpRecord S624_0xF231TrunkOpRecord S624_0xF232LocalStartUpFailRecord S624_0xF233RemoteStartUpFailRecord S624_0xF234ADSampleValue S624_0xF235DigtInSampleValue S624_0xF236DigtOutSampleValue /end SUB_GROUP
 /begin REF_MEASUREMENT DynDID_0xF22CAntitheftSta DynDID_0xF237PwrModeSta /end REF_MEASUREMENT
/end GROUP
/begin GROUP S4_ESCLCtl "AppSwcBcm/AppSwcBcm_50ms/ESCLCtl" /begin SUB_GROUP S625_ESCLCtl /end SUB_GROUP /end GROUP
/begin GROUP S4_IMMOCtl "AppSwcBcm/AppSwcBcm_50ms/IMMOCtl"
 /begin REF_MEASUREMENT IMMOCtl_AuthResp IMMOCtl_INVRandom IMMOCtl_SKRead IMMOCtl_SKSta /end REF_MEASUREMENT
/end GROUP
/begin GROUP S4_PDUCtl "AppSwcBcm/AppSwcBcm_50ms/PDUCtl"
 /begin SUB_GROUP S627_Ovrd1 S627_Ovrd2 S627_PwrOff S627_PwrOn S627_RelayDig S627_StartReq S627_Subsystem /end SUB_GROUP
 /begin REF_CHARACTERISTIC PDUCtl_J421IG1RlyCtlOvrdFlg_C PDUCtl_J421IG1RlyCtlOvrdVal_C PDUCtl_J437IG2RlyCtlOvrdFlg_C PDUCtl_J437IG2RlyCtlOvrdVal_C /end REF_CHARACTERISTIC
 /begin REF_MEASUREMENT PDUCtl_SysPowerSts PDUCtl_SysPwrMode /end REF_MEASUREMENT
/end GROUP
/begin GROUP S4_WakeUpCtl "AppSwcBcm/AppSwcBcm_50ms/WakeUpCtl" /begin SUB_GROUP S628_WakeUpCtl /end SUB_GROUP /begin REF_MEASUREMENT BSW_WakeupReas /end REF_MEASUREMENT /end GROUP
/begin GROUP S7_Ovrd "AppSwcBcm/AppSwcBcm_100ms/RVMCtl/Ovrd" /begin REF_MEASUREMENT RVMCtl_J42Heat /end REF_MEASUREMENT /end GROUP
/begin GROUP S7_RVMCtl "AppSwcBcm/AppSwcBcm_100ms/RVMCtl/RVMCtl" /begin REF_CHARACTERISTIC RVMCtl_MaxHeatTimM_C RVMCtl_Ts_C /end REF_CHARACTERISTIC
 /begin REF_MEASUREMENT AppSwcBcm_ARID_DEF.Cnt_M_h AppSwcBcm_ARID_DEF.Cnt_S_b AppSwcBcm_ARID_DEF.Cnt_Tick_a /end REF_MEASUREMENT
/end GROUP
/begin GROUP S8_SeatCtl "AppSwcBcm/AppSwcBcm_100ms/SeatCtl/SeatCtl" /begin SUB_GROUP S129_Ovrd /end SUB_GROUP
 /begin REF_CHARACTERISTIC SeatCtl_CN167DrvSeatHtPWMOvrdFlg_C SeatCtl_CN167DrvSeatHtPWMOvrdVal_C SeatCtl_DrvSeatTempLookUp_Y SeatCtl_DrvTempLvl0_C SeatCtl_DrvTempLvl1_C SeatCtl_DrvTempLvl2_C SeatCtl_DrvTempLvl3_C SeatCtl_HtDiffTemp_C /end REF_CHARACTERISTIC
 /begin REF_MEASUREMENT SeatCtl_DrvSeatTemp SeatCtl_MaiDrvSeatStFb /end REF_MEASUREMENT
/end GROUP
/begin GROUP S9_SteerWhlCtl "AppSwcBcm/AppSwcBcm_100ms/SteerWhlCtl/SteerWhlCtl" /begin SUB_GROUP S132_Ovrd /end SUB_GROUP
 /begin REF_CHARACTERISTIC SteerWhlCtl_DiffTemp_C SteerWhlCtl_J447SteerWhlHtOvrdFlg_C SteerWhlCtl_J447SteerWhlHtOvrdVal_C SteerWhlCtl_SteerWhlTempLookUp_Y SteerWhlCtl_TrgtTemp_C /end REF_CHARACTERISTIC
 /begin REF_MEASUREMENT SteerWhlCtl_SteerWhlHeatSts SteerWhlCtl_SteerWhlTemp /end REF_MEASUREMENT
/end GROUP
/begin GROUP S10_Ovrd1 "AppSwcBcm/AppSwcBcm_100ms/WinCtl/Ovrd1" /begin REF_MEASUREMENT WinCtl_J51DrvWinUp /end REF_MEASUREMENT /end GROUP
/begin GROUP S10_Ovrd2 "AppSwcBcm/AppSwcBcm_100ms/WinCtl/Ovrd2" /begin REF_MEASUREMENT WinCtl_J55PsgWinUp /end REF_MEASUREMENT /end GROUP
/begin GROUP S10_Ovrd3 "AppSwcBcm/AppSwcBcm_100ms/WinCtl/Ovrd3" /begin REF_MEASUREMENT WinCtl_J57PsgWinDn /end REF_MEASUREMENT /end GROUP
/begin GROUP S10_Ovrd4 "AppSwcBcm/AppSwcBcm_100ms/WinCtl/Ovrd4" /begin REF_MEASUREMENT WinCtl_J53DrvWinDn /end REF_MEASUREMENT /end GROUP
/begin GROUP S10_SigProc "AppSwcBcm/AppSwcBcm_100ms/WinCtl/SigProc"
 /begin REF_CHARACTERISTIC WinCtl_DrvPsgWinAutoDnMaxResis_C WinCtl_DrvPsgWinAutoDnMinResis_C WinCtl_DrvPsgWinAutoDnTimInValid_C WinCtl_DrvPsgWinAutoDnTimValid_C WinCtl_DrvPsgWinDnMaxResis_C WinCtl_DrvPsgWinDnMinResis_C WinCtl_DrvPsgWinDnTimInValid_C WinCtl_DrvPsgWinDnTimValid_C WinCtl_DrvPsgWinSwResis_C WinCtl_DrvPsgWinUpMaxResis_C WinCtl_DrvPsgWinUpMinResis_C WinCtl_DrvPsgWinUpTimInValid_C WinCtl_DrvPsgWinUpTimValid_C WinCtl_DrvWinAutoDnMaxResis_C WinCtl_DrvWinAutoDnMinResis_C WinCtl_DrvWinAutoDnTimInValid_C WinCtl_DrvWinAutoDnTimValid_C WinCtl_DrvWinDnMaxResis_C WinCtl_DrvWinDnMinResis_C WinCtl_DrvWinDnTimInValid_C WinCtl_DrvWinDnTimValid_C WinCtl_DrvWinSwResis_C WinCtl_DrvWinUpMaxResis_C WinCtl_DrvWinUpMinResis_C WinCtl_DrvWinUpTimInValid_C WinCtl_DrvWinUpTimValid_C WinCtl_InportCalSwBit_C WinCtl_PsgWinAutoDnMaxResis_C WinCtl_PsgWinAutoDnMinResis_C WinCtl_PsgWinAutoDnTimInValid_C WinCtl_PsgWinAutoDnTimValid_C WinCtl_PsgWinDnMaxResis_C WinCtl_PsgWinDnMinResis_C WinCtl_PsgWinDnTimInValid_C WinCtl_PsgWinDnTimValid_C WinCtl_PsgWinSwResis_C WinCtl_PsgWinUpMaxResis_C WinCtl_PsgWinUpMinResis_C WinCtl_PsgWinUpTimInValid_C WinCtl_PsgWinUpTimValid_C WinCtl_Ts_C /end REF_CHARACTERISTIC
 /begin REF_MEASUREMENT WinCtl_DrvPsgWinAutoDnSw WinCtl_DrvPsgWinDnSw WinCtl_DrvPsgWinUpSw WinCtl_DrvWinAutoDnSw WinCtl_DrvWinDnSw WinCtl_DrvWinUpSw WinCtl_PsgWinAutoDnSw WinCtl_PsgWinDnSw WinCtl_PsgWinUpSw /end REF_MEASUREMENT
/end GROUP
/begin GROUP S10_WinMotorProt "AppSwcBcm/AppSwcBcm_100ms/WinCtl/WinMotorProt" /begin REF_CHARACTERISTIC WinCtl_WinProtNum_C WinCtl_WinProtTim_C /end REF_CHARACTERISTIC
 /begin REF_MEASUREMENT WinCtl_DrvWinDnProt WinCtl_DrvWinUpProt WinCtl_PsgWinDnProt WinCtl_PsgWinUpProt /end REF_MEASUREMENT
/end GROUP
/begin GROUP S10_WinSwArb "AppSwcBcm/AppSwcBcm_100ms/WinCtl/WinSwArb"
 /begin REF_CHARACTERISTIC WinCtl_PwrOffWinValidTimMax_C WinCtl_Ts_C WinCtl_WinMotorCurMax_C WinCtl_WinMotorCurTimInValid_C WinCtl_WinMotorCurTimValid_C WinCtl_WinRunTimMax_C /end REF_CHARACTERISTIC
 /begin REF_MEASUREMENT WinCtl_DrvWinAutoDnReq WinCtl_DrvWinDnReq WinCtl_DrvWinReq WinCtl_DrvWinUpReq WinCtl_PsgWinAutoDnReq WinCtl_PsgWinDnReq WinCtl_PsgWinReq WinCtl_PsgWinUpReq /end REF_MEASUREMENT
/end GROUP
/begin GROUP S206_Key_FobReles "AppSwcBcm/AppSwcBcm_10ms/PEPSCtl/Key_FobReles" /begin REF_MEASUREMENT PEPSCtl_FrbdnKeyNr /end REF_MEASUREMENT /end GROUP
/begin GROUP S206_Others "AppSwcBcm/AppSwcBcm_10ms/PEPSCtl/Others" /begin REF_MEASUREMENT PEPSCtl_KeyLoBattLvlWarn PEPSCtl_WarnKeyOutReminder /end REF_MEASUREMENT /end GROUP
/begin GROUP S206_PE "AppSwcBcm/AppSwcBcm_10ms/PEPSCtl/PE"
 /begin REF_MEASUREMENT PEPSCtl_AvaluebleKeyInCar PEPSCtl_DrvPEAuthentAcsd PEPSCtl_FRPEAuthentAcsd PEPSCtl_KeyInCarSta /end REF_MEASUREMENT
/end GROUP
/begin GROUP S206_PS "AppSwcBcm/AppSwcBcm_10ms/PEPSCtl/PS"
 /begin REF_MEASUREMENT PEPSCtl_IMMOKey PEPSCtl_IndicationKeyCloser PEPSCtl_KeySta PEPSCtl_PSAuthentRes PEPSCtl_PSReq PEPSCtl_WarnNoKeyFound /end REF_MEASUREMENT
/end GROUP
/begin GROUP S206_Polling "AppSwcBcm/AppSwcBcm_10ms/PEPSCtl/Polling" /begin REF_MEASUREMENT PEPSCtl_LckWlcmReq PEPSCtl_UnlckWlcmReq /end REF_MEASUREMENT /end GROUP
/begin GROUP S232_Alarm "AppSwcBcm/AppSwcBcm_20ms/HornCtl/Alarm" /begin REF_MEASUREMENT HornCtl_AlarmSta /end REF_MEASUREMENT /end GROUP
/begin GROUP S232_AntiLck "AppSwcBcm/AppSwcBcm_20ms/HornCtl/AntiLck" /begin REF_MEASUREMENT HornCtl_AntiLckSta /end REF_MEASUREMENT /end GROUP
/begin GROUP S232_Armed "AppSwcBcm/AppSwcBcm_20ms/HornCtl/Armed" /begin REF_MEASUREMENT HornCtl_ArmedSta /end REF_MEASUREMENT /end GROUP
/begin GROUP S232_HornSet "AppSwcBcm/AppSwcBcm_20ms/HornCtl/HornSet" /begin REF_MEASUREMENT HornCtl_LockHoornOnSt HornCtl_LockHoornOnStFb /end REF_MEASUREMENT /end GROUP
/begin GROUP S232_HornSw "AppSwcBcm/AppSwcBcm_20ms/HornCtl/HornSw"
 /begin REF_CHARACTERISTIC HornCtl_HornSwTimInvalid_C HornCtl_HornSwTimValid_C HornCtl_Ts_C /end REF_CHARACTERISTIC
 /begin REF_MEASUREMENT HornCtl_HornSwCtl /end REF_MEASUREMENT
/end GROUP
/begin GROUP S232_Ovrd1 "AppSwcBcm/AppSwcBcm_20ms/HornCtl/Ovrd1" /begin REF_MEASUREMENT HornCtl_J430HornDrv /end REF_MEASUREMENT /end GROUP
/begin GROUP S232_PartArmed "AppSwcBcm/AppSwcBcm_20ms/HornCtl/PartArmed" /begin REF_MEASUREMENT HornCtl_PartArmedSta /end REF_MEASUREMENT /end GROUP
/begin GROUP S232_Seek "AppSwcBcm/AppSwcBcm_20ms/HornCtl/Seek" /begin REF_MEASUREMENT HornCtl_SeekSta /end REF_MEASUREMENT /end GROUP
/begin GROUP S232_Trunk30sWarn "AppSwcBcm/AppSwcBcm_20ms/HornCtl/Trunk30sWarn" /begin REF_CHARACTERISTIC HornCtl_TrunkWarnTim_C /end REF_CHARACTERISTIC /begin REF_MEASUREMENT HornCtl_TrunkWarnSta /end REF_MEASUREMENT /end GROUP
/begin GROUP S233_AutoLampCtl "AppSwcBcm/AppSwcBcm_20ms/LampCtl/AutoLampCtl" /begin SUB_GROUP S308_Lib_SR /end SUB_GROUP
 /begin REF_CHARACTERISTIC LampCtl_AutoLampDayDelayTim_C LampCtl_AutoLampNightDelayTim_C LampCtl_Ts_C /end REF_CHARACTERISTIC
/end GROUP
/begin GROUP S233_BackLampCtl "AppSwcBcm/AppSwcBcm_20ms/LampCtl/BackLampCtl" /begin REF_MEASUREMENT LampCtl_BackLadjvalFb /end REF_MEASUREMENT /end GROUP
/begin GROUP S233_BoxLampCtl "AppSwcBcm/AppSwcBcm_20ms/LampCtl/BoxLampCtl" /begin REF_CHARACTERISTIC LampCtl_BoxLampOpenTimMax_C /end REF_CHARACTERISTIC /end GROUP
/begin GROUP S233_DomeLampCtl "AppSwcBcm/AppSwcBcm_20ms/LampCtl/DomeLampCtl"
 /begin SUB_GROUP S313_DomeLamp10min S313_DomeLamp30sec S313_DomeLampOff S313_Lib_SR /end SUB_GROUP
 /begin REF_MEASUREMENT LampCtl_DomeLampOff LampCtl_DomeLampOffGrad LampCtl_DomeLampOn LampCtl_DomeLampOnGrad /end REF_MEASUREMENT
/end GROUP
/begin GROUP S233_HiBeamCtl "AppSwcBcm/AppSwcBcm_20ms/LampCtl/HiBeamCtl"
 /begin REF_CHARACTERISTIC LampCtl_HiBeamShortToBatTimInValid_C LampCtl_HiBeamShortToBatTimValid_C LampCtl_Ts_C /end REF_CHARACTERISTIC
 /begin REF_MEASUREMENT BSW_HiBeamDigSts LampCtl_HiBeamShortToBat /end REF_MEASUREMENT
/end GROUP
/begin GROUP S233_KnobBeamDig "AppSwcBcm/AppSwcBcm_20ms/LampCtl/KnobBeamDig" /begin REF_CHARACTERISTIC LampCtl_Ts_C /end REF_CHARACTERISTIC /begin REF_MEASUREMENT LampCtl_KnobBeamFaultSta /end REF_MEASUREMENT /end GROUP
/begin GROUP S233_LampDelayCtl "AppSwcBcm/AppSwcBcm_20ms/LampCtl/LampDelayCtl" /begin SUB_GROUP S317_Lib_SR /end SUB_GROUP /begin REF_CHARACTERISTIC LampCtl_LampDelayTim_C /end REF_CHARACTERISTIC /end GROUP
/begin GROUP S233_LightIntstDet "AppSwcBcm/AppSwcBcm_20ms/LampCtl/LightIntstDet" /begin REF_CHARACTERISTIC LampCtl_DayTimeVal_C LampCtl_NightVal_C /end REF_CHARACTERISTIC /begin REF_MEASUREMENT LampCtl_LightIntstSta /end REF_MEASUREMENT /end GROUP
/begin GROUP S233_LowBeamCtl "AppSwcBcm/AppSwcBcm_20ms/LampCtl/LowBeamCtl"
 /begin REF_CHARACTERISTIC LampCtl_LowBeamShortToBatTimInValid_C LampCtl_LowBeamShortToBatTimValid_C LampCtl_LowBeamStaTimInValid_C LampCtl_LowBeamStaTimValid_C LampCtl_Ts_C /end REF_CHARACTERISTIC
 /begin REF_MEASUREMENT BSW_LowBeamDigSts LampCtl_LowBeamShortToBat /end REF_MEASUREMENT
/end GROUP
/begin GROUP S233_Ovrd "AppSwcBcm/AppSwcBcm_20ms/LampCtl/Ovrd" /begin REF_MEASUREMENT LampCtl_PosLampSta /end REF_MEASUREMENT /end GROUP
/begin GROUP S233_Ovrd1 "AppSwcBcm/AppSwcBcm_20ms/LampCtl/Ovrd1" /begin REF_MEASUREMENT LampCtl_DayRunLightSta /end REF_MEASUREMENT /end GROUP
/begin GROUP S233_Ovrd10 "AppSwcBcm/AppSwcBcm_20ms/LampCtl/Ovrd10" /begin REF_MEASUREMENT LampCtl_DomeLampPwmDuty /end REF_MEASUREMENT /end GROUP
/begin GROUP S233_Ovrd11 "AppSwcBcm/AppSwcBcm_20ms/LampCtl/Ovrd11" /begin REF_MEASUREMENT LampCtl_TurnIndcrRSta /end REF_MEASUREMENT /end GROUP
/begin GROUP S233_Ovrd12 "AppSwcBcm/AppSwcBcm_20ms/LampCtl/Ovrd12" /begin REF_MEASUREMENT LampCtl_TurnIndcrLSta /end REF_MEASUREMENT /end GROUP
/begin GROUP S233_Ovrd13 "AppSwcBcm/AppSwcBcm_20ms/LampCtl/Ovrd13" /begin REF_MEASUREMENT LampCtl_J449BoxLamp /end REF_MEASUREMENT /end GROUP
/begin GROUP S233_Ovrd14 "AppSwcBcm/AppSwcBcm_20ms/LampCtl/Ovrd14" /begin REF_MEASUREMENT LampCtl_J408BackLampPWM /end REF_MEASUREMENT /end GROUP
/begin GROUP S233_Ovrd2 "AppSwcBcm/AppSwcBcm_20ms/LampCtl/Ovrd2" /begin REF_MEASUREMENT LampCtl_BrakeLightSta /end REF_MEASUREMENT /end GROUP
/begin GROUP S233_Ovrd3 "AppSwcBcm/AppSwcBcm_20ms/LampCtl/Ovrd3" /begin REF_MEASUREMENT LampCtl_J420BSDRightCtl /end REF_MEASUREMENT /end GROUP
/begin GROUP S233_Ovrd4 "AppSwcBcm/AppSwcBcm_20ms/LampCtl/Ovrd4" /begin REF_MEASUREMENT LampCtl_J422BSDLeftCtl /end REF_MEASUREMENT /end GROUP
/begin GROUP S233_Ovrd5 "AppSwcBcm/AppSwcBcm_20ms/LampCtl/Ovrd5" /begin REF_MEASUREMENT LampCtl_LowBeamSta /end REF_MEASUREMENT /end GROUP
/begin GROUP S233_Ovrd6 "AppSwcBcm/AppSwcBcm_20ms/LampCtl/Ovrd6" /begin REF_MEASUREMENT LampCtl_FogLampRSta /end REF_MEASUREMENT /end GROUP
/begin GROUP S233_Ovrd7 "AppSwcBcm/AppSwcBcm_20ms/LampCtl/Ovrd7" /begin REF_MEASUREMENT LampCtl_FogLampFSta /end REF_MEASUREMENT /end GROUP
/begin GROUP S233_Ovrd8 "AppSwcBcm/AppSwcBcm_20ms/LampCtl/Ovrd8" /begin REF_MEASUREMENT LampCtl_ReverseLampSta /end REF_MEASUREMENT /end GROUP
/begin GROUP S233_Ovrd9 "AppSwcBcm/AppSwcBcm_20ms/LampCtl/Ovrd9" /begin REF_MEASUREMENT LampCtl_HiBeamSta /end REF_MEASUREMENT /end GROUP
/begin GROUP S233_PassLampFunc "AppSwcBcm/AppSwcBcm_20ms/LampCtl/PassLampFunc" /begin REF_MEASUREMENT LampCtl_PassLightSta /end REF_MEASUREMENT /end GROUP
/begin GROUP S233_PosLampCtl "AppSwcBcm/AppSwcBcm_20ms/LampCtl/PosLampCtl"
 /begin REF_CHARACTERISTIC LampCtl_PosLampStaTimInValid_C LampCtl_PosLampStaTimValid_C LampCtl_Ts_C /end REF_CHARACTERISTIC
/end GROUP
/begin GROUP S233_SignalProcess "AppSwcBcm/AppSwcBcm_20ms/LampCtl/SignalProcess"
 /begin REF_CHARACTERISTIC LampCtl_AutoLampTimInValid_C LampCtl_AutoLampTimValid_C LampCtl_AutoLampVal_C LampCtl_BrakeLightVal_C LampCtl_BrakeSwInValid_C LampCtl_BrakeSwTimValid_C LampCtl_FogLampFTimInValid_C LampCtl_FogLampFTimValid_C LampCtl_FogLampFVal_C LampCtl_FogLampRTimInValid_C LampCtl_FogLampRTimValid_C LampCtl_FogLampRVal_C LampCtl_HazardLightTimInValid_C LampCtl_HazardLightTimValid_C LampCtl_HazardLightVal_C LampCtl_HiBeamTimInValid_C LampCtl_HiBeamTimValid_C LampCtl_HiBeamVal_C LampCtl_InportCalSwBit_C LampCtl_LowBeamTimInValid_C LampCtl_LowBeamTimValid_C LampCtl_LowBeamVal_C LampCtl_PassLightTimInValid_C LampCtl_PassLightTimValid_C LampCtl_PassLightVal_C LampCtl_PosLampTimInValid_C LampCtl_PosLampTimValid_C LampCtl_PosLampVal_C LampCtl_Ts_C LampCtl_TurnIndcrLTimInValid_C LampCtl_TurnIndcrLTimValid_C LampCtl_TurnIndcrLVal_C LampCtl_TurnIndcrLaneLTimInValid_C LampCtl_TurnIndcrLaneLTimValid_C LampCtl_TurnIndcrLaneRTimInValid_C LampCtl_TurnIndcrLaneRTimValid_C LampCtl_TurnIndcrRTimInValid_C LampCtl_TurnIndcrRTimValid_C LampCtl_TurnIndcrRVal_C /end REF_CHARACTERISTIC
 /begin REF_MEASUREMENT LampCtl_AutoLampSw LampCtl_BrakeLightSw LampCtl_FogLampFSw LampCtl_FogLampRSw LampCtl_HazardLightSw LampCtl_HiBeamSw LampCtl_LightIntstVal LampCtl_LowBeamSw LampCtl_PassLightSw LampCtl_PosLampSw LampCtl_RKEReq LampCtl_TurnIndcrLSw LampCtl_TurnIndcrLaneLSw LampCtl_TurnIndcrLaneRSw LampCtl_TurnIndcrRSw /end REF_MEASUREMENT
/end GROUP
/begin GROUP S233_TurnIndcrCtl "AppSwcBcm/AppSwcBcm_20ms/LampCtl/TurnIndcrCtl"
 /begin SUB_GROUP S339_AlrmFunc S339_AntiLckFunc S339_ArmedFunc S339_CrashWarnFunc S339_DisarmedFunc S339_EmergencyFunc S339_PartArmedFunc S339_RodBeamDig S339_ThermRunawayFunc S339_Trunk30sWarn S339_TurnIndcrDig S339_TurnIndcrLCtl S339_TurnIndcrRCtl S339_VehMode S339_VehSeekFunc /end SUB_GROUP
 /begin REF_MEASUREMENT LampCtl_EmerHazardLightSta LampCtl_HazardLightSta LampCtl_TurnIndcrLFlashCnt LampCtl_TurnIndcrMod LampCtl_TurnIndcrPrd LampCtl_TurnIndcrRFlashCnt LampCtl_TurnIndcrRst LampCtl_TurnIndcrWdt /end REF_MEASUREMENT
/end GROUP
/begin GROUP S233_WelcomeLampCtl "AppSwcBcm/AppSwcBcm_20ms/LampCtl/WelcomeLampCtl"
 /begin SUB_GROUP S340_FlwrMeHomeOn S340_FlwrMeHomeSet S340_Lib_SR S340_Lib_SR1 S340_WelcomeLampOff S340_WelcomeLampOn /end SUB_GROUP
/end GROUP
/begin GROUP S234_LockedRotorProt "AppSwcBcm/AppSwcBcm_20ms/WiperCtl/LockedRotorProt"
 /begin REF_CHARACTERISTIC WiperCtl_LockedRotorTimDef_C WiperCtl_LockedRotorTimOk_C WiperCtl_LockedRotorTimParkDef_C WiperCtl_LockedRotorTimParkOk_C /end REF_CHARACTERISTIC
 /begin REF_MEASUREMENT WiperCtl_LockedRotorProtSta /end REF_MEASUREMENT
/end GROUP
/begin GROUP S234_Ovrd1 "AppSwcBcm/AppSwcBcm_20ms/WiperCtl/Ovrd1" /begin REF_MEASUREMENT WiperCtl_LowSpdDrv /end REF_MEASUREMENT /end GROUP
/begin GROUP S234_Ovrd2 "AppSwcBcm/AppSwcBcm_20ms/WiperCtl/Ovrd2" /begin REF_MEASUREMENT WiperCtl_HiSpdDrv /end REF_MEASUREMENT /end GROUP
/begin GROUP S234_Ovrd3 "AppSwcBcm/AppSwcBcm_20ms/WiperCtl/Ovrd3" /begin REF_MEASUREMENT WiperCtl_WashMotorDrv /end REF_MEASUREMENT /end GROUP
/begin GROUP S234_SignalProcess "AppSwcBcm/AppSwcBcm_20ms/WiperCtl/SignalProcess"
 /begin REF_CHARACTERISTIC WiperCtl_HiSpdTimInValid_C WiperCtl_HiSpdTimValid_C WiperCtl_InportCalSwBit_C WiperCtl_InrTimInValid_C WiperCtl_InrTimValid_C WiperCtl_LowSpdTimInValid_C WiperCtl_LowSpdTimValid_C WiperCtl_MistTimInValid_C WiperCtl_MistTimValid_C WiperCtl_OffTimInValid_C WiperCtl_OffTimValid_C WiperCtl_Ts_C WiperCtl_WashTimInValid_C WiperCtl_WashTimValid_C WiperCtl_WashVal_C WiperCtl_WiperParkPosTimValid_C WiperCtl_WiperParkPosVal_C WiperCtl_WiperPosTimInValid_C WiperCtl_WiperSwVal_C /end REF_CHARACTERISTIC
 /begin REF_MEASUREMENT WiperCtl_WashSw WiperCtl_WiperHiSpdSw WiperCtl_WiperInrSw WiperCtl_WiperLowSpdSw WiperCtl_WiperMistSw WiperCtl_WiperOffSw WiperCtl_WiperParkPosSw /end REF_MEASUREMENT
/end GROUP
/begin GROUP S234_WashCtl "AppSwcBcm/AppSwcBcm_20ms/WiperCtl/WashCtl" /begin REF_CHARACTERISTIC WiperCtl_Ts_C WiperCtl_WashMaxTim_C WiperCtl_WashMinTim_C /end REF_CHARACTERISTIC /begin REF_MEASUREMENT WiperCtl_WashWiperSta /end REF_MEASUREMENT /end GROUP
/begin GROUP S234_WiperDrv "AppSwcBcm/AppSwcBcm_20ms/WiperCtl/WiperDrv"
 /begin REF_CHARACTERISTIC WiperCtl_MaintWiperRunTim_C WiperCtl_WashAfterNum_C WiperCtl_WashAfterTim_C /end REF_CHARACTERISTIC
 /begin REF_MEASUREMENT AppSwcBcm_ARID_DEF.WiperCtl_WashComp AppSwcBcm_ARID_DEF.after_cnt AppSwcBcm_ARID_DEF.last_cnt WiperCtl_WiperSta /end REF_MEASUREMENT
/end GROUP
/begin GROUP S234_WiperHiSpdCtl "AppSwcBcm/AppSwcBcm_20ms/WiperCtl/WiperHiSpdCtl" /begin REF_MEASUREMENT WiperCtl_WiperHiSpdSta /end REF_MEASUREMENT /end GROUP
/begin GROUP S234_WiperInrCtl "AppSwcBcm/AppSwcBcm_20ms/WiperCtl/WiperInrCtl"
 /begin REF_CHARACTERISTIC WiperCtl_InrLvl1Tim_C WiperCtl_InrLvl2Tim_C WiperCtl_InrLvl3Tim_C WiperCtl_InrLvl4Tim_C WiperCtl_InrLvl5Tim_C WiperCtl_InrLvl6Tim_C WiperCtl_InrLvl7Tim_C /end REF_CHARACTERISTIC
 /begin REF_MEASUREMENT WiperCtl_InrTim WiperCtl_InrTimChg WiperCtl_WiperInrSta WiperCtl_WiprIntlTimeSetFb /end REF_MEASUREMENT
/end GROUP
/begin GROUP S234_WiperLowSpdCtl "AppSwcBcm/AppSwcBcm_20ms/WiperCtl/WiperLowSpdCtl" /begin REF_MEASUREMENT WiperCtl_WiperLowSpdSta /end REF_MEASUREMENT /end GROUP
/begin GROUP S234_WiperMaintCtl "AppSwcBcm/AppSwcBcm_20ms/WiperCtl/WiperMaintCtl" /begin SUB_GROUP S577_Lib_SR /end SUB_GROUP /end GROUP
/begin GROUP S234_WiperMistCtl "AppSwcBcm/AppSwcBcm_20ms/WiperCtl/WiperMistCtl" /begin REF_MEASUREMENT WiperCtl_WiperMistSta /end REF_MEASUREMENT /end GROUP
/begin GROUP S234_WiperOffCtl "AppSwcBcm/AppSwcBcm_20ms/WiperCtl/WiperOffCtl" /begin REF_MEASUREMENT WiperCtl_WiperOffSta /end REF_MEASUREMENT /end GROUP
/begin GROUP S621_Ovrd1 "AppSwcBcm/AppSwcBcm_50ms/BatSaveCtl/Ovrd1" /begin REF_MEASUREMENT BatSaveCtl_J64SavePwr /end REF_MEASUREMENT /end GROUP
/begin GROUP S621_PwrOff "AppSwcBcm/AppSwcBcm_50ms/BatSaveCtl/PwrOff" /begin REF_CHARACTERISTIC BatSaveCtl_DlyTim_C BatSaveCtl_LckDlyTim_C /end REF_CHARACTERISTIC
 /begin REF_MEASUREMENT AppSwcBcm_ARID_DEF.Cnt_m BatSaveCtl_DoorLckPwrOff BatSaveCtl_PwrModeOff BatSaveCtl_PwrOff /end REF_MEASUREMENT
/end GROUP
/begin GROUP S621_PwrOn "AppSwcBcm/AppSwcBcm_50ms/BatSaveCtl/PwrOn"
 /begin REF_MEASUREMENT BatSaveCtl_DoorChgSta BatSaveCtl_DoorUnlckPwrOn BatSaveCtl_PwrModeOn BatSaveCtl_PwrOn /end REF_MEASUREMENT
/end GROUP
/begin GROUP S623_DoorLckCtlLogic "AppSwcBcm/AppSwcBcm_50ms/DoorLckCtl/DoorLckCtlLogic"
 /begin SUB_GROUP S657_AntiLckProt S657_IllmndLckSet S657_IllmndUnlckSet S657_InsideLck S657_InsideUnlck S657_MotorProt S657_OutsideLck S657_OutsideUnlck S657_PECtl S657_ParkUnlckSet S657_SpdLck /end SUB_GROUP
 /begin REF_MEASUREMENT AppSwcBcm_ARID_DEF.flg_l /end REF_MEASUREMENT
/end GROUP
/begin GROUP S623_Ovrd1 "AppSwcBcm/AppSwcBcm_50ms/DoorLckCtl/Ovrd1" /begin REF_MEASUREMENT DoorLckCtl_J54DoorLck /end REF_MEASUREMENT /end GROUP
/begin GROUP S623_Ovrd2 "AppSwcBcm/AppSwcBcm_50ms/DoorLckCtl/Ovrd2" /begin REF_MEASUREMENT DoorLckCtl_J511TrunkUnlck /end REF_MEASUREMENT /end GROUP
/begin GROUP S623_Ovrd3 "AppSwcBcm/AppSwcBcm_50ms/DoorLckCtl/Ovrd3" /begin REF_MEASUREMENT DoorLckCtl_J56DoorUnlck /end REF_MEASUREMENT /end GROUP
/begin GROUP S623_SignalProcess "AppSwcBcm/AppSwcBcm_50ms/DoorLckCtl/SignalProcess"
 /begin REF_CHARACTERISTIC DoorLckCtl_DoorAjarFLTimInValid_C DoorLckCtl_DoorAjarFLTimValid_C DoorLckCtl_DoorAjarFLVal_C DoorLckCtl_DoorAjarFRTimInValid_C DoorLckCtl_DoorAjarFRTimValid_C DoorLckCtl_DoorAjarFRVal_C DoorLckCtl_DoorAjarRLTimInvalid_C DoorLckCtl_DoorAjarRLTimValid_C DoorLckCtl_DoorAjarRLVal_C DoorLckCtl_DoorAjarRRTimInvalid_C DoorLckCtl_DoorAjarRRTimValid_C DoorLckCtl_DoorAjarRRVal_C DoorLckCtl_DriverDoorLckTimInValid_C DoorLckCtl_DriverDoorLckTimValid_C DoorLckCtl_DriverDoorLckVal_C DoorLckCtl_DrvPETimInvalid_C DoorLckCtl_DrvPETimValid_C DoorLckCtl_DrvPEVal_C DoorLckCtl_DrvSeatResisMin_C DoorLckCtl_DrvSeatResisVal_C DoorLckCtl_DrvSeatTimInValid_C DoorLckCtl_DrvSeatTimValid_C DoorLckCtl_EEIlluminatedEntrySys_C DoorLckCtl_EEKeyEntry_C DoorLckCtl_IllmndSts_C DoorLckCtl_InportCalSwBit_C DoorLckCtl_PsgPETimInvalid_C DoorLckCtl_PsgPETimValid_C DoorLckCtl_PsgPEVal_C DoorLckCtl_TrunkAjarTimInvalid_C DoorLckCtl_TrunkAjarTimValid_C DoorLckCtl_TrunkAjarVal_C DoorLckCtl_TrunkSwVal_C DoorLckCtl_Ts_C /end REF_CHARACTERISTIC
 /begin REF_MEASUREMENT DoorLckCtl_DoorAjarFLSw DoorLckCtl_DoorAjarFRSw DoorLckCtl_DoorAjarRLSw DoorLckCtl_DoorAjarRRSw DoorLckCtl_DriverDoorLckSw DoorLckCtl_DrvPESw DoorLckCtl_DrvSeatSw DoorLckCtl_EEIlluminatedEntrySys DoorLckCtl_EEKeyEntry DoorLckCtl_HoodAjarSw DoorLckCtl_IllmndSts DoorLckCtl_PsgPESw DoorLckCtl_TrunkAjarSw DoorLckCtl_TrunkSw DoorLckCtl_VehRun DoorLckCtl_VehSpd DoorLckCtl_VehStop /end REF_MEASUREMENT
/end GROUP
/begin GROUP S624_0xF230DoorOpRecord "AppSwcBcm/AppSwcBcm_50ms/DynDID/0xF230DoorOpRecord" /begin REF_MEASUREMENT DynDID_0xF230DoorOpRecord /end REF_MEASUREMENT /end GROUP
/begin GROUP S624_0xF231TrunkOpRecord "AppSwcBcm/AppSwcBcm_50ms/DynDID/0xF231TrunkOpRecord" /begin REF_MEASUREMENT DynDID_0xF231TrunkOpRecord /end REF_MEASUREMENT /end GROUP
/begin GROUP S624_0xF232LocalStartUpFailRecord "AppSwcBcm/AppSwcBcm_50ms/DynDID/0xF232LocalStartUpFailRecord" /begin REF_MEASUREMENT DynDID_0xF232LocalStartUpFailRecord /end REF_MEASUREMENT /end GROUP
/begin GROUP S624_0xF233RemoteStartUpFailRecord "AppSwcBcm/AppSwcBcm_50ms/DynDID/0xF233RemoteStartUpFailRecord" /begin REF_MEASUREMENT DynDID_0xF233RemoteStartUpFailRecord /end REF_MEASUREMENT /end GROUP
/begin GROUP S624_0xF234ADSampleValue "AppSwcBcm/AppSwcBcm_50ms/DynDID/0xF234ADSampleValue" /begin REF_MEASUREMENT DynDID_0xF234ADSampleValue /end REF_MEASUREMENT /end GROUP
/begin GROUP S624_0xF235DigtInSampleValue "AppSwcBcm/AppSwcBcm_50ms/DynDID/0xF235DigtInSampleValue" /begin REF_MEASUREMENT DynDID_0xF235DigtInSampleValue /end REF_MEASUREMENT /end GROUP
/begin GROUP S624_0xF236DigtOutSampleValue "AppSwcBcm/AppSwcBcm_50ms/DynDID/0xF236DigtOutSampleValue" /begin REF_MEASUREMENT DynDID_0xF236DigtOutSampleValue /end REF_MEASUREMENT /end GROUP
/begin GROUP S625_ESCLCtl "AppSwcBcm/AppSwcBcm_50ms/ESCLCtl/ESCLCtl" /begin SUB_GROUP S820_Ovrd /end SUB_GROUP
 /begin REF_CHARACTERISTIC ESCLCtl_J436PwrSupOvrdFlg_C ESCLCtl_J436PwrSupOvrdVal_C ESCLCtl_LckDelay_C ESCLCtl_LckTimMax_C ESCLCtl_UnlckDelay_C ESCLCtl_UnlckTimMax_C /end REF_CHARACTERISTIC
 /begin REF_MEASUREMENT ESCLCtl_J436Lck ESCLCtl_J436Unlck ESCLCtl_Lck ESCLCtl_UnOrLockCrtl ESCLCtl_Unlck /end REF_MEASUREMENT
/end GROUP
/begin GROUP S627_Ovrd1 "AppSwcBcm/AppSwcBcm_50ms/PDUCtl/Ovrd1" /begin REF_MEASUREMENT PDUCtl_J421IG1RlyCtl /end REF_MEASUREMENT /end GROUP
/begin GROUP S627_Ovrd2 "AppSwcBcm/AppSwcBcm_50ms/PDUCtl/Ovrd2" /begin REF_MEASUREMENT PDUCtl_J437IG2RlyCtl /end REF_MEASUREMENT /end GROUP
/begin GROUP S627_PwrOff "AppSwcBcm/AppSwcBcm_50ms/PDUCtl/PwrOff"
 /begin REF_CHARACTERISTIC PDUCtl_TimOutPwrOffH_C PDUCtl_TimOutPwrOffM_C PDUCtl_TimOutPwrOffS_C PDUCtl_Ts_C /end REF_CHARACTERISTIC
 /begin REF_MEASUREMENT PDUCtl_PwrOff /end REF_MEASUREMENT
/end GROUP
/begin GROUP S627_PwrOn "AppSwcBcm/AppSwcBcm_50ms/PDUCtl/PwrOn"
 /begin REF_CHARACTERISTIC PDUCtl_KeyValidOvrdFlg_C PDUCtl_KeyValidOvrdVal_C PDUCtl_OpenDoorPwrOnTimValid PDUCtl_PwrOnPSTimValid_C /end REF_CHARACTERISTIC
 /begin REF_MEASUREMENT PDUCtl_PwrOn /end REF_MEASUREMENT
/end GROUP
/begin GROUP S627_RelayDig "AppSwcBcm/AppSwcBcm_50ms/PDUCtl/RelayDig" /begin REF_CHARACTERISTIC PDUCtl_Ts_C /end REF_CHARACTERISTIC
 /begin REF_MEASUREMENT PDUCtl_IG1RelayFault PDUCtl_IG2RelayFault PDUCtl_IGRlyIlgCls PDUCtl_SysPwrModeV /end REF_MEASUREMENT
/end GROUP
/begin GROUP S627_StartReq "AppSwcBcm/AppSwcBcm_50ms/PDUCtl/StartReq" /begin SUB_GROUP S842_Lib_SR /end SUB_GROUP /begin REF_CHARACTERISTIC PDUCtl_StartReqOverTimValid_C PDUCtl_StartReqTimValid_C /end REF_CHARACTERISTIC /end GROUP
/begin GROUP S627_Subsystem "AppSwcBcm/AppSwcBcm_50ms/PDUCtl/Subsystem" /begin REF_MEASUREMENT PDUCtl_SysPwrModeAct /end REF_MEASUREMENT /end GROUP
/begin GROUP S628_WakeUpCtl "AppSwcBcm/AppSwcBcm_50ms/WakeUpCtl/WakeUpCtl" /begin SUB_GROUP S870_NMCtl S870_SleepCtl /end SUB_GROUP /end GROUP
/begin GROUP S129_Ovrd "AppSwcBcm/AppSwcBcm_100ms/SeatCtl/SeatCtl/Ovrd" /begin REF_MEASUREMENT SeatCtl_CN167DrvSeatHtPWM /end REF_MEASUREMENT /end GROUP
/begin GROUP S132_Ovrd "AppSwcBcm/AppSwcBcm_100ms/SteerWhlCtl/SteerWhlCtl/Ovrd" /begin REF_MEASUREMENT SteerWhlCtl_J447SteerWhlHt /end REF_MEASUREMENT /end GROUP
/begin GROUP S308_Lib_SR "AppSwcBcm/AppSwcBcm_20ms/LampCtl/AutoLampCtl/Lib_SR" /begin REF_MEASUREMENT LampCtl_AutoLampSta /end REF_MEASUREMENT /end GROUP
/begin GROUP S313_DomeLamp10min "AppSwcBcm/AppSwcBcm_20ms/LampCtl/DomeLampCtl/DomeLamp10min" /begin SUB_GROUP S361_FL10min S361_FR10min /end SUB_GROUP /end GROUP
/begin GROUP S313_DomeLamp30sec "AppSwcBcm/AppSwcBcm_20ms/LampCtl/DomeLampCtl/DomeLamp30sec" /begin SUB_GROUP S362_30s S362_30s1 /end SUB_GROUP /end GROUP
/begin GROUP S313_DomeLampOff "AppSwcBcm/AppSwcBcm_20ms/LampCtl/DomeLampCtl/DomeLampOff" /begin SUB_GROUP S364_Lib_RiseEdgeDetInit /end SUB_GROUP /begin REF_MEASUREMENT LampCtl_DomeLampCloseDoor /end REF_MEASUREMENT /end GROUP
/begin GROUP S313_Lib_SR "AppSwcBcm/AppSwcBcm_20ms/LampCtl/DomeLampCtl/Lib_SR" /begin REF_MEASUREMENT LampCtl_DomeLampCtl /end REF_MEASUREMENT /end GROUP
/begin GROUP S317_Lib_SR "AppSwcBcm/AppSwcBcm_20ms/LampCtl/LampDelayCtl/Lib_SR" /begin REF_MEASUREMENT LampCtl_LampDelay /end REF_MEASUREMENT /end GROUP
/begin GROUP S339_AlrmFunc "AppSwcBcm/AppSwcBcm_20ms/LampCtl/TurnIndcrCtl/AlrmFunc" /begin REF_MEASUREMENT LampCtl_AlrmSta /end REF_MEASUREMENT /end GROUP
/begin GROUP S339_AntiLckFunc "AppSwcBcm/AppSwcBcm_20ms/LampCtl/TurnIndcrCtl/AntiLckFunc" /begin REF_MEASUREMENT LampCtl_AntiLckSta /end REF_MEASUREMENT /end GROUP
/begin GROUP S339_ArmedFunc "AppSwcBcm/AppSwcBcm_20ms/LampCtl/TurnIndcrCtl/ArmedFunc" /begin REF_MEASUREMENT LampCtl_ArmedSta /end REF_MEASUREMENT /end GROUP
/begin GROUP S339_CrashWarnFunc "AppSwcBcm/AppSwcBcm_20ms/LampCtl/TurnIndcrCtl/CrashWarnFunc" /begin REF_MEASUREMENT LampCtl_CrashSta /end REF_MEASUREMENT /end GROUP
/begin GROUP S339_DisarmedFunc "AppSwcBcm/AppSwcBcm_20ms/LampCtl/TurnIndcrCtl/DisarmedFunc" /begin REF_MEASUREMENT LampCtl_DisarmedSta /end REF_MEASUREMENT /end GROUP
/begin GROUP S339_EmergencyFunc "AppSwcBcm/AppSwcBcm_20ms/LampCtl/TurnIndcrCtl/EmergencyFunc" /begin REF_MEASUREMENT LampCtl_EmerSta /end REF_MEASUREMENT /end GROUP
/begin GROUP S339_PartArmedFunc "AppSwcBcm/AppSwcBcm_20ms/LampCtl/TurnIndcrCtl/PartArmedFunc" /begin REF_MEASUREMENT LampCtl_PartArmedSta /end REF_MEASUREMENT /end GROUP
/begin GROUP S339_RodBeamDig "AppSwcBcm/AppSwcBcm_20ms/LampCtl/TurnIndcrCtl/RodBeamDig" /begin REF_CHARACTERISTIC LampCtl_Ts_C /end REF_CHARACTERISTIC /begin REF_MEASUREMENT LampCtl_RodBeamFaultSta /end REF_MEASUREMENT /end GROUP
/begin GROUP S339_ThermRunawayFunc "AppSwcBcm/AppSwcBcm_20ms/LampCtl/TurnIndcrCtl/ThermRunawayFunc" /begin REF_MEASUREMENT LampCtl_ThermalrunawaySta /end REF_MEASUREMENT /end GROUP
/begin GROUP S339_Trunk30sWarn "AppSwcBcm/AppSwcBcm_20ms/LampCtl/TurnIndcrCtl/Trunk30sWarn" /begin REF_CHARACTERISTIC LampCtl_TrunkWarnTim_C /end REF_CHARACTERISTIC /begin REF_MEASUREMENT LampCtl_TrunkWarnSta /end REF_MEASUREMENT /end GROUP
/begin GROUP S339_TurnIndcrDig "AppSwcBcm/AppSwcBcm_20ms/LampCtl/TurnIndcrCtl/TurnIndcrDig" /begin SUB_GROUP S448_Enabled_Subsystem1 S448_Enabled_Subsystem3 /end SUB_GROUP
 /begin REF_CHARACTERISTIC LampCtl_LOpenCnt_C LampCtl_LShortCnt_C LampCtl_ROpenCnt_C LampCtl_RShortCnt_C LampCtl_Ts_C LampCtl_TurnIndcrLOpenTimInValid_C LampCtl_TurnIndcrLOpenTimValid_C LampCtl_TurnIndcrLShortTimInValid_C LampCtl_TurnIndcrLShortTimValid_C LampCtl_TurnIndcrOpenCur_C LampCtl_TurnIndcrROpenTimInValid_C LampCtl_TurnIndcrROpenTimValid_C LampCtl_TurnIndcrRShortTimInValid_C LampCtl_TurnIndcrRShortTimValid_C LampCtl_TurnIndcrShortCur_C /end REF_CHARACTERISTIC
 /begin REF_MEASUREMENT LampCtl_TurnIndcrLOpen LampCtl_TurnIndcrLShort LampCtl_TurnIndcrROpen LampCtl_TurnIndcrRShort /end REF_MEASUREMENT
/end GROUP
/begin GROUP S339_TurnIndcrLCtl "AppSwcBcm/AppSwcBcm_20ms/LampCtl/TurnIndcrCtl/TurnIndcrLCtl" /begin REF_MEASUREMENT LampCtl_PrdSucCntL /end REF_MEASUREMENT /end GROUP
/begin GROUP S339_TurnIndcrRCtl "AppSwcBcm/AppSwcBcm_20ms/LampCtl/TurnIndcrCtl/TurnIndcrRCtl" /begin REF_MEASUREMENT LampCtl_PrdSucCntR /end REF_MEASUREMENT /end GROUP
/begin GROUP S339_VehMode "AppSwcBcm/AppSwcBcm_20ms/LampCtl/TurnIndcrCtl/VehMode" /begin REF_MEASUREMENT LampCtl_VehModeSta /end REF_MEASUREMENT /end GROUP
/begin GROUP S339_VehSeekFunc "AppSwcBcm/AppSwcBcm_20ms/LampCtl/TurnIndcrCtl/VehSeekFunc" /begin REF_MEASUREMENT LampCtl_VehSeekSta /end REF_MEASUREMENT /end GROUP
/begin GROUP S340_FlwrMeHomeOn "AppSwcBcm/AppSwcBcm_20ms/LampCtl/WelcomeLampCtl/FlwrMeHomeOn" /begin REF_CHARACTERISTIC LampCtl_FlwrMeHomeTimValid_C /end REF_CHARACTERISTIC /end GROUP
/begin GROUP S340_FlwrMeHomeSet "AppSwcBcm/AppSwcBcm_20ms/LampCtl/WelcomeLampCtl/FlwrMeHomeSet" /begin REF_MEASUREMENT LampCtl_FlwrMeHomeCtlFb LampCtl_FlwrMeHomeTim /end REF_MEASUREMENT /end GROUP
/begin GROUP S340_Lib_SR "AppSwcBcm/AppSwcBcm_20ms/LampCtl/WelcomeLampCtl/Lib_SR" /begin REF_MEASUREMENT LampCtl_WelcomeLampSta /end REF_MEASUREMENT /end GROUP
/begin GROUP S340_Lib_SR1 "AppSwcBcm/AppSwcBcm_20ms/LampCtl/WelcomeLampCtl/Lib_SR1" /begin REF_MEASUREMENT LampCtl_FlwrMeHomeSta /end REF_MEASUREMENT /end GROUP
/begin GROUP S340_WelcomeLampOff "AppSwcBcm/AppSwcBcm_20ms/LampCtl/WelcomeLampCtl/WelcomeLampOff" /begin REF_CHARACTERISTIC LampCtl_WelcomeLampTimMax_C /end REF_CHARACTERISTIC /end GROUP
/begin GROUP S340_WelcomeLampOn "AppSwcBcm/AppSwcBcm_20ms/LampCtl/WelcomeLampCtl/WelcomeLampOn" /begin REF_CHARACTERISTIC LampCtl_OsUnlckDelayTim_C /end REF_CHARACTERISTIC /end GROUP
/begin GROUP S577_Lib_SR "AppSwcBcm/AppSwcBcm_20ms/WiperCtl/WiperMaintCtl/Lib_SR" /begin REF_MEASUREMENT WiperCtl_WiperMaintSta /end REF_MEASUREMENT /end GROUP
/begin GROUP S657_AntiLckProt "AppSwcBcm/AppSwcBcm_50ms/DoorLckCtl/DoorLckCtlLogic/AntiLckProt" /begin REF_CHARACTERISTIC DoorLckCtl_AntiLckProtTim_C /end REF_CHARACTERISTIC
 /begin REF_MEASUREMENT DoorLckCtl_DoorProtUnlck DoorLckCtl_MechAntiLck DoorLckCtl_RKEAntiLck /end REF_MEASUREMENT
/end GROUP
/begin GROUP S657_IllmndLckSet "AppSwcBcm/AppSwcBcm_50ms/DoorLckCtl/DoorLckCtlLogic/IllmndLckSet" /begin REF_MEASUREMENT DoorLckCtl_IllmndLckSts DoorLckCtl_IllmndLckStsFb /end REF_MEASUREMENT /end GROUP
/begin GROUP S657_IllmndUnlckSet "AppSwcBcm/AppSwcBcm_50ms/DoorLckCtl/DoorLckCtlLogic/IllmndUnlckSet" /begin REF_MEASUREMENT DoorLckCtl_IllmndUnlockSts DoorLckCtl_IllmndUnlockStsFb /end REF_MEASUREMENT /end GROUP
/begin GROUP S657_InsideLck "AppSwcBcm/AppSwcBcm_50ms/DoorLckCtl/DoorLckCtlLogic/InsideLck" /begin SUB_GROUP S668_HULck S668_SpdLck /end SUB_GROUP /begin REF_MEASUREMENT DoorLckCtl_InsLck /end REF_MEASUREMENT /end GROUP
/begin GROUP S657_InsideUnlck "AppSwcBcm/AppSwcBcm_50ms/DoorLckCtl/DoorLckCtlLogic/InsideUnlck"
 /begin SUB_GROUP S669_CrshUnlck S669_HUUnlck S669_ParkUnlck S669_ThermalRunawayUnlck /end SUB_GROUP
 /begin REF_MEASUREMENT DoorLckCtl_InsUnlck /end REF_MEASUREMENT
/end GROUP
/begin GROUP S657_MotorProt "AppSwcBcm/AppSwcBcm_50ms/DoorLckCtl/DoorLckCtlLogic/MotorProt"
 /begin REF_CHARACTERISTIC DoorLckCtl_CntSubTim_C DoorLckCtl_MotorProtTimMax_C DoorLckCtl_MotorWorkMax_C /end REF_CHARACTERISTIC
 /begin REF_MEASUREMENT DoorLckCtl_MotorProt /end REF_MEASUREMENT
/end GROUP
/begin GROUP S657_OutsideLck "AppSwcBcm/AppSwcBcm_50ms/DoorLckCtl/DoorLckCtlLogic/OutsideLck"
 /begin SUB_GROUP S671_AutoLck S671_MechLck S671_PELck S671_RKELck S671_TrunkAutoLck S671_WelcomeLck /end SUB_GROUP
 /begin REF_MEASUREMENT DoorLckCtl_OsLck /end REF_MEASUREMENT
/end GROUP
/begin GROUP S657_OutsideUnlck "AppSwcBcm/AppSwcBcm_50ms/DoorLckCtl/DoorLckCtlLogic/OutsideUnlck"
 /begin SUB_GROUP S672_MechUnlck S672_PEUnlck S672_RKEUnlck S672_TrunkUnlck S672_WelcomeUnlck /end SUB_GROUP
 /begin REF_MEASUREMENT DoorLckCtl_OsUnlck /end REF_MEASUREMENT
/end GROUP
/begin GROUP S657_PECtl "AppSwcBcm/AppSwcBcm_50ms/DoorLckCtl/DoorLckCtlLogic/PECtl" /begin REF_CHARACTERISTIC DoorLckCtl_PEProtCnt_C DoorLckCtl_PEProtIntvlTim_C /end REF_CHARACTERISTIC /begin REF_MEASUREMENT AppSwcBcm_ARID_DEF.Cnt2_j AppSwcBcm_ARID_DEF.Cnt_j /end REF_MEASUREMENT /end GROUP
/begin GROUP S657_ParkUnlckSet "AppSwcBcm/AppSwcBcm_50ms/DoorLckCtl/DoorLckCtlLogic/ParkUnlckSet" /begin REF_MEASUREMENT DoorLckCtl_ParkAutoUnlockSetFb /end REF_MEASUREMENT /end GROUP
/begin GROUP S657_SpdLck "AppSwcBcm/AppSwcBcm_50ms/DoorLckCtl/DoorLckCtlLogic/SpdLck" /begin REF_MEASUREMENT DoorLckCtl_SpdCtlLckSet DoorLckCtl_SpdCtlLckSetFb /end REF_MEASUREMENT /end GROUP
/begin GROUP S820_Ovrd "AppSwcBcm/AppSwcBcm_50ms/ESCLCtl/ESCLCtl/Ovrd" /begin REF_MEASUREMENT ESCLCtl_J436PwrSup /end REF_MEASUREMENT /end GROUP
/begin GROUP S842_Lib_SR "AppSwcBcm/AppSwcBcm_50ms/PDUCtl/StartReq/Lib_SR" /begin REF_MEASUREMENT PDUCtl_StartReq /end REF_MEASUREMENT /end GROUP
/begin GROUP S870_NMCtl "AppSwcBcm/AppSwcBcm_50ms/WakeUpCtl/WakeUpCtl/NMCtl" /begin SUB_GROUP S871_Lib_SR /end SUB_GROUP /begin REF_CHARACTERISTIC WakeUpCtl_CANSleepDelayTim_C /end REF_CHARACTERISTIC /end GROUP
/begin GROUP S870_SleepCtl "AppSwcBcm/AppSwcBcm_50ms/WakeUpCtl/WakeUpCtl/SleepCtl" /begin REF_CHARACTERISTIC WakeUpCtl_LocalSleepDelayTim_C /end REF_CHARACTERISTIC /begin REF_MEASUREMENT WakeUpCtl_SleepAllwd /end REF_MEASUREMENT /end GROUP
/begin GROUP S361_FL10min "AppSwcBcm/AppSwcBcm_20ms/LampCtl/DomeLampCtl/DomeLamp10min/FL10min" /begin REF_MEASUREMENT AppSwcBcm_ARID_DEF.Cnt_dy LampCtl_DomeLampFLOpen /end REF_MEASUREMENT /end GROUP
/begin GROUP S361_FR10min "AppSwcBcm/AppSwcBcm_20ms/LampCtl/DomeLampCtl/DomeLamp10min/FR10min" /begin REF_MEASUREMENT LampCtl_DomeLampFROpen /end REF_MEASUREMENT /end GROUP
/begin GROUP S362_30s "AppSwcBcm/AppSwcBcm_20ms/LampCtl/DomeLampCtl/DomeLamp30sec/30s" /begin REF_MEASUREMENT AppSwcBcm_ARID_DEF.Cnt_d LampCtl_DomeLampPwrOff /end REF_MEASUREMENT /end GROUP
/begin GROUP S362_30s1 "AppSwcBcm/AppSwcBcm_20ms/LampCtl/DomeLampCtl/DomeLamp30sec/30s1" /begin REF_MEASUREMENT AppSwcBcm_ARID_DEF.Cnt_pi LampCtl_DomeLampUnlock /end REF_MEASUREMENT /end GROUP
/begin GROUP S364_Lib_RiseEdgeDetInit "AppSwcBcm/AppSwcBcm_20ms/LampCtl/DomeLampCtl/DomeLampOff/Lib_RiseEdgeDetInit" /begin REF_MEASUREMENT LampCtl_DomeLampLockDoor /end REF_MEASUREMENT /end GROUP
/begin GROUP S448_Enabled_Subsystem1 "AppSwcBcm/AppSwcBcm_20ms/LampCtl/TurnIndcrCtl/TurnIndcrDig/Enabled Subsystem1" /begin REF_MEASUREMENT LampCtl_TurnIndcrRVol /end REF_MEASUREMENT /end GROUP
/begin GROUP S448_Enabled_Subsystem3 "AppSwcBcm/AppSwcBcm_20ms/LampCtl/TurnIndcrCtl/TurnIndcrDig/Enabled Subsystem3" /begin REF_MEASUREMENT LampCtl_TurnIndcrLVol /end REF_MEASUREMENT /end GROUP
/begin GROUP S668_HULck "AppSwcBcm/AppSwcBcm_50ms/DoorLckCtl/DoorLckCtlLogic/InsideLck/HULck" /begin REF_MEASUREMENT DoorLckCtl_HULck /end REF_MEASUREMENT /end GROUP
/begin GROUP S668_SpdLck "AppSwcBcm/AppSwcBcm_50ms/DoorLckCtl/DoorLckCtlLogic/InsideLck/SpdLck" /begin SUB_GROUP S680_Lib_RiseEdgeDet /end SUB_GROUP
 /begin REF_CHARACTERISTIC DoorLckCtl_SpdLckTimInValid_C DoorLckCtl_SpdLckTimValid_C DoorLckCtl_SpdLck_C DoorLckCtl_Ts_C /end REF_CHARACTERISTIC
/end GROUP
/begin GROUP S669_CrshUnlck "AppSwcBcm/AppSwcBcm_50ms/DoorLckCtl/DoorLckCtlLogic/InsideUnlck/CrshUnlck"
 /begin REF_CHARACTERISTIC DoorLckCtl_CrshPwrOnTimInValid_C DoorLckCtl_CrshPwrOnTimValid_C DoorLckCtl_Ts_C /end REF_CHARACTERISTIC
 /begin REF_MEASUREMENT DoorLckCtl_CrshUnlck /end REF_MEASUREMENT
/end GROUP
/begin GROUP S669_HUUnlck "AppSwcBcm/AppSwcBcm_50ms/DoorLckCtl/DoorLckCtlLogic/InsideUnlck/HUUnlck" /begin REF_MEASUREMENT DoorLckCtl_HUUnLck /end REF_MEASUREMENT /end GROUP
/begin GROUP S669_ParkUnlck "AppSwcBcm/AppSwcBcm_50ms/DoorLckCtl/DoorLckCtlLogic/InsideUnlck/ParkUnlck" /begin REF_MEASUREMENT DoorLckCtl_ParkUnlck /end REF_MEASUREMENT /end GROUP
/begin GROUP S669_ThermalRunawayUnlck "AppSwcBcm/AppSwcBcm_50ms/DoorLckCtl/DoorLckCtlLogic/InsideUnlck/ThermalRunawayUnlck" /begin REF_MEASUREMENT DoorLckCtl_ThermRunawayUnlck /end REF_MEASUREMENT /end GROUP
/begin GROUP S671_AutoLck "AppSwcBcm/AppSwcBcm_50ms/DoorLckCtl/DoorLckCtlLogic/OutsideLck/AutoLck" /begin SUB_GROUP S710_Lib_RiseEdgeDet S710_Lib_SR /end SUB_GROUP /begin REF_CHARACTERISTIC DoorLckCtl_AutoLckDelayTim_C /end REF_CHARACTERISTIC /end GROUP
/begin GROUP S671_MechLck "AppSwcBcm/AppSwcBcm_50ms/DoorLckCtl/DoorLckCtlLogic/OutsideLck/MechLck" /begin REF_CHARACTERISTIC DoorLckCtl_Ts_C /end REF_CHARACTERISTIC /begin REF_MEASUREMENT DoorLckCtl_MechLck /end REF_MEASUREMENT /end GROUP
/begin GROUP S671_PELck "AppSwcBcm/AppSwcBcm_50ms/DoorLckCtl/DoorLckCtlLogic/OutsideLck/PELck" /begin REF_MEASUREMENT DoorLckCtl_PELck /end REF_MEASUREMENT /end GROUP
/begin GROUP S671_RKELck "AppSwcBcm/AppSwcBcm_50ms/DoorLckCtl/DoorLckCtlLogic/OutsideLck/RKELck" /begin SUB_GROUP S713_Lib_RiseEdgeDet /end SUB_GROUP /begin REF_MEASUREMENT AppSwcBcm_ARID_DEF.flg_a /end REF_MEASUREMENT /end GROUP
/begin GROUP S671_TrunkAutoLck "AppSwcBcm/AppSwcBcm_50ms/DoorLckCtl/DoorLckCtlLogic/OutsideLck/TrunkAutoLck" /begin SUB_GROUP S714_Lib_RiseEdgeDet /end SUB_GROUP /begin REF_CHARACTERISTIC DoorLckCtl_TrunkAutoLckTim_C /end REF_CHARACTERISTIC /begin REF_MEASUREMENT AppSwcBcm_ARID_DEF.Cnt_nz AppSwcBcm_ARID_DEF.Flg_j /end REF_MEASUREMENT /end GROUP
/begin GROUP S671_WelcomeLck "AppSwcBcm/AppSwcBcm_50ms/DoorLckCtl/DoorLckCtlLogic/OutsideLck/WelcomeLck" /begin REF_MEASUREMENT DoorLckCtl_WelcomeLck /end REF_MEASUREMENT /end GROUP
/begin GROUP S672_MechUnlck "AppSwcBcm/AppSwcBcm_50ms/DoorLckCtl/DoorLckCtlLogic/OutsideUnlck/MechUnlck" /begin REF_CHARACTERISTIC DoorLckCtl_Ts_C /end REF_CHARACTERISTIC /begin REF_MEASUREMENT DoorLckCtl_MechUnlck /end REF_MEASUREMENT /end GROUP
/begin GROUP S672_PEUnlck "AppSwcBcm/AppSwcBcm_50ms/DoorLckCtl/DoorLckCtlLogic/OutsideUnlck/PEUnlck" /begin REF_MEASUREMENT DoorLckCtl_PEUnlck /end REF_MEASUREMENT /end GROUP
/begin GROUP S672_RKEUnlck "AppSwcBcm/AppSwcBcm_50ms/DoorLckCtl/DoorLckCtlLogic/OutsideUnlck/RKEUnlck" /begin SUB_GROUP S735_Lib_RiseEdgeDet /end SUB_GROUP /begin REF_MEASUREMENT AppSwcBcm_ARID_DEF.flg /end REF_MEASUREMENT /end GROUP
/begin GROUP S672_TrunkUnlck "AppSwcBcm/AppSwcBcm_50ms/DoorLckCtl/DoorLckCtlLogic/OutsideUnlck/TrunkUnlck" /begin SUB_GROUP S736_Lib_RiseEdgeDet1 S736_Lib_RiseEdgeDet2 /end SUB_GROUP
 /begin REF_CHARACTERISTIC DoorLckCtl_TrunkUnlckTimInvalid_C DoorLckCtl_TrunkUnlckTimValid_C DoorLckCtl_Ts_C /end REF_CHARACTERISTIC
 /begin REF_MEASUREMENT DoorLckCtl_TrunkUnlck /end REF_MEASUREMENT
/end GROUP
/begin GROUP S672_WelcomeUnlck "AppSwcBcm/AppSwcBcm_50ms/DoorLckCtl/DoorLckCtlLogic/OutsideUnlck/WelcomeUnlck" /begin REF_MEASUREMENT DoorLckCtl_WelcomeUnlck /end REF_MEASUREMENT /end GROUP
/begin GROUP S871_Lib_SR "AppSwcBcm/AppSwcBcm_50ms/WakeUpCtl/WakeUpCtl/NMCtl/Lib_SR" /begin REF_MEASUREMENT WakeUpCtl_NMReq /end REF_MEASUREMENT /end GROUP
/begin GROUP S680_Lib_RiseEdgeDet "AppSwcBcm/AppSwcBcm_50ms/DoorLckCtl/DoorLckCtlLogic/InsideLck/SpdLck/Lib_RiseEdgeDet" /begin REF_MEASUREMENT DoorLckCtl_SpdLck /end REF_MEASUREMENT /end GROUP
/begin GROUP S710_Lib_RiseEdgeDet "AppSwcBcm/AppSwcBcm_50ms/DoorLckCtl/DoorLckCtlLogic/OutsideLck/AutoLck/Lib_RiseEdgeDet" /begin REF_MEASUREMENT DoorLckCtl_AutoLck /end REF_MEASUREMENT /end GROUP
/begin GROUP S710_Lib_SR "AppSwcBcm/AppSwcBcm_50ms/DoorLckCtl/DoorLckCtlLogic/OutsideLck/AutoLck/Lib_SR" /begin REF_MEASUREMENT DoorLckCtl_AutoLckSta /end REF_MEASUREMENT /end GROUP
/begin GROUP S713_Lib_RiseEdgeDet "AppSwcBcm/AppSwcBcm_50ms/DoorLckCtl/DoorLckCtlLogic/OutsideLck/RKELck/Lib_RiseEdgeDet" /begin REF_MEASUREMENT DoorLckCtl_RKELck /end REF_MEASUREMENT /end GROUP
/begin GROUP S714_Lib_RiseEdgeDet "AppSwcBcm/AppSwcBcm_50ms/DoorLckCtl/DoorLckCtlLogic/OutsideLck/TrunkAutoLck/Lib_RiseEdgeDet" /begin REF_MEASUREMENT DoorLckCtl_TrunkAutoLck /end REF_MEASUREMENT /end GROUP
/begin GROUP S735_Lib_RiseEdgeDet "AppSwcBcm/AppSwcBcm_50ms/DoorLckCtl/DoorLckCtlLogic/OutsideUnlck/RKEUnlck/Lib_RiseEdgeDet" /begin REF_MEASUREMENT DoorLckCtl_RKEUnlck /end REF_MEASUREMENT /end GROUP
/begin GROUP S736_Lib_RiseEdgeDet1 "AppSwcBcm/AppSwcBcm_50ms/DoorLckCtl/DoorLckCtlLogic/OutsideUnlck/TrunkUnlck/Lib_RiseEdgeDet1" /begin REF_MEASUREMENT DoorLckCtl_TrunkRKEUnlck /end REF_MEASUREMENT /end GROUP
/begin GROUP S736_Lib_RiseEdgeDet2 "AppSwcBcm/AppSwcBcm_50ms/DoorLckCtl/DoorLckCtlLogic/OutsideUnlck/TrunkUnlck/Lib_RiseEdgeDet2" /begin REF_MEASUREMENT DoorLckCtl_TrunkHUUnlck /end REF_MEASUREMENT /end GROUP
/end MODULE
/end PROJECT
/* (add any file trailer comments here) */
/* EOF AppSwcBcm.a2l */
