ASAP2_VERSION 1 31
/begin PROJECT ProjectName "Project Comment Goes Here"
/begin HEADER "Header Comments go here" /end HEADER
/begin MODULE ModuleName "Module Comment Goes Here"
/begin MOD_COMMON "Mod Common Comment Here" BYTE_ORDER MSB_LAST /end MOD_COMMON
/begin RECORD_LAYOUT Scalar_BOOLEAN FNC_VALUES 1 UBYTE COLUMN_DIR DIRECT /end RECORD_LAYOUT
/begin RECORD_LAYOUT Scalar_UBYTE FNC_VALUES 1 UBYTE COLUMN_DIR DIRECT /end RECORD_LAYOUT
/begin RECORD_LAYOUT Scalar_UWORD FNC_VALUES 1 UWORD COLUMN_DIR DIRECT /end RECORD_LAYOUT
/begin RECORD_LAYOUT Scalar_FLOAT32_IEEE FNC_VALUES 1 FLOAT32_IEEE COLUMN_DIR DIRECT /end RECORD_LAYOUT
/begin RECORD_LAYOUT Lookup1D_X_WORD AXIS_PTS_X 1 SWORD INDEX_INCR DIRECT /end RECORD_LAYOUT
/begin RECORD_LAYOUT Lookup1D_ULONG FNC_VALUES 1 ULONG COLUMN_DIR DIRECT /end RECORD_LAYOUT
/begin RECORD_LAYOUT Lookup1D_X_ULONG AXIS_PTS_X 1 ULONG INDEX_INCR DIRECT /end RECORD_LAYOUT
/begin RECORD_LAYOUT Lookup1D_SLONG FNC_VALUES 1 SLONG COLUMN_DIR DIRECT /end RECORD_LAYOUT
/begin RECORD_LAYOUT Lookup1D_X_LONG AXIS_PTS_X 1 SLONG INDEX_INCR DIRECT /end RECORD_LAYOUT
/begin RECORD_LAYOUT Lookup1D_FLOAT32_IEEE FNC_VALUES 1 FLOAT32_IEEE COLUMN_DIR DIRECT /end RECORD_LAYOUT
/begin RECORD_LAYOUT Lookup1D_X_FLOAT32_IEEE AXIS_PTS_X 1 FLOAT32_IEEE INDEX_INCR DIRECT /end RECORD_LAYOUT
/begin RECORD_LAYOUT Lookup1D_FLOAT64_IEEE FNC_VALUES 1 FLOAT64_IEEE COLUMN_DIR DIRECT /end RECORD_LAYOUT
/begin RECORD_LAYOUT Lookup1D_X_FLOAT64_IEEE AXIS_PTS_X 1 FLOAT64_IEEE INDEX_INCR DIRECT /end RECORD_LAYOUT
/begin RECORD_LAYOUT Lookup2D_BOOLEAN FNC_VALUES 1 UBYTE COLUMN_DIR DIRECT /end RECORD_LAYOUT
/begin RECORD_LAYOUT Lookup2D_X_BOOLEAN AXIS_PTS_X 1 UBYTE INDEX_INCR DIRECT /end RECORD_LAYOUT
/begin RECORD_LAYOUT Lookup2D_UBYTE FNC_VALUES 1 UBYTE COLUMN_DIR DIRECT /end RECORD_LAYOUT
/begin RECORD_LAYOUT Lookup2D_X_UBYTE AXIS_PTS_X 1 UBYTE INDEX_INCR DIRECT /end RECORD_LAYOUT
/begin CHARACTERISTIC KOPM_AccPedPosToESCHi_pct "VCU_D_Status_CHA" VALUE 0x0000 /* @ECU_Address@KOPM_AccPedPosToESCHi_pct@ */ Scalar_FLOAT32_IEEE 0 AppSwcOpm_CM_single_pct -100000.0 100000.0 /end CHARACTERISTIC
/begin CHARACTERISTIC KOPM_AccPedPosToESCLo_pct "VCU_D_Status_CHA" VALUE 0x0000 /* @ECU_Address@KOPM_AccPedPosToESCLo_pct@ */ Scalar_FLOAT32_IEEE 0 AppSwcOpm_CM_single_pct -100000.0 100000.0 /end CHARACTERISTIC
/begin CHARACTERISTIC KOPM_AccPedPosToESC_pct_ovrdval "VCU_D_Status_CHA" VALUE 0x0000 /* @ECU_Address@KOPM_AccPedPosToESC_pct_ovrdval@ */ Scalar_FLOAT32_IEEE 0 AppSwcOpm_CM_single_pct -100000.0 100000.0 /end CHARACTERISTIC
/begin CHARACTERISTIC KOPM_AcclPedalPosHi_pct "VCU_D_Status_CHA" VALUE 0x0000 /* @ECU_Address@KOPM_AcclPedalPosHi_pct@ */ Scalar_FLOAT32_IEEE 0 AppSwcOpm_CM_single_pct -100000.0 100000.0 /end CHARACTERISTIC
/begin CHARACTERISTIC KOPM_AcclPedalPosLo_pct "VCU_D_Status_CHA" VALUE 0x0000 /* @ECU_Address@KOPM_AcclPedalPosLo_pct@ */ Scalar_FLOAT32_IEEE 0 AppSwcOpm_CM_single_pct -100000.0 100000.0 /end CHARACTERISTIC
/begin CHARACTERISTIC KOPM_AcclPedalPos_pct_ovrdval "VCU_D_Status_CHA" VALUE 0x0000 /* @ECU_Address@KOPM_AcclPedalPos_pct_ovrdval@ */ Scalar_FLOAT32_IEEE 0 AppSwcOpm_CM_single_pct -100000.0 100000.0 /end CHARACTERISTIC
/begin CHARACTERISTIC KOPM_AllowHeatCoolMaxPwrCmspHi_kW "VCU_3_OprtCmd_EPT" VALUE 0x0000 /* @ECU_Address@KOPM_AllowHeatCoolMaxPwrCmspHi_kW@ */ Scalar_FLOAT32_IEEE 0 AppSwcOpm_CM_single_kW -100000.0 100000.0 /end CHARACTERISTIC
/begin CHARACTERISTIC KOPM_AllowHeatCoolMaxPwrCmspLo_kW "VCU_3_OprtCmd_EPT" VALUE 0x0000 /* @ECU_Address@KOPM_AllowHeatCoolMaxPwrCmspLo_kW@ */ Scalar_FLOAT32_IEEE 0 AppSwcOpm_CM_single_kW -100000.0 100000.0 /end CHARACTERISTIC
/begin CHARACTERISTIC KOPM_AllowHeatCoolMaxPwrCmsp_kW_ovrdval "VCU_3_OprtCmd_EPT" VALUE 0x0000 /* @ECU_Address@KOPM_AllowHeatCoolMaxPwrCmsp_kW_ovrdval@ */ Scalar_FLOAT32_IEEE 0 AppSwcOpm_CM_single_kW -100000.0 100000.0 /end CHARACTERISTIC
/begin CHARACTERISTIC KOPM_BrkPedalPosHi_pct "VCU_D_Status_CHA" VALUE 0x0000 /* @ECU_Address@KOPM_BrkPedalPosHi_pct@ */ Scalar_FLOAT32_IEEE 0 AppSwcOpm_CM_single_pct -100000.0 100000.0 /end CHARACTERISTIC
/begin CHARACTERISTIC KOPM_BrkPedalPosLo_pct "VCU_D_Status_CHA" VALUE 0x0000 /* @ECU_Address@KOPM_BrkPedalPosLo_pct@ */ Scalar_FLOAT32_IEEE 0 AppSwcOpm_CM_single_pct -100000.0 100000.0 /end CHARACTERISTIC
/begin CHARACTERISTIC KOPM_BrkPedalPos_pct_ovrdval "VCU_D_Status_CHA" VALUE 0x0000 /* @ECU_Address@KOPM_BrkPedalPos_pct_ovrdval@ */ Scalar_FLOAT32_IEEE 0 AppSwcOpm_CM_single_pct -100000.0 100000.0 /end CHARACTERISTIC
/begin CHARACTERISTIC KOPM_CruiseCtrTgtSpdHi_kph "VCU_DispInfo_BAC" VALUE 0x0000 /* @ECU_Address@KOPM_CruiseCtrTgtSpdHi_kph@ */ Scalar_FLOAT32_IEEE 0 AppSwcOpm_CM_single_kph -100000.0 100000.0 /end CHARACTERISTIC
/begin CHARACTERISTIC KOPM_CruiseCtrTgtSpdLo_kph "VCU_DispInfo_BAC" VALUE 0x0000 /* @ECU_Address@KOPM_CruiseCtrTgtSpdLo_kph@ */ Scalar_FLOAT32_IEEE 0 AppSwcOpm_CM_single_kph -100000.0 100000.0 /end CHARACTERISTIC
/begin CHARACTERISTIC KOPM_CruiseCtrTgtSpd_kph_ovrdval "VCU_DispInfo_BAC" VALUE 0x0000 /* @ECU_Address@KOPM_CruiseCtrTgtSpd_kph_ovrdval@ */ Scalar_FLOAT32_IEEE 0 AppSwcOpm_CM_single_kph -100000.0 100000.0 /end CHARACTERISTIC
/begin CHARACTERISTIC KOPM_DCCBoostHvVoltHi_V "VCU_C_OprtCmd_EPT" VALUE 0x0000 /* @ECU_Address@KOPM_DCCBoostHvVoltHi_V@ */ Scalar_FLOAT32_IEEE 0 AppSwcOpm_CM_single_V -100000.0 100000.0 /end CHARACTERISTIC
/begin CHARACTERISTIC KOPM_DCCBoostHvVoltLo_V "VCU_C_OprtCmd_EPT" VALUE 0x0000 /* @ECU_Address@KOPM_DCCBoostHvVoltLo_V@ */ Scalar_FLOAT32_IEEE 0 AppSwcOpm_CM_single_V -100000.0 100000.0 /end CHARACTERISTIC
/begin CHARACTERISTIC KOPM_DCCBoostHvVolt_V_ovrdval "VCU_C_OprtCmd_EPT" VALUE 0x0000 /* @ECU_Address@KOPM_DCCBoostHvVolt_V_ovrdval@ */ Scalar_FLOAT32_IEEE 0 AppSwcOpm_CM_single_V -100000.0 100000.0 /end CHARACTERISTIC
/begin CHARACTERISTIC KOPM_DCCBuckLVVoltHi_V "VCU_C_OprtCmd_EPT" VALUE 0x0000 /* @ECU_Address@KOPM_DCCBuckLVVoltHi_V@ */ Scalar_FLOAT32_IEEE 0 AppSwcOpm_CM_single_V -100000.0 100000.0 /end CHARACTERISTIC
/begin CHARACTERISTIC KOPM_DCCBuckLVVoltLo_V "VCU_C_OprtCmd_EPT" VALUE 0x0000 /* @ECU_Address@KOPM_DCCBuckLVVoltLo_V@ */ Scalar_FLOAT32_IEEE 0 AppSwcOpm_CM_single_V -100000.0 100000.0 /end CHARACTERISTIC
/begin CHARACTERISTIC KOPM_DCCBuckLVVolt_V_ovrdval "VCU_C_OprtCmd_EPT" VALUE 0x0000 /* @ECU_Address@KOPM_DCCBuckLVVolt_V_ovrdval@ */ Scalar_FLOAT32_IEEE 0 AppSwcOpm_CM_single_V -100000.0 100000.0 /end CHARACTERISTIC
/begin CHARACTERISTIC KOPM_DrvPedHi_pct "VCU_0_Value_EPT" VALUE 0x0000 /* @ECU_Address@KOPM_DrvPedHi_pct@ */ Scalar_FLOAT32_IEEE 0 AppSwcOpm_CM_single_pct -100000.0 100000.0 /end CHARACTERISTIC
/begin CHARACTERISTIC KOPM_DrvPedLo_pct "VCU_0_Value_EPT" VALUE 0x0000 /* @ECU_Address@KOPM_DrvPedLo_pct@ */ Scalar_FLOAT32_IEEE 0 AppSwcOpm_CM_single_pct -100000.0 100000.0 /end CHARACTERISTIC
/begin CHARACTERISTIC KOPM_DrvPed_pct_ovrdval "VCU_0_Value_EPT" VALUE 0x0000 /* @ECU_Address@KOPM_DrvPed_pct_ovrdval@ */ Scalar_FLOAT32_IEEE 0 AppSwcOpm_CM_single_pct -100000.0 100000.0 /end CHARACTERISTIC
/begin CHARACTERISTIC KOPM_DrvRangeDistEstHi_km "VCU_B_AcclPedal_EPT" VALUE 0x0000 /* @ECU_Address@KOPM_DrvRangeDistEstHi_km@ */ Scalar_FLOAT32_IEEE 0 AppSwcOpm_CM_single_km -100000.0 100000.0 /end CHARACTERISTIC
/begin CHARACTERISTIC KOPM_DrvRangeDistEstLo_km "VCU_B_AcclPedal_EPT" VALUE 0x0000 /* @ECU_Address@KOPM_DrvRangeDistEstLo_km@ */ Scalar_FLOAT32_IEEE 0 AppSwcOpm_CM_single_km -100000.0 100000.0 /end CHARACTERISTIC
/begin CHARACTERISTIC KOPM_DrvRangeDistEst_km_ovrdval "VCU_DispInfo_BAC" VALUE 0x0000 /* @ECU_Address@KOPM_DrvRangeDistEst_km_ovrdval@ */ Scalar_FLOAT32_IEEE 0 AppSwcOpm_CM_single_km -100000.0 100000.0 /end CHARACTERISTIC
/begin CHARACTERISTIC KOPM_DrvReqMotorTorqHi_Nm "VCU_10_Torque_CHA" VALUE 0x0000 /* @ECU_Address@KOPM_DrvReqMotorTorqHi_Nm@ */ Scalar_FLOAT32_IEEE 0 AppSwcOpm_CM_single_Nm -100000.0 100000.0 /end CHARACTERISTIC
/begin CHARACTERISTIC KOPM_DrvReqMotorTorqLo_Nm "VCU_10_Torque_CHA" VALUE 0x0000 /* @ECU_Address@KOPM_DrvReqMotorTorqLo_Nm@ */ Scalar_FLOAT32_IEEE 0 AppSwcOpm_CM_single_Nm -100000.0 100000.0 /end CHARACTERISTIC
/begin CHARACTERISTIC KOPM_DrvReqMotorTorq_Nm_ovrdval "VCU_10_Torque_CHA" VALUE 0x0000 /* @ECU_Address@KOPM_DrvReqMotorTorq_Nm_ovrdval@ */ Scalar_FLOAT32_IEEE 0 AppSwcOpm_CM_single_Nm -100000.0 100000.0 /end CHARACTERISTIC
/begin CHARACTERISTIC KOPM_DrvReqWhlTqHi_Nm "VCU_10_Torque_CHA" VALUE 0x0000 /* @ECU_Address@KOPM_DrvReqWhlTqHi_Nm@ */ Scalar_FLOAT32_IEEE 0 AppSwcOpm_CM_single_Nm -100000.0 100000.0 /end CHARACTERISTIC
/begin CHARACTERISTIC KOPM_DrvReqWhlTqLo_Nm "VCU_10_Torque_CHA" VALUE 0x0000 /* @ECU_Address@KOPM_DrvReqWhlTqLo_Nm@ */ Scalar_FLOAT32_IEEE 0 AppSwcOpm_CM_single_Nm -100000.0 100000.0 /end CHARACTERISTIC
/begin CHARACTERISTIC KOPM_DrvReqWhlTq_Nm_ovrdval "VCU_10_Torque_CHA" VALUE 0x0000 /* @ECU_Address@KOPM_DrvReqWhlTq_Nm_ovrdval@ */ Scalar_FLOAT32_IEEE 0 AppSwcOpm_CM_single_Nm -100000.0 100000.0 /end CHARACTERISTIC
/begin CHARACTERISTIC KOPM_DrvWhlTqAllwdMaxHi_Nm "VCU_10_Torque_CHA" VALUE 0x0000 /* @ECU_Address@KOPM_DrvWhlTqAllwdMaxHi_Nm@ */ Scalar_FLOAT32_IEEE 0 AppSwcOpm_CM_single_Nm -100000.0 100000.0 /end CHARACTERISTIC
/begin CHARACTERISTIC KOPM_DrvWhlTqAllwdMaxLo_Nm "VCU_10_Torque_CHA" VALUE 0x0000 /* @ECU_Address@KOPM_DrvWhlTqAllwdMaxLo_Nm@ */ Scalar_FLOAT32_IEEE 0 AppSwcOpm_CM_single_Nm -100000.0 100000.0 /end CHARACTERISTIC
/begin CHARACTERISTIC KOPM_DrvWhlTqAllwdMax_Nm_ovrdval "VCU_10_Torque_CHA" VALUE 0x0000 /* @ECU_Address@KOPM_DrvWhlTqAllwdMax_Nm_ovrdval@ */ Scalar_FLOAT32_IEEE 0 AppSwcOpm_CM_single_Nm -100000.0 100000.0 /end CHARACTERISTIC
/begin CHARACTERISTIC KOPM_MaxChrgCurntDCHi_A "VCU_4_ChrgCmd_EPT" VALUE 0x0000 /* @ECU_Address@KOPM_MaxChrgCurntDCHi_A@ */ Scalar_FLOAT32_IEEE 0 AppSwcOpm_CM_single_A -100000.0 100000.0 /end CHARACTERISTIC
/begin CHARACTERISTIC KOPM_MaxChrgCurntDCLo_A "VCU_4_ChrgCmd_EPT" VALUE 0x0000 /* @ECU_Address@KOPM_MaxChrgCurntDCLo_A@ */ Scalar_FLOAT32_IEEE 0 AppSwcOpm_CM_single_A -100000.0 100000.0 /end CHARACTERISTIC
/begin CHARACTERISTIC KOPM_MaxChrgCurntDC_A_ovrdval "VCU_4_ChrgCmd_EPT" VALUE 0x0000 /* @ECU_Address@KOPM_MaxChrgCurntDC_A_ovrdval@ */ Scalar_FLOAT32_IEEE 0 AppSwcOpm_CM_single_A -100000.0 100000.0 /end CHARACTERISTIC
/begin CHARACTERISTIC KOPM_MaxChrgVoltDCHi_V "VCU_4_ChrgCmd_EPT" VALUE 0x0000 /* @ECU_Address@KOPM_MaxChrgVoltDCHi_V@ */ Scalar_FLOAT32_IEEE 0 AppSwcOpm_CM_single_V -100000.0 100000.0 /end CHARACTERISTIC
/begin CHARACTERISTIC KOPM_MaxChrgVoltDCLo_V "VCU_4_ChrgCmd_EPT" VALUE 0x0000 /* @ECU_Address@KOPM_MaxChrgVoltDCLo_V@ */ Scalar_FLOAT32_IEEE 0 AppSwcOpm_CM_single_V -100000.0 100000.0 /end CHARACTERISTIC
/begin CHARACTERISTIC KOPM_MaxChrgVoltDC_V_ovrdval "VCU_4_ChrgCmd_EPT" VALUE 0x0000 /* @ECU_Address@KOPM_MaxChrgVoltDC_V_ovrdval@ */ Scalar_FLOAT32_IEEE 0 AppSwcOpm_CM_single_V -100000.0 100000.0 /end CHARACTERISTIC
/begin CHARACTERISTIC KOPM_MaxHVDCCurntACHi_A "VCU_C_OprtCmd_EPT" VALUE 0x0000 /* @ECU_Address@KOPM_MaxHVDCCurntACHi_A@ */ Scalar_FLOAT32_IEEE 0 AppSwcOpm_CM_single_A -100000.0 100000.0 /end CHARACTERISTIC
/begin CHARACTERISTIC KOPM_MaxHVDCCurntACLo_A "VCU_C_OprtCmd_EPT" VALUE 0x0000 /* @ECU_Address@KOPM_MaxHVDCCurntACLo_A@ */ Scalar_FLOAT32_IEEE 0 AppSwcOpm_CM_single_A -100000.0 100000.0 /end CHARACTERISTIC
/begin CHARACTERISTIC KOPM_MaxHVDCCurntAC_A_ovrdval "VCU_C_OprtCmd_EPT" VALUE 0x0000 /* @ECU_Address@KOPM_MaxHVDCCurntAC_A_ovrdval@ */ Scalar_FLOAT32_IEEE 0 AppSwcOpm_CM_single_A -100000.0 100000.0 /end CHARACTERISTIC
/begin CHARACTERISTIC KOPM_MaxHVDCVoltACHi_V "VCU_C_OprtCmd_EPT" VALUE 0x0000 /* @ECU_Address@KOPM_MaxHVDCVoltACHi_V@ */ Scalar_FLOAT32_IEEE 0 AppSwcOpm_CM_single_V -100000.0 100000.0 /end CHARACTERISTIC
/begin CHARACTERISTIC KOPM_MaxHVDCVoltACLo_V "VCU_C_OprtCmd_EPT" VALUE 0x0000 /* @ECU_Address@KOPM_MaxHVDCVoltACLo_V@ */ Scalar_FLOAT32_IEEE 0 AppSwcOpm_CM_single_V -100000.0 100000.0 /end CHARACTERISTIC
/begin CHARACTERISTIC KOPM_MaxHVDCVoltAC_V_ovrdval "VCU_C_OprtCmd_EPT" VALUE 0x0000 /* @ECU_Address@KOPM_MaxHVDCVoltAC_V_ovrdval@ */ Scalar_FLOAT32_IEEE 0 AppSwcOpm_CM_single_V -100000.0 100000.0 /end CHARACTERISTIC
/begin CHARACTERISTIC KOPM_MotActPwrHi_Kw "VCU_B_AcclPedal_EPT" VALUE 0x0000 /* @ECU_Address@KOPM_MotActPwrHi_Kw@ */ Scalar_FLOAT32_IEEE 0 AppSwcOpm_CM_single_kW -100000.0 100000.0 /end CHARACTERISTIC
/begin CHARACTERISTIC KOPM_MotActPwrLo_Kw "VCU_B_AcclPedal_EPT" VALUE 0x0000 /* @ECU_Address@KOPM_MotActPwrLo_Kw@ */ Scalar_FLOAT32_IEEE 0 AppSwcOpm_CM_single_kW -100000.0 100000.0 /end CHARACTERISTIC
/begin CHARACTERISTIC KOPM_MotActPwr_Kw_ovrdval "VCU_DispInfo_BAC" VALUE 0x0000 /* @ECU_Address@KOPM_MotActPwr_Kw_ovrdval@ */ Scalar_FLOAT32_IEEE 0 AppSwcOpm_CM_single_kW -100000.0 100000.0 /end CHARACTERISTIC
/begin CHARACTERISTIC KOPM_MotDmpgLmtHi_Nm "VCU_0_Value_EPT" VALUE 0x0000 /* @ECU_Address@KOPM_MotDmpgLmtHi_Nm@ */ Scalar_FLOAT32_IEEE 0 AppSwcOpm_CM_single_Nm -100000.0 100000.0 /end CHARACTERISTIC
/begin CHARACTERISTIC KOPM_MotDmpgLmtLo_Nm "VCU_0_Value_EPT" VALUE 0x0000 /* @ECU_Address@KOPM_MotDmpgLmtLo_Nm@ */ Scalar_FLOAT32_IEEE 0 AppSwcOpm_CM_single_Nm -100000.0 100000.0 /end CHARACTERISTIC
/begin CHARACTERISTIC KOPM_MotDmpgLmt_Nm_ovrdval "VCU_0_Value_EPT" VALUE 0x0000 /* @ECU_Address@KOPM_MotDmpgLmt_Nm_ovrdval@ */ Scalar_FLOAT32_IEEE 0 AppSwcOpm_CM_single_Nm -100000.0 100000.0 /end CHARACTERISTIC
/begin CHARACTERISTIC KOPM_MotSpdReqHi_rpm "VCU_1_InvCmd_EPT" VALUE 0x0000 /* @ECU_Address@KOPM_MotSpdReqHi_rpm@ */ Scalar_FLOAT32_IEEE 0 AppSwcOpm_CM_single_rpm -100000.0 100000.0 /end CHARACTERISTIC
/begin CHARACTERISTIC KOPM_MotSpdReqLo_rpm "VCU_1_InvCmd_EPT" VALUE 0x0000 /* @ECU_Address@KOPM_MotSpdReqLo_rpm@ */ Scalar_FLOAT32_IEEE 0 AppSwcOpm_CM_single_rpm -100000.0 100000.0 /end CHARACTERISTIC
/begin CHARACTERISTIC KOPM_MotSpdReq_rpm_ovrdval "VCU_1_InvCmd_EPT" VALUE 0x0000 /* @ECU_Address@KOPM_MotSpdReq_rpm_ovrdval@ */ Scalar_FLOAT32_IEEE 0 AppSwcOpm_CM_single_rpm -100000.0 100000.0 /end CHARACTERISTIC
/begin CHARACTERISTIC KOPM_MotTorqReqHi_Nm "VCU_1_InvCmd_EPT" VALUE 0x0000 /* @ECU_Address@KOPM_MotTorqReqHi_Nm@ */ Scalar_FLOAT32_IEEE 0 AppSwcOpm_CM_single_Nm -100000.0 100000.0 /end CHARACTERISTIC
/begin CHARACTERISTIC KOPM_MotTorqReqLo_Nm "VCU_1_InvCmd_EPT" VALUE 0x0000 /* @ECU_Address@KOPM_MotTorqReqLo_Nm@ */ Scalar_FLOAT32_IEEE 0 AppSwcOpm_CM_single_Nm -100000.0 100000.0 /end CHARACTERISTIC
/begin CHARACTERISTIC KOPM_MotTorqReq_Nm_ovrdval "VCU_1_InvCmd_EPT" VALUE 0x0000 /* @ECU_Address@KOPM_MotTorqReq_Nm_ovrdval@ */ Scalar_FLOAT32_IEEE 0 AppSwcOpm_CM_single_Nm -100000.0 100000.0 /end CHARACTERISTIC
/begin CHARACTERISTIC KOPM_MotorOutputCooltTempHi_C "VCU_3_OprtCmd_EPT" VALUE 0x0000 /* @ECU_Address@KOPM_MotorOutputCooltTempHi_C@ */ Scalar_FLOAT32_IEEE 0 AppSwcOpm_CM_single_C -100000.0 100000.0 /end CHARACTERISTIC
/begin CHARACTERISTIC KOPM_MotorOutputCooltTempLo_C "VCU_3_OprtCmd_EPT" VALUE 0x0000 /* @ECU_Address@KOPM_MotorOutputCooltTempLo_C@ */ Scalar_FLOAT32_IEEE 0 AppSwcOpm_CM_single_C -100000.0 100000.0 /end CHARACTERISTIC
/begin CHARACTERISTIC KOPM_MotorOutputCooltTemp_C_ovrdval "VCU_3_OprtCmd_EPT" VALUE 0x0000 /* @ECU_Address@KOPM_MotorOutputCooltTemp_C_ovrdval@ */ Scalar_FLOAT32_IEEE 0 AppSwcOpm_CM_single_C -100000.0 100000.0 /end CHARACTERISTIC
/begin CHARACTERISTIC KOPM_PwrRecupActWhlTqHi_Nm "VCU_10_Torque_CHA" VALUE 0x0000 /* @ECU_Address@KOPM_PwrRecupActWhlTqHi_Nm@ */ Scalar_FLOAT32_IEEE 0 AppSwcOpm_CM_single_Nm -100000.0 100000.0 /end CHARACTERISTIC
/begin CHARACTERISTIC KOPM_PwrRecupActWhlTqLo_Nm "VCU_10_Torque_CHA" VALUE 0x0000 /* @ECU_Address@KOPM_PwrRecupActWhlTqLo_Nm@ */ Scalar_FLOAT32_IEEE 0 AppSwcOpm_CM_single_Nm -100000.0 100000.0 /end CHARACTERISTIC
/begin CHARACTERISTIC KOPM_PwrRecupActWhlTq_Nm_ovrdval "VCU_10_Torque_CHA" VALUE 0x0000 /* @ECU_Address@KOPM_PwrRecupActWhlTq_Nm_ovrdval@ */ Scalar_FLOAT32_IEEE 0 AppSwcOpm_CM_single_Nm -100000.0 100000.0 /end CHARACTERISTIC
/begin CHARACTERISTIC KOPM_RsrvdPwrHi_kW "VCU_B_AcclPedal_EPT" VALUE 0x0000 /* @ECU_Address@KOPM_RsrvdPwrHi_kW@ */ Scalar_FLOAT32_IEEE 0 AppSwcOpm_CM_single_kW -100000.0 100000.0 /end CHARACTERISTIC
/begin CHARACTERISTIC KOPM_RsrvdPwrLo_kW "VCU_B_AcclPedal_EPT" VALUE 0x0000 /* @ECU_Address@KOPM_RsrvdPwrLo_kW@ */ Scalar_FLOAT32_IEEE 0 AppSwcOpm_CM_single_kW -100000.0 100000.0 /end CHARACTERISTIC
/begin CHARACTERISTIC KOPM_RsrvdPwr_kW_ovrdval "VCU_DispInfo_BAC" VALUE 0x0000 /* @ECU_Address@KOPM_RsrvdPwr_kW_ovrdval@ */ Scalar_FLOAT32_IEEE 0 AppSwcOpm_CM_single_kW -100000.0 100000.0 /end CHARACTERISTIC
/begin CHARACTERISTIC KOPM_SIBSKL30VoltHi_V "VCU_DispInfo_BAC" VALUE 0x0000 /* @ECU_Address@KOPM_SIBSKL30VoltHi_V@ */ Scalar_FLOAT32_IEEE 0 AppSwcOpm_CM_single_V -100000.0 100000.0 /end CHARACTERISTIC
/begin CHARACTERISTIC KOPM_SIBSKL30VoltLo_V "VCU_DispInfo_BAC" VALUE 0x0000 /* @ECU_Address@KOPM_SIBSKL30VoltLo_V@ */ Scalar_FLOAT32_IEEE 0 AppSwcOpm_CM_single_V -100000.0 100000.0 /end CHARACTERISTIC
/begin CHARACTERISTIC KOPM_SIBSKL30Volt_V_ovrdval "VCU_DispInfo_BAC" VALUE 0x0000 /* @ECU_Address@KOPM_SIBSKL30Volt_V_ovrdval@ */ Scalar_FLOAT32_IEEE 0 AppSwcOpm_CM_single_V -100000.0 100000.0 /end CHARACTERISTIC
/begin CHARACTERISTIC KOPM_VCUAccTgtAxHi_mps2 "VCU_D_Status_CHA" VALUE 0x0000 /* @ECU_Address@KOPM_VCUAccTgtAxHi_mps2@ */ Scalar_FLOAT32_IEEE 0 AppSwcOpm_CM_single_mps2 -100000.0 100000.0 /end CHARACTERISTIC
/begin CHARACTERISTIC KOPM_VCUAccTgtAxLo_mps2 "VCU_D_Status_CHA" VALUE 0x0000 /* @ECU_Address@KOPM_VCUAccTgtAxLo_mps2@ */ Scalar_FLOAT32_IEEE 0 AppSwcOpm_CM_single_mps2 -100000.0 100000.0 /end CHARACTERISTIC
/begin CHARACTERISTIC KOPM_VCUAccTgtAx_mps2_ovrdval "VCU_D_Status_CHA" VALUE 0x0000 /* @ECU_Address@KOPM_VCUAccTgtAx_mps2_ovrdval@ */ Scalar_FLOAT32_IEEE 0 AppSwcOpm_CM_single_mps2 -100000.0 100000.0 /end CHARACTERISTIC
/begin CHARACTERISTIC KOPM_VCUBraTorReqHi_Nm "VCU_D_Status_CHA" VALUE 0x0000 /* @ECU_Address@KOPM_VCUBraTorReqHi_Nm@ */ Scalar_FLOAT32_IEEE 0 AppSwcOpm_CM_single_Nm -100000.0 100000.0 /end CHARACTERISTIC
/begin CHARACTERISTIC KOPM_VCUBraTorReqLo_Nm "VCU_D_Status_CHA" VALUE 0x0000 /* @ECU_Address@KOPM_VCUBraTorReqLo_Nm@ */ Scalar_FLOAT32_IEEE 0 AppSwcOpm_CM_single_Nm -100000.0 100000.0 /end CHARACTERISTIC
/begin CHARACTERISTIC KOPM_VCUBraTorReq_Nm_ovrdval "VCU_D_Status_CHA" VALUE 0x0000 /* @ECU_Address@KOPM_VCUBraTorReq_Nm_ovrdval@ */ Scalar_FLOAT32_IEEE 0 AppSwcOpm_CM_single_Nm -100000.0 100000.0 /end CHARACTERISTIC
/begin CHARACTERISTIC KOPM_VCUCruiseCtrTgtSpdHi_kph "VCU_D_Status_CHA" VALUE 0x0000 /* @ECU_Address@KOPM_VCUCruiseCtrTgtSpdHi_kph@ */ Scalar_FLOAT32_IEEE 0 AppSwcOpm_CM_single_kph -100000.0 100000.0 /end CHARACTERISTIC
/begin CHARACTERISTIC KOPM_VCUCruiseCtrTgtSpdLo_kph "VCU_D_Status_CHA" VALUE 0x0000 /* @ECU_Address@KOPM_VCUCruiseCtrTgtSpdLo_kph@ */ Scalar_FLOAT32_IEEE 0 AppSwcOpm_CM_single_kph -100000.0 100000.0 /end CHARACTERISTIC
/begin CHARACTERISTIC KOPM_VCUCruiseCtrTgtSpd_kph_ovrdval "VCU_D_Status_CHA" VALUE 0x0000 /* @ECU_Address@KOPM_VCUCruiseCtrTgtSpd_kph_ovrdval@ */ Scalar_FLOAT32_IEEE 0 AppSwcOpm_CM_single_kph -100000.0 100000.0 /end CHARACTERISTIC
/begin CHARACTERISTIC KOPM_VCUMasterCylinderPreReqHi_Bar "VCU_10_Torque_CHA" VALUE 0x0000 /* @ECU_Address@KOPM_VCUMasterCylinderPreReqHi_Bar@ */ Scalar_FLOAT32_IEEE 0 AppSwcOpm_CM_single_Bar -100000.0 100000.0 /end CHARACTERISTIC
/begin CHARACTERISTIC KOPM_VCUMasterCylinderPreReqLo_Bar "VCU_10_Torque_CHA" VALUE 0x0000 /* @ECU_Address@KOPM_VCUMasterCylinderPreReqLo_Bar@ */ Scalar_FLOAT32_IEEE 0 AppSwcOpm_CM_single_Bar -100000.0 100000.0 /end CHARACTERISTIC
/begin CHARACTERISTIC KOPM_VCUMasterCylinderPreReq_Bar_ovrdval "VCU_10_Torque_CHA" VALUE 0x0000 /* @ECU_Address@KOPM_VCUMasterCylinderPreReq_Bar_ovrdval@ */ Scalar_FLOAT32_IEEE 0 AppSwcOpm_CM_single_Bar -100000.0 100000.0 /end CHARACTERISTIC
/begin CHARACTERISTIC KOPM_VCUMotTorqueReqToEHBHi_Nm "VCU_10_Torque_CHA" VALUE 0x0000 /* @ECU_Address@KOPM_VCUMotTorqueReqToEHBHi_Nm@ */ Scalar_FLOAT32_IEEE 0 AppSwcOpm_CM_single_Nm -100000.0 100000.0 /end CHARACTERISTIC
/begin CHARACTERISTIC KOPM_VCUMotTorqueReqToEHBLo_Nm "VCU_10_Torque_CHA" VALUE 0x0000 /* @ECU_Address@KOPM_VCUMotTorqueReqToEHBLo_Nm@ */ Scalar_FLOAT32_IEEE 0 AppSwcOpm_CM_single_Nm -100000.0 100000.0 /end CHARACTERISTIC
/begin CHARACTERISTIC KOPM_VCUMotTorqueReqToEHB_Nm_ovrdval "VCU_10_Torque_CHA" VALUE 0x0000 /* @ECU_Address@KOPM_VCUMotTorqueReqToEHB_Nm_ovrdval@ */ Scalar_FLOAT32_IEEE 0 AppSwcOpm_CM_single_Nm -100000.0 100000.0 /end CHARACTERISTIC
/begin CHARACTERISTIC KOPM_VehPwrCnsmpAvrgHi_kWh "VCU_B_AcclPedal_EPT" VALUE 0x0000 /* @ECU_Address@KOPM_VehPwrCnsmpAvrgHi_kWh@ */ Scalar_FLOAT32_IEEE 0 AppSwcOpm_CM_single_kWh -100000.0 100000.0 /end CHARACTERISTIC
/begin CHARACTERISTIC KOPM_VehPwrCnsmpAvrgLo_kWh "VCU_B_AcclPedal_EPT" VALUE 0x0000 /* @ECU_Address@KOPM_VehPwrCnsmpAvrgLo_kWh@ */ Scalar_FLOAT32_IEEE 0 AppSwcOpm_CM_single_kWh -100000.0 100000.0 /end CHARACTERISTIC
/begin CHARACTERISTIC KOPM_VehPwrCnsmpAvrg_kWh_ovrdval "VCU_DispInfo_BAC" VALUE 0x0000 /* @ECU_Address@KOPM_VehPwrCnsmpAvrg_kWh_ovrdval@ */ Scalar_FLOAT32_IEEE 0 AppSwcOpm_CM_single_kWh -100000.0 100000.0 /end CHARACTERISTIC
/begin CHARACTERISTIC KOPM_VhclActlCnsmPwrHi_kWh "VCU_B_AcclPedal_EPT" VALUE 0x0000 /* @ECU_Address@KOPM_VhclActlCnsmPwrHi_kWh@ */ Scalar_FLOAT32_IEEE 0 AppSwcOpm_CM_single_kWh -100000.0 100000.0 /end CHARACTERISTIC
/begin CHARACTERISTIC KOPM_VhclActlCnsmPwrLo_kWh "VCU_B_AcclPedal_EPT" VALUE 0x0000 /* @ECU_Address@KOPM_VhclActlCnsmPwrLo_kWh@ */ Scalar_FLOAT32_IEEE 0 AppSwcOpm_CM_single_kWh -100000.0 100000.0 /end CHARACTERISTIC
/begin CHARACTERISTIC KOPM_VhclActlCnsmPwr_kWh_ovrdval "VCU_DispInfo_BAC" VALUE 0x0000 /* @ECU_Address@KOPM_VhclActlCnsmPwr_kWh_ovrdval@ */ Scalar_FLOAT32_IEEE 0 AppSwcOpm_CM_single_kWh -100000.0 100000.0 /end CHARACTERISTIC
/begin CHARACTERISTIC KOPM_WLTPDrvgRngDstHi_km "VCU_B_AcclPedal_EPT" VALUE 0x0000 /* @ECU_Address@KOPM_WLTPDrvgRngDstHi_km@ */ Scalar_FLOAT32_IEEE 0 AppSwcOpm_CM_single_km -100000.0 100000.0 /end CHARACTERISTIC
/begin CHARACTERISTIC KOPM_WLTPDrvgRngDstLo_km "VCU_B_AcclPedal_EPT" VALUE 0x0000 /* @ECU_Address@KOPM_WLTPDrvgRngDstLo_km@ */ Scalar_FLOAT32_IEEE 0 AppSwcOpm_CM_single_km -100000.0 100000.0 /end CHARACTERISTIC
/begin CHARACTERISTIC KOPM_WLTPDrvgRngDst_km_ovrdval "VCU_DispInfo_BAC" VALUE 0x0000 /* @ECU_Address@KOPM_WLTPDrvgRngDst_km_ovrdval@ */ Scalar_FLOAT32_IEEE 0 AppSwcOpm_CM_single_km -100000.0 100000.0 /end CHARACTERISTIC
/begin CHARACTERISTIC KOPM_WghEstHi_kg "VCU_DispInfo_BAC" VALUE 0x0000 /* @ECU_Address@KOPM_WghEstHi_kg@ */ Scalar_FLOAT32_IEEE 0 AppSwcOpm_CM_single_kg -100000.0 100000.0 /end CHARACTERISTIC
/begin CHARACTERISTIC KOPM_WghEstLo_kg "VCU_DispInfo_BAC" VALUE 0x0000 /* @ECU_Address@KOPM_WghEstLo_kg@ */ Scalar_FLOAT32_IEEE 0 AppSwcOpm_CM_single_kg -100000.0 100000.0 /end CHARACTERISTIC
/begin CHARACTERISTIC KOPM_WghEst_kg_ovrdval "VCU_DispInfo_BAC" VALUE 0x0000 /* @ECU_Address@KOPM_WghEst_kg_ovrdval@ */ Scalar_FLOAT32_IEEE 0 AppSwcOpm_CM_single_kg -100000.0 100000.0 /end CHARACTERISTIC
/begin CHARACTERISTIC KOPM_ErrBitHi_nu "VCU_B_AcclPedal_EPT" VALUE 0x0000 /* @ECU_Address@KOPM_ErrBitHi_nu@ */ Scalar_UWORD 0 AppSwcOpm_CM_uint16_nu 0.0 65535.0 /end CHARACTERISTIC
/begin CHARACTERISTIC KOPM_ErrBitLo_nu "VCU_B_AcclPedal_EPT" VALUE 0x0000 /* @ECU_Address@KOPM_ErrBitLo_nu@ */ Scalar_UWORD 0 AppSwcOpm_CM_uint16_nu 0.0 65535.0 /end CHARACTERISTIC
/begin CHARACTERISTIC KOPM_ErrBit_nu_ovrdval "VCU_B_AcclPedal_EPT" VALUE 0x0000 /* @ECU_Address@KOPM_ErrBit_nu_ovrdval@ */ Scalar_UWORD 0 AppSwcOpm_CM_uint16_nu 0.0 65535.0 /end CHARACTERISTIC
/begin CHARACTERISTIC KOPM_AccPedPosSnsrSta_enum_ovrdval "VCU_D_Status_CHA" VALUE 0x0000 /* @ECU_Address@KOPM_AccPedPosSnsrSta_enum_ovrdval@ */ Scalar_UBYTE 0 AppSwcOpm_CM_EnumAccPedSnsrSt 0 3 /end CHARACTERISTIC
/begin CHARACTERISTIC KOPM_BMSShutdown_enum_ovrdval "VCU_4_ChrgCmd_EPT" VALUE 0x0000 /* @ECU_Address@KOPM_BMSShutdown_enum_ovrdval@ */ Scalar_UBYTE 0 AppSwcOpm_CM_EnumBMSSdnCmd 0 3 /end CHARACTERISTIC
/begin CHARACTERISTIC KOPM_BMSWakeupMode_enum_ovrdval "VCU_3_OprtCmd_EPT" VALUE 0x0000 /* @ECU_Address@KOPM_BMSWakeupMode_enum_ovrdval@ */ Scalar_UBYTE 0 AppSwcOpm_CM_EnumBMSWakeUpMd 0 3 /end CHARACTERISTIC
/begin CHARACTERISTIC KOPM_ChrgAllowCmd_enum_ovrdval "VCU_4_ChrgCmd_EPT" VALUE 0x0000 /* @ECU_Address@KOPM_ChrgAllowCmd_enum_ovrdval@ */ Scalar_UBYTE 0 AppSwcOpm_CM_EnumChrgAllwCmd 0 3 /end CHARACTERISTIC
/begin CHARACTERISTIC KOPM_ChrgEnaAC_enum_ovrdval "VCU_3_OprtCmd_EPT" VALUE 0x0000 /* @ECU_Address@KOPM_ChrgEnaAC_enum_ovrdval@ */ Scalar_UBYTE 0 AppSwcOpm_CM_EnumChrgEnaAC 0 3 /end CHARACTERISTIC
/begin CHARACTERISTIC KOPM_VCUCruiseCtrlSta_enum_ovrdval "VCU_D_Status_CHA" VALUE 0x0000 /* @ECU_Address@KOPM_VCUCruiseCtrlSta_enum_ovrdval@ */ Scalar_UBYTE 0 AppSwcOpm_CM_EnumCruiseStatus 0 6 /end CHARACTERISTIC
/begin CHARACTERISTIC KOPM_DCCOprtCmd_enum_ovrdval "VCU_B_AcclPedal_EPT" VALUE 0x0000 /* @ECU_Address@KOPM_DCCOprtCmd_enum_ovrdval@ */ Scalar_UBYTE 0 AppSwcOpm_CM_EnumDCCOprtCmd 0 4 /end CHARACTERISTIC
/begin CHARACTERISTIC KOPM_VCUReqEPB_enum_ovrdval "VCU_D_Status_CHA" VALUE 0x0000 /* @ECU_Address@KOPM_VCUReqEPB_enum_ovrdval@ */ Scalar_UBYTE 0 AppSwcOpm_CM_EnumEPBReq 0 2 /end CHARACTERISTIC
/begin CHARACTERISTIC KOPM_SIBSRTCChrgSt_enum_ovrdval "VCU_DispInfo_BAC" VALUE 0x0000 /* @ECU_Address@KOPM_SIBSRTCChrgSt_enum_ovrdval@ */ Scalar_UBYTE 0 AppSwcOpm_CM_EnumIBSChrgSt 0 3 /end CHARACTERISTIC
/begin CHARACTERISTIC KOPM_MotDirReq_enum_ovrdval "VCU_1_InvCmd_EPT" VALUE 0x0000 /* @ECU_Address@KOPM_MotDirReq_enum_ovrdval@ */ Scalar_UBYTE 0 AppSwcOpm_CM_EnumMotorDirReq 0 3 /end CHARACTERISTIC
/begin CHARACTERISTIC KOPM_MotModeReq_enum_ovrdval "VCU_1_InvCmd_EPT" VALUE 0x0000 /* @ECU_Address@KOPM_MotModeReq_enum_ovrdval@ */ Scalar_UBYTE 0 AppSwcOpm_CM_EnumMotorModeReq 0 2 /end CHARACTERISTIC
/begin CHARACTERISTIC KOPM_OBCOprtCmdToICU_enum_ovrdval "VCU_DispInfo_BAC" VALUE 0x0000 /* @ECU_Address@KOPM_OBCOprtCmdToICU_enum_ovrdval@ */ Scalar_UBYTE 0 AppSwcOpm_CM_EnumOBCOprtCmd 0 6 /end CHARACTERISTIC
/begin CHARACTERISTIC KOPM_OBCOprtCmd_enum_ovrdval "VCU_4_ChrgCmd_EPT" VALUE 0x0000 /* @ECU_Address@KOPM_OBCOprtCmd_enum_ovrdval@ */ Scalar_UBYTE 0 AppSwcOpm_CM_EnumOBCOprtCmd 0 6 /end CHARACTERISTIC
/begin CHARACTERISTIC KOPM_VehTrgtGearPos_enum_ovrdval "VCU_1_InvCmd_EPT" VALUE 0x0000 /* @ECU_Address@KOPM_VehTrgtGearPos_enum_ovrdval@ */ Scalar_UBYTE 0 AppSwcOpm_CM_EnumTgtGearPstn 0 4 /end CHARACTERISTIC
/begin CHARACTERISTIC KOPM_12VBatLowVolSta_enum_ovrdflg "CCU_VehInfo_BAC" VALUE 0x0000 /* @ECU_Address@KOPM_12VBatLowVolSta_enum_ovrdflg@ */ Scalar_BOOLEAN 0 AppSwcOpm_CM_boolean_flg 0.0 1.0 /end CHARACTERISTIC
/begin CHARACTERISTIC KOPM_ACCTrqCtrlAvl_flg_ovrdflg "VCU_D_Status_CHA" VALUE 0x0000 /* @ECU_Address@KOPM_ACCTrqCtrlAvl_flg_ovrdflg@ */ Scalar_BOOLEAN 0 AppSwcOpm_CM_boolean_flg 0.0 1.0 /end CHARACTERISTIC
/begin CHARACTERISTIC KOPM_ACCTrqCtrlAvl_flg_ovrdval "VCU_D_Status_CHA" VALUE 0x0000 /* @ECU_Address@KOPM_ACCTrqCtrlAvl_flg_ovrdval@ */ Scalar_BOOLEAN 0 AppSwcOpm_CM_boolean_flg 0.0 1.0 /end CHARACTERISTIC
/begin CHARACTERISTIC KOPM_ACChrgMaxCurr_A_ovrdflg "VCU_DispInfo_BAC" VALUE 0x0000 /* @ECU_Address@KOPM_ACChrgMaxCurr_A_ovrdflg@ */ Scalar_BOOLEAN 0 AppSwcOpm_CM_boolean_flg 0.0 1.0 /end CHARACTERISTIC
/begin CHARACTERISTIC KOPM_ACChrgMode_enum_ovrdflg "VCU_DispInfo_BAC" VALUE 0x0000 /* @ECU_Address@KOPM_ACChrgMode_enum_ovrdflg@ */ Scalar_BOOLEAN 0 AppSwcOpm_CM_boolean_flg 0.0 1.0 /end CHARACTERISTIC
/begin CHARACTERISTIC KOPM_ACRemtCtrlFb_enum_ovrdflg "VCU_DispInfo_BAC" VALUE 0x0000 /* @ECU_Address@KOPM_ACRemtCtrlFb_enum_ovrdflg@ */ Scalar_BOOLEAN 0 AppSwcOpm_CM_boolean_flg 0.0 1.0 /end CHARACTERISTIC
/begin CHARACTERISTIC KOPM_ACRmtDefrstCtlFb_enum_ovrdflg "VCU_DispInfo_BAC" VALUE 0x0000 /* @ECU_Address@KOPM_ACRmtDefrstCtlFb_enum_ovrdflg@ */ Scalar_BOOLEAN 0 AppSwcOpm_CM_boolean_flg 0.0 1.0 /end CHARACTERISTIC
/begin CHARACTERISTIC KOPM_ACTempSetFb_enum_ovrdflg "VCU_DispInfo_BAC" VALUE 0x0000 /* @ECU_Address@KOPM_ACTempSetFb_enum_ovrdflg@ */ Scalar_BOOLEAN 0 AppSwcOpm_CM_boolean_flg 0.0 1.0 /end CHARACTERISTIC
/begin CHARACTERISTIC KOPM_ACUnlckVentSetFB_enum_ovrdflg "VCU_DispInfo_BAC" VALUE 0x0000 /* @ECU_Address@KOPM_ACUnlckVentSetFB_enum_ovrdflg@ */ Scalar_BOOLEAN 0 AppSwcOpm_CM_boolean_flg 0.0 1.0 /end CHARACTERISTIC
/begin CHARACTERISTIC KOPM_AccPedPosSnsrSta_enum_ovrdflg "VCU_D_Status_CHA" VALUE 0x0000 /* @ECU_Address@KOPM_AccPedPosSnsrSta_enum_ovrdflg@ */ Scalar_BOOLEAN 0 AppSwcOpm_CM_boolean_flg 0.0 1.0 /end CHARACTERISTIC
/begin CHARACTERISTIC KOPM_AccPedPosToESCSta_enum_ovrdflg "VCU_D_Status_CHA" VALUE 0x0000 /* @ECU_Address@KOPM_AccPedPosToESCSta_enum_ovrdflg@ */ Scalar_BOOLEAN 0 AppSwcOpm_CM_boolean_flg 0.0 1.0 /end CHARACTERISTIC
/begin CHARACTERISTIC KOPM_AccPedPosToESC_pct_ovrdflg "VCU_D_Status_CHA" VALUE 0x0000 /* @ECU_Address@KOPM_AccPedPosToESC_pct_ovrdflg@ */ Scalar_BOOLEAN 0 AppSwcOpm_CM_boolean_flg 0.0 1.0 /end CHARACTERISTIC
/begin CHARACTERISTIC KOPM_AcclPedalPos_pct_ovrdflg "VCU_D_Status_CHA" VALUE 0x0000 /* @ECU_Address@KOPM_AcclPedalPos_pct_ovrdflg@ */ Scalar_BOOLEAN 0 AppSwcOpm_CM_boolean_flg 0.0 1.0 /end CHARACTERISTIC
/begin CHARACTERISTIC KOPM_AllowHeatCoolMaxPwrCmsp_kW_ovrdflg "VCU_3_OprtCmd_EPT" VALUE 0x0000 /* @ECU_Address@KOPM_AllowHeatCoolMaxPwrCmsp_kW_ovrdflg@ */ Scalar_BOOLEAN 0 AppSwcOpm_CM_boolean_flg 0.0 1.0 /end CHARACTERISTIC
/begin CHARACTERISTIC KOPM_AppSoftNumb_nu_ovrdflg "VCU_0_Value_EPT" VALUE 0x0000 /* @ECU_Address@KOPM_AppSoftNumb_nu_ovrdflg@ */ Scalar_BOOLEAN 0 AppSwcOpm_CM_boolean_flg 0.0 1.0 /end CHARACTERISTIC
/begin CHARACTERISTIC KOPM_BCMIllmndLckStsFb_flg_ovrdflg "VCU_DispInfo_BAC" VALUE 0x0000 /* @ECU_Address@KOPM_BCMIllmndLckStsFb_flg_ovrdflg@ */ Scalar_BOOLEAN 0 AppSwcOpm_CM_boolean_flg 0.0 1.0 /end CHARACTERISTIC
/begin CHARACTERISTIC KOPM_BCMIllmndLckStsFb_flg_ovrdval "VCU_DispInfo_BAC" VALUE 0x0000 /* @ECU_Address@KOPM_BCMIllmndLckStsFb_flg_ovrdval@ */ Scalar_BOOLEAN 0 AppSwcOpm_CM_boolean_flg 0.0 1.0 /end CHARACTERISTIC
/begin CHARACTERISTIC KOPM_BCMIllmndUnlckStsFb_flg_ovrdflg "VCU_DispInfo_BAC" VALUE 0x0000 /* @ECU_Address@KOPM_BCMIllmndUnlckStsFb_flg_ovrdflg@ */ Scalar_BOOLEAN 0 AppSwcOpm_CM_boolean_flg 0.0 1.0 /end CHARACTERISTIC
/begin CHARACTERISTIC KOPM_BCMIllmndUnlckStsFb_flg_ovrdval "VCU_DispInfo_BAC" VALUE 0x0000 /* @ECU_Address@KOPM_BCMIllmndUnlckStsFb_flg_ovrdval@ */ Scalar_BOOLEAN 0 AppSwcOpm_CM_boolean_flg 0.0 1.0 /end CHARACTERISTIC
/begin CHARACTERISTIC KOPM_BMSShutdown_enum_ovrdflg "VCU_4_ChrgCmd_EPT" VALUE 0x0000 /* @ECU_Address@KOPM_BMSShutdown_enum_ovrdflg@ */ Scalar_BOOLEAN 0 AppSwcOpm_CM_boolean_flg 0.0 1.0 /end CHARACTERISTIC
/begin CHARACTERISTIC KOPM_BMSWakeupMode_enum_ovrdflg "VCU_3_OprtCmd_EPT" VALUE 0x0000 /* @ECU_Address@KOPM_BMSWakeupMode_enum_ovrdflg@ */ Scalar_BOOLEAN 0 AppSwcOpm_CM_boolean_flg 0.0 1.0 /end CHARACTERISTIC
/begin CHARACTERISTIC KOPM_Bat2DrvTrainEnb_flg_ovrdflg "VCU_3_OprtCmd_EPT" VALUE 0x0000 /* @ECU_Address@KOPM_Bat2DrvTrainEnb_flg_ovrdflg@ */ Scalar_BOOLEAN 0 AppSwcOpm_CM_boolean_flg 0.0 1.0 /end CHARACTERISTIC
/begin CHARACTERISTIC KOPM_Bat2DrvTrainEnb_flg_ovrdval "VCU_3_OprtCmd_EPT" VALUE 0x0000 /* @ECU_Address@KOPM_Bat2DrvTrainEnb_flg_ovrdval@ */ Scalar_BOOLEAN 0 AppSwcOpm_CM_boolean_flg 0.0 1.0 /end CHARACTERISTIC
/begin CHARACTERISTIC KOPM_BraSwi_flg_ovrdflg "VCU_0_Value_EPT" VALUE 0x0000 /* @ECU_Address@KOPM_BraSwi_flg_ovrdflg@ */ Scalar_BOOLEAN 0 AppSwcOpm_CM_boolean_flg 0.0 1.0 /end CHARACTERISTIC
/begin CHARACTERISTIC KOPM_BraSwi_flg_ovrdval "VCU_0_Value_EPT" VALUE 0x0000 /* @ECU_Address@KOPM_BraSwi_flg_ovrdval@ */ Scalar_BOOLEAN 0 AppSwcOpm_CM_boolean_flg 0.0 1.0 /end CHARACTERISTIC
/begin CHARACTERISTIC KOPM_BrkPedSnsrPosVRsrvd_enum_ovrdflg "VCU_D_Status_CHA" VALUE 0x0000 /* @ECU_Address@KOPM_BrkPedSnsrPosVRsrvd_enum_ovrdflg@ */ Scalar_BOOLEAN 0 AppSwcOpm_CM_boolean_flg 0.0 1.0 /end CHARACTERISTIC
/begin CHARACTERISTIC KOPM_BrkPedalPos_pct_ovrdflg "VCU_D_Status_CHA" VALUE 0x0000 /* @ECU_Address@KOPM_BrkPedalPos_pct_ovrdflg@ */ Scalar_BOOLEAN 0 AppSwcOpm_CM_boolean_flg 0.0 1.0 /end CHARACTERISTIC
/begin CHARACTERISTIC KOPM_CCKeyStgntn_enum_ovrdflg "VCU_DispInfo_BAC" VALUE 0x0000 /* @ECU_Address@KOPM_CCKeyStgntn_enum_ovrdflg@ */ Scalar_BOOLEAN 0 AppSwcOpm_CM_boolean_flg 0.0 1.0 /end CHARACTERISTIC
/begin CHARACTERISTIC KOPM_CCUOpenVentnFb_enum_ovrdflg "VCU_DispInfo_BAC" VALUE 0x0000 /* @ECU_Address@KOPM_CCUOpenVentnFb_enum_ovrdflg@ */ Scalar_BOOLEAN 0 AppSwcOpm_CM_boolean_flg 0.0 1.0 /end CHARACTERISTIC
/begin CHARACTERISTIC KOPM_CCURmtCarSearchFb_enum_ovrdflg "VCU_DispInfo_BAC" VALUE 0x0000 /* @ECU_Address@KOPM_CCURmtCarSearchFb_enum_ovrdflg@ */ Scalar_BOOLEAN 0 AppSwcOpm_CM_boolean_flg 0.0 1.0 /end CHARACTERISTIC
/begin CHARACTERISTIC KOPM_CCURmtLckFb_enum_ovrdflg "VCU_DispInfo_BAC" VALUE 0x0000 /* @ECU_Address@KOPM_CCURmtLckFb_enum_ovrdflg@ */ Scalar_BOOLEAN 0 AppSwcOpm_CM_boolean_flg 0.0 1.0 /end CHARACTERISTIC
/begin CHARACTERISTIC KOPM_CCURmtPwrLckFb_enum_ovrdflg "VCU_DispInfo_BAC" VALUE 0x0000 /* @ECU_Address@KOPM_CCURmtPwrLckFb_enum_ovrdflg@ */ Scalar_BOOLEAN 0 AppSwcOpm_CM_boolean_flg 0.0 1.0 /end CHARACTERISTIC
/begin CHARACTERISTIC KOPM_ChrgAllowCmd_enum_ovrdflg "VCU_4_ChrgCmd_EPT" VALUE 0x0000 /* @ECU_Address@KOPM_ChrgAllowCmd_enum_ovrdflg@ */ Scalar_BOOLEAN 0 AppSwcOpm_CM_boolean_flg 0.0 1.0 /end CHARACTERISTIC
/begin CHARACTERISTIC KOPM_ChrgEnaAC_enum_ovrdflg "VCU_3_OprtCmd_EPT" VALUE 0x0000 /* @ECU_Address@KOPM_ChrgEnaAC_enum_ovrdflg@ */ Scalar_BOOLEAN 0 AppSwcOpm_CM_boolean_flg 0.0 1.0 /end CHARACTERISTIC
/begin CHARACTERISTIC KOPM_ChrgEnaDC_flg_ovrdflg "VCU_4_ChrgCmd_EPT" VALUE 0x0000 /* @ECU_Address@KOPM_ChrgEnaDC_flg_ovrdflg@ */ Scalar_BOOLEAN 0 AppSwcOpm_CM_boolean_flg 0.0 1.0 /end CHARACTERISTIC
/begin CHARACTERISTIC KOPM_ChrgEnaDC_flg_ovrdval "VCU_4_ChrgCmd_EPT" VALUE 0x0000 /* @ECU_Address@KOPM_ChrgEnaDC_flg_ovrdval@ */ Scalar_BOOLEAN 0 AppSwcOpm_CM_boolean_flg 0.0 1.0 /end CHARACTERISTIC
/begin CHARACTERISTIC KOPM_CruiseCtrTgtSpd_kph_ovrdflg "VCU_DispInfo_BAC" VALUE 0x0000 /* @ECU_Address@KOPM_CruiseCtrTgtSpd_kph_ovrdflg@ */ Scalar_BOOLEAN 0 AppSwcOpm_CM_boolean_flg 0.0 1.0 /end CHARACTERISTIC
/begin CHARACTERISTIC KOPM_CruiseCtrlSta_enum_ovrdflg "VCU_DispInfo_BAC" VALUE 0x0000 /* @ECU_Address@KOPM_CruiseCtrlSta_enum_ovrdflg@ */ Scalar_BOOLEAN 0 AppSwcOpm_CM_boolean_flg 0.0 1.0 /end CHARACTERISTIC
/begin CHARACTERISTIC KOPM_DCCBoostHvVolt_V_ovrdflg "VCU_C_OprtCmd_EPT" VALUE 0x0000 /* @ECU_Address@KOPM_DCCBoostHvVolt_V_ovrdflg@ */ Scalar_BOOLEAN 0 AppSwcOpm_CM_boolean_flg 0.0 1.0 /end CHARACTERISTIC
/begin CHARACTERISTIC KOPM_DCCBuckLVVolt_V_ovrdflg "VCU_C_OprtCmd_EPT" VALUE 0x0000 /* @ECU_Address@KOPM_DCCBuckLVVolt_V_ovrdflg@ */ Scalar_BOOLEAN 0 AppSwcOpm_CM_boolean_flg 0.0 1.0 /end CHARACTERISTIC
/begin CHARACTERISTIC KOPM_DCCOprtCmd_enum_ovrdflg "VCU_B_AcclPedal_EPT" VALUE 0x0000 /* @ECU_Address@KOPM_DCCOprtCmd_enum_ovrdflg@ */ Scalar_BOOLEAN 0 AppSwcOpm_CM_boolean_flg 0.0 1.0 /end CHARACTERISTIC
/begin CHARACTERISTIC KOPM_DrvModeKeyStgntn_enum_ovrdflg "VCU_DispInfo_BAC" VALUE 0x0000 /* @ECU_Address@KOPM_DrvModeKeyStgntn_enum_ovrdflg@ */ Scalar_BOOLEAN 0 AppSwcOpm_CM_boolean_flg 0.0 1.0 /end CHARACTERISTIC
/begin CHARACTERISTIC KOPM_DrvMotorSta_enum_ovrdflg "VCU_DispInfo_BAC" VALUE 0x0000 /* @ECU_Address@KOPM_DrvMotorSta_enum_ovrdflg@ */ Scalar_BOOLEAN 0 AppSwcOpm_CM_boolean_flg 0.0 1.0 /end CHARACTERISTIC
/begin CHARACTERISTIC KOPM_DrvPed_pct_ovrdflg "VCU_0_Value_EPT" VALUE 0x0000 /* @ECU_Address@KOPM_DrvPed_pct_ovrdflg@ */ Scalar_BOOLEAN 0 AppSwcOpm_CM_boolean_flg 0.0 1.0 /end CHARACTERISTIC
/begin CHARACTERISTIC KOPM_DrvRangeDistEstVld_flg_ovrdflg "VCU_DispInfo_BAC" VALUE 0x0000 /* @ECU_Address@KOPM_DrvRangeDistEstVld_flg_ovrdflg@ */ Scalar_BOOLEAN 0 AppSwcOpm_CM_boolean_flg 0.0 1.0 /end CHARACTERISTIC
/begin CHARACTERISTIC KOPM_DrvRangeDistEstVld_flg_ovrdval "VCU_DispInfo_BAC" VALUE 0x0000 /* @ECU_Address@KOPM_DrvRangeDistEstVld_flg_ovrdval@ */ Scalar_BOOLEAN 0 AppSwcOpm_CM_boolean_flg 0.0 1.0 /end CHARACTERISTIC
/begin CHARACTERISTIC KOPM_DrvRangeDistEst_km_ovrdflg "VCU_DispInfo_BAC" VALUE 0x0000 /* @ECU_Address@KOPM_DrvRangeDistEst_km_ovrdflg@ */ Scalar_BOOLEAN 0 AppSwcOpm_CM_boolean_flg 0.0 1.0 /end CHARACTERISTIC
/begin CHARACTERISTIC KOPM_DrvReqMotorTorqVld_flg_ovrdflg "VCU_10_Torque_CHA" VALUE 0x0000 /* @ECU_Address@KOPM_DrvReqMotorTorqVld_flg_ovrdflg@ */ Scalar_BOOLEAN 0 AppSwcOpm_CM_boolean_flg 0.0 1.0 /end CHARACTERISTIC
/begin CHARACTERISTIC KOPM_DrvReqMotorTorqVld_flg_ovrdval "VCU_10_Torque_CHA" VALUE 0x0000 /* @ECU_Address@KOPM_DrvReqMotorTorqVld_flg_ovrdval@ */ Scalar_BOOLEAN 0 AppSwcOpm_CM_boolean_flg 0.0 1.0 /end CHARACTERISTIC
/begin CHARACTERISTIC KOPM_DrvReqMotorTorq_Nm_ovrdflg "VCU_10_Torque_CHA" VALUE 0x0000 /* @ECU_Address@KOPM_DrvReqMotorTorq_Nm_ovrdflg@ */ Scalar_BOOLEAN 0 AppSwcOpm_CM_boolean_flg 0.0 1.0 /end CHARACTERISTIC
/begin CHARACTERISTIC KOPM_DrvReqTorqOverrideFCM_flg_ovrdflg "VCU_D_Status_CHA" VALUE 0x0000 /* @ECU_Address@KOPM_DrvReqTorqOverrideFCM_flg_ovrdflg@ */ Scalar_BOOLEAN 0 AppSwcOpm_CM_boolean_flg 0.0 1.0 /end CHARACTERISTIC
/begin CHARACTERISTIC KOPM_DrvReqTorqOverrideFCM_flg_ovrdval "VCU_D_Status_CHA" VALUE 0x0000 /* @ECU_Address@KOPM_DrvReqTorqOverrideFCM_flg_ovrdval@ */ Scalar_BOOLEAN 0 AppSwcOpm_CM_boolean_flg 0.0 1.0 /end CHARACTERISTIC
/begin CHARACTERISTIC KOPM_DrvReqTorqOvrdESC_flg_ovrdflg "VCU_D_Status_CHA" VALUE 0x0000 /* @ECU_Address@KOPM_DrvReqTorqOvrdESC_flg_ovrdflg@ */ Scalar_BOOLEAN 0 AppSwcOpm_CM_boolean_flg 0.0 1.0 /end CHARACTERISTIC
/begin CHARACTERISTIC KOPM_DrvReqTorqOvrdESC_flg_ovrdval "VCU_D_Status_CHA" VALUE 0x0000 /* @ECU_Address@KOPM_DrvReqTorqOvrdESC_flg_ovrdval@ */ Scalar_BOOLEAN 0 AppSwcOpm_CM_boolean_flg 0.0 1.0 /end CHARACTERISTIC
/begin CHARACTERISTIC KOPM_DrvReqWhlTqVld_flg_ovrdflg "VCU_10_Torque_CHA" VALUE 0x0000 /* @ECU_Address@KOPM_DrvReqWhlTqVld_flg_ovrdflg@ */ Scalar_BOOLEAN 0 AppSwcOpm_CM_boolean_flg 0.0 1.0 /end CHARACTERISTIC
/begin CHARACTERISTIC KOPM_DrvReqWhlTqVld_flg_ovrdval "VCU_10_Torque_CHA" VALUE 0x0000 /* @ECU_Address@KOPM_DrvReqWhlTqVld_flg_ovrdval@ */ Scalar_BOOLEAN 0 AppSwcOpm_CM_boolean_flg 0.0 1.0 /end CHARACTERISTIC
/begin CHARACTERISTIC KOPM_DrvReqWhlTq_Nm_ovrdflg "VCU_10_Torque_CHA" VALUE 0x0000 /* @ECU_Address@KOPM_DrvReqWhlTq_Nm_ovrdflg@ */ Scalar_BOOLEAN 0 AppSwcOpm_CM_boolean_flg 0.0 1.0 /end CHARACTERISTIC
/begin CHARACTERISTIC KOPM_DrvSwi_flg_ovrdflg "VCU_0_Value_EPT" VALUE 0x0000 /* @ECU_Address@KOPM_DrvSwi_flg_ovrdflg@ */ Scalar_BOOLEAN 0 AppSwcOpm_CM_boolean_flg 0.0 1.0 /end CHARACTERISTIC
/begin CHARACTERISTIC KOPM_DrvSwi_flg_ovrdval "VCU_0_Value_EPT" VALUE 0x0000 /* @ECU_Address@KOPM_DrvSwi_flg_ovrdval@ */ Scalar_BOOLEAN 0 AppSwcOpm_CM_boolean_flg 0.0 1.0 /end CHARACTERISTIC
/begin CHARACTERISTIC KOPM_DrvWhlTqAllwdMax_Nm_ovrdflg "VCU_10_Torque_CHA" VALUE 0x0000 /* @ECU_Address@KOPM_DrvWhlTqAllwdMax_Nm_ovrdflg@ */ Scalar_BOOLEAN 0 AppSwcOpm_CM_boolean_flg 0.0 1.0 /end CHARACTERISTIC
/begin CHARACTERISTIC KOPM_EmgcySdn_flg_ovrdflg "VCU_1_InvCmd_EPT" VALUE 0x0000 /* @ECU_Address@KOPM_EmgcySdn_flg_ovrdflg@ */ Scalar_BOOLEAN 0 AppSwcOpm_CM_boolean_flg 0.0 1.0 /end CHARACTERISTIC
/begin CHARACTERISTIC KOPM_EmgcySdn_flg_ovrdval "VCU_1_InvCmd_EPT" VALUE 0x0000 /* @ECU_Address@KOPM_EmgcySdn_flg_ovrdval@ */ Scalar_BOOLEAN 0 AppSwcOpm_CM_boolean_flg 0.0 1.0 /end CHARACTERISTIC
/begin CHARACTERISTIC KOPM_EnaDisChg_flg_ovrdflg "VCU_1_InvCmd_EPT" VALUE 0x0000 /* @ECU_Address@KOPM_EnaDisChg_flg_ovrdflg@ */ Scalar_BOOLEAN 0 AppSwcOpm_CM_boolean_flg 0.0 1.0 /end CHARACTERISTIC
/begin CHARACTERISTIC KOPM_EnaDisChg_flg_ovrdval "VCU_1_InvCmd_EPT" VALUE 0x0000 /* @ECU_Address@KOPM_EnaDisChg_flg_ovrdval@ */ Scalar_BOOLEAN 0 AppSwcOpm_CM_boolean_flg 0.0 1.0 /end CHARACTERISTIC
/begin CHARACTERISTIC KOPM_EnaInvRun_flg_ovrdflg "VCU_1_InvCmd_EPT" VALUE 0x0000 /* @ECU_Address@KOPM_EnaInvRun_flg_ovrdflg@ */ Scalar_BOOLEAN 0 AppSwcOpm_CM_boolean_flg 0.0 1.0 /end CHARACTERISTIC
/begin CHARACTERISTIC KOPM_EnaInvRun_flg_ovrdval "VCU_1_InvCmd_EPT" VALUE 0x0000 /* @ECU_Address@KOPM_EnaInvRun_flg_ovrdval@ */ Scalar_BOOLEAN 0 AppSwcOpm_CM_boolean_flg 0.0 1.0 /end CHARACTERISTIC
/begin CHARACTERISTIC KOPM_ErrAmount_cnt_ovrdflg "VCU_B_AcclPedal_EPT" VALUE 0x0000 /* @ECU_Address@KOPM_ErrAmount_cnt_ovrdflg@ */ Scalar_BOOLEAN 0 AppSwcOpm_CM_boolean_flg 0.0 1.0 /end CHARACTERISTIC
/begin CHARACTERISTIC KOPM_ErrBit_nu_ovrdflg "VCU_B_AcclPedal_EPT" VALUE 0x0000 /* @ECU_Address@KOPM_ErrBit_nu_ovrdflg@ */ Scalar_BOOLEAN 0 AppSwcOpm_CM_boolean_flg 0.0 1.0 /end CHARACTERISTIC
/begin CHARACTERISTIC KOPM_GearShiftInhibited_flg_ovrdflg "VCU_D_Status_CHA" VALUE 0x0000 /* @ECU_Address@KOPM_GearShiftInhibited_flg_ovrdflg@ */ Scalar_BOOLEAN 0 AppSwcOpm_CM_boolean_flg 0.0 1.0 /end CHARACTERISTIC
/begin CHARACTERISTIC KOPM_GearShiftInhibited_flg_ovrdval "VCU_D_Status_CHA" VALUE 0x0000 /* @ECU_Address@KOPM_GearShiftInhibited_flg_ovrdval@ */ Scalar_BOOLEAN 0 AppSwcOpm_CM_boolean_flg 0.0 1.0 /end CHARACTERISTIC
/begin CHARACTERISTIC KOPM_InfoDisp_enum_ovrdflg "VCU_DispInfo_BAC" VALUE 0x0000 /* @ECU_Address@KOPM_InfoDisp_enum_ovrdflg@ */ Scalar_BOOLEAN 0 AppSwcOpm_CM_boolean_flg 0.0 1.0 /end CHARACTERISTIC
/begin CHARACTERISTIC KOPM_LckVehWrm_enum_ovrdflg "VCU_DispInfo_BAC" VALUE 0x0000 /* @ECU_Address@KOPM_LckVehWrm_enum_ovrdflg@ */ Scalar_BOOLEAN 0 AppSwcOpm_CM_boolean_flg 0.0 1.0 /end CHARACTERISTIC
/begin CHARACTERISTIC KOPM_MCUHiTempWrning_flg_ovrdflg "VCU_DispInfo_BAC" VALUE 0x0000 /* @ECU_Address@KOPM_MCUHiTempWrning_flg_ovrdflg@ */ Scalar_BOOLEAN 0 AppSwcOpm_CM_boolean_flg 0.0 1.0 /end CHARACTERISTIC
/begin CHARACTERISTIC KOPM_MCUHiTempWrning_flg_ovrdval "VCU_DispInfo_BAC" VALUE 0x0000 /* @ECU_Address@KOPM_MCUHiTempWrning_flg_ovrdval@ */ Scalar_BOOLEAN 0 AppSwcOpm_CM_boolean_flg 0.0 1.0 /end CHARACTERISTIC
/begin CHARACTERISTIC KOPM_MaxChrgCurntAC_A_ovrdflg "VCU_4_ChrgCmd_EPT" VALUE 0x0000 /* @ECU_Address@KOPM_MaxChrgCurntAC_A_ovrdflg@ */ Scalar_BOOLEAN 0 AppSwcOpm_CM_boolean_flg 0.0 1.0 /end CHARACTERISTIC
/begin CHARACTERISTIC KOPM_MaxChrgCurntDC_A_ovrdflg "VCU_4_ChrgCmd_EPT" VALUE 0x0000 /* @ECU_Address@KOPM_MaxChrgCurntDC_A_ovrdflg@ */ Scalar_BOOLEAN 0 AppSwcOpm_CM_boolean_flg 0.0 1.0 /end CHARACTERISTIC
/begin CHARACTERISTIC KOPM_MaxChrgVoltDC_V_ovrdflg "VCU_4_ChrgCmd_EPT" VALUE 0x0000 /* @ECU_Address@KOPM_MaxChrgVoltDC_V_ovrdflg@ */ Scalar_BOOLEAN 0 AppSwcOpm_CM_boolean_flg 0.0 1.0 /end CHARACTERISTIC
/begin CHARACTERISTIC KOPM_MaxHVDCCurntAC_A_ovrdflg "VCU_C_OprtCmd_EPT" VALUE 0x0000 /* @ECU_Address@KOPM_MaxHVDCCurntAC_A_ovrdflg@ */ Scalar_BOOLEAN 0 AppSwcOpm_CM_boolean_flg 0.0 1.0 /end CHARACTERISTIC
/begin CHARACTERISTIC KOPM_MaxHVDCVoltAC_V_ovrdflg "VCU_C_OprtCmd_EPT" VALUE 0x0000 /* @ECU_Address@KOPM_MaxHVDCVoltAC_V_ovrdflg@ */ Scalar_BOOLEAN 0 AppSwcOpm_CM_boolean_flg 0.0 1.0 /end CHARACTERISTIC
/begin CHARACTERISTIC KOPM_MotActPwrTyp_enum_ovrdflg "VCU_DispInfo_BAC" VALUE 0x0000 /* @ECU_Address@KOPM_MotActPwrTyp_enum_ovrdflg@ */ Scalar_BOOLEAN 0 AppSwcOpm_CM_boolean_flg 0.0 1.0 /end CHARACTERISTIC
/begin CHARACTERISTIC KOPM_MotActPwr_Kw_ovrdflg "VCU_DispInfo_BAC" VALUE 0x0000 /* @ECU_Address@KOPM_MotActPwr_Kw_ovrdflg@ */ Scalar_BOOLEAN 0 AppSwcOpm_CM_boolean_flg 0.0 1.0 /end CHARACTERISTIC
/begin CHARACTERISTIC KOPM_MotDirReq_enum_ovrdflg "VCU_1_InvCmd_EPT" VALUE 0x0000 /* @ECU_Address@KOPM_MotDirReq_enum_ovrdflg@ */ Scalar_BOOLEAN 0 AppSwcOpm_CM_boolean_flg 0.0 1.0 /end CHARACTERISTIC
/begin CHARACTERISTIC KOPM_MotDmpgLmt_Nm_ovrdflg "VCU_0_Value_EPT" VALUE 0x0000 /* @ECU_Address@KOPM_MotDmpgLmt_Nm_ovrdflg@ */ Scalar_BOOLEAN 0 AppSwcOpm_CM_boolean_flg 0.0 1.0 /end CHARACTERISTIC
/begin CHARACTERISTIC KOPM_MotModeReq_enum_ovrdflg "VCU_1_InvCmd_EPT" VALUE 0x0000 /* @ECU_Address@KOPM_MotModeReq_enum_ovrdflg@ */ Scalar_BOOLEAN 0 AppSwcOpm_CM_boolean_flg 0.0 1.0 /end CHARACTERISTIC
/begin CHARACTERISTIC KOPM_MotSpdReq_rpm_ovrdflg "VCU_1_InvCmd_EPT" VALUE 0x0000 /* @ECU_Address@KOPM_MotSpdReq_rpm_ovrdflg@ */ Scalar_BOOLEAN 0 AppSwcOpm_CM_boolean_flg 0.0 1.0 /end CHARACTERISTIC
/begin CHARACTERISTIC KOPM_MotTorqReq_Nm_ovrdflg "VCU_1_InvCmd_EPT" VALUE 0x0000 /* @ECU_Address@KOPM_MotTorqReq_Nm_ovrdflg@ */ Scalar_BOOLEAN 0 AppSwcOpm_CM_boolean_flg 0.0 1.0 /end CHARACTERISTIC
/begin CHARACTERISTIC KOPM_MotorHiTempWrning_flg_ovrdflg "VCU_DispInfo_BAC" VALUE 0x0000 /* @ECU_Address@KOPM_MotorHiTempWrning_flg_ovrdflg@ */ Scalar_BOOLEAN 0 AppSwcOpm_CM_boolean_flg 0.0 1.0 /end CHARACTERISTIC
/begin CHARACTERISTIC KOPM_MotorHiTempWrning_flg_ovrdval "VCU_DispInfo_BAC" VALUE 0x0000 /* @ECU_Address@KOPM_MotorHiTempWrning_flg_ovrdval@ */ Scalar_BOOLEAN 0 AppSwcOpm_CM_boolean_flg 0.0 1.0 /end CHARACTERISTIC
/begin CHARACTERISTIC KOPM_MotorOutputCooltTemp_C_ovrdflg "VCU_3_OprtCmd_EPT" VALUE 0x0000 /* @ECU_Address@KOPM_MotorOutputCooltTemp_C_ovrdflg@ */ Scalar_BOOLEAN 0 AppSwcOpm_CM_boolean_flg 0.0 1.0 /end CHARACTERISTIC
/begin CHARACTERISTIC KOPM_OBCIntDchrgEna_flg_ovrdflg "VCU_C_OprtCmd_EPT" VALUE 0x0000 /* @ECU_Address@KOPM_OBCIntDchrgEna_flg_ovrdflg@ */ Scalar_BOOLEAN 0 AppSwcOpm_CM_boolean_flg 0.0 1.0 /end CHARACTERISTIC
/begin CHARACTERISTIC KOPM_OBCIntDchrgEna_flg_ovrdval "VCU_C_OprtCmd_EPT" VALUE 0x0000 /* @ECU_Address@KOPM_OBCIntDchrgEna_flg_ovrdval@ */ Scalar_BOOLEAN 0 AppSwcOpm_CM_boolean_flg 0.0 1.0 /end CHARACTERISTIC
/begin CHARACTERISTIC KOPM_OBCOprtCmdToICU_enum_ovrdflg "VCU_DispInfo_BAC" VALUE 0x0000 /* @ECU_Address@KOPM_OBCOprtCmdToICU_enum_ovrdflg@ */ Scalar_BOOLEAN 0 AppSwcOpm_CM_boolean_flg 0.0 1.0 /end CHARACTERISTIC
/begin CHARACTERISTIC KOPM_OBCOprtCmd_enum_ovrdflg "VCU_4_ChrgCmd_EPT" VALUE 0x0000 /* @ECU_Address@KOPM_OBCOprtCmd_enum_ovrdflg@ */ Scalar_BOOLEAN 0 AppSwcOpm_CM_boolean_flg 0.0 1.0 /end CHARACTERISTIC
/begin CHARACTERISTIC KOPM_OTAModeSts_flg_ovrdflg "VCU_D_Status_CHA" VALUE 0x0000 /* @ECU_Address@KOPM_OTAModeSts_flg_ovrdflg@ */ Scalar_BOOLEAN 0 AppSwcOpm_CM_boolean_flg 0.0 1.0 /end CHARACTERISTIC
/begin CHARACTERISTIC KOPM_OTAModeSts_flg_ovrdval "VCU_D_Status_CHA" VALUE 0x0000 /* @ECU_Address@KOPM_OTAModeSts_flg_ovrdval@ */ Scalar_BOOLEAN 0 AppSwcOpm_CM_boolean_flg 0.0 1.0 /end CHARACTERISTIC
/begin CHARACTERISTIC KOPM_PGrSwcSt_enum_ovrdflg "VCU_D_Status_CHA" VALUE 0x0000 /* @ECU_Address@KOPM_PGrSwcSt_enum_ovrdflg@ */ Scalar_BOOLEAN 0 AppSwcOpm_CM_boolean_flg 0.0 1.0 /end CHARACTERISTIC
/begin CHARACTERISTIC KOPM_PwrRecupActWhlTq_Nm_ovrdflg "VCU_10_Torque_CHA" VALUE 0x0000 /* @ECU_Address@KOPM_PwrRecupActWhlTq_Nm_ovrdflg@ */ Scalar_BOOLEAN 0 AppSwcOpm_CM_boolean_flg 0.0 1.0 /end CHARACTERISTIC
/begin CHARACTERISTIC KOPM_PwrRecupActlWhlTqSts_enum_ovrdflg "VCU_10_Torque_CHA" VALUE 0x0000 /* @ECU_Address@KOPM_PwrRecupActlWhlTqSts_enum_ovrdflg@ */ Scalar_BOOLEAN 0 AppSwcOpm_CM_boolean_flg 0.0 1.0 /end CHARACTERISTIC
/begin CHARACTERISTIC KOPM_PwrRecupMaxAvlbMotorTorqSta_enum_ovrdflg "VCU_D_Status_CHA" VALUE 0x0000 /* @ECU_Address@KOPM_PwrRecupMaxAvlbMotorTorqSta_enum_ovrdflg@ */ Scalar_BOOLEAN 0 AppSwcOpm_CM_boolean_flg 0.0 1.0 /end CHARACTERISTIC
/begin CHARACTERISTIC KOPM_PwrRecupMaxAvlbWhlTqSts_enum_ovrdflg "VCU_10_Torque_CHA" VALUE 0x0000 /* @ECU_Address@KOPM_PwrRecupMaxAvlbWhlTqSts_enum_ovrdflg@ */ Scalar_BOOLEAN 0 AppSwcOpm_CM_boolean_flg 0.0 1.0 /end CHARACTERISTIC
/begin CHARACTERISTIC KOPM_RsrvdPwr_kW_ovrdflg "VCU_DispInfo_BAC" VALUE 0x0000 /* @ECU_Address@KOPM_RsrvdPwr_kW_ovrdflg@ */ Scalar_BOOLEAN 0 AppSwcOpm_CM_boolean_flg 0.0 1.0 /end CHARACTERISTIC
/begin CHARACTERISTIC KOPM_SIBSBMSBatSOCAllow_flg_ovrdflg "VCU_DispInfo_BAC" VALUE 0x0000 /* @ECU_Address@KOPM_SIBSBMSBatSOCAllow_flg_ovrdflg@ */ Scalar_BOOLEAN 0 AppSwcOpm_CM_boolean_flg 0.0 1.0 /end CHARACTERISTIC
/begin CHARACTERISTIC KOPM_SIBSBMSBatSOCAllow_flg_ovrdval "VCU_DispInfo_BAC" VALUE 0x0000 /* @ECU_Address@KOPM_SIBSBMSBatSOCAllow_flg_ovrdval@ */ Scalar_BOOLEAN 0 AppSwcOpm_CM_boolean_flg 0.0 1.0 /end CHARACTERISTIC
/begin CHARACTERISTIC KOPM_SIBSChgNumAllow_flg_ovrdflg "VCU_DispInfo_BAC" VALUE 0x0000 /* @ECU_Address@KOPM_SIBSChgNumAllow_flg_ovrdflg@ */ Scalar_BOOLEAN 0 AppSwcOpm_CM_boolean_flg 0.0 1.0 /end CHARACTERISTIC
/begin CHARACTERISTIC KOPM_SIBSChgNumAllow_flg_ovrdval "VCU_DispInfo_BAC" VALUE 0x0000 /* @ECU_Address@KOPM_SIBSChgNumAllow_flg_ovrdval@ */ Scalar_BOOLEAN 0 AppSwcOpm_CM_boolean_flg 0.0 1.0 /end CHARACTERISTIC
/begin CHARACTERISTIC KOPM_SIBSFbRTCWupFlg_flg_ovrdflg "VCU_DispInfo_BAC" VALUE 0x0000 /* @ECU_Address@KOPM_SIBSFbRTCWupFlg_flg_ovrdflg@ */ Scalar_BOOLEAN 0 AppSwcOpm_CM_boolean_flg 0.0 1.0 /end CHARACTERISTIC
/begin CHARACTERISTIC KOPM_SIBSFbRTCWupFlg_flg_ovrdval "VCU_DispInfo_BAC" VALUE 0x0000 /* @ECU_Address@KOPM_SIBSFbRTCWupFlg_flg_ovrdval@ */ Scalar_BOOLEAN 0 AppSwcOpm_CM_boolean_flg 0.0 1.0 /end CHARACTERISTIC
/begin CHARACTERISTIC KOPM_SIBSKL30Volt_V_ovrdflg "VCU_DispInfo_BAC" VALUE 0x0000 /* @ECU_Address@KOPM_SIBSKL30Volt_V_ovrdflg@ */ Scalar_BOOLEAN 0 AppSwcOpm_CM_boolean_flg 0.0 1.0 /end CHARACTERISTIC
/begin CHARACTERISTIC KOPM_SIBSRTCChrgSt_enum_ovrdflg "VCU_DispInfo_BAC" VALUE 0x0000 /* @ECU_Address@KOPM_SIBSRTCChrgSt_enum_ovrdflg@ */ Scalar_BOOLEAN 0 AppSwcOpm_CM_boolean_flg 0.0 1.0 /end CHARACTERISTIC
/begin CHARACTERISTIC KOPM_SIBSRTCWUChgFailNum_cnt_ovrdflg "VCU_DispInfo_BAC" VALUE 0x0000 /* @ECU_Address@KOPM_SIBSRTCWUChgFailNum_cnt_ovrdflg@ */ Scalar_BOOLEAN 0 AppSwcOpm_CM_boolean_flg 0.0 1.0 /end CHARACTERISTIC
/begin CHARACTERISTIC KOPM_SIBSRTCWUChgNum_cnt_ovrdflg "VCU_DispInfo_BAC" VALUE 0x0000 /* @ECU_Address@KOPM_SIBSRTCWUChgNum_cnt_ovrdflg@ */ Scalar_BOOLEAN 0 AppSwcOpm_CM_boolean_flg 0.0 1.0 /end CHARACTERISTIC
/begin CHARACTERISTIC KOPM_SIBSWupVoltAllow_flg_ovrdflg "VCU_DispInfo_BAC" VALUE 0x0000 /* @ECU_Address@KOPM_SIBSWupVoltAllow_flg_ovrdflg@ */ Scalar_BOOLEAN 0 AppSwcOpm_CM_boolean_flg 0.0 1.0 /end CHARACTERISTIC
/begin CHARACTERISTIC KOPM_SIBSWupVoltAllow_flg_ovrdval "VCU_DispInfo_BAC" VALUE 0x0000 /* @ECU_Address@KOPM_SIBSWupVoltAllow_flg_ovrdval@ */ Scalar_BOOLEAN 0 AppSwcOpm_CM_boolean_flg 0.0 1.0 /end CHARACTERISTIC
/begin CHARACTERISTIC KOPM_ShftKeyStgntn_enum_ovrdflg "VCU_DispInfo_BAC" VALUE 0x0000 /* @ECU_Address@KOPM_ShftKeyStgntn_enum_ovrdflg@ */ Scalar_BOOLEAN 0 AppSwcOpm_CM_boolean_flg 0.0 1.0 /end CHARACTERISTIC
/begin CHARACTERISTIC KOPM_StrgRecupReqBrkLampOn_flg_ovrdflg "VCU_D_Status_CHA" VALUE 0x0000 /* @ECU_Address@KOPM_StrgRecupReqBrkLampOn_flg_ovrdflg@ */ Scalar_BOOLEAN 0 AppSwcOpm_CM_boolean_flg 0.0 1.0 /end CHARACTERISTIC
/begin CHARACTERISTIC KOPM_StrgRecupReqBrkLampOn_flg_ovrdval "VCU_D_Status_CHA" VALUE 0x0000 /* @ECU_Address@KOPM_StrgRecupReqBrkLampOn_flg_ovrdval@ */ Scalar_BOOLEAN 0 AppSwcOpm_CM_boolean_flg 0.0 1.0 /end CHARACTERISTIC
/begin CHARACTERISTIC KOPM_SysFailSta_enum_ovrdflg "VCU_B_AcclPedal_EPT" VALUE 0x0000 /* @ECU_Address@KOPM_SysFailSta_enum_ovrdflg@ */ Scalar_BOOLEAN 0 AppSwcOpm_CM_boolean_flg 0.0 1.0 /end CHARACTERISTIC
/begin CHARACTERISTIC KOPM_VCUACCStandstillReq_flg_ovrdflg "VCU_D_Status_CHA" VALUE 0x0000 /* @ECU_Address@KOPM_VCUACCStandstillReq_flg_ovrdflg@ */ Scalar_BOOLEAN 0 AppSwcOpm_CM_boolean_flg 0.0 1.0 /end CHARACTERISTIC
/begin CHARACTERISTIC KOPM_VCUACCStandstillReq_flg_ovrdval "VCU_D_Status_CHA" VALUE 0x0000 /* @ECU_Address@KOPM_VCUACCStandstillReq_flg_ovrdval@ */ Scalar_BOOLEAN 0 AppSwcOpm_CM_boolean_flg 0.0 1.0 /end CHARACTERISTIC
/begin CHARACTERISTIC KOPM_VCUACCStat_enum_ovrdflg "VCU_D_Status_CHA" VALUE 0x0000 /* @ECU_Address@KOPM_VCUACCStat_enum_ovrdflg@ */ Scalar_BOOLEAN 0 AppSwcOpm_CM_boolean_flg 0.0 1.0 /end CHARACTERISTIC
/begin CHARACTERISTIC KOPM_VCUAccReqDrvOff_flg_ovrdflg "VCU_10_Torque_CHA" VALUE 0x0000 /* @ECU_Address@KOPM_VCUAccReqDrvOff_flg_ovrdflg@ */ Scalar_BOOLEAN 0 AppSwcOpm_CM_boolean_flg 0.0 1.0 /end CHARACTERISTIC
/begin CHARACTERISTIC KOPM_VCUAccReqDrvOff_flg_ovrdval "VCU_10_Torque_CHA" VALUE 0x0000 /* @ECU_Address@KOPM_VCUAccReqDrvOff_flg_ovrdval@ */ Scalar_BOOLEAN 0 AppSwcOpm_CM_boolean_flg 0.0 1.0 /end CHARACTERISTIC
/begin CHARACTERISTIC KOPM_VCUAccReqStandstill_flg_ovrdflg "VCU_10_Torque_CHA" VALUE 0x0000 /* @ECU_Address@KOPM_VCUAccReqStandstill_flg_ovrdflg@ */ Scalar_BOOLEAN 0 AppSwcOpm_CM_boolean_flg 0.0 1.0 /end CHARACTERISTIC
/begin CHARACTERISTIC KOPM_VCUAccReqStandstill_flg_ovrdval "VCU_10_Torque_CHA" VALUE 0x0000 /* @ECU_Address@KOPM_VCUAccReqStandstill_flg_ovrdval@ */ Scalar_BOOLEAN 0 AppSwcOpm_CM_boolean_flg 0.0 1.0 /end CHARACTERISTIC
/begin CHARACTERISTIC KOPM_VCUAccTgtAxReq_flg_ovrdflg "VCU_D_Status_CHA" VALUE 0x0000 /* @ECU_Address@KOPM_VCUAccTgtAxReq_flg_ovrdflg@ */ Scalar_BOOLEAN 0 AppSwcOpm_CM_boolean_flg 0.0 1.0 /end CHARACTERISTIC
/begin CHARACTERISTIC KOPM_VCUAccTgtAxReq_flg_ovrdval "VCU_D_Status_CHA" VALUE 0x0000 /* @ECU_Address@KOPM_VCUAccTgtAxReq_flg_ovrdval@ */ Scalar_BOOLEAN 0 AppSwcOpm_CM_boolean_flg 0.0 1.0 /end CHARACTERISTIC
/begin CHARACTERISTIC KOPM_VCUAccTgtAx_mps2_ovrdflg "VCU_D_Status_CHA" VALUE 0x0000 /* @ECU_Address@KOPM_VCUAccTgtAx_mps2_ovrdflg@ */ Scalar_BOOLEAN 0 AppSwcOpm_CM_boolean_flg 0.0 1.0 /end CHARACTERISTIC
/begin CHARACTERISTIC KOPM_VCUBraTorReq_Nm_ovrdflg "VCU_D_Status_CHA" VALUE 0x0000 /* @ECU_Address@KOPM_VCUBraTorReq_Nm_ovrdflg@ */ Scalar_BOOLEAN 0 AppSwcOpm_CM_boolean_flg 0.0 1.0 /end CHARACTERISTIC
/begin CHARACTERISTIC KOPM_VCUCruiseCtrTgtSpd_kph_ovrdflg "VCU_D_Status_CHA" VALUE 0x0000 /* @ECU_Address@KOPM_VCUCruiseCtrTgtSpd_kph_ovrdflg@ */ Scalar_BOOLEAN 0 AppSwcOpm_CM_boolean_flg 0.0 1.0 /end CHARACTERISTIC
/begin CHARACTERISTIC KOPM_VCUCruiseCtrlSta_enum_ovrdflg "VCU_D_Status_CHA" VALUE 0x0000 /* @ECU_Address@KOPM_VCUCruiseCtrlSta_enum_ovrdflg@ */ Scalar_BOOLEAN 0 AppSwcOpm_CM_boolean_flg 0.0 1.0 /end CHARACTERISTIC
/begin CHARACTERISTIC KOPM_VCUEPBApplyForbid_enum_ovrdflg "VCU_D_Status_CHA" VALUE 0x0000 /* @ECU_Address@KOPM_VCUEPBApplyForbid_enum_ovrdflg@ */ Scalar_BOOLEAN 0 AppSwcOpm_CM_boolean_flg 0.0 1.0 /end CHARACTERISTIC
/begin CHARACTERISTIC KOPM_VCUEnaEHBBrkRun_flg_ovrdflg "VCU_10_Torque_CHA" VALUE 0x0000 /* @ECU_Address@KOPM_VCUEnaEHBBrkRun_flg_ovrdflg@ */ Scalar_BOOLEAN 0 AppSwcOpm_CM_boolean_flg 0.0 1.0 /end CHARACTERISTIC
/begin CHARACTERISTIC KOPM_VCUEnaEHBBrkRun_flg_ovrdval "VCU_10_Torque_CHA" VALUE 0x0000 /* @ECU_Address@KOPM_VCUEnaEHBBrkRun_flg_ovrdval@ */ Scalar_BOOLEAN 0 AppSwcOpm_CM_boolean_flg 0.0 1.0 /end CHARACTERISTIC
/begin CHARACTERISTIC KOPM_VCUMasterCylinderPreReq_Bar_ovrdflg "VCU_10_Torque_CHA" VALUE 0x0000 /* @ECU_Address@KOPM_VCUMasterCylinderPreReq_Bar_ovrdflg@ */ Scalar_BOOLEAN 0 AppSwcOpm_CM_boolean_flg 0.0 1.0 /end CHARACTERISTIC
/begin CHARACTERISTIC KOPM_VCUMotTorqueReqToEHB_Nm_ovrdflg "VCU_10_Torque_CHA" VALUE 0x0000 /* @ECU_Address@KOPM_VCUMotTorqueReqToEHB_Nm_ovrdflg@ */ Scalar_BOOLEAN 0 AppSwcOpm_CM_boolean_flg 0.0 1.0 /end CHARACTERISTIC
/begin CHARACTERISTIC KOPM_VCUOprtLicFb_flg_ovrdflg "VCU_DispInfo_BAC" VALUE 0x0000 /* @ECU_Address@KOPM_VCUOprtLicFb_flg_ovrdflg@ */ Scalar_BOOLEAN 0 AppSwcOpm_CM_boolean_flg 0.0 1.0 /end CHARACTERISTIC
/begin CHARACTERISTIC KOPM_VCUOprtLicFb_flg_ovrdval "VCU_DispInfo_BAC" VALUE 0x0000 /* @ECU_Address@KOPM_VCUOprtLicFb_flg_ovrdval@ */ Scalar_BOOLEAN 0 AppSwcOpm_CM_boolean_flg 0.0 1.0 /end CHARACTERISTIC
/begin CHARACTERISTIC KOPM_VCUParkSwStaVld_flg_ovrdflg "VCU_D_Status_CHA" VALUE 0x0000 /* @ECU_Address@KOPM_VCUParkSwStaVld_flg_ovrdflg@ */ Scalar_BOOLEAN 0 AppSwcOpm_CM_boolean_flg 0.0 1.0 /end CHARACTERISTIC
/begin CHARACTERISTIC KOPM_VCUParkSwStaVld_flg_ovrdval "VCU_D_Status_CHA" VALUE 0x0000 /* @ECU_Address@KOPM_VCUParkSwStaVld_flg_ovrdval@ */ Scalar_BOOLEAN 0 AppSwcOpm_CM_boolean_flg 0.0 1.0 /end CHARACTERISTIC
/begin CHARACTERISTIC KOPM_VCUParkSwSta_flg_ovrdflg "VCU_D_Status_CHA" VALUE 0x0000 /* @ECU_Address@KOPM_VCUParkSwSta_flg_ovrdflg@ */ Scalar_BOOLEAN 0 AppSwcOpm_CM_boolean_flg 0.0 1.0 /end CHARACTERISTIC
/begin CHARACTERISTIC KOPM_VCUParkSwSta_flg_ovrdval "VCU_D_Status_CHA" VALUE 0x0000 /* @ECU_Address@KOPM_VCUParkSwSta_flg_ovrdval@ */ Scalar_BOOLEAN 0 AppSwcOpm_CM_boolean_flg 0.0 1.0 /end CHARACTERISTIC
/begin CHARACTERISTIC KOPM_VCUPreKeReq_flg_ovrdflg "VCU_D_Status_CHA" VALUE 0x0000 /* @ECU_Address@KOPM_VCUPreKeReq_flg_ovrdflg@ */ Scalar_BOOLEAN 0 AppSwcOpm_CM_boolean_flg 0.0 1.0 /end CHARACTERISTIC
/begin CHARACTERISTIC KOPM_VCUPreKeReq_flg_ovrdval "VCU_D_Status_CHA" VALUE 0x0000 /* @ECU_Address@KOPM_VCUPreKeReq_flg_ovrdval@ */ Scalar_BOOLEAN 0 AppSwcOpm_CM_boolean_flg 0.0 1.0 /end CHARACTERISTIC
/begin CHARACTERISTIC KOPM_VCUReqAutoBrk_enum_ovrdflg "VCU_D_Status_CHA" VALUE 0x0000 /* @ECU_Address@KOPM_VCUReqAutoBrk_enum_ovrdflg@ */ Scalar_BOOLEAN 0 AppSwcOpm_CM_boolean_flg 0.0 1.0 /end CHARACTERISTIC
/begin CHARACTERISTIC KOPM_VCUReqEPBVld_flg_ovrdflg "VCU_D_Status_CHA" VALUE 0x0000 /* @ECU_Address@KOPM_VCUReqEPBVld_flg_ovrdflg@ */ Scalar_BOOLEAN 0 AppSwcOpm_CM_boolean_flg 0.0 1.0 /end CHARACTERISTIC
/begin CHARACTERISTIC KOPM_VCUReqEPBVld_flg_ovrdval "VCU_D_Status_CHA" VALUE 0x0000 /* @ECU_Address@KOPM_VCUReqEPBVld_flg_ovrdval@ */ Scalar_BOOLEAN 0 AppSwcOpm_CM_boolean_flg 0.0 1.0 /end CHARACTERISTIC
/begin CHARACTERISTIC KOPM_VCUReqEPB_enum_ovrdflg "VCU_D_Status_CHA" VALUE 0x0000 /* @ECU_Address@KOPM_VCUReqEPB_enum_ovrdflg@ */ Scalar_BOOLEAN 0 AppSwcOpm_CM_boolean_flg 0.0 1.0 /end CHARACTERISTIC
/begin CHARACTERISTIC KOPM_VCUSpdLimLvlFb_enum_ovrdflg "VCU_DispInfo_BAC" VALUE 0x0000 /* @ECU_Address@KOPM_VCUSpdLimLvlFb_enum_ovrdflg@ */ Scalar_BOOLEAN 0 AppSwcOpm_CM_boolean_flg 0.0 1.0 /end CHARACTERISTIC
/begin CHARACTERISTIC KOPM_VCUSpdLimLvlSetFb_enum_ovrdflg "VCU_DispInfo_BAC" VALUE 0x0000 /* @ECU_Address@KOPM_VCUSpdLimLvlSetFb_enum_ovrdflg@ */ Scalar_BOOLEAN 0 AppSwcOpm_CM_boolean_flg 0.0 1.0 /end CHARACTERISTIC
/begin CHARACTERISTIC KOPM_VCUVehSpdFastWarn_flg_ovrdflg "VCU_10_Torque_CHA" VALUE 0x0000 /* @ECU_Address@KOPM_VCUVehSpdFastWarn_flg_ovrdflg@ */ Scalar_BOOLEAN 0 AppSwcOpm_CM_boolean_flg 0.0 1.0 /end CHARACTERISTIC
/begin CHARACTERISTIC KOPM_VCUVehSpdFastWarn_flg_ovrdval "VCU_10_Torque_CHA" VALUE 0x0000 /* @ECU_Address@KOPM_VCUVehSpdFastWarn_flg_ovrdval@ */ Scalar_BOOLEAN 0 AppSwcOpm_CM_boolean_flg 0.0 1.0 /end CHARACTERISTIC
/begin CHARACTERISTIC KOPM_VCUVerFb_flg_ovrdflg "VCU_DispInfo_BAC" VALUE 0x0000 /* @ECU_Address@KOPM_VCUVerFb_flg_ovrdflg@ */ Scalar_BOOLEAN 0 AppSwcOpm_CM_boolean_flg 0.0 1.0 /end CHARACTERISTIC
/begin CHARACTERISTIC KOPM_VCUVerFb_flg_ovrdval "VCU_DispInfo_BAC" VALUE 0x0000 /* @ECU_Address@KOPM_VCUVerFb_flg_ovrdval@ */ Scalar_BOOLEAN 0 AppSwcOpm_CM_boolean_flg 0.0 1.0 /end CHARACTERISTIC
/begin CHARACTERISTIC KOPM_VCUVerSetFb_enum_ovrdflg "VCU_DispInfo_BAC" VALUE 0x0000 /* @ECU_Address@KOPM_VCUVerSetFb_enum_ovrdflg@ */ Scalar_BOOLEAN 0 AppSwcOpm_CM_boolean_flg 0.0 1.0 /end CHARACTERISTIC
/begin CHARACTERISTIC KOPM_VehActDrvPwr_pct_ovrdflg "VCU_DispInfo_BAC" VALUE 0x0000 /* @ECU_Address@KOPM_VehActDrvPwr_pct_ovrdflg@ */ Scalar_BOOLEAN 0 AppSwcOpm_CM_boolean_flg 0.0 1.0 /end CHARACTERISTIC
/begin CHARACTERISTIC KOPM_VehActRecupPwr_pct_ovrdflg "VCU_DispInfo_BAC" VALUE 0x0000 /* @ECU_Address@KOPM_VehActRecupPwr_pct_ovrdflg@ */ Scalar_BOOLEAN 0 AppSwcOpm_CM_boolean_flg 0.0 1.0 /end CHARACTERISTIC
/begin CHARACTERISTIC KOPM_VehPGearError_flg_ovrdflg "VCU_DispInfo_BAC" VALUE 0x0000 /* @ECU_Address@KOPM_VehPGearError_flg_ovrdflg@ */ Scalar_BOOLEAN 0 AppSwcOpm_CM_boolean_flg 0.0 1.0 /end CHARACTERISTIC
/begin CHARACTERISTIC KOPM_VehPGearError_flg_ovrdval "VCU_DispInfo_BAC" VALUE 0x0000 /* @ECU_Address@KOPM_VehPGearError_flg_ovrdval@ */ Scalar_BOOLEAN 0 AppSwcOpm_CM_boolean_flg 0.0 1.0 /end CHARACTERISTIC
/begin CHARACTERISTIC KOPM_VehPwrCnsmpAvrg_kWh_ovrdflg "VCU_DispInfo_BAC" VALUE 0x0000 /* @ECU_Address@KOPM_VehPwrCnsmpAvrg_kWh_ovrdflg@ */ Scalar_BOOLEAN 0 AppSwcOpm_CM_boolean_flg 0.0 1.0 /end CHARACTERISTIC
/begin CHARACTERISTIC KOPM_VehTrgtGearPos_enum_ovrdflg "VCU_1_InvCmd_EPT" VALUE 0x0000 /* @ECU_Address@KOPM_VehTrgtGearPos_enum_ovrdflg@ */ Scalar_BOOLEAN 0 AppSwcOpm_CM_boolean_flg 0.0 1.0 /end CHARACTERISTIC
/begin CHARACTERISTIC KOPM_VhclActlCnsmPwr_kWh_ovrdflg "VCU_DispInfo_BAC" VALUE 0x0000 /* @ECU_Address@KOPM_VhclActlCnsmPwr_kWh_ovrdflg@ */ Scalar_BOOLEAN 0 AppSwcOpm_CM_boolean_flg 0.0 1.0 /end CHARACTERISTIC
/begin CHARACTERISTIC KOPM_VhclSpdFstWarn_flg_ovrdflg "VCU_DispInfo_BAC" VALUE 0x0000 /* @ECU_Address@KOPM_VhclSpdFstWarn_flg_ovrdflg@ */ Scalar_BOOLEAN 0 AppSwcOpm_CM_boolean_flg 0.0 1.0 /end CHARACTERISTIC
/begin CHARACTERISTIC KOPM_VhclSpdFstWarn_flg_ovrdval "VCU_DispInfo_BAC" VALUE 0x0000 /* @ECU_Address@KOPM_VhclSpdFstWarn_flg_ovrdval@ */ Scalar_BOOLEAN 0 AppSwcOpm_CM_boolean_flg 0.0 1.0 /end CHARACTERISTIC
/begin CHARACTERISTIC KOPM_WLTPDrvgRngDstVld_flg_ovrdflg "VCU_DispInfo_BAC" VALUE 0x0000 /* @ECU_Address@KOPM_WLTPDrvgRngDstVld_flg_ovrdflg@ */ Scalar_BOOLEAN 0 AppSwcOpm_CM_boolean_flg 0.0 1.0 /end CHARACTERISTIC
/begin CHARACTERISTIC KOPM_WLTPDrvgRngDstVld_flg_ovrdval "VCU_DispInfo_BAC" VALUE 0x0000 /* @ECU_Address@KOPM_WLTPDrvgRngDstVld_flg_ovrdval@ */ Scalar_BOOLEAN 0 AppSwcOpm_CM_boolean_flg 0.0 1.0 /end CHARACTERISTIC
/begin CHARACTERISTIC KOPM_WLTPDrvgRngDst_km_ovrdflg "VCU_DispInfo_BAC" VALUE 0x0000 /* @ECU_Address@KOPM_WLTPDrvgRngDst_km_ovrdflg@ */ Scalar_BOOLEAN 0 AppSwcOpm_CM_boolean_flg 0.0 1.0 /end CHARACTERISTIC
/begin CHARACTERISTIC KOPM_WghConfdence_flg_ovrdflg "VCU_DispInfo_BAC" VALUE 0x0000 /* @ECU_Address@KOPM_WghConfdence_flg_ovrdflg@ */ Scalar_BOOLEAN 0 AppSwcOpm_CM_boolean_flg 0.0 1.0 /end CHARACTERISTIC
/begin CHARACTERISTIC KOPM_WghConfdence_flg_ovrdval "VCU_DispInfo_BAC" VALUE 0x0000 /* @ECU_Address@KOPM_WghConfdence_flg_ovrdval@ */ Scalar_BOOLEAN 0 AppSwcOpm_CM_boolean_flg 0.0 1.0 /end CHARACTERISTIC
/begin CHARACTERISTIC KOPM_WghDistb_enum_ovrdflg "VCU_DispInfo_BAC" VALUE 0x0000 /* @ECU_Address@KOPM_WghDistb_enum_ovrdflg@ */ Scalar_BOOLEAN 0 AppSwcOpm_CM_boolean_flg 0.0 1.0 /end CHARACTERISTIC
/begin CHARACTERISTIC KOPM_WghEst_kg_ovrdflg "VCU_DispInfo_BAC" VALUE 0x0000 /* @ECU_Address@KOPM_WghEst_kg_ovrdflg@ */ Scalar_BOOLEAN 0 AppSwcOpm_CM_boolean_flg 0.0 1.0 /end CHARACTERISTIC
/begin CHARACTERISTIC KOPM_Zdznswi_flg_ovrdflg "VCU_0_Value_EPT" VALUE 0x0000 /* @ECU_Address@KOPM_Zdznswi_flg_ovrdflg@ */ Scalar_BOOLEAN 0 AppSwcOpm_CM_boolean_flg 0.0 1.0 /end CHARACTERISTIC
/begin CHARACTERISTIC KOPM_Zdznswi_flg_ovrdval "VCU_0_Value_EPT" VALUE 0x0000 /* @ECU_Address@KOPM_Zdznswi_flg_ovrdval@ */ Scalar_BOOLEAN 0 AppSwcOpm_CM_boolean_flg 0.0 1.0 /end CHARACTERISTIC
/begin CHARACTERISTIC KOPM_12VBatLowVolStaHi_enum "CCU_VehInfo_BAC" VALUE 0x0000 /* @ECU_Address@KOPM_12VBatLowVolStaHi_enum@ */ Scalar_UBYTE 0 AppSwcOpm_CM_uint8_enum 0.0 255.0 /end CHARACTERISTIC
/begin CHARACTERISTIC KOPM_12VBatLowVolStaLo_enum "CCU_VehInfo_BAC" VALUE 0x0000 /* @ECU_Address@KOPM_12VBatLowVolStaLo_enum@ */ Scalar_UBYTE 0 AppSwcOpm_CM_uint8_enum 0.0 255.0 /end CHARACTERISTIC
/begin CHARACTERISTIC KOPM_12VBatLowVolSta_enum_ovrdval "CCU_VehInfo_BAC" VALUE 0x0000 /* @ECU_Address@KOPM_12VBatLowVolSta_enum_ovrdval@ */ Scalar_UBYTE 0 AppSwcOpm_CM_uint8_enum 0.0 255.0 /end CHARACTERISTIC
/begin CHARACTERISTIC KOPM_ACChrgMaxCurrHi_A "VCU_DispInfo_BAC" VALUE 0x0000 /* @ECU_Address@KOPM_ACChrgMaxCurrHi_A@ */ Scalar_UBYTE 0 AppSwcOpm_CM_uint8_A 0.0 255.0 /end CHARACTERISTIC
/begin CHARACTERISTIC KOPM_ACChrgMaxCurrLo_A "VCU_DispInfo_BAC" VALUE 0x0000 /* @ECU_Address@KOPM_ACChrgMaxCurrLo_A@ */ Scalar_UBYTE 0 AppSwcOpm_CM_uint8_A 0.0 255.0 /end CHARACTERISTIC
/begin CHARACTERISTIC KOPM_ACChrgMaxCurr_A_ovrdval "VCU_DispInfo_BAC" VALUE 0x0000 /* @ECU_Address@KOPM_ACChrgMaxCurr_A_ovrdval@ */ Scalar_UBYTE 0 AppSwcOpm_CM_uint8_A 0.0 255.0 /end CHARACTERISTIC
/begin CHARACTERISTIC KOPM_ACChrgModeHi_enum "VCU_DispInfo_BAC" VALUE 0x0000 /* @ECU_Address@KOPM_ACChrgModeHi_enum@ */ Scalar_UBYTE 0 AppSwcOpm_CM_uint8_enum 0.0 255.0 /end CHARACTERISTIC
/begin CHARACTERISTIC KOPM_ACChrgModeLo_enum "VCU_DispInfo_BAC" VALUE 0x0000 /* @ECU_Address@KOPM_ACChrgModeLo_enum@ */ Scalar_UBYTE 0 AppSwcOpm_CM_uint8_enum 0.0 255.0 /end CHARACTERISTIC
/begin CHARACTERISTIC KOPM_ACChrgMode_enum_ovrdval "VCU_DispInfo_BAC" VALUE 0x0000 /* @ECU_Address@KOPM_ACChrgMode_enum_ovrdval@ */ Scalar_UBYTE 0 AppSwcOpm_CM_uint8_enum 0.0 255.0 /end CHARACTERISTIC
/begin CHARACTERISTIC KOPM_ACRemtCtrlFbHi_enum "VCU_DispInfo_BAC" VALUE 0x0000 /* @ECU_Address@KOPM_ACRemtCtrlFbHi_enum@ */ Scalar_UBYTE 0 AppSwcOpm_CM_uint8_enum 0.0 255.0 /end CHARACTERISTIC
/begin CHARACTERISTIC KOPM_ACRemtCtrlFbLo_enum "VCU_DispInfo_BAC" VALUE 0x0000 /* @ECU_Address@KOPM_ACRemtCtrlFbLo_enum@ */ Scalar_UBYTE 0 AppSwcOpm_CM_uint8_enum 0.0 255.0 /end CHARACTERISTIC
/begin CHARACTERISTIC KOPM_ACRemtCtrlFb_enum_ovrdval "VCU_DispInfo_BAC" VALUE 0x0000 /* @ECU_Address@KOPM_ACRemtCtrlFb_enum_ovrdval@ */ Scalar_UBYTE 0 AppSwcOpm_CM_uint8_enum 0.0 255.0 /end CHARACTERISTIC
/begin CHARACTERISTIC KOPM_ACRmtDefrstCtlFbHi_enum "VCU_DispInfo_BAC" VALUE 0x0000 /* @ECU_Address@KOPM_ACRmtDefrstCtlFbHi_enum@ */ Scalar_UBYTE 0 AppSwcOpm_CM_uint8_enum 0.0 255.0 /end CHARACTERISTIC
/begin CHARACTERISTIC KOPM_ACRmtDefrstCtlFbLo_enum "VCU_DispInfo_BAC" VALUE 0x0000 /* @ECU_Address@KOPM_ACRmtDefrstCtlFbLo_enum@ */ Scalar_UBYTE 0 AppSwcOpm_CM_uint8_enum 0.0 255.0 /end CHARACTERISTIC
/begin CHARACTERISTIC KOPM_ACRmtDefrstCtlFb_enum_ovrdval "VCU_DispInfo_BAC" VALUE 0x0000 /* @ECU_Address@KOPM_ACRmtDefrstCtlFb_enum_ovrdval@ */ Scalar_UBYTE 0 AppSwcOpm_CM_uint8_enum 0.0 255.0 /end CHARACTERISTIC
/begin CHARACTERISTIC KOPM_ACTempSetFbHi_enum "VCU_DispInfo_BAC" VALUE 0x0000 /* @ECU_Address@KOPM_ACTempSetFbHi_enum@ */ Scalar_UBYTE 0 AppSwcOpm_CM_uint8_enum 0.0 255.0 /end CHARACTERISTIC
/begin CHARACTERISTIC KOPM_ACTempSetFbLo_enum "VCU_DispInfo_BAC" VALUE 0x0000 /* @ECU_Address@KOPM_ACTempSetFbLo_enum@ */ Scalar_UBYTE 0 AppSwcOpm_CM_uint8_enum 0.0 255.0 /end CHARACTERISTIC
/begin CHARACTERISTIC KOPM_ACTempSetFb_enum_ovrdval "VCU_DispInfo_BAC" VALUE 0x0000 /* @ECU_Address@KOPM_ACTempSetFb_enum_ovrdval@ */ Scalar_UBYTE 0 AppSwcOpm_CM_uint8_enum 0.0 255.0 /end CHARACTERISTIC
/begin CHARACTERISTIC KOPM_ACUnlckVentSetFBHi_enum "VCU_DispInfo_BAC" VALUE 0x0000 /* @ECU_Address@KOPM_ACUnlckVentSetFBHi_enum@ */ Scalar_UBYTE 0 AppSwcOpm_CM_uint8_enum 0.0 255.0 /end CHARACTERISTIC
/begin CHARACTERISTIC KOPM_ACUnlckVentSetFBLo_enum "VCU_DispInfo_BAC" VALUE 0x0000 /* @ECU_Address@KOPM_ACUnlckVentSetFBLo_enum@ */ Scalar_UBYTE 0 AppSwcOpm_CM_uint8_enum 0.0 255.0 /end CHARACTERISTIC
/begin CHARACTERISTIC KOPM_ACUnlckVentSetFB_enum_ovrdval "VCU_DispInfo_BAC" VALUE 0x0000 /* @ECU_Address@KOPM_ACUnlckVentSetFB_enum_ovrdval@ */ Scalar_UBYTE 0 AppSwcOpm_CM_uint8_enum 0.0 255.0 /end CHARACTERISTIC
/begin CHARACTERISTIC KOPM_AccPedPosSnsrStaHi_enum "VCU_D_Status_CHA" VALUE 0x0000 /* @ECU_Address@KOPM_AccPedPosSnsrStaHi_enum@ */ Scalar_UBYTE 0 AppSwcOpm_CM_uint8_enum 0.0 255.0 /end CHARACTERISTIC
/begin CHARACTERISTIC KOPM_AccPedPosSnsrStaLo_enum "VCU_D_Status_CHA" VALUE 0x0000 /* @ECU_Address@KOPM_AccPedPosSnsrStaLo_enum@ */ Scalar_UBYTE 0 AppSwcOpm_CM_uint8_enum 0.0 255.0 /end CHARACTERISTIC
/begin CHARACTERISTIC KOPM_AccPedPosToESCStaHi_enum "VCU_D_Status_CHA" VALUE 0x0000 /* @ECU_Address@KOPM_AccPedPosToESCStaHi_enum@ */ Scalar_UBYTE 0 AppSwcOpm_CM_uint8_enum 0.0 255.0 /end CHARACTERISTIC
/begin CHARACTERISTIC KOPM_AccPedPosToESCStaLo_enum "VCU_D_Status_CHA" VALUE 0x0000 /* @ECU_Address@KOPM_AccPedPosToESCStaLo_enum@ */ Scalar_UBYTE 0 AppSwcOpm_CM_uint8_enum 0.0 255.0 /end CHARACTERISTIC
/begin CHARACTERISTIC KOPM_AccPedPosToESCSta_enum_ovrdval "VCU_D_Status_CHA" VALUE 0x0000 /* @ECU_Address@KOPM_AccPedPosToESCSta_enum_ovrdval@ */ Scalar_UBYTE 0 AppSwcOpm_CM_uint8_enum 0.0 255.0 /end CHARACTERISTIC
/begin CHARACTERISTIC KOPM_AppSoftNumbHi_nu "VCU_0_Value_EPT" VALUE 0x0000 /* @ECU_Address@KOPM_AppSoftNumbHi_nu@ */ Scalar_UBYTE 0 AppSwcOpm_CM_uint8_nu 0.0 255.0 /end CHARACTERISTIC
/begin CHARACTERISTIC KOPM_AppSoftNumbLo_nu "VCU_0_Value_EPT" VALUE 0x0000 /* @ECU_Address@KOPM_AppSoftNumbLo_nu@ */ Scalar_UBYTE 0 AppSwcOpm_CM_uint8_nu 0.0 255.0 /end CHARACTERISTIC
/begin CHARACTERISTIC KOPM_AppSoftNumb_nu_ovrdval "VCU_0_Value_EPT" VALUE 0x0000 /* @ECU_Address@KOPM_AppSoftNumb_nu_ovrdval@ */ Scalar_UBYTE 0 AppSwcOpm_CM_uint8_nu 0.0 255.0 /end CHARACTERISTIC
/begin CHARACTERISTIC KOPM_BMSShutdownHi_enum "VCU_4_ChrgCmd_EPT" VALUE 0x0000 /* @ECU_Address@KOPM_BMSShutdownHi_enum@ */ Scalar_UBYTE 0 AppSwcOpm_CM_uint8_enum 0.0 255.0 /end CHARACTERISTIC
/begin CHARACTERISTIC KOPM_BMSShutdownLo_enum "VCU_4_ChrgCmd_EPT" VALUE 0x0000 /* @ECU_Address@KOPM_BMSShutdownLo_enum@ */ Scalar_UBYTE 0 AppSwcOpm_CM_uint8_enum 0.0 255.0 /end CHARACTERISTIC
/begin CHARACTERISTIC KOPM_BMSWakeupModeHi_enum "VCU_3_OprtCmd_EPT" VALUE 0x0000 /* @ECU_Address@KOPM_BMSWakeupModeHi_enum@ */ Scalar_UBYTE 0 AppSwcOpm_CM_uint8_enum 0.0 255.0 /end CHARACTERISTIC
/begin CHARACTERISTIC KOPM_BMSWakeupModeLo_enum "VCU_3_OprtCmd_EPT" VALUE 0x0000 /* @ECU_Address@KOPM_BMSWakeupModeLo_enum@ */ Scalar_UBYTE 0 AppSwcOpm_CM_uint8_enum 0.0 255.0 /end CHARACTERISTIC
/begin CHARACTERISTIC KOPM_BrkPedSnsrPosVRsrvdHi_enum "VCU_D_Status_CHA" VALUE 0x0000 /* @ECU_Address@KOPM_BrkPedSnsrPosVRsrvdHi_enum@ */ Scalar_UBYTE 0 AppSwcOpm_CM_uint8_enum 0.0 255.0 /end CHARACTERISTIC
/begin CHARACTERISTIC KOPM_BrkPedSnsrPosVRsrvdLo_enum "VCU_D_Status_CHA" VALUE 0x0000 /* @ECU_Address@KOPM_BrkPedSnsrPosVRsrvdLo_enum@ */ Scalar_UBYTE 0 AppSwcOpm_CM_uint8_enum 0.0 255.0 /end CHARACTERISTIC
/begin CHARACTERISTIC KOPM_BrkPedSnsrPosVRsrvd_enum_ovrdval "VCU_D_Status_CHA" VALUE 0x0000 /* @ECU_Address@KOPM_BrkPedSnsrPosVRsrvd_enum_ovrdval@ */ Scalar_UBYTE 0 AppSwcOpm_CM_uint8_enum 0.0 255.0 /end CHARACTERISTIC
/begin CHARACTERISTIC KOPM_CCKeyStgntnHi_enum "VCU_B_AcclPedal_EPT" VALUE 0x0000 /* @ECU_Address@KOPM_CCKeyStgntnHi_enum@ */ Scalar_UBYTE 0 AppSwcOpm_CM_uint8_enum 0.0 255.0 /end CHARACTERISTIC
/begin CHARACTERISTIC KOPM_CCKeyStgntnLo_enum "VCU_B_AcclPedal_EPT" VALUE 0x0000 /* @ECU_Address@KOPM_CCKeyStgntnLo_enum@ */ Scalar_UBYTE 0 AppSwcOpm_CM_uint8_enum 0.0 255.0 /end CHARACTERISTIC
/begin CHARACTERISTIC KOPM_CCKeyStgntn_enum_ovrdval "VCU_DispInfo_BAC" VALUE 0x0000 /* @ECU_Address@KOPM_CCKeyStgntn_enum_ovrdval@ */ Scalar_UBYTE 0 AppSwcOpm_CM_uint8_enum 0.0 255.0 /end CHARACTERISTIC
/begin CHARACTERISTIC KOPM_CCUOpenVentnFbHi_enum "VCU_DispInfo_BAC" VALUE 0x0000 /* @ECU_Address@KOPM_CCUOpenVentnFbHi_enum@ */ Scalar_UBYTE 0 AppSwcOpm_CM_uint8_enum 0.0 255.0 /end CHARACTERISTIC
/begin CHARACTERISTIC KOPM_CCUOpenVentnFbLo_enum "VCU_DispInfo_BAC" VALUE 0x0000 /* @ECU_Address@KOPM_CCUOpenVentnFbLo_enum@ */ Scalar_UBYTE 0 AppSwcOpm_CM_uint8_enum 0.0 255.0 /end CHARACTERISTIC
/begin CHARACTERISTIC KOPM_CCUOpenVentnFb_enum_ovrdval "VCU_DispInfo_BAC" VALUE 0x0000 /* @ECU_Address@KOPM_CCUOpenVentnFb_enum_ovrdval@ */ Scalar_UBYTE 0 AppSwcOpm_CM_uint8_enum 0.0 255.0 /end CHARACTERISTIC
/begin CHARACTERISTIC KOPM_CCURmtCarSearchFbHi_enum "VCU_DispInfo_BAC" VALUE 0x0000 /* @ECU_Address@KOPM_CCURmtCarSearchFbHi_enum@ */ Scalar_UBYTE 0 AppSwcOpm_CM_uint8_enum 0.0 255.0 /end CHARACTERISTIC
/begin CHARACTERISTIC KOPM_CCURmtCarSearchFbLo_enum "VCU_DispInfo_BAC" VALUE 0x0000 /* @ECU_Address@KOPM_CCURmtCarSearchFbLo_enum@ */ Scalar_UBYTE 0 AppSwcOpm_CM_uint8_enum 0.0 255.0 /end CHARACTERISTIC
/begin CHARACTERISTIC KOPM_CCURmtCarSearchFb_enum_ovrdval "VCU_DispInfo_BAC" VALUE 0x0000 /* @ECU_Address@KOPM_CCURmtCarSearchFb_enum_ovrdval@ */ Scalar_UBYTE 0 AppSwcOpm_CM_uint8_enum 0.0 255.0 /end CHARACTERISTIC
/begin CHARACTERISTIC KOPM_CCURmtLckFbHi_enum "VCU_DispInfo_BAC" VALUE 0x0000 /* @ECU_Address@KOPM_CCURmtLckFbHi_enum@ */ Scalar_UBYTE 0 AppSwcOpm_CM_uint8_enum 0.0 255.0 /end CHARACTERISTIC
/begin CHARACTERISTIC KOPM_CCURmtLckFbLo_enum "VCU_DispInfo_BAC" VALUE 0x0000 /* @ECU_Address@KOPM_CCURmtLckFbLo_enum@ */ Scalar_UBYTE 0 AppSwcOpm_CM_uint8_enum 0.0 255.0 /end CHARACTERISTIC
/begin CHARACTERISTIC KOPM_CCURmtLckFb_enum_ovrdval "VCU_DispInfo_BAC" VALUE 0x0000 /* @ECU_Address@KOPM_CCURmtLckFb_enum_ovrdval@ */ Scalar_UBYTE 0 AppSwcOpm_CM_uint8_enum 0.0 255.0 /end CHARACTERISTIC
/begin CHARACTERISTIC KOPM_CCURmtPwrLckFbHi_enum "VCU_DispInfo_BAC" VALUE 0x0000 /* @ECU_Address@KOPM_CCURmtPwrLckFbHi_enum@ */ Scalar_UBYTE 0 AppSwcOpm_CM_uint8_enum 0.0 255.0 /end CHARACTERISTIC
/begin CHARACTERISTIC KOPM_CCURmtPwrLckFbLo_enum "VCU_DispInfo_BAC" VALUE 0x0000 /* @ECU_Address@KOPM_CCURmtPwrLckFbLo_enum@ */ Scalar_UBYTE 0 AppSwcOpm_CM_uint8_enum 0.0 255.0 /end CHARACTERISTIC
/begin CHARACTERISTIC KOPM_CCURmtPwrLckFb_enum_ovrdval "VCU_DispInfo_BAC" VALUE 0x0000 /* @ECU_Address@KOPM_CCURmtPwrLckFb_enum_ovrdval@ */ Scalar_UBYTE 0 AppSwcOpm_CM_uint8_enum 0.0 255.0 /end CHARACTERISTIC
/begin CHARACTERISTIC KOPM_ChrgAllowCmdHi_enum "VCU_4_ChrgCmd_EPT" VALUE 0x0000 /* @ECU_Address@KOPM_ChrgAllowCmdHi_enum@ */ Scalar_UBYTE 0 AppSwcOpm_CM_uint8_enum 0.0 255.0 /end CHARACTERISTIC
/begin CHARACTERISTIC KOPM_ChrgAllowCmdLo_enum "VCU_4_ChrgCmd_EPT" VALUE 0x0000 /* @ECU_Address@KOPM_ChrgAllowCmdLo_enum@ */ Scalar_UBYTE 0 AppSwcOpm_CM_uint8_enum 0.0 255.0 /end CHARACTERISTIC
/begin CHARACTERISTIC KOPM_ChrgEnaACHi_enum "VCU_3_OprtCmd_EPT" VALUE 0x0000 /* @ECU_Address@KOPM_ChrgEnaACHi_enum@ */ Scalar_UBYTE 0 AppSwcOpm_CM_uint8_enum 0.0 255.0 /end CHARACTERISTIC
/begin CHARACTERISTIC KOPM_ChrgEnaACLo_enum "VCU_3_OprtCmd_EPT" VALUE 0x0000 /* @ECU_Address@KOPM_ChrgEnaACLo_enum@ */ Scalar_UBYTE 0 AppSwcOpm_CM_uint8_enum 0.0 255.0 /end CHARACTERISTIC
/begin CHARACTERISTIC KOPM_CruiseCtrlStaHi_enum "VCU_DispInfo_BAC" VALUE 0x0000 /* @ECU_Address@KOPM_CruiseCtrlStaHi_enum@ */ Scalar_UBYTE 0 AppSwcOpm_CM_uint8_enum 0.0 255.0 /end CHARACTERISTIC
/begin CHARACTERISTIC KOPM_CruiseCtrlStaLo_enum "VCU_DispInfo_BAC" VALUE 0x0000 /* @ECU_Address@KOPM_CruiseCtrlStaLo_enum@ */ Scalar_UBYTE 0 AppSwcOpm_CM_uint8_enum 0.0 255.0 /end CHARACTERISTIC
/begin CHARACTERISTIC KOPM_CruiseCtrlSta_enum_ovrdval "VCU_DispInfo_BAC" VALUE 0x0000 /* @ECU_Address@KOPM_CruiseCtrlSta_enum_ovrdval@ */ Scalar_UBYTE 0 AppSwcOpm_CM_uint8_enum 0.0 255.0 /end CHARACTERISTIC
/begin CHARACTERISTIC KOPM_DCCOprtCmdHi_enum "VCU_B_AcclPedal_EPT" VALUE 0x0000 /* @ECU_Address@KOPM_DCCOprtCmdHi_enum@ */ Scalar_UBYTE 0 AppSwcOpm_CM_uint8_enum 0.0 255.0 /end CHARACTERISTIC
/begin CHARACTERISTIC KOPM_DCCOprtCmdLo_enum "VCU_B_AcclPedal_EPT" VALUE 0x0000 /* @ECU_Address@KOPM_DCCOprtCmdLo_enum@ */ Scalar_UBYTE 0 AppSwcOpm_CM_uint8_enum 0.0 255.0 /end CHARACTERISTIC
/begin CHARACTERISTIC KOPM_DrvModeKeyStgntnHi_enum "VCU_B_AcclPedal_EPT" VALUE 0x0000 /* @ECU_Address@KOPM_DrvModeKeyStgntnHi_enum@ */ Scalar_UBYTE 0 AppSwcOpm_CM_uint8_enum 0.0 255.0 /end CHARACTERISTIC
/begin CHARACTERISTIC KOPM_DrvModeKeyStgntnLo_enum "VCU_B_AcclPedal_EPT" VALUE 0x0000 /* @ECU_Address@KOPM_DrvModeKeyStgntnLo_enum@ */ Scalar_UBYTE 0 AppSwcOpm_CM_uint8_enum 0.0 255.0 /end CHARACTERISTIC
/begin CHARACTERISTIC KOPM_DrvModeKeyStgntn_enum_ovrdval "VCU_DispInfo_BAC" VALUE 0x0000 /* @ECU_Address@KOPM_DrvModeKeyStgntn_enum_ovrdval@ */ Scalar_UBYTE 0 AppSwcOpm_CM_uint8_enum 0.0 255.0 /end CHARACTERISTIC
/begin CHARACTERISTIC KOPM_DrvMotorStaHi_enum "VCU_B_AcclPedal_EPT" VALUE 0x0000 /* @ECU_Address@KOPM_DrvMotorStaHi_enum@ */ Scalar_UBYTE 0 AppSwcOpm_CM_uint8_enum 0.0 255.0 /end CHARACTERISTIC
/begin CHARACTERISTIC KOPM_DrvMotorStaLo_enum "VCU_B_AcclPedal_EPT" VALUE 0x0000 /* @ECU_Address@KOPM_DrvMotorStaLo_enum@ */ Scalar_UBYTE 0 AppSwcOpm_CM_uint8_enum 0.0 255.0 /end CHARACTERISTIC
/begin CHARACTERISTIC KOPM_DrvMotorSta_enum_ovrdval "VCU_DispInfo_BAC" VALUE 0x0000 /* @ECU_Address@KOPM_DrvMotorSta_enum_ovrdval@ */ Scalar_UBYTE 0 AppSwcOpm_CM_uint8_enum 0.0 255.0 /end CHARACTERISTIC
/begin CHARACTERISTIC KOPM_ErrAmountHi_cnt "VCU_B_AcclPedal_EPT" VALUE 0x0000 /* @ECU_Address@KOPM_ErrAmountHi_cnt@ */ Scalar_UBYTE 0 AppSwcOpm_CM_uint8_enum 0.0 255.0 /end CHARACTERISTIC
/begin CHARACTERISTIC KOPM_ErrAmountLo_cnt "VCU_B_AcclPedal_EPT" VALUE 0x0000 /* @ECU_Address@KOPM_ErrAmountLo_cnt@ */ Scalar_UBYTE 0 AppSwcOpm_CM_uint8_enum 0.0 255.0 /end CHARACTERISTIC
/begin CHARACTERISTIC KOPM_ErrAmount_cnt_ovrdval "VCU_B_AcclPedal_EPT" VALUE 0x0000 /* @ECU_Address@KOPM_ErrAmount_cnt_ovrdval@ */ Scalar_UBYTE 0 AppSwcOpm_CM_uint8_cnt 0.0 255.0 /end CHARACTERISTIC
/begin CHARACTERISTIC KOPM_InfoDispHi_enum "VCU_B_AcclPedal_EPT" VALUE 0x0000 /* @ECU_Address@KOPM_InfoDispHi_enum@ */ Scalar_UBYTE 0 AppSwcOpm_CM_uint8_enum 0.0 255.0 /end CHARACTERISTIC
/begin CHARACTERISTIC KOPM_InfoDispLo_enum "VCU_B_AcclPedal_EPT" VALUE 0x0000 /* @ECU_Address@KOPM_InfoDispLo_enum@ */ Scalar_UBYTE 0 AppSwcOpm_CM_uint8_enum 0.0 255.0 /end CHARACTERISTIC
/begin CHARACTERISTIC KOPM_InfoDisp_enum_ovrdval "VCU_DispInfo_BAC" VALUE 0x0000 /* @ECU_Address@KOPM_InfoDisp_enum_ovrdval@ */ Scalar_UBYTE 0 AppSwcOpm_CM_uint8_enum 0.0 255.0 /end CHARACTERISTIC
/begin CHARACTERISTIC KOPM_LckVehWrmHi_enum "VCU_DispInfo_BAC" VALUE 0x0000 /* @ECU_Address@KOPM_LckVehWrmHi_enum@ */ Scalar_UBYTE 0 AppSwcOpm_CM_uint8_enum 0.0 255.0 /end CHARACTERISTIC
/begin CHARACTERISTIC KOPM_LckVehWrmLo_enum "VCU_DispInfo_BAC" VALUE 0x0000 /* @ECU_Address@KOPM_LckVehWrmLo_enum@ */ Scalar_UBYTE 0 AppSwcOpm_CM_uint8_enum 0.0 255.0 /end CHARACTERISTIC
/begin CHARACTERISTIC KOPM_LckVehWrm_enum_ovrdval "VCU_DispInfo_BAC" VALUE 0x0000 /* @ECU_Address@KOPM_LckVehWrm_enum_ovrdval@ */ Scalar_UBYTE 0 AppSwcOpm_CM_uint8_enum 0.0 255.0 /end CHARACTERISTIC
/begin CHARACTERISTIC KOPM_MaxChrgCurntACHi_A "VCU_4_ChrgCmd_EPT" VALUE 0x0000 /* @ECU_Address@KOPM_MaxChrgCurntACHi_A@ */ Scalar_UBYTE 0 AppSwcOpm_CM_uint8_A 0.0 255.0 /end CHARACTERISTIC
/begin CHARACTERISTIC KOPM_MaxChrgCurntACLo_A "VCU_4_ChrgCmd_EPT" VALUE 0x0000 /* @ECU_Address@KOPM_MaxChrgCurntACLo_A@ */ Scalar_UBYTE 0 AppSwcOpm_CM_uint8_A 0.0 255.0 /end CHARACTERISTIC
/begin CHARACTERISTIC KOPM_MaxChrgCurntAC_A_ovrdval "VCU_4_ChrgCmd_EPT" VALUE 0x0000 /* @ECU_Address@KOPM_MaxChrgCurntAC_A_ovrdval@ */ Scalar_UBYTE 0 AppSwcOpm_CM_uint8_A 0.0 255.0 /end CHARACTERISTIC
/begin CHARACTERISTIC KOPM_MotActPwrTypHi_enum "VCU_B_AcclPedal_EPT" VALUE 0x0000 /* @ECU_Address@KOPM_MotActPwrTypHi_enum@ */ Scalar_UBYTE 0 AppSwcOpm_CM_uint8_enum 0.0 255.0 /end CHARACTERISTIC
/begin CHARACTERISTIC KOPM_MotActPwrTypLo_enum "VCU_B_AcclPedal_EPT" VALUE 0x0000 /* @ECU_Address@KOPM_MotActPwrTypLo_enum@ */ Scalar_UBYTE 0 AppSwcOpm_CM_uint8_enum 0.0 255.0 /end CHARACTERISTIC
/begin CHARACTERISTIC KOPM_MotActPwrTyp_enum_ovrdval "VCU_DispInfo_BAC" VALUE 0x0000 /* @ECU_Address@KOPM_MotActPwrTyp_enum_ovrdval@ */ Scalar_UBYTE 0 AppSwcOpm_CM_uint8_enum 0.0 255.0 /end CHARACTERISTIC
/begin CHARACTERISTIC KOPM_MotDirReqHi_enum "VCU_1_InvCmd_EPT" VALUE 0x0000 /* @ECU_Address@KOPM_MotDirReqHi_enum@ */ Scalar_UBYTE 0 AppSwcOpm_CM_uint8_enum 0.0 255.0 /end CHARACTERISTIC
/begin CHARACTERISTIC KOPM_MotDirReqLo_enum "VCU_1_InvCmd_EPT" VALUE 0x0000 /* @ECU_Address@KOPM_MotDirReqLo_enum@ */ Scalar_UBYTE 0 AppSwcOpm_CM_uint8_enum 0.0 255.0 /end CHARACTERISTIC
/begin CHARACTERISTIC KOPM_MotModeReqHi_enum "VCU_1_InvCmd_EPT" VALUE 0x0000 /* @ECU_Address@KOPM_MotModeReqHi_enum@ */ Scalar_UBYTE 0 AppSwcOpm_CM_uint8_enum 0.0 255.0 /end CHARACTERISTIC
/begin CHARACTERISTIC KOPM_MotModeReqLo_enum "VCU_1_InvCmd_EPT" VALUE 0x0000 /* @ECU_Address@KOPM_MotModeReqLo_enum@ */ Scalar_UBYTE 0 AppSwcOpm_CM_uint8_enum 0.0 255.0 /end CHARACTERISTIC
/begin CHARACTERISTIC KOPM_OBCOprtCmdHi_enum "VCU_4_ChrgCmd_EPT" VALUE 0x0000 /* @ECU_Address@KOPM_OBCOprtCmdHi_enum@ */ Scalar_UBYTE 0 AppSwcOpm_CM_uint8_enum 0.0 255.0 /end CHARACTERISTIC
/begin CHARACTERISTIC KOPM_OBCOprtCmdLo_enum "VCU_4_ChrgCmd_EPT" VALUE 0x0000 /* @ECU_Address@KOPM_OBCOprtCmdLo_enum@ */ Scalar_UBYTE 0 AppSwcOpm_CM_uint8_enum 0.0 255.0 /end CHARACTERISTIC
/begin CHARACTERISTIC KOPM_OBCOprtCmdToICUHi_enum "VCU_B_AcclPedal_EPT" VALUE 0x0000 /* @ECU_Address@KOPM_OBCOprtCmdToICUHi_enum@ */ Scalar_UBYTE 0 AppSwcOpm_CM_uint8_enum 0.0 255.0 /end CHARACTERISTIC
/begin CHARACTERISTIC KOPM_OBCOprtCmdToICULo_enum "VCU_B_AcclPedal_EPT" VALUE 0x0000 /* @ECU_Address@KOPM_OBCOprtCmdToICULo_enum@ */ Scalar_UBYTE 0 AppSwcOpm_CM_uint8_enum 0.0 255.0 /end CHARACTERISTIC
/begin CHARACTERISTIC KOPM_PGrSwcStHi_enum "VCU_D_Status_CHA" VALUE 0x0000 /* @ECU_Address@KOPM_PGrSwcStHi_enum@ */ Scalar_UBYTE 0 AppSwcOpm_CM_uint8_enum 0.0 255.0 /end CHARACTERISTIC
/begin CHARACTERISTIC KOPM_PGrSwcStLo_enum "VCU_D_Status_CHA" VALUE 0x0000 /* @ECU_Address@KOPM_PGrSwcStLo_enum@ */ Scalar_UBYTE 0 AppSwcOpm_CM_uint8_enum 0.0 255.0 /end CHARACTERISTIC
/begin CHARACTERISTIC KOPM_PGrSwcSt_enum_ovrdval "VCU_D_Status_CHA" VALUE 0x0000 /* @ECU_Address@KOPM_PGrSwcSt_enum_ovrdval@ */ Scalar_UBYTE 0 AppSwcOpm_CM_uint8_enum 0.0 255.0 /end CHARACTERISTIC
/begin CHARACTERISTIC KOPM_PwrRecupActlWhlTqStsHi_enum "VCU_10_Torque_CHA" VALUE 0x0000 /* @ECU_Address@KOPM_PwrRecupActlWhlTqStsHi_enum@ */ Scalar_UBYTE 0 AppSwcOpm_CM_uint8_enum 0.0 255.0 /end CHARACTERISTIC
/begin CHARACTERISTIC KOPM_PwrRecupActlWhlTqStsLo_enum "VCU_10_Torque_CHA" VALUE 0x0000 /* @ECU_Address@KOPM_PwrRecupActlWhlTqStsLo_enum@ */ Scalar_UBYTE 0 AppSwcOpm_CM_uint8_enum 0.0 255.0 /end CHARACTERISTIC
/begin CHARACTERISTIC KOPM_PwrRecupActlWhlTqSts_enum_ovrdval "VCU_10_Torque_CHA" VALUE 0x0000 /* @ECU_Address@KOPM_PwrRecupActlWhlTqSts_enum_ovrdval@ */ Scalar_UBYTE 0 AppSwcOpm_CM_uint8_enum 0.0 255.0 /end CHARACTERISTIC
/begin CHARACTERISTIC KOPM_PwrRecupMaxAvlbMotorTorqStaHi_enum "VCU_D_Status_CHA" VALUE 0x0000 /* @ECU_Address@KOPM_PwrRecupMaxAvlbMotorTorqStaHi_enum@ */ Scalar_UBYTE 0 AppSwcOpm_CM_uint8_enum 0.0 255.0 /end CHARACTERISTIC
/begin CHARACTERISTIC KOPM_PwrRecupMaxAvlbMotorTorqStaLo_enum "VCU_D_Status_CHA" VALUE 0x0000 /* @ECU_Address@KOPM_PwrRecupMaxAvlbMotorTorqStaLo_enum@ */ Scalar_UBYTE 0 AppSwcOpm_CM_uint8_enum 0.0 255.0 /end CHARACTERISTIC
/begin CHARACTERISTIC KOPM_PwrRecupMaxAvlbMotorTorqSta_enum_ovrdval "VCU_D_Status_CHA" VALUE 0x0000 /* @ECU_Address@KOPM_PwrRecupMaxAvlbMotorTorqSta_enum_ovrdval@ */ Scalar_UBYTE 0 AppSwcOpm_CM_uint8_enum 0.0 255.0 /end CHARACTERISTIC
/begin CHARACTERISTIC KOPM_PwrRecupMaxAvlbWhlTqStsHi_enum "VCU_10_Torque_CHA" VALUE 0x0000 /* @ECU_Address@KOPM_PwrRecupMaxAvlbWhlTqStsHi_enum@ */ Scalar_UBYTE 0 AppSwcOpm_CM_uint8_enum 0.0 255.0 /end CHARACTERISTIC
/begin CHARACTERISTIC KOPM_PwrRecupMaxAvlbWhlTqStsLo_enum "VCU_10_Torque_CHA" VALUE 0x0000 /* @ECU_Address@KOPM_PwrRecupMaxAvlbWhlTqStsLo_enum@ */ Scalar_UBYTE 0 AppSwcOpm_CM_uint8_enum 0.0 255.0 /end CHARACTERISTIC
/begin CHARACTERISTIC KOPM_PwrRecupMaxAvlbWhlTqSts_enum_ovrdval "VCU_10_Torque_CHA" VALUE 0x0000 /* @ECU_Address@KOPM_PwrRecupMaxAvlbWhlTqSts_enum_ovrdval@ */ Scalar_UBYTE 0 AppSwcOpm_CM_uint8_enum 0.0 255.0 /end CHARACTERISTIC
/begin CHARACTERISTIC KOPM_SIBSRTCChrgStHi_enum "VCU_DispInfo_BAC" VALUE 0x0000 /* @ECU_Address@KOPM_SIBSRTCChrgStHi_enum@ */ Scalar_UBYTE 0 AppSwcOpm_CM_uint8_enum 0.0 255.0 /end CHARACTERISTIC
/begin CHARACTERISTIC KOPM_SIBSRTCChrgStLo_enum "VCU_DispInfo_BAC" VALUE 0x0000 /* @ECU_Address@KOPM_SIBSRTCChrgStLo_enum@ */ Scalar_UBYTE 0 AppSwcOpm_CM_uint8_enum 0.0 255.0 /end CHARACTERISTIC
/begin CHARACTERISTIC KOPM_SIBSRTCWUChgFailNumHi_cnt "VCU_DispInfo_BAC" VALUE 0x0000 /* @ECU_Address@KOPM_SIBSRTCWUChgFailNumHi_cnt@ */ Scalar_UBYTE 0 AppSwcOpm_CM_uint8_cnt 0.0 255.0 /end CHARACTERISTIC
/begin CHARACTERISTIC KOPM_SIBSRTCWUChgFailNumLo_cnt "VCU_DispInfo_BAC" VALUE 0x0000 /* @ECU_Address@KOPM_SIBSRTCWUChgFailNumLo_cnt@ */ Scalar_UBYTE 0 AppSwcOpm_CM_uint8_cnt 0.0 255.0 /end CHARACTERISTIC
/begin CHARACTERISTIC KOPM_SIBSRTCWUChgFailNum_cnt_ovrdval "VCU_DispInfo_BAC" VALUE 0x0000 /* @ECU_Address@KOPM_SIBSRTCWUChgFailNum_cnt_ovrdval@ */ Scalar_UBYTE 0 AppSwcOpm_CM_uint8_cnt 0.0 255.0 /end CHARACTERISTIC
/begin CHARACTERISTIC KOPM_SIBSRTCWUChgNumHi_cnt "VCU_DispInfo_BAC" VALUE 0x0000 /* @ECU_Address@KOPM_SIBSRTCWUChgNumHi_cnt@ */ Scalar_UBYTE 0 AppSwcOpm_CM_uint8_cnt 0.0 255.0 /end CHARACTERISTIC
/begin CHARACTERISTIC KOPM_SIBSRTCWUChgNumLo_cnt "VCU_DispInfo_BAC" VALUE 0x0000 /* @ECU_Address@KOPM_SIBSRTCWUChgNumLo_cnt@ */ Scalar_UBYTE 0 AppSwcOpm_CM_uint8_cnt 0.0 255.0 /end CHARACTERISTIC
/begin CHARACTERISTIC KOPM_SIBSRTCWUChgNum_cnt_ovrdval "VCU_DispInfo_BAC" VALUE 0x0000 /* @ECU_Address@KOPM_SIBSRTCWUChgNum_cnt_ovrdval@ */ Scalar_UBYTE 0 AppSwcOpm_CM_uint8_cnt 0.0 255.0 /end CHARACTERISTIC
/begin CHARACTERISTIC KOPM_ShftKeyStgntnHi_enum "VCU_B_AcclPedal_EPT" VALUE 0x0000 /* @ECU_Address@KOPM_ShftKeyStgntnHi_enum@ */ Scalar_UBYTE 0 AppSwcOpm_CM_uint8_enum 0.0 255.0 /end CHARACTERISTIC
/begin CHARACTERISTIC KOPM_ShftKeyStgntnLo_enum "VCU_B_AcclPedal_EPT" VALUE 0x0000 /* @ECU_Address@KOPM_ShftKeyStgntnLo_enum@ */ Scalar_UBYTE 0 AppSwcOpm_CM_uint8_enum 0.0 255.0 /end CHARACTERISTIC
/begin CHARACTERISTIC KOPM_ShftKeyStgntn_enum_ovrdval "VCU_DispInfo_BAC" VALUE 0x0000 /* @ECU_Address@KOPM_ShftKeyStgntn_enum_ovrdval@ */ Scalar_UBYTE 0 AppSwcOpm_CM_uint8_enum 0.0 255.0 /end CHARACTERISTIC
/begin CHARACTERISTIC KOPM_SysFailStaHi_enum "VCU_B_AcclPedal_EPT" VALUE 0x0000 /* @ECU_Address@KOPM_SysFailStaHi_enum@ */ Scalar_UBYTE 0 AppSwcOpm_CM_uint8_enum 0.0 255.0 /end CHARACTERISTIC
/begin CHARACTERISTIC KOPM_SysFailStaLo_enum "VCU_B_AcclPedal_EPT" VALUE 0x0000 /* @ECU_Address@KOPM_SysFailStaLo_enum@ */ Scalar_UBYTE 0 AppSwcOpm_CM_uint8_enum 0.0 255.0 /end CHARACTERISTIC
/begin CHARACTERISTIC KOPM_SysFailSta_enum_ovrdval "VCU_B_AcclPedal_EPT" VALUE 0x0000 /* @ECU_Address@KOPM_SysFailSta_enum_ovrdval@ */ Scalar_UBYTE 0 AppSwcOpm_CM_uint8_enum 0.0 255.0 /end CHARACTERISTIC
/begin CHARACTERISTIC KOPM_VCUACCStatHi_enum "VCU_D_Status_CHA" VALUE 0x0000 /* @ECU_Address@KOPM_VCUACCStatHi_enum@ */ Scalar_UBYTE 0 AppSwcOpm_CM_uint8_enum 0.0 255.0 /end CHARACTERISTIC
/begin CHARACTERISTIC KOPM_VCUACCStatLo_enum "VCU_D_Status_CHA" VALUE 0x0000 /* @ECU_Address@KOPM_VCUACCStatLo_enum@ */ Scalar_UBYTE 0 AppSwcOpm_CM_uint8_enum 0.0 255.0 /end CHARACTERISTIC
/begin CHARACTERISTIC KOPM_VCUACCStat_enum_ovrdval "VCU_D_Status_CHA" VALUE 0x0000 /* @ECU_Address@KOPM_VCUACCStat_enum_ovrdval@ */ Scalar_UBYTE 0 AppSwcOpm_CM_uint8_enum 0.0 255.0 /end CHARACTERISTIC
/begin CHARACTERISTIC KOPM_VCUCruiseCtrlStaHi_enum "VCU_D_Status_CHA" VALUE 0x0000 /* @ECU_Address@KOPM_VCUCruiseCtrlStaHi_enum@ */ Scalar_UBYTE 0 AppSwcOpm_CM_uint8_enum 0.0 255.0 /end CHARACTERISTIC
/begin CHARACTERISTIC KOPM_VCUCruiseCtrlStaLo_enum "VCU_D_Status_CHA" VALUE 0x0000 /* @ECU_Address@KOPM_VCUCruiseCtrlStaLo_enum@ */ Scalar_UBYTE 0 AppSwcOpm_CM_uint8_enum 0.0 255.0 /end CHARACTERISTIC
/begin CHARACTERISTIC KOPM_VCUEPBApplyForbidHi_enum "VCU_D_Status_CHA" VALUE 0x0000 /* @ECU_Address@KOPM_VCUEPBApplyForbidHi_enum@ */ Scalar_UBYTE 0 AppSwcOpm_CM_uint8_enum 0.0 255.0 /end CHARACTERISTIC
/begin CHARACTERISTIC KOPM_VCUEPBApplyForbidLo_enum "VCU_D_Status_CHA" VALUE 0x0000 /* @ECU_Address@KOPM_VCUEPBApplyForbidLo_enum@ */ Scalar_UBYTE 0 AppSwcOpm_CM_uint8_enum 0.0 255.0 /end CHARACTERISTIC
/begin CHARACTERISTIC KOPM_VCUEPBApplyForbid_enum_ovrdval "VCU_D_Status_CHA" VALUE 0x0000 /* @ECU_Address@KOPM_VCUEPBApplyForbid_enum_ovrdval@ */ Scalar_UBYTE 0 AppSwcOpm_CM_uint8_enum 0.0 255.0 /end CHARACTERISTIC
/begin CHARACTERISTIC KOPM_VCUReqAutoBrkHi_enum "VCU_D_Status_CHA" VALUE 0x0000 /* @ECU_Address@KOPM_VCUReqAutoBrkHi_enum@ */ Scalar_UBYTE 0 AppSwcOpm_CM_uint8_enum 0.0 255.0 /end CHARACTERISTIC
/begin CHARACTERISTIC KOPM_VCUReqAutoBrkLo_enum "VCU_D_Status_CHA" VALUE 0x0000 /* @ECU_Address@KOPM_VCUReqAutoBrkLo_enum@ */ Scalar_UBYTE 0 AppSwcOpm_CM_uint8_enum 0.0 255.0 /end CHARACTERISTIC
/begin CHARACTERISTIC KOPM_VCUReqAutoBrk_enum_ovrdval "VCU_D_Status_CHA" VALUE 0x0000 /* @ECU_Address@KOPM_VCUReqAutoBrk_enum_ovrdval@ */ Scalar_UBYTE 0 AppSwcOpm_CM_uint8_enum 0.0 255.0 /end CHARACTERISTIC
/begin CHARACTERISTIC KOPM_VCUReqEPBHi_enum "VCU_D_Status_CHA" VALUE 0x0000 /* @ECU_Address@KOPM_VCUReqEPBHi_enum@ */ Scalar_UBYTE 0 AppSwcOpm_CM_uint8_enum 0.0 255.0 /end CHARACTERISTIC
/begin CHARACTERISTIC KOPM_VCUReqEPBLo_enum "VCU_D_Status_CHA" VALUE 0x0000 /* @ECU_Address@KOPM_VCUReqEPBLo_enum@ */ Scalar_UBYTE 0 AppSwcOpm_CM_uint8_enum 0.0 255.0 /end CHARACTERISTIC
/begin CHARACTERISTIC KOPM_VCUSpdLimLvlFbHi_enum "VCU_DispInfo_BAC" VALUE 0x0000 /* @ECU_Address@KOPM_VCUSpdLimLvlFbHi_enum@ */ Scalar_UBYTE 0 AppSwcOpm_CM_uint8_enum 0.0 255.0 /end CHARACTERISTIC
/begin CHARACTERISTIC KOPM_VCUSpdLimLvlFbLo_enum "VCU_DispInfo_BAC" VALUE 0x0000 /* @ECU_Address@KOPM_VCUSpdLimLvlFbLo_enum@ */ Scalar_UBYTE 0 AppSwcOpm_CM_uint8_enum 0.0 255.0 /end CHARACTERISTIC
/begin CHARACTERISTIC KOPM_VCUSpdLimLvlFb_enum_ovrdval "VCU_DispInfo_BAC" VALUE 0x0000 /* @ECU_Address@KOPM_VCUSpdLimLvlFb_enum_ovrdval@ */ Scalar_UBYTE 0 AppSwcOpm_CM_uint8_enum 0.0 255.0 /end CHARACTERISTIC
/begin CHARACTERISTIC KOPM_VCUSpdLimLvlSetFbHi_enum "VCU_DispInfo_BAC" VALUE 0x0000 /* @ECU_Address@KOPM_VCUSpdLimLvlSetFbHi_enum@ */ Scalar_UBYTE 0 AppSwcOpm_CM_uint8_enum 0.0 255.0 /end CHARACTERISTIC
/begin CHARACTERISTIC KOPM_VCUSpdLimLvlSetFbLo_enum "VCU_DispInfo_BAC" VALUE 0x0000 /* @ECU_Address@KOPM_VCUSpdLimLvlSetFbLo_enum@ */ Scalar_UBYTE 0 AppSwcOpm_CM_uint8_enum 0.0 255.0 /end CHARACTERISTIC
/begin CHARACTERISTIC KOPM_VCUSpdLimLvlSetFb_enum_ovrdval "VCU_DispInfo_BAC" VALUE 0x0000 /* @ECU_Address@KOPM_VCUSpdLimLvlSetFb_enum_ovrdval@ */ Scalar_UBYTE 0 AppSwcOpm_CM_uint8_enum 0.0 255.0 /end CHARACTERISTIC
/begin CHARACTERISTIC KOPM_VCUVerSetFbHi_enum "VCU_DispInfo_BAC" VALUE 0x0000 /* @ECU_Address@KOPM_VCUVerSetFbHi_enum@ */ Scalar_UBYTE 0 AppSwcOpm_CM_uint8_enum 0.0 255.0 /end CHARACTERISTIC
/begin CHARACTERISTIC KOPM_VCUVerSetFbLo_enum "VCU_DispInfo_BAC" VALUE 0x0000 /* @ECU_Address@KOPM_VCUVerSetFbLo_enum@ */ Scalar_UBYTE 0 AppSwcOpm_CM_uint8_enum 0.0 255.0 /end CHARACTERISTIC
/begin CHARACTERISTIC KOPM_VCUVerSetFb_enum_ovrdval "VCU_DispInfo_BAC" VALUE 0x0000 /* @ECU_Address@KOPM_VCUVerSetFb_enum_ovrdval@ */ Scalar_UBYTE 0 AppSwcOpm_CM_uint8_enum 0.0 255.0 /end CHARACTERISTIC
/begin CHARACTERISTIC KOPM_VehActDrvPwrHi_pct "VCU_DispInfo_BAC" VALUE 0x0000 /* @ECU_Address@KOPM_VehActDrvPwrHi_pct@ */ Scalar_UBYTE 0 AppSwcOpm_CM_uint8_pct 0.0 255.0 /end CHARACTERISTIC
/begin CHARACTERISTIC KOPM_VehActDrvPwrLo_pct "VCU_DispInfo_BAC" VALUE 0x0000 /* @ECU_Address@KOPM_VehActDrvPwrLo_pct@ */ Scalar_UBYTE 0 AppSwcOpm_CM_uint8_pct 0.0 255.0 /end CHARACTERISTIC
/begin CHARACTERISTIC KOPM_VehActDrvPwr_pct_ovrdval "VCU_DispInfo_BAC" VALUE 0x0000 /* @ECU_Address@KOPM_VehActDrvPwr_pct_ovrdval@ */ Scalar_UBYTE 0 AppSwcOpm_CM_uint8_pct 0.0 255.0 /end CHARACTERISTIC
/begin CHARACTERISTIC KOPM_VehActRecupPwrHi_pct "VCU_DispInfo_BAC" VALUE 0x0000 /* @ECU_Address@KOPM_VehActRecupPwrHi_pct@ */ Scalar_UBYTE 0 AppSwcOpm_CM_uint8_pct 0.0 255.0 /end CHARACTERISTIC
/begin CHARACTERISTIC KOPM_VehActRecupPwrLo_pct "VCU_DispInfo_BAC" VALUE 0x0000 /* @ECU_Address@KOPM_VehActRecupPwrLo_pct@ */ Scalar_UBYTE 0 AppSwcOpm_CM_uint8_pct 0.0 255.0 /end CHARACTERISTIC
/begin CHARACTERISTIC KOPM_VehActRecupPwr_pct_ovrdval "VCU_DispInfo_BAC" VALUE 0x0000 /* @ECU_Address@KOPM_VehActRecupPwr_pct_ovrdval@ */ Scalar_UBYTE 0 AppSwcOpm_CM_uint8_pct 0.0 255.0 /end CHARACTERISTIC
/begin CHARACTERISTIC KOPM_VehTrgtGearPosHi_enum "VCU_1_InvCmd_EPT" VALUE 0x0000 /* @ECU_Address@KOPM_VehTrgtGearPosHi_enum@ */ Scalar_UBYTE 0 AppSwcOpm_CM_uint8_enum 0.0 255.0 /end CHARACTERISTIC
/begin CHARACTERISTIC KOPM_VehTrgtGearPosLo_enum "VCU_1_InvCmd_EPT" VALUE 0x0000 /* @ECU_Address@KOPM_VehTrgtGearPosLo_enum@ */ Scalar_UBYTE 0 AppSwcOpm_CM_uint8_enum 0.0 255.0 /end CHARACTERISTIC
/begin CHARACTERISTIC KOPM_WghDistbHi_enum "VCU_DispInfo_BAC" VALUE 0x0000 /* @ECU_Address@KOPM_WghDistbHi_enum@ */ Scalar_UBYTE 0 AppSwcOpm_CM_uint8_enum 0.0 255.0 /end CHARACTERISTIC
/begin CHARACTERISTIC KOPM_WghDistbLo_enum "VCU_DispInfo_BAC" VALUE 0x0000 /* @ECU_Address@KOPM_WghDistbLo_enum@ */ Scalar_UBYTE 0 AppSwcOpm_CM_uint8_enum 0.0 255.0 /end CHARACTERISTIC
/begin CHARACTERISTIC KOPM_WghDistb_enum_ovrdval "VCU_DispInfo_BAC" VALUE 0x0000 /* @ECU_Address@KOPM_WghDistb_enum_ovrdval@ */ Scalar_UBYTE 0 AppSwcOpm_CM_uint8_enum 0.0 255.0 /end CHARACTERISTIC
/begin MEASUREMENT VOPM_MaxHVDCVoltAC_V "VCU_C_OprtCmd_EPT" FLOAT32_IEEE AppSwcOpm_CM_single_V 0 0 -100000.0 100000.0 ECU_ADDRESS 0x0000 /* @ECU_Address@VOPM_MaxHVDCVoltAC_V@ */ /end MEASUREMENT
/begin MEASUREMENT VOPM_MaxHVDCCurntAC_A "VCU_C_OprtCmd_EPT" FLOAT32_IEEE AppSwcOpm_CM_single_A 0 0 -100000.0 100000.0 ECU_ADDRESS 0x0000 /* @ECU_Address@VOPM_MaxHVDCCurntAC_A@ */ /end MEASUREMENT
/begin MEASUREMENT VOPM_DCCBuckLVVolt_V "VCU_C_OprtCmd_EPT" FLOAT32_IEEE AppSwcOpm_CM_single_V 0 0 -100000.0 100000.0 ECU_ADDRESS 0x0000 /* @ECU_Address@VOPM_DCCBuckLVVolt_V@ */ /end MEASUREMENT
/begin MEASUREMENT VOPM_DCCBoostHvVolt_V "VCU_C_OprtCmd_EPT" FLOAT32_IEEE AppSwcOpm_CM_single_V 0 0 -100000.0 100000.0 ECU_ADDRESS 0x0000 /* @ECU_Address@VOPM_DCCBoostHvVolt_V@ */ /end MEASUREMENT
/begin MEASUREMENT VOPM_MaxChrgVoltDC_V "VCU_4_ChrgCmd_EPT" FLOAT32_IEEE AppSwcOpm_CM_single_V 0 0 -100000.0 100000.0 ECU_ADDRESS 0x0000 /* @ECU_Address@VOPM_MaxChrgVoltDC_V@ */ /end MEASUREMENT
/begin MEASUREMENT VOPM_MaxChrgCurntDC_A "VCU_4_ChrgCmd_EPT" FLOAT32_IEEE AppSwcOpm_CM_single_A 0 0 -100000.0 100000.0 ECU_ADDRESS 0x0000 /* @ECU_Address@VOPM_MaxChrgCurntDC_A@ */ /end MEASUREMENT
/begin MEASUREMENT VOPM_MotorOutputCooltTemp_C "VCU_3_OprtCmd_EPT" FLOAT32_IEEE AppSwcOpm_CM_single_C 0 0 -100000.0 100000.0 ECU_ADDRESS 0x0000 /* @ECU_Address@VOPM_MotorOutputCooltTemp_C@ */ /end MEASUREMENT
/begin MEASUREMENT VOPM_AllowHeatCoolMaxPwrCmsp_kW "VCU_3_OprtCmd_EPT" FLOAT32_IEEE AppSwcOpm_CM_single_kW 0 0 -100000.0 100000.0 ECU_ADDRESS 0x0000 /* @ECU_Address@VOPM_AllowHeatCoolMaxPwrCmsp_kW@ */ /end MEASUREMENT
/begin MEASUREMENT VOPM_VCUCruiseCtrTgtSpd_kph "VCU_D_Status_CHA" FLOAT32_IEEE AppSwcOpm_CM_single_kph 0 0 -100000.0 100000.0 ECU_ADDRESS 0x0000 /* @ECU_Address@VOPM_VCUCruiseCtrTgtSpd_kph@ */ /end MEASUREMENT
/begin MEASUREMENT VOPM_VCUBraTorReq_Nm "VCU_D_Status_CHA" FLOAT32_IEEE AppSwcOpm_CM_single_Nm 0 0 -100000.0 100000.0 ECU_ADDRESS 0x0000 /* @ECU_Address@VOPM_VCUBraTorReq_Nm@ */ /end MEASUREMENT
/begin MEASUREMENT VOPM_VCUAccTgtAx_mps2 "VCU_D_Status_CHA" FLOAT32_IEEE AppSwcOpm_CM_single_mps2 0 0 -100000.0 100000.0 ECU_ADDRESS 0x0000 /* @ECU_Address@VOPM_VCUAccTgtAx_mps2@ */ /end MEASUREMENT
/begin MEASUREMENT VOPM_BrkPedalPos_pct "VCU_D_Status_CHA" FLOAT32_IEEE AppSwcOpm_CM_single_pct 0 0 -100000.0 100000.0 ECU_ADDRESS 0x0000 /* @ECU_Address@VOPM_BrkPedalPos_pct@ */ /end MEASUREMENT
/begin MEASUREMENT VOPM_AcclPedalPos_pct "VCU_D_Status_CHA" FLOAT32_IEEE AppSwcOpm_CM_single_pct 0 0 -100000.0 100000.0 ECU_ADDRESS 0x0000 /* @ECU_Address@VOPM_AcclPedalPos_pct@ */ /end MEASUREMENT
/begin MEASUREMENT VOPM_AccPedPosToESC_pct "VCU_D_Status_CHA" FLOAT32_IEEE AppSwcOpm_CM_single_pct 0 0 -100000.0 100000.0 ECU_ADDRESS 0x0000 /* @ECU_Address@VOPM_AccPedPosToESC_pct@ */ /end MEASUREMENT
/begin MEASUREMENT VOPM_WghEst_kg "VCU_DispInfo_BAC" FLOAT32_IEEE AppSwcOpm_CM_single_kg 0 0 -100000.0 100000.0 ECU_ADDRESS 0x0000 /* @ECU_Address@VOPM_WghEst_kg@ */ /end MEASUREMENT
/begin MEASUREMENT VOPM_WLTPDrvgRngDst_km "VCU_DispInfo_BAC" FLOAT32_IEEE AppSwcOpm_CM_single_km 0 0 -100000.0 100000.0 ECU_ADDRESS 0x0000 /* @ECU_Address@VOPM_WLTPDrvgRngDst_km@ */ /end MEASUREMENT
/begin MEASUREMENT VOPM_VhclActlCnsmPwr_kWh "VCU_DispInfo_BAC" FLOAT32_IEEE AppSwcOpm_CM_single_kWh 0 0 -100000.0 100000.0 ECU_ADDRESS 0x0000 /* @ECU_Address@VOPM_VhclActlCnsmPwr_kWh@ */ /end MEASUREMENT
/begin MEASUREMENT VOPM_VehPwrCnsmpAvrg_kWh "VCU_DispInfo_BAC" FLOAT32_IEEE AppSwcOpm_CM_single_kWh 0 0 -100000.0 100000.0 ECU_ADDRESS 0x0000 /* @ECU_Address@VOPM_VehPwrCnsmpAvrg_kWh@ */ /end MEASUREMENT
/begin MEASUREMENT VOPM_SIBSKL30Volt_V "VCU_DispInfo_BAC" FLOAT32_IEEE AppSwcOpm_CM_single_V 0 0 -100000.0 100000.0 ECU_ADDRESS 0x0000 /* @ECU_Address@VOPM_SIBSKL30Volt_V@ */ /end MEASUREMENT
/begin MEASUREMENT VOPM_RsrvdPwr_kW "VCU_DispInfo_BAC" FLOAT32_IEEE AppSwcOpm_CM_single_kW 0 0 -100000.0 100000.0 ECU_ADDRESS 0x0000 /* @ECU_Address@VOPM_RsrvdPwr_kW@ */ /end MEASUREMENT
/begin MEASUREMENT VOPM_MotActPwr_Kw "VCU_DispInfo_BAC" FLOAT32_IEEE AppSwcOpm_CM_single_kW 0 0 -100000.0 100000.0 ECU_ADDRESS 0x0000 /* @ECU_Address@VOPM_MotActPwr_Kw@ */ /end MEASUREMENT
/begin MEASUREMENT VOPM_DrvRangeDistEst_km "VCU_DispInfo_BAC" FLOAT32_IEEE AppSwcOpm_CM_single_km 0 0 -100000.0 100000.0 ECU_ADDRESS 0x0000 /* @ECU_Address@VOPM_DrvRangeDistEst_km@ */ /end MEASUREMENT
/begin MEASUREMENT VOPM_CruiseCtrTgtSpd_kph "VCU_DispInfo_BAC" FLOAT32_IEEE AppSwcOpm_CM_single_kph 0 0 -100000.0 100000.0 ECU_ADDRESS 0x0000 /* @ECU_Address@VOPM_CruiseCtrTgtSpd_kph@ */ /end MEASUREMENT
/begin MEASUREMENT VOPM_MotTorqReq_Nm "VCU_1_InvCmd_EPT" FLOAT32_IEEE AppSwcOpm_CM_single_Nm 0 0 -100000.0 100000.0 ECU_ADDRESS 0x0000 /* @ECU_Address@VOPM_MotTorqReq_Nm@ */ /end MEASUREMENT
/begin MEASUREMENT VOPM_MotSpdReq_rpm "VCU_1_InvCmd_EPT" FLOAT32_IEEE AppSwcOpm_CM_single_rpm 0 0 -100000.0 100000.0 ECU_ADDRESS 0x0000 /* @ECU_Address@VOPM_MotSpdReq_rpm@ */ /end MEASUREMENT
/begin MEASUREMENT VOPM_MotDmpgLmt_Nm "VCU_0_Value_EPT" FLOAT32_IEEE AppSwcOpm_CM_single_Nm 0 0 -100000.0 100000.0 ECU_ADDRESS 0x0000 /* @ECU_Address@VOPM_MotDmpgLmt_Nm@ */ /end MEASUREMENT
/begin MEASUREMENT VOPM_DrvPed_pct "VCU_0_Value_EPT" FLOAT32_IEEE AppSwcOpm_CM_single_pct 0 0 -100000.0 100000.0 ECU_ADDRESS 0x0000 /* @ECU_Address@VOPM_DrvPed_pct@ */ /end MEASUREMENT
/begin MEASUREMENT VOPM_VCUMotTorqueReqToEHB_Nm "VCU_10_Torque_CHA" FLOAT32_IEEE AppSwcOpm_CM_single_Nm 0 0 -100000.0 100000.0 ECU_ADDRESS 0x0000 /* @ECU_Address@VOPM_VCUMotTorqueReqToEHB_Nm@ */ /end MEASUREMENT
/begin MEASUREMENT VOPM_VCUMasterCylinderPreReq_Bar "VCU_10_Torque_CHA" FLOAT32_IEEE AppSwcOpm_CM_single_Bar 0 0 -100000.0 100000.0 ECU_ADDRESS 0x0000 /* @ECU_Address@VOPM_VCUMasterCylinderPreReq_Bar@ */ /end MEASUREMENT
/begin MEASUREMENT VOPM_PwrRecupActWhlTq_Nm "VCU_10_Torque_CHA" FLOAT32_IEEE AppSwcOpm_CM_single_Nm 0 0 -100000.0 100000.0 ECU_ADDRESS 0x0000 /* @ECU_Address@VOPM_PwrRecupActWhlTq_Nm@ */ /end MEASUREMENT
/begin MEASUREMENT VOPM_DrvWhlTqAllwdMax_Nm "VCU_10_Torque_CHA" FLOAT32_IEEE AppSwcOpm_CM_single_Nm 0 0 -100000.0 100000.0 ECU_ADDRESS 0x0000 /* @ECU_Address@VOPM_DrvWhlTqAllwdMax_Nm@ */ /end MEASUREMENT
/begin MEASUREMENT VOPM_DrvReqWhlTq_Nm "VCU_10_Torque_CHA" FLOAT32_IEEE AppSwcOpm_CM_single_Nm 0 0 -100000.0 100000.0 ECU_ADDRESS 0x0000 /* @ECU_Address@VOPM_DrvReqWhlTq_Nm@ */ /end MEASUREMENT
/begin MEASUREMENT VOPM_DrvReqMotorTorq_Nm "VCU_10_Torque_CHA" FLOAT32_IEEE AppSwcOpm_CM_single_Nm 0 0 -100000.0 100000.0 ECU_ADDRESS 0x0000 /* @ECU_Address@VOPM_DrvReqMotorTorq_Nm@ */ /end MEASUREMENT
/begin MEASUREMENT VOPM_ErrBit_nu "VCU_B_AcclPedal_EPT" UWORD AppSwcOpm_CM_uint16_nu 0 0 0.0 65535.0 ECU_ADDRESS 0x0000 /* @ECU_Address@VOPM_ErrBit_nu@ */ /end MEASUREMENT
/begin MEASUREMENT VOPM_12VBatLowVolSta_enum "CCU_VehInfo_BAC" UBYTE AppSwcOpm_CM_uint8_enum 0 0 0.0 255.0 ECU_ADDRESS 0x0000 /* @ECU_Address@VOPM_12VBatLowVolSta_enum@ */ /end MEASUREMENT
/begin MEASUREMENT VOPM_SysFailSta_enum "VCU_B_AcclPedal_EPT" UBYTE AppSwcOpm_CM_uint8_enum 0 0 0.0 255.0 ECU_ADDRESS 0x0000 /* @ECU_Address@VOPM_SysFailSta_enum@ */ /end MEASUREMENT
/begin MEASUREMENT VOPM_ErrAmount_cnt "VCU_B_AcclPedal_EPT" UBYTE AppSwcOpm_CM_uint8_cnt 0 0 0.0 255.0 ECU_ADDRESS 0x0000 /* @ECU_Address@VOPM_ErrAmount_cnt@ */ /end MEASUREMENT
/begin MEASUREMENT VOPM_MaxChrgCurntAC_A "VCU_4_ChrgCmd_EPT" UBYTE AppSwcOpm_CM_uint8_A 0 0 0.0 255.0 ECU_ADDRESS 0x0000 /* @ECU_Address@VOPM_MaxChrgCurntAC_A@ */ /end MEASUREMENT
/begin MEASUREMENT VOPM_VCUReqAutoBrk_enum "VCU_D_Status_CHA" UBYTE AppSwcOpm_CM_uint8_enum 0 0 0.0 255.0 ECU_ADDRESS 0x0000 /* @ECU_Address@VOPM_VCUReqAutoBrk_enum@ */ /end MEASUREMENT
/begin MEASUREMENT VOPM_VCUEPBApplyForbid_enum "VCU_D_Status_CHA" UBYTE AppSwcOpm_CM_uint8_enum 0 0 0.0 255.0 ECU_ADDRESS 0x0000 /* @ECU_Address@VOPM_VCUEPBApplyForbid_enum@ */ /end MEASUREMENT
/begin MEASUREMENT VOPM_VCUACCStat_enum "VCU_D_Status_CHA" UBYTE AppSwcOpm_CM_uint8_enum 0 0 0.0 255.0 ECU_ADDRESS 0x0000 /* @ECU_Address@VOPM_VCUACCStat_enum@ */ /end MEASUREMENT
/begin MEASUREMENT VOPM_PwrRecupMaxAvlbMotorTorqSta_enum "VCU_D_Status_CHA" UBYTE AppSwcOpm_CM_uint8_enum 0 0 0.0 255.0 ECU_ADDRESS 0x0000 /* @ECU_Address@VOPM_PwrRecupMaxAvlbMotorTorqSta_enum@ */ /end MEASUREMENT
/begin MEASUREMENT VOPM_PGrSwcSt_enum "VCU_D_Status_CHA" UBYTE AppSwcOpm_CM_uint8_enum 0 0 0.0 255.0 ECU_ADDRESS 0x0000 /* @ECU_Address@VOPM_PGrSwcSt_enum@ */ /end MEASUREMENT
/begin MEASUREMENT VOPM_BrkPedSnsrPosVRsrvd_enum "VCU_D_Status_CHA" UBYTE AppSwcOpm_CM_uint8_enum 0 0 0.0 255.0 ECU_ADDRESS 0x0000 /* @ECU_Address@VOPM_BrkPedSnsrPosVRsrvd_enum@ */ /end MEASUREMENT
/begin MEASUREMENT VOPM_AccPedPosToESCSta_enum "VCU_D_Status_CHA" UBYTE AppSwcOpm_CM_uint8_enum 0 0 0.0 255.0 ECU_ADDRESS 0x0000 /* @ECU_Address@VOPM_AccPedPosToESCSta_enum@ */ /end MEASUREMENT
/begin MEASUREMENT VOPM_WghDistb_enum "VCU_DispInfo_BAC" UBYTE AppSwcOpm_CM_uint8_enum 0 0 0.0 255.0 ECU_ADDRESS 0x0000 /* @ECU_Address@VOPM_WghDistb_enum@ */ /end MEASUREMENT
/begin MEASUREMENT VOPM_VehActRecupPwr_pct "VCU_DispInfo_BAC" UBYTE AppSwcOpm_CM_uint8_pct 0 0 0.0 255.0 ECU_ADDRESS 0x0000 /* @ECU_Address@VOPM_VehActRecupPwr_pct@ */ /end MEASUREMENT
/begin MEASUREMENT VOPM_VehActDrvPwr_pct "VCU_DispInfo_BAC" UBYTE AppSwcOpm_CM_uint8_pct 0 0 0.0 255.0 ECU_ADDRESS 0x0000 /* @ECU_Address@VOPM_VehActDrvPwr_pct@ */ /end MEASUREMENT
/begin MEASUREMENT VOPM_VCUVerSetFb_enum "VCU_DispInfo_BAC" UBYTE AppSwcOpm_CM_uint8_enum 0 0 0.0 255.0 ECU_ADDRESS 0x0000 /* @ECU_Address@VOPM_VCUVerSetFb_enum@ */ /end MEASUREMENT
/begin MEASUREMENT VOPM_VCUSpdLimLvlSetFb_enum "VCU_DispInfo_BAC" UBYTE AppSwcOpm_CM_uint8_enum 0 0 0.0 255.0 ECU_ADDRESS 0x0000 /* @ECU_Address@VOPM_VCUSpdLimLvlSetFb_enum@ */ /end MEASUREMENT
/begin MEASUREMENT VOPM_VCUSpdLimLvlFb_enum "VCU_DispInfo_BAC" UBYTE AppSwcOpm_CM_uint8_enum 0 0 0.0 255.0 ECU_ADDRESS 0x0000 /* @ECU_Address@VOPM_VCUSpdLimLvlFb_enum@ */ /end MEASUREMENT
/begin MEASUREMENT VOPM_ShftKeyStgntn_enum "VCU_DispInfo_BAC" UBYTE AppSwcOpm_CM_uint8_enum 0 0 0.0 255.0 ECU_ADDRESS 0x0000 /* @ECU_Address@VOPM_ShftKeyStgntn_enum@ */ /end MEASUREMENT
/begin MEASUREMENT VOPM_SIBSRTCWUChgNum_cnt "VCU_DispInfo_BAC" UBYTE AppSwcOpm_CM_uint8_cnt 0 0 0.0 255.0 ECU_ADDRESS 0x0000 /* @ECU_Address@VOPM_SIBSRTCWUChgNum_cnt@ */ /end MEASUREMENT
/begin MEASUREMENT VOPM_SIBSRTCWUChgFailNum_cnt "VCU_DispInfo_BAC" UBYTE AppSwcOpm_CM_uint8_cnt 0 0 0.0 255.0 ECU_ADDRESS 0x0000 /* @ECU_Address@VOPM_SIBSRTCWUChgFailNum_cnt@ */ /end MEASUREMENT
/begin MEASUREMENT VOPM_MotActPwrTyp_enum "VCU_DispInfo_BAC" UBYTE AppSwcOpm_CM_uint8_enum 0 0 0.0 255.0 ECU_ADDRESS 0x0000 /* @ECU_Address@VOPM_MotActPwrTyp_enum@ */ /end MEASUREMENT
/begin MEASUREMENT VOPM_LckVehWrm_enum "VCU_DispInfo_BAC" UBYTE AppSwcOpm_CM_uint8_enum 0 0 0.0 255.0 ECU_ADDRESS 0x0000 /* @ECU_Address@VOPM_LckVehWrm_enum@ */ /end MEASUREMENT
/begin MEASUREMENT VOPM_InfoDisp_enum "VCU_DispInfo_BAC" UBYTE AppSwcOpm_CM_uint8_enum 0 0 0.0 255.0 ECU_ADDRESS 0x0000 /* @ECU_Address@VOPM_InfoDisp_enum@ */ /end MEASUREMENT
/begin MEASUREMENT VOPM_DrvMotorSta_enum "VCU_DispInfo_BAC" UBYTE AppSwcOpm_CM_uint8_enum 0 0 0.0 255.0 ECU_ADDRESS 0x0000 /* @ECU_Address@VOPM_DrvMotorSta_enum@ */ /end MEASUREMENT
/begin MEASUREMENT VOPM_DrvModeKeyStgntn_enum "VCU_DispInfo_BAC" UBYTE AppSwcOpm_CM_uint8_enum 0 0 0.0 255.0 ECU_ADDRESS 0x0000 /* @ECU_Address@VOPM_DrvModeKeyStgntn_enum@ */ /end MEASUREMENT
/begin MEASUREMENT VOPM_CruiseCtrlSta_enum "VCU_DispInfo_BAC" UBYTE AppSwcOpm_CM_uint8_enum 0 0 0.0 255.0 ECU_ADDRESS 0x0000 /* @ECU_Address@VOPM_CruiseCtrlSta_enum@ */ /end MEASUREMENT
/begin MEASUREMENT VOPM_CCURmtPwrLckFb_enum "VCU_DispInfo_BAC" UBYTE AppSwcOpm_CM_uint8_enum 0 0 0.0 255.0 ECU_ADDRESS 0x0000 /* @ECU_Address@VOPM_CCURmtPwrLckFb_enum@ */ /end MEASUREMENT
/begin MEASUREMENT VOPM_CCURmtLckFb_enum "VCU_DispInfo_BAC" UBYTE AppSwcOpm_CM_uint8_enum 0 0 0.0 255.0 ECU_ADDRESS 0x0000 /* @ECU_Address@VOPM_CCURmtLckFb_enum@ */ /end MEASUREMENT
/begin MEASUREMENT VOPM_CCURmtCarSearchFb_enum "VCU_DispInfo_BAC" UBYTE AppSwcOpm_CM_uint8_enum 0 0 0.0 255.0 ECU_ADDRESS 0x0000 /* @ECU_Address@VOPM_CCURmtCarSearchFb_enum@ */ /end MEASUREMENT
/begin MEASUREMENT VOPM_CCUOpenVentnFb_enum "VCU_DispInfo_BAC" UBYTE AppSwcOpm_CM_uint8_enum 0 0 0.0 255.0 ECU_ADDRESS 0x0000 /* @ECU_Address@VOPM_CCUOpenVentnFb_enum@ */ /end MEASUREMENT
/begin MEASUREMENT VOPM_CCKeyStgntn_enum "VCU_DispInfo_BAC" UBYTE AppSwcOpm_CM_uint8_enum 0 0 0.0 255.0 ECU_ADDRESS 0x0000 /* @ECU_Address@VOPM_CCKeyStgntn_enum@ */ /end MEASUREMENT
/begin MEASUREMENT VOPM_ACUnlckVentSetFB_enum "VCU_DispInfo_BAC" UBYTE AppSwcOpm_CM_uint8_enum 0 0 0.0 255.0 ECU_ADDRESS 0x0000 /* @ECU_Address@VOPM_ACUnlckVentSetFB_enum@ */ /end MEASUREMENT
/begin MEASUREMENT VOPM_ACTempSetFb_enum "VCU_DispInfo_BAC" UBYTE AppSwcOpm_CM_uint8_enum 0 0 0.0 255.0 ECU_ADDRESS 0x0000 /* @ECU_Address@VOPM_ACTempSetFb_enum@ */ /end MEASUREMENT
/begin MEASUREMENT VOPM_ACRmtDefrstCtlFb_enum "VCU_DispInfo_BAC" UBYTE AppSwcOpm_CM_uint8_enum 0 0 0.0 255.0 ECU_ADDRESS 0x0000 /* @ECU_Address@VOPM_ACRmtDefrstCtlFb_enum@ */ /end MEASUREMENT
/begin MEASUREMENT VOPM_ACRemtCtrlFb_enum "VCU_DispInfo_BAC" UBYTE AppSwcOpm_CM_uint8_enum 0 0 0.0 255.0 ECU_ADDRESS 0x0000 /* @ECU_Address@VOPM_ACRemtCtrlFb_enum@ */ /end MEASUREMENT
/begin MEASUREMENT VOPM_ACChrgMode_enum "VCU_DispInfo_BAC" UBYTE AppSwcOpm_CM_uint8_enum 0 0 0.0 255.0 ECU_ADDRESS 0x0000 /* @ECU_Address@VOPM_ACChrgMode_enum@ */ /end MEASUREMENT
/begin MEASUREMENT VOPM_ACChrgMaxCurr_A "VCU_DispInfo_BAC" UBYTE AppSwcOpm_CM_uint8_A 0 0 0.0 255.0 ECU_ADDRESS 0x0000 /* @ECU_Address@VOPM_ACChrgMaxCurr_A@ */ /end MEASUREMENT
/begin MEASUREMENT VOPM_AppSoftNumb_nu "VCU_0_Value_EPT" UBYTE AppSwcOpm_CM_uint8_nu 0 0 0.0 255.0 ECU_ADDRESS 0x0000 /* @ECU_Address@VOPM_AppSoftNumb_nu@ */ /end MEASUREMENT
/begin MEASUREMENT VOPM_PwrRecupMaxAvlbWhlTqSts_enum "VCU_10_Torque_CHA" UBYTE AppSwcOpm_CM_uint8_enum 0 0 0.0 255.0 ECU_ADDRESS 0x0000 /* @ECU_Address@VOPM_PwrRecupMaxAvlbWhlTqSts_enum@ */ /end MEASUREMENT
/begin MEASUREMENT VOPM_PwrRecupActlWhlTqSts_enum "VCU_10_Torque_CHA" UBYTE AppSwcOpm_CM_uint8_enum 0 0 0.0 255.0 ECU_ADDRESS 0x0000 /* @ECU_Address@VOPM_PwrRecupActlWhlTqSts_enum@ */ /end MEASUREMENT
/begin MEASUREMENT VOPM_OBCIntDchrgEna_flg "VCU_C_OprtCmd_EPT" UBYTE AppSwcOpm_CM_boolean_flg 0 0 0.0 1.0 ECU_ADDRESS 0x0000 /* @ECU_Address@VOPM_OBCIntDchrgEna_flg@ */ /end MEASUREMENT
/begin MEASUREMENT VOPM_ChrgEnaDC_flg "VCU_4_ChrgCmd_EPT" UBYTE AppSwcOpm_CM_boolean_flg 0 0 0.0 1.0 ECU_ADDRESS 0x0000 /* @ECU_Address@VOPM_ChrgEnaDC_flg@ */ /end MEASUREMENT
/begin MEASUREMENT VOPM_Bat2DrvTrainEnb_flg "VCU_3_OprtCmd_EPT" UBYTE AppSwcOpm_CM_boolean_flg 0 0 0.0 1.0 ECU_ADDRESS 0x0000 /* @ECU_Address@VOPM_Bat2DrvTrainEnb_flg@ */ /end MEASUREMENT
/begin MEASUREMENT VOPM_VCUReqEPBVld_flg "VCU_D_Status_CHA" UBYTE AppSwcOpm_CM_boolean_flg 0 0 0.0 1.0 ECU_ADDRESS 0x0000 /* @ECU_Address@VOPM_VCUReqEPBVld_flg@ */ /end MEASUREMENT
/begin MEASUREMENT VOPM_VCUPreKeReq_flg "VCU_D_Status_CHA" UBYTE AppSwcOpm_CM_boolean_flg 0 0 0.0 1.0 ECU_ADDRESS 0x0000 /* @ECU_Address@VOPM_VCUPreKeReq_flg@ */ /end MEASUREMENT
/begin MEASUREMENT VOPM_VCUParkSwSta_flg "VCU_D_Status_CHA" UBYTE AppSwcOpm_CM_boolean_flg 0 0 0.0 1.0 ECU_ADDRESS 0x0000 /* @ECU_Address@VOPM_VCUParkSwSta_flg@ */ /end MEASUREMENT
/begin MEASUREMENT VOPM_VCUParkSwStaVld_flg "VCU_D_Status_CHA" UBYTE AppSwcOpm_CM_boolean_flg 0 0 0.0 1.0 ECU_ADDRESS 0x0000 /* @ECU_Address@VOPM_VCUParkSwStaVld_flg@ */ /end MEASUREMENT
/begin MEASUREMENT VOPM_VCUAccTgtAxReq_flg "VCU_D_Status_CHA" UBYTE AppSwcOpm_CM_boolean_flg 0 0 0.0 1.0 ECU_ADDRESS 0x0000 /* @ECU_Address@VOPM_VCUAccTgtAxReq_flg@ */ /end MEASUREMENT
/begin MEASUREMENT VOPM_VCUACCStandstillReq_flg "VCU_D_Status_CHA" UBYTE AppSwcOpm_CM_boolean_flg 0 0 0.0 1.0 ECU_ADDRESS 0x0000 /* @ECU_Address@VOPM_VCUACCStandstillReq_flg@ */ /end MEASUREMENT
/begin MEASUREMENT VOPM_StrgRecupReqBrkLampOn_flg "VCU_D_Status_CHA" UBYTE AppSwcOpm_CM_boolean_flg 0 0 0.0 1.0 ECU_ADDRESS 0x0000 /* @ECU_Address@VOPM_StrgRecupReqBrkLampOn_flg@ */ /end MEASUREMENT
/begin MEASUREMENT VOPM_OTAModeSts_flg "VCU_D_Status_CHA" UBYTE AppSwcOpm_CM_boolean_flg 0 0 0.0 1.0 ECU_ADDRESS 0x0000 /* @ECU_Address@VOPM_OTAModeSts_flg@ */ /end MEASUREMENT
/begin MEASUREMENT VOPM_GearShiftInhibited_flg "VCU_D_Status_CHA" UBYTE AppSwcOpm_CM_boolean_flg 0 0 0.0 1.0 ECU_ADDRESS 0x0000 /* @ECU_Address@VOPM_GearShiftInhibited_flg@ */ /end MEASUREMENT
/begin MEASUREMENT VOPM_DrvReqTorqOvrdESC_flg "VCU_D_Status_CHA" UBYTE AppSwcOpm_CM_boolean_flg 0 0 0.0 1.0 ECU_ADDRESS 0x0000 /* @ECU_Address@VOPM_DrvReqTorqOvrdESC_flg@ */ /end MEASUREMENT
/begin MEASUREMENT VOPM_DrvReqTorqOverrideFCM_flg "VCU_D_Status_CHA" UBYTE AppSwcOpm_CM_boolean_flg 0 0 0.0 1.0 ECU_ADDRESS 0x0000 /* @ECU_Address@VOPM_DrvReqTorqOverrideFCM_flg@ */ /end MEASUREMENT
/begin MEASUREMENT VOPM_ACCTrqCtrlAvl_flg "VCU_D_Status_CHA" UBYTE AppSwcOpm_CM_boolean_flg 0 0 0.0 1.0 ECU_ADDRESS 0x0000 /* @ECU_Address@VOPM_ACCTrqCtrlAvl_flg@ */ /end MEASUREMENT
/begin MEASUREMENT VOPM_WghConfdence_flg "VCU_DispInfo_BAC" UBYTE AppSwcOpm_CM_boolean_flg 0 0 0.0 1.0 ECU_ADDRESS 0x0000 /* @ECU_Address@VOPM_WghConfdence_flg@ */ /end MEASUREMENT
/begin MEASUREMENT VOPM_WLTPDrvgRngDstVld_flg "VCU_DispInfo_BAC" UBYTE AppSwcOpm_CM_boolean_flg 0 0 0.0 1.0 ECU_ADDRESS 0x0000 /* @ECU_Address@VOPM_WLTPDrvgRngDstVld_flg@ */ /end MEASUREMENT
/begin MEASUREMENT VOPM_VhclSpdFstWarn_flg "VCU_DispInfo_BAC" UBYTE AppSwcOpm_CM_boolean_flg 0 0 0.0 1.0 ECU_ADDRESS 0x0000 /* @ECU_Address@VOPM_VhclSpdFstWarn_flg@ */ /end MEASUREMENT
/begin MEASUREMENT VOPM_VehPGearError_flg "VCU_DispInfo_BAC" UBYTE AppSwcOpm_CM_boolean_flg 0 0 0.0 1.0 ECU_ADDRESS 0x0000 /* @ECU_Address@VOPM_VehPGearError_flg@ */ /end MEASUREMENT
/begin MEASUREMENT VOPM_VCUVerFb_flg "VCU_DispInfo_BAC" UBYTE AppSwcOpm_CM_boolean_flg 0 0 0.0 1.0 ECU_ADDRESS 0x0000 /* @ECU_Address@VOPM_VCUVerFb_flg@ */ /end MEASUREMENT
/begin MEASUREMENT VOPM_VCUOprtLicFb_flg "VCU_DispInfo_BAC" UBYTE AppSwcOpm_CM_boolean_flg 0 0 0.0 1.0 ECU_ADDRESS 0x0000 /* @ECU_Address@VOPM_VCUOprtLicFb_flg@ */ /end MEASUREMENT
/begin MEASUREMENT VOPM_SIBSWupVoltAllow_flg "VCU_DispInfo_BAC" UBYTE AppSwcOpm_CM_boolean_flg 0 0 0.0 1.0 ECU_ADDRESS 0x0000 /* @ECU_Address@VOPM_SIBSWupVoltAllow_flg@ */ /end MEASUREMENT
/begin MEASUREMENT VOPM_SIBSFbRTCWupFlg_flg "VCU_DispInfo_BAC" UBYTE AppSwcOpm_CM_boolean_flg 0 0 0.0 1.0 ECU_ADDRESS 0x0000 /* @ECU_Address@VOPM_SIBSFbRTCWupFlg_flg@ */ /end MEASUREMENT
/begin MEASUREMENT VOPM_SIBSChgNumAllow_flg "VCU_DispInfo_BAC" UBYTE AppSwcOpm_CM_boolean_flg 0 0 0.0 1.0 ECU_ADDRESS 0x0000 /* @ECU_Address@VOPM_SIBSChgNumAllow_flg@ */ /end MEASUREMENT
/begin MEASUREMENT VOPM_SIBSBMSBatSOCAllow_flg "VCU_DispInfo_BAC" UBYTE AppSwcOpm_CM_boolean_flg 0 0 0.0 1.0 ECU_ADDRESS 0x0000 /* @ECU_Address@VOPM_SIBSBMSBatSOCAllow_flg@ */ /end MEASUREMENT
/begin MEASUREMENT VOPM_MotorHiTempWrning_flg "VCU_DispInfo_BAC" UBYTE AppSwcOpm_CM_boolean_flg 0 0 0.0 1.0 ECU_ADDRESS 0x0000 /* @ECU_Address@VOPM_MotorHiTempWrning_flg@ */ /end MEASUREMENT
/begin MEASUREMENT VOPM_MCUHiTempWrning_flg "VCU_DispInfo_BAC" UBYTE AppSwcOpm_CM_boolean_flg 0 0 0.0 1.0 ECU_ADDRESS 0x0000 /* @ECU_Address@VOPM_MCUHiTempWrning_flg@ */ /end MEASUREMENT
/begin MEASUREMENT VOPM_DrvRangeDistEstVld_flg "VCU_DispInfo_BAC" UBYTE AppSwcOpm_CM_boolean_flg 0 0 0.0 1.0 ECU_ADDRESS 0x0000 /* @ECU_Address@VOPM_DrvRangeDistEstVld_flg@ */ /end MEASUREMENT
/begin MEASUREMENT VOPM_BCMIllmndUnlckStsFb_flg "VCU_DispInfo_BAC" UBYTE AppSwcOpm_CM_boolean_flg 0 0 0.0 1.0 ECU_ADDRESS 0x0000 /* @ECU_Address@VOPM_BCMIllmndUnlckStsFb_flg@ */ /end MEASUREMENT
/begin MEASUREMENT VOPM_BCMIllmndLckStsFb_flg "VCU_DispInfo_BAC" UBYTE AppSwcOpm_CM_boolean_flg 0 0 0.0 1.0 ECU_ADDRESS 0x0000 /* @ECU_Address@VOPM_BCMIllmndLckStsFb_flg@ */ /end MEASUREMENT
/begin MEASUREMENT VOPM_EnaInvRun_flg "VCU_1_InvCmd_EPT" UBYTE AppSwcOpm_CM_boolean_flg 0 0 0.0 1.0 ECU_ADDRESS 0x0000 /* @ECU_Address@VOPM_EnaInvRun_flg@ */ /end MEASUREMENT
/begin MEASUREMENT VOPM_EnaDisChg_flg "VCU_1_InvCmd_EPT" UBYTE AppSwcOpm_CM_boolean_flg 0 0 0.0 1.0 ECU_ADDRESS 0x0000 /* @ECU_Address@VOPM_EnaDisChg_flg@ */ /end MEASUREMENT
/begin MEASUREMENT VOPM_EmgcySdn_flg "VCU_1_InvCmd_EPT" UBYTE AppSwcOpm_CM_boolean_flg 0 0 0.0 1.0 ECU_ADDRESS 0x0000 /* @ECU_Address@VOPM_EmgcySdn_flg@ */ /end MEASUREMENT
/begin MEASUREMENT VOPM_Zdznswi_flg "VCU_0_Value_EPT" UBYTE AppSwcOpm_CM_boolean_flg 0 0 0.0 1.0 ECU_ADDRESS 0x0000 /* @ECU_Address@VOPM_Zdznswi_flg@ */ /end MEASUREMENT
/begin MEASUREMENT VOPM_DrvSwi_flg "VCU_0_Value_EPT" UBYTE AppSwcOpm_CM_boolean_flg 0 0 0.0 1.0 ECU_ADDRESS 0x0000 /* @ECU_Address@VOPM_DrvSwi_flg@ */ /end MEASUREMENT
/begin MEASUREMENT VOPM_BraSwi_flg "VCU_0_Value_EPT" UBYTE AppSwcOpm_CM_boolean_flg 0 0 0.0 1.0 ECU_ADDRESS 0x0000 /* @ECU_Address@VOPM_BraSwi_flg@ */ /end MEASUREMENT
/begin MEASUREMENT VOPM_VCUVehSpdFastWarn_flg "VCU_10_Torque_CHA" UBYTE AppSwcOpm_CM_boolean_flg 0 0 0.0 1.0 ECU_ADDRESS 0x0000 /* @ECU_Address@VOPM_VCUVehSpdFastWarn_flg@ */ /end MEASUREMENT
/begin MEASUREMENT VOPM_VCUEnaEHBBrkRun_flg "VCU_10_Torque_CHA" UBYTE AppSwcOpm_CM_boolean_flg 0 0 0.0 1.0 ECU_ADDRESS 0x0000 /* @ECU_Address@VOPM_VCUEnaEHBBrkRun_flg@ */ /end MEASUREMENT
/begin MEASUREMENT VOPM_VCUAccReqStandstill_flg "VCU_10_Torque_CHA" UBYTE AppSwcOpm_CM_boolean_flg 0 0 0.0 1.0 ECU_ADDRESS 0x0000 /* @ECU_Address@VOPM_VCUAccReqStandstill_flg@ */ /end MEASUREMENT
/begin MEASUREMENT VOPM_VCUAccReqDrvOff_flg "VCU_10_Torque_CHA" UBYTE AppSwcOpm_CM_boolean_flg 0 0 0.0 1.0 ECU_ADDRESS 0x0000 /* @ECU_Address@VOPM_VCUAccReqDrvOff_flg@ */ /end MEASUREMENT
/begin MEASUREMENT VOPM_DrvReqWhlTqVld_flg "VCU_10_Torque_CHA" UBYTE AppSwcOpm_CM_boolean_flg 0 0 0.0 1.0 ECU_ADDRESS 0x0000 /* @ECU_Address@VOPM_DrvReqWhlTqVld_flg@ */ /end MEASUREMENT
/begin MEASUREMENT VOPM_DrvReqMotorTorqVld_flg "VCU_10_Torque_CHA" UBYTE AppSwcOpm_CM_boolean_flg 0 0 0.0 1.0 ECU_ADDRESS 0x0000 /* @ECU_Address@VOPM_DrvReqMotorTorqVld_flg@ */ /end MEASUREMENT
/begin MEASUREMENT VOPM_VehTrgtGearPos_enum "VCU_1_InvCmd_EPT" UBYTE AppSwcOpm_CM_EnumTgtGearPstn 0 0 0 4 ECU_ADDRESS 0x0000 /* @ECU_Address@VOPM_VehTrgtGearPos_enum@ */ /end MEASUREMENT
/begin MEASUREMENT VOPM_OBCOprtCmd_enum "VCU_4_ChrgCmd_EPT" UBYTE AppSwcOpm_CM_EnumOBCOprtCmd 0 0 0 6 ECU_ADDRESS 0x0000 /* @ECU_Address@VOPM_OBCOprtCmd_enum@ */ /end MEASUREMENT
/begin MEASUREMENT VOPM_OBCOprtCmdToICU_enum "VCU_DispInfo_BAC" UBYTE AppSwcOpm_CM_EnumOBCOprtCmd 0 0 0 6 ECU_ADDRESS 0x0000 /* @ECU_Address@VOPM_OBCOprtCmdToICU_enum@ */ /end MEASUREMENT
/begin MEASUREMENT VOPM_MotModeReq_enum "VCU_1_InvCmd_EPT" UBYTE AppSwcOpm_CM_EnumMotorModeReq 0 0 0 2 ECU_ADDRESS 0x0000 /* @ECU_Address@VOPM_MotModeReq_enum@ */ /end MEASUREMENT
/begin MEASUREMENT VOPM_MotDirReq_enum "VCU_1_InvCmd_EPT" UBYTE AppSwcOpm_CM_EnumMotorDirReq 0 0 0 3 ECU_ADDRESS 0x0000 /* @ECU_Address@VOPM_MotDirReq_enum@ */ /end MEASUREMENT
/begin MEASUREMENT VOPM_SIBSRTCChrgSt_enum "VCU_DispInfo_BAC" UBYTE AppSwcOpm_CM_EnumIBSChrgSt 0 0 0 3 ECU_ADDRESS 0x0000 /* @ECU_Address@VOPM_SIBSRTCChrgSt_enum@ */ /end MEASUREMENT
/begin MEASUREMENT VOPM_VCUReqEPB_enum "VCU_D_Status_CHA" UBYTE AppSwcOpm_CM_EnumEPBReq 0 0 0 2 ECU_ADDRESS 0x0000 /* @ECU_Address@VOPM_VCUReqEPB_enum@ */ /end MEASUREMENT
/begin MEASUREMENT VOPM_DCCOprtCmd_enum "VCU_B_AcclPedal_EPT" UBYTE AppSwcOpm_CM_EnumDCCOprtCmd 0 0 0 4 ECU_ADDRESS 0x0000 /* @ECU_Address@VOPM_DCCOprtCmd_enum@ */ /end MEASUREMENT
/begin MEASUREMENT VOPM_VCUCruiseCtrlSta_enum "VCU_D_Status_CHA" UBYTE AppSwcOpm_CM_EnumCruiseStatus 0 0 0 6 ECU_ADDRESS 0x0000 /* @ECU_Address@VOPM_VCUCruiseCtrlSta_enum@ */ /end MEASUREMENT
/begin MEASUREMENT VOPM_ChrgEnaAC_enum "VCU_3_OprtCmd_EPT" UBYTE AppSwcOpm_CM_EnumChrgEnaAC 0 0 0 3 ECU_ADDRESS 0x0000 /* @ECU_Address@VOPM_ChrgEnaAC_enum@ */ /end MEASUREMENT
/begin MEASUREMENT VOPM_ChrgAllowCmd_enum "VCU_4_ChrgCmd_EPT" UBYTE AppSwcOpm_CM_EnumChrgAllwCmd 0 0 0 3 ECU_ADDRESS 0x0000 /* @ECU_Address@VOPM_ChrgAllowCmd_enum@ */ /end MEASUREMENT
/begin MEASUREMENT VOPM_BMSWakeupMode_enum "VCU_3_OprtCmd_EPT" UBYTE AppSwcOpm_CM_EnumBMSWakeUpMd 0 0 0 3 ECU_ADDRESS 0x0000 /* @ECU_Address@VOPM_BMSWakeupMode_enum@ */ /end MEASUREMENT
/begin MEASUREMENT VOPM_BMSShutdown_enum "VCU_4_ChrgCmd_EPT" UBYTE AppSwcOpm_CM_EnumBMSSdnCmd 0 0 0 3 ECU_ADDRESS 0x0000 /* @ECU_Address@VOPM_BMSShutdown_enum@ */ /end MEASUREMENT
/begin MEASUREMENT VOPM_AccPedPosSnsrSta_enum "VCU_D_Status_CHA" UBYTE AppSwcOpm_CM_EnumAccPedSnsrSt 0 0 0 3 ECU_ADDRESS 0x0000 /* @ECU_Address@VOPM_AccPedPosSnsrSta_enum@ */ /end MEASUREMENT
/begin COMPU_METHOD AppSwcOpm_CM_single_kW "Q = V" RAT_FUNC "%8.6" "kW" COEFFS 0 1 0 0 0 1 /end COMPU_METHOD
/begin COMPU_METHOD AppSwcOpm_CM_single_rpm "Q = V" RAT_FUNC "%8.6" "rpm" COEFFS 0 1 0 0 0 1 /end COMPU_METHOD
/begin COMPU_METHOD AppSwcOpm_CM_single_C "Q = V" RAT_FUNC "%8.6" "C" COEFFS 0 1 0 0 0 1 /end COMPU_METHOD
/begin COMPU_METHOD AppSwcOpm_CM_single_pct "Q = V" RAT_FUNC "%8.6" "pct" COEFFS 0 1 0 0 0 1 /end COMPU_METHOD
/begin COMPU_METHOD AppSwcOpm_CM_single_Nm "Q = V" RAT_FUNC "%8.6" "Nm" COEFFS 0 1 0 0 0 1 /end COMPU_METHOD
/begin COMPU_METHOD AppSwcOpm_CM_single_kph "Q = V" RAT_FUNC "%8.6" "kph" COEFFS 0 1 0 0 0 1 /end COMPU_METHOD
/begin COMPU_METHOD AppSwcOpm_CM_single_V "Q = V" RAT_FUNC "%8.6" "V" COEFFS 0 1 0 0 0 1 /end COMPU_METHOD
/begin COMPU_METHOD AppSwcOpm_CM_single_km "Q = V" RAT_FUNC "%8.6" "km" COEFFS 0 1 0 0 0 1 /end COMPU_METHOD
/begin COMPU_METHOD AppSwcOpm_CM_single_A "Q = V" RAT_FUNC "%8.6" "A" COEFFS 0 1 0 0 0 1 /end COMPU_METHOD
/begin COMPU_METHOD AppSwcOpm_CM_single_mps2 "Q = V" RAT_FUNC "%8.6" "mps2" COEFFS 0 1 0 0 0 1 /end COMPU_METHOD
/begin COMPU_METHOD AppSwcOpm_CM_single_Bar "Q = V" RAT_FUNC "%8.6" "Bar" COEFFS 0 1 0 0 0 1 /end COMPU_METHOD
/begin COMPU_METHOD AppSwcOpm_CM_single_kWh "Q = V" RAT_FUNC "%8.6" "kWh" COEFFS 0 1 0 0 0 1 /end COMPU_METHOD
/begin COMPU_METHOD AppSwcOpm_CM_single_kg "Q = V" RAT_FUNC "%8.6" "kg" COEFFS 0 1 0 0 0 1 /end COMPU_METHOD
/begin COMPU_METHOD AppSwcOpm_CM_uint16_nu "Q = V" RAT_FUNC "%5.0" "nu" COEFFS 0 1 0 0 0 1 /end COMPU_METHOD
/begin COMPU_METHOD AppSwcOpm_CM_EnumAccPedSnsrSt "Enumerated data type: EnumAccPedSnsrSt" TAB_VERB "%0.6" "" COMPU_TAB_REF VTAB_FOR_AppSwcOpm_CM_EnumAccPedSnsrSt /end COMPU_METHOD
/begin COMPU_VTAB VTAB_FOR_AppSwcOpm_CM_EnumAccPedSnsrSt "Enumerated data type: EnumAccPedSnsrSt" TAB_VERB 4 0 "EnumAccPedSnsrSt_Invalid" 1 "EnumAccPedSnsrSt_Normal" 2 "EnumAccPedSnsrSt_Estimated" 3 "EnumAccPedSnsrSt_Faulty" /end COMPU_VTAB
/begin COMPU_METHOD AppSwcOpm_CM_EnumBMSSdnCmd "Enumerated data type: EnumBMSSdnCmd" TAB_VERB "%0.6" "" COMPU_TAB_REF VTAB_FOR_AppSwcOpm_CM_EnumBMSSdnCmd /end COMPU_METHOD
/begin COMPU_VTAB VTAB_FOR_AppSwcOpm_CM_EnumBMSSdnCmd "Enumerated data type: EnumBMSSdnCmd" TAB_VERB 4 0 "EnumBMSSdnCmd_Normal" 1 "EnumBMSSdnCmd_Shutdwn" 2 "EnumBMSSdnCmd_EmgcySdn" 3 "EnumBMSSdnCmd_Rsrvd" /end COMPU_VTAB
/begin COMPU_METHOD AppSwcOpm_CM_EnumBMSWakeUpMd "Enumerated data type: EnumBMSWakeUpMd" TAB_VERB "%0.6" "" COMPU_TAB_REF VTAB_FOR_AppSwcOpm_CM_EnumBMSWakeUpMd /end COMPU_METHOD
/begin COMPU_VTAB VTAB_FOR_AppSwcOpm_CM_EnumBMSWakeUpMd "Enumerated data type: EnumBMSWakeUpMd" TAB_VERB 4 0 "EnumBMSWakeUpMd_Invld" 1 "EnumBMSWakeUpMd_ACChrg" 2 "EnumBMSWakeUpMd_ACDcha" 3 "EnumBMSWakeUpMd_DisChrg" /end COMPU_VTAB
/begin COMPU_METHOD AppSwcOpm_CM_EnumChrgAllwCmd "Enumerated data type: EnumChrgAllwCmd" TAB_VERB "%0.6" "" COMPU_TAB_REF VTAB_FOR_AppSwcOpm_CM_EnumChrgAllwCmd /end COMPU_METHOD
/begin COMPU_VTAB VTAB_FOR_AppSwcOpm_CM_EnumChrgAllwCmd "Enumerated data type: EnumChrgAllwCmd" TAB_VERB 4 0 "EnumChrgAllwCmd_NotAllwd" 1 "EnumChrgAllwCmd_DCChrg" 2 "EnumChrgAllwCmd_ACChrg" 3 "EnumChrgAllwCmd_ACDcha" /end COMPU_VTAB
/begin COMPU_METHOD AppSwcOpm_CM_EnumChrgEnaAC "Enumerated data type: EnumChrgEnaAC" TAB_VERB "%0.6" "" COMPU_TAB_REF VTAB_FOR_AppSwcOpm_CM_EnumChrgEnaAC /end COMPU_METHOD
/begin COMPU_VTAB VTAB_FOR_AppSwcOpm_CM_EnumChrgEnaAC "Enumerated data type: EnumChrgEnaAC" TAB_VERB 4 0 "EnumChrgEnaAC_Disable" 1 "EnumChrgEnaAC_ChrgEnbl" 2 "EnumChrgEnaAC_DchaEnbl" 3 "EnumChrgEnaAC_Rsrvd" /end COMPU_VTAB
/begin COMPU_METHOD AppSwcOpm_CM_EnumCruiseStatus "Enumerated data type: EnumCruiseStatus" TAB_VERB "%0.6" "" COMPU_TAB_REF VTAB_FOR_AppSwcOpm_CM_EnumCruiseStatus /end COMPU_METHOD
/begin COMPU_VTAB VTAB_FOR_AppSwcOpm_CM_EnumCruiseStatus "Enumerated data type: EnumCruiseStatus" TAB_VERB 7 0 "EnumCruiseStatus_NormOff" 1 "EnumCruiseStatus_ErrOff" 2 "EnumCruiseStatus_OutRngStby" 3 "EnumCruiseStatus_NormStby" 4 "EnumCruiseStatus_NormActv" 5 "EnumCruiseStatus_OvrdActv" 6 "EnumCruiseStatus_SpdLmt" /end COMPU_VTAB
/begin COMPU_METHOD AppSwcOpm_CM_EnumDCCOprtCmd "Enumerated data type: EnumDCCOprtCmd" TAB_VERB "%0.6" "" COMPU_TAB_REF VTAB_FOR_AppSwcOpm_CM_EnumDCCOprtCmd /end COMPU_METHOD
/begin COMPU_VTAB VTAB_FOR_AppSwcOpm_CM_EnumDCCOprtCmd "Enumerated data type: EnumDCCOprtCmd" TAB_VERB 4 4 "EnumDCCOprtCmd_Off" 0 "EnumDCCOprtCmd_Standby" 2 "EnumDCCOprtCmd_Buck" 3 "EnumDCCOprtCmd_Boost" /end COMPU_VTAB
/begin COMPU_METHOD AppSwcOpm_CM_EnumEPBReq "Enumerated data type: EnumEPBReq" TAB_VERB "%0.6" "" COMPU_TAB_REF VTAB_FOR_AppSwcOpm_CM_EnumEPBReq /end COMPU_METHOD
/begin COMPU_VTAB VTAB_FOR_AppSwcOpm_CM_EnumEPBReq "Enumerated data type: EnumEPBReq" TAB_VERB 3 0 "EnumEPBReq_NoCmd" 1 "EnumEPBReq_Apply" 2 "EnumEPBReq_Release" /end COMPU_VTAB
/begin COMPU_METHOD AppSwcOpm_CM_EnumIBSChrgSt "Enumerated data type: EnumIBSChrgSt" TAB_VERB "%0.6" "" COMPU_TAB_REF VTAB_FOR_AppSwcOpm_CM_EnumIBSChrgSt /end COMPU_METHOD
/begin COMPU_VTAB VTAB_FOR_AppSwcOpm_CM_EnumIBSChrgSt "Enumerated data type: EnumIBSChrgSt" TAB_VERB 4 0 "EnumIBSChrgSt_Idle" 1 "EnumIBSChrgSt_Charging" 2 "EnumIBSChrgSt_ChrgCmpld" 3 "EnumIBSChrgSt_Fail" /end COMPU_VTAB
/begin COMPU_METHOD AppSwcOpm_CM_EnumMotorDirReq "Enumerated data type: EnumMotorDirReq" TAB_VERB "%0.6" "" COMPU_TAB_REF VTAB_FOR_AppSwcOpm_CM_EnumMotorDirReq /end COMPU_METHOD
/begin COMPU_VTAB VTAB_FOR_AppSwcOpm_CM_EnumMotorDirReq "Enumerated data type: EnumMotorDirReq" TAB_VERB 4 0 "EnumMotorDirReq_Stdby" 1 "EnumMotorDirReq_Forward" 2 "EnumMotorDirReq_Reverse" 3 "EnumMotorDirReq_Invalid" /end COMPU_VTAB
/begin COMPU_METHOD AppSwcOpm_CM_EnumMotorModeReq "Enumerated data type: EnumMotorModeReq" TAB_VERB "%0.6" "" COMPU_TAB_REF VTAB_FOR_AppSwcOpm_CM_EnumMotorModeReq /end COMPU_METHOD
/begin COMPU_VTAB VTAB_FOR_AppSwcOpm_CM_EnumMotorModeReq "Enumerated data type: EnumMotorModeReq" TAB_VERB 3 0 "EnumMotorModeReq_Stdby" 1 "EnumMotorModeReq_TqCtrl" 2 "EnumMotorModeReq_SpdCtrl" /end COMPU_VTAB
/begin COMPU_METHOD AppSwcOpm_CM_EnumOBCOprtCmd "Enumerated data type: EnumOBCOprtCmd" TAB_VERB "%0.6" "" COMPU_TAB_REF VTAB_FOR_AppSwcOpm_CM_EnumOBCOprtCmd /end COMPU_METHOD
/begin COMPU_VTAB VTAB_FOR_AppSwcOpm_CM_EnumOBCOprtCmd "Enumerated data type: EnumOBCOprtCmd" TAB_VERB 7 0 "EnumOBCOprtCmd_Standby" 1 "EnumOBCOprtCmd_Charge" 2 "EnumOBCOprtCmd_Rsrvd" 3 "EnumOBCOprtCmd_ChrgCmpl" 4 "EnumOBCOprtCmd_Discharge" 5 "EnumOBCOprtCmd_DchaCmpl" 6 "EnumOBCOprtCmd_ChrgAftOTA" /end COMPU_VTAB
/begin COMPU_METHOD AppSwcOpm_CM_EnumTgtGearPstn "Enumerated data type: EnumTgtGearPstn" TAB_VERB "%0.6" "" COMPU_TAB_REF VTAB_FOR_AppSwcOpm_CM_EnumTgtGearPstn /end COMPU_METHOD
/begin COMPU_VTAB VTAB_FOR_AppSwcOpm_CM_EnumTgtGearPstn "Enumerated data type: EnumTgtGearPstn" TAB_VERB 5 0 "EnumTgtGearPstn_NoReq" 1 "EnumTgtGearPstn_P" 2 "EnumTgtGearPstn_N" 3 "EnumTgtGearPstn_D" 4 "EnumTgtGearPstn_R" /end COMPU_VTAB
/begin COMPU_METHOD AppSwcOpm_CM_boolean_flg "Q = V" RAT_FUNC "%1.0" "flg" COEFFS 0 1 0 0 0 1 /end COMPU_METHOD
/begin COMPU_METHOD AppSwcOpm_CM_uint8_enum "Q = V" RAT_FUNC "%3.0" "enum" COEFFS 0 1 0 0 0 1 /end COMPU_METHOD
/begin COMPU_METHOD AppSwcOpm_CM_uint8_A "Q = V" RAT_FUNC "%3.0" "A" COEFFS 0 1 0 0 0 1 /end COMPU_METHOD
/begin COMPU_METHOD AppSwcOpm_CM_uint8_pct "Q = V" RAT_FUNC "%3.0" "pct" COEFFS 0 1 0 0 0 1 /end COMPU_METHOD
/begin COMPU_METHOD AppSwcOpm_CM_uint8_nu "Q = V" RAT_FUNC "%3.0" "nu" COEFFS 0 1 0 0 0 1 /end COMPU_METHOD
/begin COMPU_METHOD AppSwcOpm_CM_uint8_cnt "Q = V" RAT_FUNC "%3.0" "cnt" COEFFS 0 1 0 0 0 1 /end COMPU_METHOD
/begin GROUP S156_Subsys_VOPM_DrvReqMotorTorqVld_flg "AppSwcOpm/Opm10ms/CHACAN_OUT_10ms/Msg_VCU_10_Torque_CHA/Subsys_VOPM_DrvReqMotorTorqVld_flg"
 /begin REF_CHARACTERISTIC KOPM_DrvReqMotorTorqVld_flg_ovrdflg KOPM_DrvReqMotorTorqVld_flg_ovrdval /end REF_CHARACTERISTIC
 /begin REF_MEASUREMENT VOPM_DrvReqMotorTorqVld_flg /end REF_MEASUREMENT
/end GROUP
/begin GROUP S156_Subsys_VOPM_DrvReqMotorTorq_Nm "AppSwcOpm/Opm10ms/CHACAN_OUT_10ms/Msg_VCU_10_Torque_CHA/Subsys_VOPM_DrvReqMotorTorq_Nm"
 /begin REF_CHARACTERISTIC KOPM_DrvReqMotorTorqHi_Nm KOPM_DrvReqMotorTorqLo_Nm KOPM_DrvReqMotorTorq_Nm_ovrdflg KOPM_DrvReqMotorTorq_Nm_ovrdval /end REF_CHARACTERISTIC
 /begin REF_MEASUREMENT VOPM_DrvReqMotorTorq_Nm /end REF_MEASUREMENT
/end GROUP
/begin GROUP S156_Subsys_VOPM_DrvReqWhlTqVld_flg "AppSwcOpm/Opm10ms/CHACAN_OUT_10ms/Msg_VCU_10_Torque_CHA/Subsys_VOPM_DrvReqWhlTqVld_flg"
 /begin REF_CHARACTERISTIC KOPM_DrvReqWhlTqVld_flg_ovrdflg KOPM_DrvReqWhlTqVld_flg_ovrdval /end REF_CHARACTERISTIC
 /begin REF_MEASUREMENT VOPM_DrvReqWhlTqVld_flg /end REF_MEASUREMENT
/end GROUP
/begin GROUP S156_Subsys_VOPM_DrvReqWhlTq_Nm "AppSwcOpm/Opm10ms/CHACAN_OUT_10ms/Msg_VCU_10_Torque_CHA/Subsys_VOPM_DrvReqWhlTq_Nm"
 /begin REF_CHARACTERISTIC KOPM_DrvReqWhlTqHi_Nm KOPM_DrvReqWhlTqLo_Nm KOPM_DrvReqWhlTq_Nm_ovrdflg KOPM_DrvReqWhlTq_Nm_ovrdval /end REF_CHARACTERISTIC
 /begin REF_MEASUREMENT VOPM_DrvReqWhlTq_Nm /end REF_MEASUREMENT
/end GROUP
/begin GROUP S156_Subsys_VOPM_DrvWhlTqAllwdMax_Nm "AppSwcOpm/Opm10ms/CHACAN_OUT_10ms/Msg_VCU_10_Torque_CHA/Subsys_VOPM_DrvWhlTqAllwdMax_Nm"
 /begin REF_CHARACTERISTIC KOPM_DrvWhlTqAllwdMaxHi_Nm KOPM_DrvWhlTqAllwdMaxLo_Nm KOPM_DrvWhlTqAllwdMax_Nm_ovrdflg KOPM_DrvWhlTqAllwdMax_Nm_ovrdval /end REF_CHARACTERISTIC
 /begin REF_MEASUREMENT VOPM_DrvWhlTqAllwdMax_Nm /end REF_MEASUREMENT
/end GROUP
/begin GROUP S156_Subsys_VOPM_PwrRecupActWhlTq_Nm "AppSwcOpm/Opm10ms/CHACAN_OUT_10ms/Msg_VCU_10_Torque_CHA/Subsys_VOPM_PwrRecupActWhlTq_Nm"
 /begin REF_CHARACTERISTIC KOPM_PwrRecupActWhlTqHi_Nm KOPM_PwrRecupActWhlTqLo_Nm KOPM_PwrRecupActWhlTq_Nm_ovrdflg KOPM_PwrRecupActWhlTq_Nm_ovrdval /end REF_CHARACTERISTIC
 /begin REF_MEASUREMENT VOPM_PwrRecupActWhlTq_Nm /end REF_MEASUREMENT
/end GROUP
/begin GROUP S156_Subsys_VOPM_PwrRecupActlWhlTqSts_enum "AppSwcOpm/Opm10ms/CHACAN_OUT_10ms/Msg_VCU_10_Torque_CHA/Subsys_VOPM_PwrRecupActlWhlTqSts_enum"
 /begin REF_CHARACTERISTIC KOPM_PwrRecupActlWhlTqStsHi_enum KOPM_PwrRecupActlWhlTqStsLo_enum KOPM_PwrRecupActlWhlTqSts_enum_ovrdflg KOPM_PwrRecupActlWhlTqSts_enum_ovrdval /end REF_CHARACTERISTIC
 /begin REF_MEASUREMENT VOPM_PwrRecupActlWhlTqSts_enum /end REF_MEASUREMENT
/end GROUP
/begin GROUP S156_Subsys_VOPM_PwrRecupMaxAvlbWhlTqSts_enum "AppSwcOpm/Opm10ms/CHACAN_OUT_10ms/Msg_VCU_10_Torque_CHA/Subsys_VOPM_PwrRecupMaxAvlbWhlTqSts_enum"
 /begin REF_CHARACTERISTIC KOPM_PwrRecupMaxAvlbWhlTqStsHi_enum KOPM_PwrRecupMaxAvlbWhlTqStsLo_enum KOPM_PwrRecupMaxAvlbWhlTqSts_enum_ovrdflg KOPM_PwrRecupMaxAvlbWhlTqSts_enum_ovrdval /end REF_CHARACTERISTIC
 /begin REF_MEASUREMENT VOPM_PwrRecupMaxAvlbWhlTqSts_enum /end REF_MEASUREMENT
/end GROUP
/begin GROUP S156_Subsys_VOPM_VCUAccReqDrvOff_flg "AppSwcOpm/Opm10ms/CHACAN_OUT_10ms/Msg_VCU_10_Torque_CHA/Subsys_VOPM_VCUAccReqDrvOff_flg"
 /begin REF_CHARACTERISTIC KOPM_VCUAccReqDrvOff_flg_ovrdflg KOPM_VCUAccReqDrvOff_flg_ovrdval /end REF_CHARACTERISTIC
 /begin REF_MEASUREMENT VOPM_VCUAccReqDrvOff_flg /end REF_MEASUREMENT
/end GROUP
/begin GROUP S156_Subsys_VOPM_VCUAccReqStandstill_flg "AppSwcOpm/Opm10ms/CHACAN_OUT_10ms/Msg_VCU_10_Torque_CHA/Subsys_VOPM_VCUAccReqStandstill_flg"
 /begin REF_CHARACTERISTIC KOPM_VCUAccReqStandstill_flg_ovrdflg KOPM_VCUAccReqStandstill_flg_ovrdval /end REF_CHARACTERISTIC
 /begin REF_MEASUREMENT VOPM_VCUAccReqStandstill_flg /end REF_MEASUREMENT
/end GROUP
/begin GROUP S156_Subsys_VOPM_VCUEnaEHBBrkRun_flg "AppSwcOpm/Opm10ms/CHACAN_OUT_10ms/Msg_VCU_10_Torque_CHA/Subsys_VOPM_VCUEnaEHBBrkRun_flg"
 /begin REF_CHARACTERISTIC KOPM_VCUEnaEHBBrkRun_flg_ovrdflg KOPM_VCUEnaEHBBrkRun_flg_ovrdval /end REF_CHARACTERISTIC
 /begin REF_MEASUREMENT VOPM_VCUEnaEHBBrkRun_flg /end REF_MEASUREMENT
/end GROUP
/begin GROUP S156_Subsys_VOPM_VCUMasterCylinderPreReq_Bar "AppSwcOpm/Opm10ms/CHACAN_OUT_10ms/Msg_VCU_10_Torque_CHA/Subsys_VOPM_VCUMasterCylinderPreReq_Bar"
 /begin REF_CHARACTERISTIC KOPM_VCUMasterCylinderPreReqHi_Bar KOPM_VCUMasterCylinderPreReqLo_Bar KOPM_VCUMasterCylinderPreReq_Bar_ovrdflg KOPM_VCUMasterCylinderPreReq_Bar_ovrdval /end REF_CHARACTERISTIC
 /begin REF_MEASUREMENT VOPM_VCUMasterCylinderPreReq_Bar /end REF_MEASUREMENT
/end GROUP
/begin GROUP S156_Subsys_VOPM_VCUMotTorqueReqToEHB_Nm "AppSwcOpm/Opm10ms/CHACAN_OUT_10ms/Msg_VCU_10_Torque_CHA/Subsys_VOPM_VCUMotTorqueReqToEHB_Nm"
 /begin REF_CHARACTERISTIC KOPM_VCUMotTorqueReqToEHBHi_Nm KOPM_VCUMotTorqueReqToEHBLo_Nm KOPM_VCUMotTorqueReqToEHB_Nm_ovrdflg KOPM_VCUMotTorqueReqToEHB_Nm_ovrdval /end REF_CHARACTERISTIC
 /begin REF_MEASUREMENT VOPM_VCUMotTorqueReqToEHB_Nm /end REF_MEASUREMENT
/end GROUP
/begin GROUP S156_Subsys_VOPM_VCUVehSpdFastWarn_flg "AppSwcOpm/Opm10ms/CHACAN_OUT_10ms/Msg_VCU_10_Torque_CHA/Subsys_VOPM_VCUVehSpdFastWarn_flg"
 /begin REF_CHARACTERISTIC KOPM_VCUVehSpdFastWarn_flg_ovrdflg KOPM_VCUVehSpdFastWarn_flg_ovrdval /end REF_CHARACTERISTIC
 /begin REF_MEASUREMENT VOPM_VCUVehSpdFastWarn_flg /end REF_MEASUREMENT
/end GROUP
/begin GROUP S190_Subsys_VOPM_AppSoftNumb_nu "AppSwcOpm/Opm10ms/EptCAN_OUT_10ms/Msg_VCU_0_Value_EPT/Subsys_VOPM_AppSoftNumb_nu"
 /begin REF_CHARACTERISTIC KOPM_AppSoftNumbHi_nu KOPM_AppSoftNumbLo_nu KOPM_AppSoftNumb_nu_ovrdflg KOPM_AppSoftNumb_nu_ovrdval /end REF_CHARACTERISTIC
 /begin REF_MEASUREMENT VOPM_AppSoftNumb_nu /end REF_MEASUREMENT
/end GROUP
/begin GROUP S190_Subsys_VOPM_BraSwi_flg "AppSwcOpm/Opm10ms/EptCAN_OUT_10ms/Msg_VCU_0_Value_EPT/Subsys_VOPM_BraSwi_flg" /begin REF_CHARACTERISTIC KOPM_BraSwi_flg_ovrdflg KOPM_BraSwi_flg_ovrdval /end REF_CHARACTERISTIC /begin REF_MEASUREMENT VOPM_BraSwi_flg /end REF_MEASUREMENT /end GROUP
/begin GROUP S190_Subsys_VOPM_DrvPed_pct "AppSwcOpm/Opm10ms/EptCAN_OUT_10ms/Msg_VCU_0_Value_EPT/Subsys_VOPM_DrvPed_pct"
 /begin REF_CHARACTERISTIC KOPM_DrvPedHi_pct KOPM_DrvPedLo_pct KOPM_DrvPed_pct_ovrdflg KOPM_DrvPed_pct_ovrdval /end REF_CHARACTERISTIC
 /begin REF_MEASUREMENT VOPM_DrvPed_pct /end REF_MEASUREMENT
/end GROUP
/begin GROUP S190_Subsys_VOPM_DrvSwi_flg "AppSwcOpm/Opm10ms/EptCAN_OUT_10ms/Msg_VCU_0_Value_EPT/Subsys_VOPM_DrvSwi_flg" /begin REF_CHARACTERISTIC KOPM_DrvSwi_flg_ovrdflg KOPM_DrvSwi_flg_ovrdval /end REF_CHARACTERISTIC /begin REF_MEASUREMENT VOPM_DrvSwi_flg /end REF_MEASUREMENT /end GROUP
/begin GROUP S190_Subsys_VOPM_MotDmpgLmt_Nm "AppSwcOpm/Opm10ms/EptCAN_OUT_10ms/Msg_VCU_0_Value_EPT/Subsys_VOPM_MotDmpgLmt_Nm"
 /begin REF_CHARACTERISTIC KOPM_MotDmpgLmtHi_Nm KOPM_MotDmpgLmtLo_Nm KOPM_MotDmpgLmt_Nm_ovrdflg KOPM_MotDmpgLmt_Nm_ovrdval /end REF_CHARACTERISTIC
 /begin REF_MEASUREMENT VOPM_MotDmpgLmt_Nm /end REF_MEASUREMENT
/end GROUP
/begin GROUP S190_Subsys_VOPM_Zdznswi_flg "AppSwcOpm/Opm10ms/EptCAN_OUT_10ms/Msg_VCU_0_Value_EPT/Subsys_VOPM_Zdznswi_flg" /begin REF_CHARACTERISTIC KOPM_Zdznswi_flg_ovrdflg KOPM_Zdznswi_flg_ovrdval /end REF_CHARACTERISTIC /begin REF_MEASUREMENT VOPM_Zdznswi_flg /end REF_MEASUREMENT /end GROUP
/begin GROUP S191_Subsys_VOPM_EmgcySdn_flg "AppSwcOpm/Opm10ms/EptCAN_OUT_10ms/Msg_VCU_1_InvCmd_EPT/Subsys_VOPM_EmgcySdn_flg" /begin REF_CHARACTERISTIC KOPM_EmgcySdn_flg_ovrdflg KOPM_EmgcySdn_flg_ovrdval /end REF_CHARACTERISTIC /begin REF_MEASUREMENT VOPM_EmgcySdn_flg /end REF_MEASUREMENT /end GROUP
/begin GROUP S191_Subsys_VOPM_EnaDisChg_flg "AppSwcOpm/Opm10ms/EptCAN_OUT_10ms/Msg_VCU_1_InvCmd_EPT/Subsys_VOPM_EnaDisChg_flg" /begin REF_CHARACTERISTIC KOPM_EnaDisChg_flg_ovrdflg KOPM_EnaDisChg_flg_ovrdval /end REF_CHARACTERISTIC /begin REF_MEASUREMENT VOPM_EnaDisChg_flg /end REF_MEASUREMENT /end GROUP
/begin GROUP S191_Subsys_VOPM_EnaInvRun_flg "AppSwcOpm/Opm10ms/EptCAN_OUT_10ms/Msg_VCU_1_InvCmd_EPT/Subsys_VOPM_EnaInvRun_flg" /begin REF_CHARACTERISTIC KOPM_EnaInvRun_flg_ovrdflg KOPM_EnaInvRun_flg_ovrdval /end REF_CHARACTERISTIC /begin REF_MEASUREMENT VOPM_EnaInvRun_flg /end REF_MEASUREMENT /end GROUP
/begin GROUP S191_Subsys_VOPM_MotDirReq_enum "AppSwcOpm/Opm10ms/EptCAN_OUT_10ms/Msg_VCU_1_InvCmd_EPT/Subsys_VOPM_MotDirReq_enum"
 /begin REF_CHARACTERISTIC KOPM_MotDirReqHi_enum KOPM_MotDirReqLo_enum KOPM_MotDirReq_enum_ovrdflg KOPM_MotDirReq_enum_ovrdval /end REF_CHARACTERISTIC
 /begin REF_MEASUREMENT VOPM_MotDirReq_enum /end REF_MEASUREMENT
/end GROUP
/begin GROUP S191_Subsys_VOPM_MotModeReq_enum "AppSwcOpm/Opm10ms/EptCAN_OUT_10ms/Msg_VCU_1_InvCmd_EPT/Subsys_VOPM_MotModeReq_enum"
 /begin REF_CHARACTERISTIC KOPM_MotModeReqHi_enum KOPM_MotModeReqLo_enum KOPM_MotModeReq_enum_ovrdflg KOPM_MotModeReq_enum_ovrdval /end REF_CHARACTERISTIC
 /begin REF_MEASUREMENT VOPM_MotModeReq_enum /end REF_MEASUREMENT
/end GROUP
/begin GROUP S191_Subsys_VOPM_MotSpdReq_rpm "AppSwcOpm/Opm10ms/EptCAN_OUT_10ms/Msg_VCU_1_InvCmd_EPT/Subsys_VOPM_MotSpdReq_rpm"
 /begin REF_CHARACTERISTIC KOPM_MotSpdReqHi_rpm KOPM_MotSpdReqLo_rpm KOPM_MotSpdReq_rpm_ovrdflg KOPM_MotSpdReq_rpm_ovrdval /end REF_CHARACTERISTIC
 /begin REF_MEASUREMENT VOPM_MotSpdReq_rpm /end REF_MEASUREMENT
/end GROUP
/begin GROUP S191_Subsys_VOPM_MotTorqReq_Nm "AppSwcOpm/Opm10ms/EptCAN_OUT_10ms/Msg_VCU_1_InvCmd_EPT/Subsys_VOPM_MotTorqReq_Nm"
 /begin REF_CHARACTERISTIC KOPM_MotTorqReqHi_Nm KOPM_MotTorqReqLo_Nm KOPM_MotTorqReq_Nm_ovrdflg KOPM_MotTorqReq_Nm_ovrdval /end REF_CHARACTERISTIC
 /begin REF_MEASUREMENT VOPM_MotTorqReq_Nm /end REF_MEASUREMENT
/end GROUP
/begin GROUP S191_Subsys_VOPM_VehTrgtGearPos_enum "AppSwcOpm/Opm10ms/EptCAN_OUT_10ms/Msg_VCU_1_InvCmd_EPT/Subsys_VOPM_VehTrgtGearPos_enum"
 /begin REF_CHARACTERISTIC KOPM_VehTrgtGearPosHi_enum KOPM_VehTrgtGearPosLo_enum KOPM_VehTrgtGearPos_enum_ovrdflg KOPM_VehTrgtGearPos_enum_ovrdval /end REF_CHARACTERISTIC
 /begin REF_MEASUREMENT VOPM_VehTrgtGearPos_enum /end REF_MEASUREMENT
/end GROUP
/begin GROUP S213_Subsys_VOPM_ACChrgMaxCurr_A "AppSwcOpm/Opm20ms/BacCAN_OUT_20ms/Msg_VCU_DispInfo_BAC/Subsys_VOPM_ACChrgMaxCurr_A"
 /begin REF_CHARACTERISTIC KOPM_ACChrgMaxCurrHi_A KOPM_ACChrgMaxCurrLo_A KOPM_ACChrgMaxCurr_A_ovrdflg KOPM_ACChrgMaxCurr_A_ovrdval /end REF_CHARACTERISTIC
 /begin REF_MEASUREMENT VOPM_ACChrgMaxCurr_A /end REF_MEASUREMENT
/end GROUP
/begin GROUP S213_Subsys_VOPM_ACChrgMode_enum "AppSwcOpm/Opm20ms/BacCAN_OUT_20ms/Msg_VCU_DispInfo_BAC/Subsys_VOPM_ACChrgMode_enum"
 /begin REF_CHARACTERISTIC KOPM_ACChrgModeHi_enum KOPM_ACChrgModeLo_enum KOPM_ACChrgMode_enum_ovrdflg KOPM_ACChrgMode_enum_ovrdval /end REF_CHARACTERISTIC
 /begin REF_MEASUREMENT VOPM_ACChrgMode_enum /end REF_MEASUREMENT
/end GROUP
/begin GROUP S213_Subsys_VOPM_ACRemtCtrlFb_enum "AppSwcOpm/Opm20ms/BacCAN_OUT_20ms/Msg_VCU_DispInfo_BAC/Subsys_VOPM_ACRemtCtrlFb_enum"
 /begin REF_CHARACTERISTIC KOPM_ACRemtCtrlFbHi_enum KOPM_ACRemtCtrlFbLo_enum KOPM_ACRemtCtrlFb_enum_ovrdflg KOPM_ACRemtCtrlFb_enum_ovrdval /end REF_CHARACTERISTIC
 /begin REF_MEASUREMENT VOPM_ACRemtCtrlFb_enum /end REF_MEASUREMENT
/end GROUP
/begin GROUP S213_Subsys_VOPM_ACRmtDefrstCtlFb_enum "AppSwcOpm/Opm20ms/BacCAN_OUT_20ms/Msg_VCU_DispInfo_BAC/Subsys_VOPM_ACRmtDefrstCtlFb_enum"
 /begin REF_CHARACTERISTIC KOPM_ACRmtDefrstCtlFbHi_enum KOPM_ACRmtDefrstCtlFbLo_enum KOPM_ACRmtDefrstCtlFb_enum_ovrdflg KOPM_ACRmtDefrstCtlFb_enum_ovrdval /end REF_CHARACTERISTIC
 /begin REF_MEASUREMENT VOPM_ACRmtDefrstCtlFb_enum /end REF_MEASUREMENT
/end GROUP
/begin GROUP S213_Subsys_VOPM_ACTempSetFb_enum "AppSwcOpm/Opm20ms/BacCAN_OUT_20ms/Msg_VCU_DispInfo_BAC/Subsys_VOPM_ACTempSetFb_enum"
 /begin REF_CHARACTERISTIC KOPM_ACTempSetFbHi_enum KOPM_ACTempSetFbLo_enum KOPM_ACTempSetFb_enum_ovrdflg KOPM_ACTempSetFb_enum_ovrdval /end REF_CHARACTERISTIC
 /begin REF_MEASUREMENT VOPM_ACTempSetFb_enum /end REF_MEASUREMENT
/end GROUP
/begin GROUP S213_Subsys_VOPM_ACUnlckVentSetFB_enum "AppSwcOpm/Opm20ms/BacCAN_OUT_20ms/Msg_VCU_DispInfo_BAC/Subsys_VOPM_ACUnlckVentSetFB_enum"
 /begin REF_CHARACTERISTIC KOPM_ACUnlckVentSetFBHi_enum KOPM_ACUnlckVentSetFBLo_enum KOPM_ACUnlckVentSetFB_enum_ovrdflg KOPM_ACUnlckVentSetFB_enum_ovrdval /end REF_CHARACTERISTIC
 /begin REF_MEASUREMENT VOPM_ACUnlckVentSetFB_enum /end REF_MEASUREMENT
/end GROUP
/begin GROUP S213_Subsys_VOPM_BCMIllmndLckStsFb_flg "AppSwcOpm/Opm20ms/BacCAN_OUT_20ms/Msg_VCU_DispInfo_BAC/Subsys_VOPM_BCMIllmndLckStsFb_flg"
 /begin REF_CHARACTERISTIC KOPM_BCMIllmndLckStsFb_flg_ovrdflg KOPM_BCMIllmndLckStsFb_flg_ovrdval /end REF_CHARACTERISTIC
 /begin REF_MEASUREMENT VOPM_BCMIllmndLckStsFb_flg /end REF_MEASUREMENT
/end GROUP
/begin GROUP S213_Subsys_VOPM_BCMIllmndUnlckStsFb_flg "AppSwcOpm/Opm20ms/BacCAN_OUT_20ms/Msg_VCU_DispInfo_BAC/Subsys_VOPM_BCMIllmndUnlckStsFb_flg"
 /begin REF_CHARACTERISTIC KOPM_BCMIllmndUnlckStsFb_flg_ovrdflg KOPM_BCMIllmndUnlckStsFb_flg_ovrdval /end REF_CHARACTERISTIC
 /begin REF_MEASUREMENT VOPM_BCMIllmndUnlckStsFb_flg /end REF_MEASUREMENT
/end GROUP
/begin GROUP S213_Subsys_VOPM_CCKeyStgntn_enum1 "AppSwcOpm/Opm20ms/BacCAN_OUT_20ms/Msg_VCU_DispInfo_BAC/Subsys_VOPM_CCKeyStgntn_enum1"
 /begin REF_CHARACTERISTIC KOPM_CCKeyStgntnHi_enum KOPM_CCKeyStgntnLo_enum KOPM_CCKeyStgntn_enum_ovrdflg KOPM_CCKeyStgntn_enum_ovrdval /end REF_CHARACTERISTIC
 /begin REF_MEASUREMENT VOPM_CCKeyStgntn_enum /end REF_MEASUREMENT
/end GROUP
/begin GROUP S213_Subsys_VOPM_CCUOpenVentnFb_enum "AppSwcOpm/Opm20ms/BacCAN_OUT_20ms/Msg_VCU_DispInfo_BAC/Subsys_VOPM_CCUOpenVentnFb_enum"
 /begin REF_CHARACTERISTIC KOPM_CCUOpenVentnFbHi_enum KOPM_CCUOpenVentnFbLo_enum KOPM_CCUOpenVentnFb_enum_ovrdflg KOPM_CCUOpenVentnFb_enum_ovrdval /end REF_CHARACTERISTIC
 /begin REF_MEASUREMENT VOPM_CCUOpenVentnFb_enum /end REF_MEASUREMENT
/end GROUP
/begin GROUP S213_Subsys_VOPM_CCURmtCarSearchFb_enum "AppSwcOpm/Opm20ms/BacCAN_OUT_20ms/Msg_VCU_DispInfo_BAC/Subsys_VOPM_CCURmtCarSearchFb_enum"
 /begin REF_CHARACTERISTIC KOPM_CCURmtCarSearchFbHi_enum KOPM_CCURmtCarSearchFbLo_enum KOPM_CCURmtCarSearchFb_enum_ovrdflg KOPM_CCURmtCarSearchFb_enum_ovrdval /end REF_CHARACTERISTIC
 /begin REF_MEASUREMENT VOPM_CCURmtCarSearchFb_enum /end REF_MEASUREMENT
/end GROUP
/begin GROUP S213_Subsys_VOPM_CCURmtLckFb_enum "AppSwcOpm/Opm20ms/BacCAN_OUT_20ms/Msg_VCU_DispInfo_BAC/Subsys_VOPM_CCURmtLckFb_enum"
 /begin REF_CHARACTERISTIC KOPM_CCURmtLckFbHi_enum KOPM_CCURmtLckFbLo_enum KOPM_CCURmtLckFb_enum_ovrdflg KOPM_CCURmtLckFb_enum_ovrdval /end REF_CHARACTERISTIC
 /begin REF_MEASUREMENT VOPM_CCURmtLckFb_enum /end REF_MEASUREMENT
/end GROUP
/begin GROUP S213_Subsys_VOPM_CCURmtPwrLckFb_enum "AppSwcOpm/Opm20ms/BacCAN_OUT_20ms/Msg_VCU_DispInfo_BAC/Subsys_VOPM_CCURmtPwrLckFb_enum"
 /begin REF_CHARACTERISTIC KOPM_CCURmtPwrLckFbHi_enum KOPM_CCURmtPwrLckFbLo_enum KOPM_CCURmtPwrLckFb_enum_ovrdflg KOPM_CCURmtPwrLckFb_enum_ovrdval /end REF_CHARACTERISTIC
 /begin REF_MEASUREMENT VOPM_CCURmtPwrLckFb_enum /end REF_MEASUREMENT
/end GROUP
/begin GROUP S213_Subsys_VOPM_CruiseCtrTgtSpd_kph "AppSwcOpm/Opm20ms/BacCAN_OUT_20ms/Msg_VCU_DispInfo_BAC/Subsys_VOPM_CruiseCtrTgtSpd_kph"
 /begin REF_CHARACTERISTIC KOPM_CruiseCtrTgtSpdHi_kph KOPM_CruiseCtrTgtSpdLo_kph KOPM_CruiseCtrTgtSpd_kph_ovrdflg KOPM_CruiseCtrTgtSpd_kph_ovrdval /end REF_CHARACTERISTIC
 /begin REF_MEASUREMENT VOPM_CruiseCtrTgtSpd_kph /end REF_MEASUREMENT
/end GROUP
/begin GROUP S213_Subsys_VOPM_CruiseCtrlSta_enum "AppSwcOpm/Opm20ms/BacCAN_OUT_20ms/Msg_VCU_DispInfo_BAC/Subsys_VOPM_CruiseCtrlSta_enum"
 /begin REF_CHARACTERISTIC KOPM_CruiseCtrlStaHi_enum KOPM_CruiseCtrlStaLo_enum KOPM_CruiseCtrlSta_enum_ovrdflg KOPM_CruiseCtrlSta_enum_ovrdval /end REF_CHARACTERISTIC
 /begin REF_MEASUREMENT VOPM_CruiseCtrlSta_enum /end REF_MEASUREMENT
/end GROUP
/begin GROUP S213_Subsys_VOPM_DrvModeKeyStgntn_enum1 "AppSwcOpm/Opm20ms/BacCAN_OUT_20ms/Msg_VCU_DispInfo_BAC/Subsys_VOPM_DrvModeKeyStgntn_enum1"
 /begin REF_CHARACTERISTIC KOPM_DrvModeKeyStgntnHi_enum KOPM_DrvModeKeyStgntnLo_enum KOPM_DrvModeKeyStgntn_enum_ovrdflg KOPM_DrvModeKeyStgntn_enum_ovrdval /end REF_CHARACTERISTIC
 /begin REF_MEASUREMENT VOPM_DrvModeKeyStgntn_enum /end REF_MEASUREMENT
/end GROUP
/begin GROUP S213_Subsys_VOPM_DrvMotorSta_enum1 "AppSwcOpm/Opm20ms/BacCAN_OUT_20ms/Msg_VCU_DispInfo_BAC/Subsys_VOPM_DrvMotorSta_enum1"
 /begin REF_CHARACTERISTIC KOPM_DrvMotorStaHi_enum KOPM_DrvMotorStaLo_enum KOPM_DrvMotorSta_enum_ovrdflg KOPM_DrvMotorSta_enum_ovrdval /end REF_CHARACTERISTIC
 /begin REF_MEASUREMENT VOPM_DrvMotorSta_enum /end REF_MEASUREMENT
/end GROUP
/begin GROUP S213_Subsys_VOPM_DrvRangeDistEstVld_flg1 "AppSwcOpm/Opm20ms/BacCAN_OUT_20ms/Msg_VCU_DispInfo_BAC/Subsys_VOPM_DrvRangeDistEstVld_flg1"
 /begin REF_CHARACTERISTIC KOPM_DrvRangeDistEstVld_flg_ovrdflg KOPM_DrvRangeDistEstVld_flg_ovrdval /end REF_CHARACTERISTIC
 /begin REF_MEASUREMENT VOPM_DrvRangeDistEstVld_flg /end REF_MEASUREMENT
/end GROUP
/begin GROUP S213_Subsys_VOPM_DrvRangeDistEst_km1 "AppSwcOpm/Opm20ms/BacCAN_OUT_20ms/Msg_VCU_DispInfo_BAC/Subsys_VOPM_DrvRangeDistEst_km1"
 /begin REF_CHARACTERISTIC KOPM_DrvRangeDistEstHi_km KOPM_DrvRangeDistEstLo_km KOPM_DrvRangeDistEst_km_ovrdflg KOPM_DrvRangeDistEst_km_ovrdval /end REF_CHARACTERISTIC
 /begin REF_MEASUREMENT VOPM_DrvRangeDistEst_km /end REF_MEASUREMENT
/end GROUP
/begin GROUP S213_Subsys_VOPM_InfoDisp_enum1 "AppSwcOpm/Opm20ms/BacCAN_OUT_20ms/Msg_VCU_DispInfo_BAC/Subsys_VOPM_InfoDisp_enum1"
 /begin REF_CHARACTERISTIC KOPM_InfoDispHi_enum KOPM_InfoDispLo_enum KOPM_InfoDisp_enum_ovrdflg KOPM_InfoDisp_enum_ovrdval /end REF_CHARACTERISTIC
 /begin REF_MEASUREMENT VOPM_InfoDisp_enum /end REF_MEASUREMENT
/end GROUP
/begin GROUP S213_Subsys_VOPM_LckVehWrm_enum "AppSwcOpm/Opm20ms/BacCAN_OUT_20ms/Msg_VCU_DispInfo_BAC/Subsys_VOPM_LckVehWrm_enum"
 /begin REF_CHARACTERISTIC KOPM_LckVehWrmHi_enum KOPM_LckVehWrmLo_enum KOPM_LckVehWrm_enum_ovrdflg KOPM_LckVehWrm_enum_ovrdval /end REF_CHARACTERISTIC
 /begin REF_MEASUREMENT VOPM_LckVehWrm_enum /end REF_MEASUREMENT
/end GROUP
/begin GROUP S213_Subsys_VOPM_MCUHiTempWrning_flg1 "AppSwcOpm/Opm20ms/BacCAN_OUT_20ms/Msg_VCU_DispInfo_BAC/Subsys_VOPM_MCUHiTempWrning_flg1"
 /begin REF_CHARACTERISTIC KOPM_MCUHiTempWrning_flg_ovrdflg KOPM_MCUHiTempWrning_flg_ovrdval /end REF_CHARACTERISTIC
 /begin REF_MEASUREMENT VOPM_MCUHiTempWrning_flg /end REF_MEASUREMENT
/end GROUP
/begin GROUP S213_Subsys_VOPM_MotActPwrTyp_enum1 "AppSwcOpm/Opm20ms/BacCAN_OUT_20ms/Msg_VCU_DispInfo_BAC/Subsys_VOPM_MotActPwrTyp_enum1"
 /begin REF_CHARACTERISTIC KOPM_MotActPwrTypHi_enum KOPM_MotActPwrTypLo_enum KOPM_MotActPwrTyp_enum_ovrdflg KOPM_MotActPwrTyp_enum_ovrdval /end REF_CHARACTERISTIC
 /begin REF_MEASUREMENT VOPM_MotActPwrTyp_enum /end REF_MEASUREMENT
/end GROUP
/begin GROUP S213_Subsys_VOPM_MotActPwr_Kw1 "AppSwcOpm/Opm20ms/BacCAN_OUT_20ms/Msg_VCU_DispInfo_BAC/Subsys_VOPM_MotActPwr_Kw1"
 /begin REF_CHARACTERISTIC KOPM_MotActPwrHi_Kw KOPM_MotActPwrLo_Kw KOPM_MotActPwr_Kw_ovrdflg KOPM_MotActPwr_Kw_ovrdval /end REF_CHARACTERISTIC
 /begin REF_MEASUREMENT VOPM_MotActPwr_Kw /end REF_MEASUREMENT
/end GROUP
/begin GROUP S213_Subsys_VOPM_MotorHiTempWrning_flg1 "AppSwcOpm/Opm20ms/BacCAN_OUT_20ms/Msg_VCU_DispInfo_BAC/Subsys_VOPM_MotorHiTempWrning_flg1"
 /begin REF_CHARACTERISTIC KOPM_MotorHiTempWrning_flg_ovrdflg KOPM_MotorHiTempWrning_flg_ovrdval /end REF_CHARACTERISTIC
 /begin REF_MEASUREMENT VOPM_MotorHiTempWrning_flg /end REF_MEASUREMENT
/end GROUP
/begin GROUP S213_Subsys_VOPM_OBCOprtCmdToICU_enum1 "AppSwcOpm/Opm20ms/BacCAN_OUT_20ms/Msg_VCU_DispInfo_BAC/Subsys_VOPM_OBCOprtCmdToICU_enum1"
 /begin REF_CHARACTERISTIC KOPM_OBCOprtCmdToICUHi_enum KOPM_OBCOprtCmdToICULo_enum KOPM_OBCOprtCmdToICU_enum_ovrdflg KOPM_OBCOprtCmdToICU_enum_ovrdval /end REF_CHARACTERISTIC
 /begin REF_MEASUREMENT VOPM_OBCOprtCmdToICU_enum /end REF_MEASUREMENT
/end GROUP
/begin GROUP S213_Subsys_VOPM_RsrvdPwr_kW1 "AppSwcOpm/Opm20ms/BacCAN_OUT_20ms/Msg_VCU_DispInfo_BAC/Subsys_VOPM_RsrvdPwr_kW1"
 /begin REF_CHARACTERISTIC KOPM_RsrvdPwrHi_kW KOPM_RsrvdPwrLo_kW KOPM_RsrvdPwr_kW_ovrdflg KOPM_RsrvdPwr_kW_ovrdval /end REF_CHARACTERISTIC
 /begin REF_MEASUREMENT VOPM_RsrvdPwr_kW /end REF_MEASUREMENT
/end GROUP
/begin GROUP S213_Subsys_VOPM_SIBSBMSBatSOCAllow_flg "AppSwcOpm/Opm20ms/BacCAN_OUT_20ms/Msg_VCU_DispInfo_BAC/Subsys_VOPM_SIBSBMSBatSOCAllow_flg"
 /begin REF_CHARACTERISTIC KOPM_SIBSBMSBatSOCAllow_flg_ovrdflg KOPM_SIBSBMSBatSOCAllow_flg_ovrdval /end REF_CHARACTERISTIC
 /begin REF_MEASUREMENT VOPM_SIBSBMSBatSOCAllow_flg /end REF_MEASUREMENT
/end GROUP
/begin GROUP S213_Subsys_VOPM_SIBSChgNumAllow_flg "AppSwcOpm/Opm20ms/BacCAN_OUT_20ms/Msg_VCU_DispInfo_BAC/Subsys_VOPM_SIBSChgNumAllow_flg"
 /begin REF_CHARACTERISTIC KOPM_SIBSChgNumAllow_flg_ovrdflg KOPM_SIBSChgNumAllow_flg_ovrdval /end REF_CHARACTERISTIC
 /begin REF_MEASUREMENT VOPM_SIBSChgNumAllow_flg /end REF_MEASUREMENT
/end GROUP
/begin GROUP S213_Subsys_VOPM_SIBSFbRTCWupFlg_flg "AppSwcOpm/Opm20ms/BacCAN_OUT_20ms/Msg_VCU_DispInfo_BAC/Subsys_VOPM_SIBSFbRTCWupFlg_flg"
 /begin REF_CHARACTERISTIC KOPM_SIBSFbRTCWupFlg_flg_ovrdflg KOPM_SIBSFbRTCWupFlg_flg_ovrdval /end REF_CHARACTERISTIC
 /begin REF_MEASUREMENT VOPM_SIBSFbRTCWupFlg_flg /end REF_MEASUREMENT
/end GROUP
/begin GROUP S213_Subsys_VOPM_SIBSKL30Volt_V "AppSwcOpm/Opm20ms/BacCAN_OUT_20ms/Msg_VCU_DispInfo_BAC/Subsys_VOPM_SIBSKL30Volt_V"
 /begin REF_CHARACTERISTIC KOPM_SIBSKL30VoltHi_V KOPM_SIBSKL30VoltLo_V KOPM_SIBSKL30Volt_V_ovrdflg KOPM_SIBSKL30Volt_V_ovrdval /end REF_CHARACTERISTIC
 /begin REF_MEASUREMENT VOPM_SIBSKL30Volt_V /end REF_MEASUREMENT
/end GROUP
/begin GROUP S213_Subsys_VOPM_SIBSRTCChrgSt_enum "AppSwcOpm/Opm20ms/BacCAN_OUT_20ms/Msg_VCU_DispInfo_BAC/Subsys_VOPM_SIBSRTCChrgSt_enum"
 /begin REF_CHARACTERISTIC KOPM_SIBSRTCChrgStHi_enum KOPM_SIBSRTCChrgStLo_enum KOPM_SIBSRTCChrgSt_enum_ovrdflg KOPM_SIBSRTCChrgSt_enum_ovrdval /end REF_CHARACTERISTIC
 /begin REF_MEASUREMENT VOPM_SIBSRTCChrgSt_enum /end REF_MEASUREMENT
/end GROUP
/begin GROUP S213_Subsys_VOPM_SIBSRTCWUChgFailNum_cnt "AppSwcOpm/Opm20ms/BacCAN_OUT_20ms/Msg_VCU_DispInfo_BAC/Subsys_VOPM_SIBSRTCWUChgFailNum_cnt"
 /begin REF_CHARACTERISTIC KOPM_SIBSRTCWUChgFailNumHi_cnt KOPM_SIBSRTCWUChgFailNumLo_cnt KOPM_SIBSRTCWUChgFailNum_cnt_ovrdflg KOPM_SIBSRTCWUChgFailNum_cnt_ovrdval /end REF_CHARACTERISTIC
 /begin REF_MEASUREMENT VOPM_SIBSRTCWUChgFailNum_cnt /end REF_MEASUREMENT
/end GROUP
/begin GROUP S213_Subsys_VOPM_SIBSRTCWUChgNum_cnt "AppSwcOpm/Opm20ms/BacCAN_OUT_20ms/Msg_VCU_DispInfo_BAC/Subsys_VOPM_SIBSRTCWUChgNum_cnt"
 /begin REF_CHARACTERISTIC KOPM_SIBSRTCWUChgNumHi_cnt KOPM_SIBSRTCWUChgNumLo_cnt KOPM_SIBSRTCWUChgNum_cnt_ovrdflg KOPM_SIBSRTCWUChgNum_cnt_ovrdval /end REF_CHARACTERISTIC
 /begin REF_MEASUREMENT VOPM_SIBSRTCWUChgNum_cnt /end REF_MEASUREMENT
/end GROUP
/begin GROUP S213_Subsys_VOPM_SIBSWupVoltAllow_flg "AppSwcOpm/Opm20ms/BacCAN_OUT_20ms/Msg_VCU_DispInfo_BAC/Subsys_VOPM_SIBSWupVoltAllow_flg"
 /begin REF_CHARACTERISTIC KOPM_SIBSWupVoltAllow_flg_ovrdflg KOPM_SIBSWupVoltAllow_flg_ovrdval /end REF_CHARACTERISTIC
 /begin REF_MEASUREMENT VOPM_SIBSWupVoltAllow_flg /end REF_MEASUREMENT
/end GROUP
/begin GROUP S213_Subsys_VOPM_ShftKeyStgntn_enum1 "AppSwcOpm/Opm20ms/BacCAN_OUT_20ms/Msg_VCU_DispInfo_BAC/Subsys_VOPM_ShftKeyStgntn_enum1"
 /begin REF_CHARACTERISTIC KOPM_ShftKeyStgntnHi_enum KOPM_ShftKeyStgntnLo_enum KOPM_ShftKeyStgntn_enum_ovrdflg KOPM_ShftKeyStgntn_enum_ovrdval /end REF_CHARACTERISTIC
 /begin REF_MEASUREMENT VOPM_ShftKeyStgntn_enum /end REF_MEASUREMENT
/end GROUP
/begin GROUP S213_Subsys_VOPM_VCUOprtLicFb_flg "AppSwcOpm/Opm20ms/BacCAN_OUT_20ms/Msg_VCU_DispInfo_BAC/Subsys_VOPM_VCUOprtLicFb_flg"
 /begin REF_CHARACTERISTIC KOPM_VCUOprtLicFb_flg_ovrdflg KOPM_VCUOprtLicFb_flg_ovrdval /end REF_CHARACTERISTIC
 /begin REF_MEASUREMENT VOPM_VCUOprtLicFb_flg /end REF_MEASUREMENT
/end GROUP
/begin GROUP S213_Subsys_VOPM_VCUSpdLimLvlFb_enum "AppSwcOpm/Opm20ms/BacCAN_OUT_20ms/Msg_VCU_DispInfo_BAC/Subsys_VOPM_VCUSpdLimLvlFb_enum"
 /begin REF_CHARACTERISTIC KOPM_VCUSpdLimLvlFbHi_enum KOPM_VCUSpdLimLvlFbLo_enum KOPM_VCUSpdLimLvlFb_enum_ovrdflg KOPM_VCUSpdLimLvlFb_enum_ovrdval /end REF_CHARACTERISTIC
 /begin REF_MEASUREMENT VOPM_VCUSpdLimLvlFb_enum /end REF_MEASUREMENT
/end GROUP
/begin GROUP S213_Subsys_VOPM_VCUSpdLimLvlSetFb_enum "AppSwcOpm/Opm20ms/BacCAN_OUT_20ms/Msg_VCU_DispInfo_BAC/Subsys_VOPM_VCUSpdLimLvlSetFb_enum"
 /begin REF_CHARACTERISTIC KOPM_VCUSpdLimLvlSetFbHi_enum KOPM_VCUSpdLimLvlSetFbLo_enum KOPM_VCUSpdLimLvlSetFb_enum_ovrdflg KOPM_VCUSpdLimLvlSetFb_enum_ovrdval /end REF_CHARACTERISTIC
 /begin REF_MEASUREMENT VOPM_VCUSpdLimLvlSetFb_enum /end REF_MEASUREMENT
/end GROUP
/begin GROUP S213_Subsys_VOPM_VCUVerFb_flg "AppSwcOpm/Opm20ms/BacCAN_OUT_20ms/Msg_VCU_DispInfo_BAC/Subsys_VOPM_VCUVerFb_flg" /begin REF_CHARACTERISTIC KOPM_VCUVerFb_flg_ovrdflg KOPM_VCUVerFb_flg_ovrdval /end REF_CHARACTERISTIC /begin REF_MEASUREMENT VOPM_VCUVerFb_flg /end REF_MEASUREMENT /end GROUP
/begin GROUP S213_Subsys_VOPM_VCUVerSetFb_enum "AppSwcOpm/Opm20ms/BacCAN_OUT_20ms/Msg_VCU_DispInfo_BAC/Subsys_VOPM_VCUVerSetFb_enum"
 /begin REF_CHARACTERISTIC KOPM_VCUVerSetFbHi_enum KOPM_VCUVerSetFbLo_enum KOPM_VCUVerSetFb_enum_ovrdflg KOPM_VCUVerSetFb_enum_ovrdval /end REF_CHARACTERISTIC
 /begin REF_MEASUREMENT VOPM_VCUVerSetFb_enum /end REF_MEASUREMENT
/end GROUP
/begin GROUP S213_Subsys_VOPM_VehActDrvPwr_pct "AppSwcOpm/Opm20ms/BacCAN_OUT_20ms/Msg_VCU_DispInfo_BAC/Subsys_VOPM_VehActDrvPwr_pct"
 /begin REF_CHARACTERISTIC KOPM_VehActDrvPwrHi_pct KOPM_VehActDrvPwrLo_pct KOPM_VehActDrvPwr_pct_ovrdflg KOPM_VehActDrvPwr_pct_ovrdval /end REF_CHARACTERISTIC
 /begin REF_MEASUREMENT VOPM_VehActDrvPwr_pct /end REF_MEASUREMENT
/end GROUP
/begin GROUP S213_Subsys_VOPM_VehActRecupPwr_pct "AppSwcOpm/Opm20ms/BacCAN_OUT_20ms/Msg_VCU_DispInfo_BAC/Subsys_VOPM_VehActRecupPwr_pct"
 /begin REF_CHARACTERISTIC KOPM_VehActRecupPwrHi_pct KOPM_VehActRecupPwrLo_pct KOPM_VehActRecupPwr_pct_ovrdflg KOPM_VehActRecupPwr_pct_ovrdval /end REF_CHARACTERISTIC
 /begin REF_MEASUREMENT VOPM_VehActRecupPwr_pct /end REF_MEASUREMENT
/end GROUP
/begin GROUP S213_Subsys_VOPM_VehPGearError_flg1 "AppSwcOpm/Opm20ms/BacCAN_OUT_20ms/Msg_VCU_DispInfo_BAC/Subsys_VOPM_VehPGearError_flg1"
 /begin REF_CHARACTERISTIC KOPM_VehPGearError_flg_ovrdflg KOPM_VehPGearError_flg_ovrdval /end REF_CHARACTERISTIC
 /begin REF_MEASUREMENT VOPM_VehPGearError_flg /end REF_MEASUREMENT
/end GROUP
/begin GROUP S213_Subsys_VOPM_VehPwrCnsmpAvrg_kWh1 "AppSwcOpm/Opm20ms/BacCAN_OUT_20ms/Msg_VCU_DispInfo_BAC/Subsys_VOPM_VehPwrCnsmpAvrg_kWh1"
 /begin REF_CHARACTERISTIC KOPM_VehPwrCnsmpAvrgHi_kWh KOPM_VehPwrCnsmpAvrgLo_kWh KOPM_VehPwrCnsmpAvrg_kWh_ovrdflg KOPM_VehPwrCnsmpAvrg_kWh_ovrdval /end REF_CHARACTERISTIC
 /begin REF_MEASUREMENT VOPM_VehPwrCnsmpAvrg_kWh /end REF_MEASUREMENT
/end GROUP
/begin GROUP S213_Subsys_VOPM_VhclActlCnsmPwr_kWh1 "AppSwcOpm/Opm20ms/BacCAN_OUT_20ms/Msg_VCU_DispInfo_BAC/Subsys_VOPM_VhclActlCnsmPwr_kWh1"
 /begin REF_CHARACTERISTIC KOPM_VhclActlCnsmPwrHi_kWh KOPM_VhclActlCnsmPwrLo_kWh KOPM_VhclActlCnsmPwr_kWh_ovrdflg KOPM_VhclActlCnsmPwr_kWh_ovrdval /end REF_CHARACTERISTIC
 /begin REF_MEASUREMENT VOPM_VhclActlCnsmPwr_kWh /end REF_MEASUREMENT
/end GROUP
/begin GROUP S213_Subsys_VOPM_VhclSpdFstWarn_flg1 "AppSwcOpm/Opm20ms/BacCAN_OUT_20ms/Msg_VCU_DispInfo_BAC/Subsys_VOPM_VhclSpdFstWarn_flg1"
 /begin REF_CHARACTERISTIC KOPM_VhclSpdFstWarn_flg_ovrdflg KOPM_VhclSpdFstWarn_flg_ovrdval /end REF_CHARACTERISTIC
 /begin REF_MEASUREMENT VOPM_VhclSpdFstWarn_flg /end REF_MEASUREMENT
/end GROUP
/begin GROUP S213_Subsys_VOPM_WLTPDrvgRngDstVld_flg1 "AppSwcOpm/Opm20ms/BacCAN_OUT_20ms/Msg_VCU_DispInfo_BAC/Subsys_VOPM_WLTPDrvgRngDstVld_flg1"
 /begin REF_CHARACTERISTIC KOPM_WLTPDrvgRngDstVld_flg_ovrdflg KOPM_WLTPDrvgRngDstVld_flg_ovrdval /end REF_CHARACTERISTIC
 /begin REF_MEASUREMENT VOPM_WLTPDrvgRngDstVld_flg /end REF_MEASUREMENT
/end GROUP
/begin GROUP S213_Subsys_VOPM_WLTPDrvgRngDst_km1 "AppSwcOpm/Opm20ms/BacCAN_OUT_20ms/Msg_VCU_DispInfo_BAC/Subsys_VOPM_WLTPDrvgRngDst_km1"
 /begin REF_CHARACTERISTIC KOPM_WLTPDrvgRngDstHi_km KOPM_WLTPDrvgRngDstLo_km KOPM_WLTPDrvgRngDst_km_ovrdflg KOPM_WLTPDrvgRngDst_km_ovrdval /end REF_CHARACTERISTIC
 /begin REF_MEASUREMENT VOPM_WLTPDrvgRngDst_km /end REF_MEASUREMENT
/end GROUP
/begin GROUP S213_Subsys_VOPM_WghConfdence_flg "AppSwcOpm/Opm20ms/BacCAN_OUT_20ms/Msg_VCU_DispInfo_BAC/Subsys_VOPM_WghConfdence_flg"
 /begin REF_CHARACTERISTIC KOPM_WghConfdence_flg_ovrdflg KOPM_WghConfdence_flg_ovrdval /end REF_CHARACTERISTIC
 /begin REF_MEASUREMENT VOPM_WghConfdence_flg /end REF_MEASUREMENT
/end GROUP
/begin GROUP S213_Subsys_VOPM_WghDistb_enum "AppSwcOpm/Opm20ms/BacCAN_OUT_20ms/Msg_VCU_DispInfo_BAC/Subsys_VOPM_WghDistb_enum"
 /begin REF_CHARACTERISTIC KOPM_WghDistbHi_enum KOPM_WghDistbLo_enum KOPM_WghDistb_enum_ovrdflg KOPM_WghDistb_enum_ovrdval /end REF_CHARACTERISTIC
 /begin REF_MEASUREMENT VOPM_WghDistb_enum /end REF_MEASUREMENT
/end GROUP
/begin GROUP S213_Subsys_VOPM_WghEst_kg "AppSwcOpm/Opm20ms/BacCAN_OUT_20ms/Msg_VCU_DispInfo_BAC/Subsys_VOPM_WghEst_kg"
 /begin REF_CHARACTERISTIC KOPM_WghEstHi_kg KOPM_WghEstLo_kg KOPM_WghEst_kg_ovrdflg KOPM_WghEst_kg_ovrdval /end REF_CHARACTERISTIC
 /begin REF_MEASUREMENT VOPM_WghEst_kg /end REF_MEASUREMENT
/end GROUP
/begin GROUP S272_Subsys_VOPM_ACCTrqCtrlAvl_flg1 "AppSwcOpm/Opm20ms/CHACAN_OUT_20ms/Msg_VCU_D_Status_CHA/Subsys_VOPM_ACCTrqCtrlAvl_flg1"
 /begin REF_CHARACTERISTIC KOPM_ACCTrqCtrlAvl_flg_ovrdflg KOPM_ACCTrqCtrlAvl_flg_ovrdval /end REF_CHARACTERISTIC
 /begin REF_MEASUREMENT VOPM_ACCTrqCtrlAvl_flg /end REF_MEASUREMENT
/end GROUP
/begin GROUP S272_Subsys_VOPM_AccPedPosSnsrSta_enum1 "AppSwcOpm/Opm20ms/CHACAN_OUT_20ms/Msg_VCU_D_Status_CHA/Subsys_VOPM_AccPedPosSnsrSta_enum1"
 /begin REF_CHARACTERISTIC KOPM_AccPedPosSnsrStaHi_enum KOPM_AccPedPosSnsrStaLo_enum KOPM_AccPedPosSnsrSta_enum_ovrdflg KOPM_AccPedPosSnsrSta_enum_ovrdval /end REF_CHARACTERISTIC
 /begin REF_MEASUREMENT VOPM_AccPedPosSnsrSta_enum /end REF_MEASUREMENT
/end GROUP
/begin GROUP S272_Subsys_VOPM_AccPedPosToESCSta_enum1 "AppSwcOpm/Opm20ms/CHACAN_OUT_20ms/Msg_VCU_D_Status_CHA/Subsys_VOPM_AccPedPosToESCSta_enum1"
 /begin REF_CHARACTERISTIC KOPM_AccPedPosToESCStaHi_enum KOPM_AccPedPosToESCStaLo_enum KOPM_AccPedPosToESCSta_enum_ovrdflg KOPM_AccPedPosToESCSta_enum_ovrdval /end REF_CHARACTERISTIC
 /begin REF_MEASUREMENT VOPM_AccPedPosToESCSta_enum /end REF_MEASUREMENT
/end GROUP
/begin GROUP S272_Subsys_VOPM_AccPedPosToESC_pct1 "AppSwcOpm/Opm20ms/CHACAN_OUT_20ms/Msg_VCU_D_Status_CHA/Subsys_VOPM_AccPedPosToESC_pct1"
 /begin REF_CHARACTERISTIC KOPM_AccPedPosToESCHi_pct KOPM_AccPedPosToESCLo_pct KOPM_AccPedPosToESC_pct_ovrdflg KOPM_AccPedPosToESC_pct_ovrdval /end REF_CHARACTERISTIC
 /begin REF_MEASUREMENT VOPM_AccPedPosToESC_pct /end REF_MEASUREMENT
/end GROUP
/begin GROUP S272_Subsys_VOPM_AcclPedalPos_pct1 "AppSwcOpm/Opm20ms/CHACAN_OUT_20ms/Msg_VCU_D_Status_CHA/Subsys_VOPM_AcclPedalPos_pct1"
 /begin REF_CHARACTERISTIC KOPM_AcclPedalPosHi_pct KOPM_AcclPedalPosLo_pct KOPM_AcclPedalPos_pct_ovrdflg KOPM_AcclPedalPos_pct_ovrdval /end REF_CHARACTERISTIC
 /begin REF_MEASUREMENT VOPM_AcclPedalPos_pct /end REF_MEASUREMENT
/end GROUP
/begin GROUP S272_Subsys_VOPM_BrkPedSnsrPosVRsrvd_enum1 "AppSwcOpm/Opm20ms/CHACAN_OUT_20ms/Msg_VCU_D_Status_CHA/Subsys_VOPM_BrkPedSnsrPosVRsrvd_enum1"
 /begin REF_CHARACTERISTIC KOPM_BrkPedSnsrPosVRsrvdHi_enum KOPM_BrkPedSnsrPosVRsrvdLo_enum KOPM_BrkPedSnsrPosVRsrvd_enum_ovrdflg KOPM_BrkPedSnsrPosVRsrvd_enum_ovrdval /end REF_CHARACTERISTIC
 /begin REF_MEASUREMENT VOPM_BrkPedSnsrPosVRsrvd_enum /end REF_MEASUREMENT
/end GROUP
/begin GROUP S272_Subsys_VOPM_BrkPedalPos_pct1 "AppSwcOpm/Opm20ms/CHACAN_OUT_20ms/Msg_VCU_D_Status_CHA/Subsys_VOPM_BrkPedalPos_pct1"
 /begin REF_CHARACTERISTIC KOPM_BrkPedalPosHi_pct KOPM_BrkPedalPosLo_pct KOPM_BrkPedalPos_pct_ovrdflg KOPM_BrkPedalPos_pct_ovrdval /end REF_CHARACTERISTIC
 /begin REF_MEASUREMENT VOPM_BrkPedalPos_pct /end REF_MEASUREMENT
/end GROUP
/begin GROUP S272_Subsys_VOPM_DrvReqTorqOverrideFCM_flg1 "AppSwcOpm/Opm20ms/CHACAN_OUT_20ms/Msg_VCU_D_Status_CHA/Subsys_VOPM_DrvReqTorqOverrideFCM_flg1"
 /begin REF_CHARACTERISTIC KOPM_DrvReqTorqOverrideFCM_flg_ovrdflg KOPM_DrvReqTorqOverrideFCM_flg_ovrdval /end REF_CHARACTERISTIC
 /begin REF_MEASUREMENT VOPM_DrvReqTorqOverrideFCM_flg /end REF_MEASUREMENT
/end GROUP
/begin GROUP S272_Subsys_VOPM_DrvReqTorqOvrdESC_flg1 "AppSwcOpm/Opm20ms/CHACAN_OUT_20ms/Msg_VCU_D_Status_CHA/Subsys_VOPM_DrvReqTorqOvrdESC_flg1"
 /begin REF_CHARACTERISTIC KOPM_DrvReqTorqOvrdESC_flg_ovrdflg KOPM_DrvReqTorqOvrdESC_flg_ovrdval /end REF_CHARACTERISTIC
 /begin REF_MEASUREMENT VOPM_DrvReqTorqOvrdESC_flg /end REF_MEASUREMENT
/end GROUP
/begin GROUP S272_Subsys_VOPM_GearShiftInhibited_flg1 "AppSwcOpm/Opm20ms/CHACAN_OUT_20ms/Msg_VCU_D_Status_CHA/Subsys_VOPM_GearShiftInhibited_flg1"
 /begin REF_CHARACTERISTIC KOPM_GearShiftInhibited_flg_ovrdflg KOPM_GearShiftInhibited_flg_ovrdval /end REF_CHARACTERISTIC
 /begin REF_MEASUREMENT VOPM_GearShiftInhibited_flg /end REF_MEASUREMENT
/end GROUP
/begin GROUP S272_Subsys_VOPM_OTAModeSts_flg1 "AppSwcOpm/Opm20ms/CHACAN_OUT_20ms/Msg_VCU_D_Status_CHA/Subsys_VOPM_OTAModeSts_flg1" /begin REF_CHARACTERISTIC KOPM_OTAModeSts_flg_ovrdflg KOPM_OTAModeSts_flg_ovrdval /end REF_CHARACTERISTIC /begin REF_MEASUREMENT VOPM_OTAModeSts_flg /end REF_MEASUREMENT /end GROUP
/begin GROUP S272_Subsys_VOPM_PGrSwcSt_enum "AppSwcOpm/Opm20ms/CHACAN_OUT_20ms/Msg_VCU_D_Status_CHA/Subsys_VOPM_PGrSwcSt_enum"
 /begin REF_CHARACTERISTIC KOPM_PGrSwcStHi_enum KOPM_PGrSwcStLo_enum KOPM_PGrSwcSt_enum_ovrdflg KOPM_PGrSwcSt_enum_ovrdval /end REF_CHARACTERISTIC
 /begin REF_MEASUREMENT VOPM_PGrSwcSt_enum /end REF_MEASUREMENT
/end GROUP
/begin GROUP S272_Subsys_VOPM_PwrRecupMaxAvlbMotorTorqSta_enum1 "AppSwcOpm/Opm20ms/CHACAN_OUT_20ms/Msg_VCU_D_Status_CHA/Subsys_VOPM_PwrRecupMaxAvlbMotorTorqSta_enum1"
 /begin REF_CHARACTERISTIC KOPM_PwrRecupMaxAvlbMotorTorqStaHi_enum KOPM_PwrRecupMaxAvlbMotorTorqStaLo_enum KOPM_PwrRecupMaxAvlbMotorTorqSta_enum_ovrdflg KOPM_PwrRecupMaxAvlbMotorTorqSta_enum_ovrdval /end REF_CHARACTERISTIC
 /begin REF_MEASUREMENT VOPM_PwrRecupMaxAvlbMotorTorqSta_enum /end REF_MEASUREMENT
/end GROUP
/begin GROUP S272_Subsys_VOPM_StrgRecupReqBrkLampOn_flg1 "AppSwcOpm/Opm20ms/CHACAN_OUT_20ms/Msg_VCU_D_Status_CHA/Subsys_VOPM_StrgRecupReqBrkLampOn_flg1"
 /begin REF_CHARACTERISTIC KOPM_StrgRecupReqBrkLampOn_flg_ovrdflg KOPM_StrgRecupReqBrkLampOn_flg_ovrdval /end REF_CHARACTERISTIC
 /begin REF_MEASUREMENT VOPM_StrgRecupReqBrkLampOn_flg /end REF_MEASUREMENT
/end GROUP
/begin GROUP S272_Subsys_VOPM_VCUACCStandstillReq_flg1 "AppSwcOpm/Opm20ms/CHACAN_OUT_20ms/Msg_VCU_D_Status_CHA/Subsys_VOPM_VCUACCStandstillReq_flg1"
 /begin REF_CHARACTERISTIC KOPM_VCUACCStandstillReq_flg_ovrdflg KOPM_VCUACCStandstillReq_flg_ovrdval /end REF_CHARACTERISTIC
 /begin REF_MEASUREMENT VOPM_VCUACCStandstillReq_flg /end REF_MEASUREMENT
/end GROUP
/begin GROUP S272_Subsys_VOPM_VCUACCStat_enum "AppSwcOpm/Opm20ms/CHACAN_OUT_20ms/Msg_VCU_D_Status_CHA/Subsys_VOPM_VCUACCStat_enum"
 /begin REF_CHARACTERISTIC KOPM_VCUACCStatHi_enum KOPM_VCUACCStatLo_enum KOPM_VCUACCStat_enum_ovrdflg KOPM_VCUACCStat_enum_ovrdval /end REF_CHARACTERISTIC
 /begin REF_MEASUREMENT VOPM_VCUACCStat_enum /end REF_MEASUREMENT
/end GROUP
/begin GROUP S272_Subsys_VOPM_VCUAccTgtAxReq_flg1 "AppSwcOpm/Opm20ms/CHACAN_OUT_20ms/Msg_VCU_D_Status_CHA/Subsys_VOPM_VCUAccTgtAxReq_flg1"
 /begin REF_CHARACTERISTIC KOPM_VCUAccTgtAxReq_flg_ovrdflg KOPM_VCUAccTgtAxReq_flg_ovrdval /end REF_CHARACTERISTIC
 /begin REF_MEASUREMENT VOPM_VCUAccTgtAxReq_flg /end REF_MEASUREMENT
/end GROUP
/begin GROUP S272_Subsys_VOPM_VCUAccTgtAx_mps1 "AppSwcOpm/Opm20ms/CHACAN_OUT_20ms/Msg_VCU_D_Status_CHA/Subsys_VOPM_VCUAccTgtAx_mps1"
 /begin REF_CHARACTERISTIC KOPM_VCUAccTgtAxHi_mps2 KOPM_VCUAccTgtAxLo_mps2 KOPM_VCUAccTgtAx_mps2_ovrdflg KOPM_VCUAccTgtAx_mps2_ovrdval /end REF_CHARACTERISTIC
 /begin REF_MEASUREMENT VOPM_VCUAccTgtAx_mps2 /end REF_MEASUREMENT
/end GROUP
/begin GROUP S272_Subsys_VOPM_VCUBraTorReq_Nm1 "AppSwcOpm/Opm20ms/CHACAN_OUT_20ms/Msg_VCU_D_Status_CHA/Subsys_VOPM_VCUBraTorReq_Nm1"
 /begin REF_CHARACTERISTIC KOPM_VCUBraTorReqHi_Nm KOPM_VCUBraTorReqLo_Nm KOPM_VCUBraTorReq_Nm_ovrdflg KOPM_VCUBraTorReq_Nm_ovrdval /end REF_CHARACTERISTIC
 /begin REF_MEASUREMENT VOPM_VCUBraTorReq_Nm /end REF_MEASUREMENT
/end GROUP
/begin GROUP S272_Subsys_VOPM_VCUCruiseCtrTgtSpd_kph1 "AppSwcOpm/Opm20ms/CHACAN_OUT_20ms/Msg_VCU_D_Status_CHA/Subsys_VOPM_VCUCruiseCtrTgtSpd_kph1"
 /begin REF_CHARACTERISTIC KOPM_VCUCruiseCtrTgtSpdHi_kph KOPM_VCUCruiseCtrTgtSpdLo_kph KOPM_VCUCruiseCtrTgtSpd_kph_ovrdflg KOPM_VCUCruiseCtrTgtSpd_kph_ovrdval /end REF_CHARACTERISTIC
 /begin REF_MEASUREMENT VOPM_VCUCruiseCtrTgtSpd_kph /end REF_MEASUREMENT
/end GROUP
/begin GROUP S272_Subsys_VOPM_VCUCruiseCtrlSta_enum1 "AppSwcOpm/Opm20ms/CHACAN_OUT_20ms/Msg_VCU_D_Status_CHA/Subsys_VOPM_VCUCruiseCtrlSta_enum1"
 /begin REF_CHARACTERISTIC KOPM_VCUCruiseCtrlStaHi_enum KOPM_VCUCruiseCtrlStaLo_enum KOPM_VCUCruiseCtrlSta_enum_ovrdflg KOPM_VCUCruiseCtrlSta_enum_ovrdval /end REF_CHARACTERISTIC
 /begin REF_MEASUREMENT VOPM_VCUCruiseCtrlSta_enum /end REF_MEASUREMENT
/end GROUP
/begin GROUP S272_Subsys_VOPM_VCUEPBApplyForbid_enum1 "AppSwcOpm/Opm20ms/CHACAN_OUT_20ms/Msg_VCU_D_Status_CHA/Subsys_VOPM_VCUEPBApplyForbid_enum1"
 /begin REF_CHARACTERISTIC KOPM_VCUEPBApplyForbidHi_enum KOPM_VCUEPBApplyForbidLo_enum KOPM_VCUEPBApplyForbid_enum_ovrdflg KOPM_VCUEPBApplyForbid_enum_ovrdval /end REF_CHARACTERISTIC
 /begin REF_MEASUREMENT VOPM_VCUEPBApplyForbid_enum /end REF_MEASUREMENT
/end GROUP
/begin GROUP S272_Subsys_VOPM_VCUParkSwStaVld_flg1 "AppSwcOpm/Opm20ms/CHACAN_OUT_20ms/Msg_VCU_D_Status_CHA/Subsys_VOPM_VCUParkSwStaVld_flg1"
 /begin REF_CHARACTERISTIC KOPM_VCUParkSwStaVld_flg_ovrdflg KOPM_VCUParkSwStaVld_flg_ovrdval /end REF_CHARACTERISTIC
 /begin REF_MEASUREMENT VOPM_VCUParkSwStaVld_flg /end REF_MEASUREMENT
/end GROUP
/begin GROUP S272_Subsys_VOPM_VCUParkSwSta_flg1 "AppSwcOpm/Opm20ms/CHACAN_OUT_20ms/Msg_VCU_D_Status_CHA/Subsys_VOPM_VCUParkSwSta_flg1"
 /begin REF_CHARACTERISTIC KOPM_VCUParkSwSta_flg_ovrdflg KOPM_VCUParkSwSta_flg_ovrdval /end REF_CHARACTERISTIC
 /begin REF_MEASUREMENT VOPM_VCUParkSwSta_flg /end REF_MEASUREMENT
/end GROUP
/begin GROUP S272_Subsys_VOPM_VCUPreKeReq_flg1 "AppSwcOpm/Opm20ms/CHACAN_OUT_20ms/Msg_VCU_D_Status_CHA/Subsys_VOPM_VCUPreKeReq_flg1" /begin REF_CHARACTERISTIC KOPM_VCUPreKeReq_flg_ovrdflg KOPM_VCUPreKeReq_flg_ovrdval /end REF_CHARACTERISTIC /begin REF_MEASUREMENT VOPM_VCUPreKeReq_flg /end REF_MEASUREMENT /end GROUP
/begin GROUP S272_Subsys_VOPM_VCUReqAutoBrk_enum1 "AppSwcOpm/Opm20ms/CHACAN_OUT_20ms/Msg_VCU_D_Status_CHA/Subsys_VOPM_VCUReqAutoBrk_enum1"
 /begin REF_CHARACTERISTIC KOPM_VCUReqAutoBrkHi_enum KOPM_VCUReqAutoBrkLo_enum KOPM_VCUReqAutoBrk_enum_ovrdflg KOPM_VCUReqAutoBrk_enum_ovrdval /end REF_CHARACTERISTIC
 /begin REF_MEASUREMENT VOPM_VCUReqAutoBrk_enum /end REF_MEASUREMENT
/end GROUP
/begin GROUP S272_Subsys_VOPM_VCUReqEPBVld_flg1 "AppSwcOpm/Opm20ms/CHACAN_OUT_20ms/Msg_VCU_D_Status_CHA/Subsys_VOPM_VCUReqEPBVld_flg1"
 /begin REF_CHARACTERISTIC KOPM_VCUReqEPBVld_flg_ovrdflg KOPM_VCUReqEPBVld_flg_ovrdval /end REF_CHARACTERISTIC
 /begin REF_MEASUREMENT VOPM_VCUReqEPBVld_flg /end REF_MEASUREMENT
/end GROUP
/begin GROUP S272_Subsys_VOPM_VCUReqEPB_enum1 "AppSwcOpm/Opm20ms/CHACAN_OUT_20ms/Msg_VCU_D_Status_CHA/Subsys_VOPM_VCUReqEPB_enum1"
 /begin REF_CHARACTERISTIC KOPM_VCUReqEPBHi_enum KOPM_VCUReqEPBLo_enum KOPM_VCUReqEPB_enum_ovrdflg KOPM_VCUReqEPB_enum_ovrdval /end REF_CHARACTERISTIC
 /begin REF_MEASUREMENT VOPM_VCUReqEPB_enum /end REF_MEASUREMENT
/end GROUP
/begin GROUP S308_Subsys_VOPM_AllowHeatCoolMaxPwrCmsp_kW "AppSwcOpm/Opm20ms/EptCAN_OUT_20ms/Msg_VCU_3_OprtCmd_EPT/Subsys_VOPM_AllowHeatCoolMaxPwrCmsp_kW"
 /begin REF_CHARACTERISTIC KOPM_AllowHeatCoolMaxPwrCmspHi_kW KOPM_AllowHeatCoolMaxPwrCmspLo_kW KOPM_AllowHeatCoolMaxPwrCmsp_kW_ovrdflg KOPM_AllowHeatCoolMaxPwrCmsp_kW_ovrdval /end REF_CHARACTERISTIC
 /begin REF_MEASUREMENT VOPM_AllowHeatCoolMaxPwrCmsp_kW /end REF_MEASUREMENT
/end GROUP
/begin GROUP S308_Subsys_VOPM_BMSWakeupMode_enum "AppSwcOpm/Opm20ms/EptCAN_OUT_20ms/Msg_VCU_3_OprtCmd_EPT/Subsys_VOPM_BMSWakeupMode_enum"
 /begin REF_CHARACTERISTIC KOPM_BMSWakeupModeHi_enum KOPM_BMSWakeupModeLo_enum KOPM_BMSWakeupMode_enum_ovrdflg KOPM_BMSWakeupMode_enum_ovrdval /end REF_CHARACTERISTIC
 /begin REF_MEASUREMENT VOPM_BMSWakeupMode_enum /end REF_MEASUREMENT
/end GROUP
/begin GROUP S308_Subsys_VOPM_Bat2DrvTrainEnb_flg "AppSwcOpm/Opm20ms/EptCAN_OUT_20ms/Msg_VCU_3_OprtCmd_EPT/Subsys_VOPM_Bat2DrvTrainEnb_flg"
 /begin REF_CHARACTERISTIC KOPM_Bat2DrvTrainEnb_flg_ovrdflg KOPM_Bat2DrvTrainEnb_flg_ovrdval /end REF_CHARACTERISTIC
 /begin REF_MEASUREMENT VOPM_Bat2DrvTrainEnb_flg /end REF_MEASUREMENT
/end GROUP
/begin GROUP S308_Subsys_VOPM_ChrgEnaAC_enum "AppSwcOpm/Opm20ms/EptCAN_OUT_20ms/Msg_VCU_3_OprtCmd_EPT/Subsys_VOPM_ChrgEnaAC_enum"
 /begin REF_CHARACTERISTIC KOPM_ChrgEnaACHi_enum KOPM_ChrgEnaACLo_enum KOPM_ChrgEnaAC_enum_ovrdflg KOPM_ChrgEnaAC_enum_ovrdval /end REF_CHARACTERISTIC
 /begin REF_MEASUREMENT VOPM_ChrgEnaAC_enum /end REF_MEASUREMENT
/end GROUP
/begin GROUP S308_Subsys_VOPM_MotorOutputCooltTemp_C "AppSwcOpm/Opm20ms/EptCAN_OUT_20ms/Msg_VCU_3_OprtCmd_EPT/Subsys_VOPM_MotorOutputCooltTemp_C"
 /begin REF_CHARACTERISTIC KOPM_MotorOutputCooltTempHi_C KOPM_MotorOutputCooltTempLo_C KOPM_MotorOutputCooltTemp_C_ovrdflg KOPM_MotorOutputCooltTemp_C_ovrdval /end REF_CHARACTERISTIC
 /begin REF_MEASUREMENT VOPM_MotorOutputCooltTemp_C /end REF_MEASUREMENT
/end GROUP
/begin GROUP S309_Subsys_VOPM_BMSShutdown_enum "AppSwcOpm/Opm20ms/EptCAN_OUT_20ms/Msg_VCU_4_ChrgCmd_EPT/Subsys_VOPM_BMSShutdown_enum"
 /begin REF_CHARACTERISTIC KOPM_BMSShutdownHi_enum KOPM_BMSShutdownLo_enum KOPM_BMSShutdown_enum_ovrdflg KOPM_BMSShutdown_enum_ovrdval /end REF_CHARACTERISTIC
 /begin REF_MEASUREMENT VOPM_BMSShutdown_enum /end REF_MEASUREMENT
/end GROUP
/begin GROUP S309_Subsys_VOPM_ChrgAllowCmd_enum "AppSwcOpm/Opm20ms/EptCAN_OUT_20ms/Msg_VCU_4_ChrgCmd_EPT/Subsys_VOPM_ChrgAllowCmd_enum"
 /begin REF_CHARACTERISTIC KOPM_ChrgAllowCmdHi_enum KOPM_ChrgAllowCmdLo_enum KOPM_ChrgAllowCmd_enum_ovrdflg KOPM_ChrgAllowCmd_enum_ovrdval /end REF_CHARACTERISTIC
 /begin REF_MEASUREMENT VOPM_ChrgAllowCmd_enum /end REF_MEASUREMENT
/end GROUP
/begin GROUP S309_Subsys_VOPM_ChrgEnaDC_flg "AppSwcOpm/Opm20ms/EptCAN_OUT_20ms/Msg_VCU_4_ChrgCmd_EPT/Subsys_VOPM_ChrgEnaDC_flg" /begin REF_CHARACTERISTIC KOPM_ChrgEnaDC_flg_ovrdflg KOPM_ChrgEnaDC_flg_ovrdval /end REF_CHARACTERISTIC /begin REF_MEASUREMENT VOPM_ChrgEnaDC_flg /end REF_MEASUREMENT /end GROUP
/begin GROUP S309_Subsys_VOPM_MaxChrgCurntAC_A "AppSwcOpm/Opm20ms/EptCAN_OUT_20ms/Msg_VCU_4_ChrgCmd_EPT/Subsys_VOPM_MaxChrgCurntAC_A"
 /begin REF_CHARACTERISTIC KOPM_MaxChrgCurntACHi_A KOPM_MaxChrgCurntACLo_A KOPM_MaxChrgCurntAC_A_ovrdflg KOPM_MaxChrgCurntAC_A_ovrdval /end REF_CHARACTERISTIC
 /begin REF_MEASUREMENT VOPM_MaxChrgCurntAC_A /end REF_MEASUREMENT
/end GROUP
/begin GROUP S309_Subsys_VOPM_MaxChrgCurntDC_A "AppSwcOpm/Opm20ms/EptCAN_OUT_20ms/Msg_VCU_4_ChrgCmd_EPT/Subsys_VOPM_MaxChrgCurntDC_A"
 /begin REF_CHARACTERISTIC KOPM_MaxChrgCurntDCHi_A KOPM_MaxChrgCurntDCLo_A KOPM_MaxChrgCurntDC_A_ovrdflg KOPM_MaxChrgCurntDC_A_ovrdval /end REF_CHARACTERISTIC
 /begin REF_MEASUREMENT VOPM_MaxChrgCurntDC_A /end REF_MEASUREMENT
/end GROUP
/begin GROUP S309_Subsys_VOPM_MaxChrgVoltDC_V "AppSwcOpm/Opm20ms/EptCAN_OUT_20ms/Msg_VCU_4_ChrgCmd_EPT/Subsys_VOPM_MaxChrgVoltDC_V"
 /begin REF_CHARACTERISTIC KOPM_MaxChrgVoltDCHi_V KOPM_MaxChrgVoltDCLo_V KOPM_MaxChrgVoltDC_V_ovrdflg KOPM_MaxChrgVoltDC_V_ovrdval /end REF_CHARACTERISTIC
 /begin REF_MEASUREMENT VOPM_MaxChrgVoltDC_V /end REF_MEASUREMENT
/end GROUP
/begin GROUP S309_Subsys_VOPM_OBCOprtCmd_enum "AppSwcOpm/Opm20ms/EptCAN_OUT_20ms/Msg_VCU_4_ChrgCmd_EPT/Subsys_VOPM_OBCOprtCmd_enum"
 /begin REF_CHARACTERISTIC KOPM_OBCOprtCmdHi_enum KOPM_OBCOprtCmdLo_enum KOPM_OBCOprtCmd_enum_ovrdflg KOPM_OBCOprtCmd_enum_ovrdval /end REF_CHARACTERISTIC
 /begin REF_MEASUREMENT VOPM_OBCOprtCmd_enum /end REF_MEASUREMENT
/end GROUP
/begin GROUP S310_Subsys_VOPM_DCCOprtCmd_enum "AppSwcOpm/Opm20ms/EptCAN_OUT_20ms/Msg_VCU_B_AcclPedal_EPT/Subsys_VOPM_DCCOprtCmd_enum"
 /begin REF_CHARACTERISTIC KOPM_DCCOprtCmdHi_enum KOPM_DCCOprtCmdLo_enum KOPM_DCCOprtCmd_enum_ovrdflg KOPM_DCCOprtCmd_enum_ovrdval /end REF_CHARACTERISTIC
 /begin REF_MEASUREMENT VOPM_DCCOprtCmd_enum /end REF_MEASUREMENT
/end GROUP
/begin GROUP S310_Subsys_VOPM_ErrAmount_cnt "AppSwcOpm/Opm20ms/EptCAN_OUT_20ms/Msg_VCU_B_AcclPedal_EPT/Subsys_VOPM_ErrAmount_cnt"
 /begin REF_CHARACTERISTIC KOPM_ErrAmountHi_cnt KOPM_ErrAmountLo_cnt KOPM_ErrAmount_cnt_ovrdflg KOPM_ErrAmount_cnt_ovrdval /end REF_CHARACTERISTIC
 /begin REF_MEASUREMENT VOPM_ErrAmount_cnt /end REF_MEASUREMENT
/end GROUP
/begin GROUP S310_Subsys_VOPM_ErrBit_nu "AppSwcOpm/Opm20ms/EptCAN_OUT_20ms/Msg_VCU_B_AcclPedal_EPT/Subsys_VOPM_ErrBit_nu"
 /begin REF_CHARACTERISTIC KOPM_ErrBitHi_nu KOPM_ErrBitLo_nu KOPM_ErrBit_nu_ovrdflg KOPM_ErrBit_nu_ovrdval /end REF_CHARACTERISTIC
 /begin REF_MEASUREMENT VOPM_ErrBit_nu /end REF_MEASUREMENT
/end GROUP
/begin GROUP S310_Subsys_VOPM_SysFailSta_enum "AppSwcOpm/Opm20ms/EptCAN_OUT_20ms/Msg_VCU_B_AcclPedal_EPT/Subsys_VOPM_SysFailSta_enum"
 /begin REF_CHARACTERISTIC KOPM_SysFailStaHi_enum KOPM_SysFailStaLo_enum KOPM_SysFailSta_enum_ovrdflg KOPM_SysFailSta_enum_ovrdval /end REF_CHARACTERISTIC
 /begin REF_MEASUREMENT VOPM_SysFailSta_enum /end REF_MEASUREMENT
/end GROUP
/begin GROUP S311_Subsys_VOPM_DCCBoostHvVolt_V "AppSwcOpm/Opm20ms/EptCAN_OUT_20ms/Msg_VCU_C_OprtCmd_EPT/Subsys_VOPM_DCCBoostHvVolt_V"
 /begin REF_CHARACTERISTIC KOPM_DCCBoostHvVoltHi_V KOPM_DCCBoostHvVoltLo_V KOPM_DCCBoostHvVolt_V_ovrdflg KOPM_DCCBoostHvVolt_V_ovrdval /end REF_CHARACTERISTIC
 /begin REF_MEASUREMENT VOPM_DCCBoostHvVolt_V /end REF_MEASUREMENT
/end GROUP
/begin GROUP S311_Subsys_VOPM_DCCBuckLVVolt_V "AppSwcOpm/Opm20ms/EptCAN_OUT_20ms/Msg_VCU_C_OprtCmd_EPT/Subsys_VOPM_DCCBuckLVVolt_V"
 /begin REF_CHARACTERISTIC KOPM_DCCBuckLVVoltHi_V KOPM_DCCBuckLVVoltLo_V KOPM_DCCBuckLVVolt_V_ovrdflg KOPM_DCCBuckLVVolt_V_ovrdval /end REF_CHARACTERISTIC
 /begin REF_MEASUREMENT VOPM_DCCBuckLVVolt_V /end REF_MEASUREMENT
/end GROUP
/begin GROUP S311_Subsys_VOPM_MaxHVDCCurntAC_A "AppSwcOpm/Opm20ms/EptCAN_OUT_20ms/Msg_VCU_C_OprtCmd_EPT/Subsys_VOPM_MaxHVDCCurntAC_A"
 /begin REF_CHARACTERISTIC KOPM_MaxHVDCCurntACHi_A KOPM_MaxHVDCCurntACLo_A KOPM_MaxHVDCCurntAC_A_ovrdflg KOPM_MaxHVDCCurntAC_A_ovrdval /end REF_CHARACTERISTIC
 /begin REF_MEASUREMENT VOPM_MaxHVDCCurntAC_A /end REF_MEASUREMENT
/end GROUP
/begin GROUP S311_Subsys_VOPM_MaxHVDCVoltAC_V "AppSwcOpm/Opm20ms/EptCAN_OUT_20ms/Msg_VCU_C_OprtCmd_EPT/Subsys_VOPM_MaxHVDCVoltAC_V"
 /begin REF_CHARACTERISTIC KOPM_MaxHVDCVoltACHi_V KOPM_MaxHVDCVoltACLo_V KOPM_MaxHVDCVoltAC_V_ovrdflg KOPM_MaxHVDCVoltAC_V_ovrdval /end REF_CHARACTERISTIC
 /begin REF_MEASUREMENT VOPM_MaxHVDCVoltAC_V /end REF_MEASUREMENT
/end GROUP
/begin GROUP S311_Subsys_VOPM_OBCIntDchrgEna_flg "AppSwcOpm/Opm20ms/EptCAN_OUT_20ms/Msg_VCU_C_OprtCmd_EPT/Subsys_VOPM_OBCIntDchrgEna_flg"
 /begin REF_CHARACTERISTIC KOPM_OBCIntDchrgEna_flg_ovrdflg KOPM_OBCIntDchrgEna_flg_ovrdval /end REF_CHARACTERISTIC
 /begin REF_MEASUREMENT VOPM_OBCIntDchrgEna_flg /end REF_MEASUREMENT
/end GROUP
/begin GROUP S342_Subsys_VOPM_12VBatLowVolSta_enum "AppSwcOpm/Opm50ms/BacCAN_OUT_50ms/Msg_BCML_B_Package/Subsys_VOPM_12VBatLowVolSta_enum"
 /begin REF_CHARACTERISTIC KOPM_12VBatLowVolStaHi_enum KOPM_12VBatLowVolStaLo_enum KOPM_12VBatLowVolSta_enum_ovrdflg KOPM_12VBatLowVolSta_enum_ovrdval /end REF_CHARACTERISTIC
 /begin REF_MEASUREMENT VOPM_12VBatLowVolSta_enum /end REF_MEASUREMENT
/end GROUP
/end MODULE
/end PROJECT
