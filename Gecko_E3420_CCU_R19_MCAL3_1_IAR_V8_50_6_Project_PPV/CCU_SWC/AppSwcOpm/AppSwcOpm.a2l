/******************************************************************************
* ASAP2 file: AppSwcOpm.a2l
* Code generation for model "AppSwcOpm".
* Model version : 9.95
* Simulink Coder version : 9.8 (R2022b) 13-May-2022
* C source code generated on : Wed Sep 25 10:30:11 2024
* Target selection: autosar.tlc
* Embedded hardware selection: NXP->Cortex-M4
* Code generation objectives: Unspecified
* Validation result: Not run
* (add additional file header information here)
******************************************************************************/
/* Version 1.31 */
ASAP2_VERSION 1 31
/begin PROJECT ProjectName "Project Comment Goes Here"
/begin HEADER "Header Comments go here" /end HEADER
/begin MODULE ModuleName "Module Comment Goes Here"
/begin MOD_PAR "MOD PAR Comment Goes Here" /end MOD_PAR
/begin MOD_COMMON "Mod Common Comment Here" BYTE_ORDER MSB_LAST /end MOD_COMMON
/begin RECORD_LAYOUT Scalar_BOOLEAN FNC_VALUES 1 UBYTE COLUMN_DIR DIRECT /end RECORD_LAYOUT
/begin RECORD_LAYOUT Scalar_UBYTE FNC_VALUES 1 UBYTE COLUMN_DIR DIRECT /end RECORD_LAYOUT
/begin RECORD_LAYOUT Scalar_BYTE FNC_VALUES 1 SBYTE COLUMN_DIR DIRECT /end RECORD_LAYOUT
/begin RECORD_LAYOUT Scalar_UWORD FNC_VALUES 1 UWORD COLUMN_DIR DIRECT /end RECORD_LAYOUT
/begin RECORD_LAYOUT Scalar_SWORD FNC_VALUES 1 SWORD COLUMN_DIR DIRECT /end RECORD_LAYOUT
/begin RECORD_LAYOUT Scalar_ULONG FNC_VALUES 1 ULONG COLUMN_DIR DIRECT /end RECORD_LAYOUT
/begin RECORD_LAYOUT Scalar_LONG FNC_VALUES 1 SLONG COLUMN_DIR DIRECT /end RECORD_LAYOUT
/begin RECORD_LAYOUT Scalar_FLOAT32_IEEE FNC_VALUES 1 FLOAT32_IEEE COLUMN_DIR DIRECT /end RECORD_LAYOUT
/begin RECORD_LAYOUT Scalar_FLOAT64_IEEE FNC_VALUES 1 FLOAT64_IEEE COLUMN_DIR DIRECT /end RECORD_LAYOUT
/begin RECORD_LAYOUT Lookup1D_BOOLEAN FNC_VALUES 1 UBYTE COLUMN_DIR DIRECT /end RECORD_LAYOUT
/begin RECORD_LAYOUT Lookup1D_X_BOOLEAN AXIS_PTS_X 1 UBYTE INDEX_INCR DIRECT /end RECORD_LAYOUT
/begin RECORD_LAYOUT Lookup1D_BYTE FNC_VALUES 1 SBYTE COLUMN_DIR DIRECT /end RECORD_LAYOUT
/begin RECORD_LAYOUT Lookup1D_X_BYTE AXIS_PTS_X 1 SBYTE INDEX_INCR DIRECT /end RECORD_LAYOUT
/begin RECORD_LAYOUT Lookup1D_UBYTE FNC_VALUES 1 UBYTE COLUMN_DIR DIRECT /end RECORD_LAYOUT
/begin RECORD_LAYOUT Lookup1D_X_UBYTE AXIS_PTS_X 1 UBYTE INDEX_INCR DIRECT /end RECORD_LAYOUT
/begin RECORD_LAYOUT Lookup1D_UWORD FNC_VALUES 1 UWORD COLUMN_DIR DIRECT /end RECORD_LAYOUT
/begin RECORD_LAYOUT Lookup1D_X_UWORD AXIS_PTS_X 1 UWORD INDEX_INCR DIRECT /end RECORD_LAYOUT
/begin RECORD_LAYOUT Lookup1D_WORD FNC_VALUES 1 SWORD COLUMN_DIR DIRECT /end RECORD_LAYOUT
/begin CHARACTERISTIC KOPM_ACActTotPwrHi_kW "AC_2_State_BOD" VALUE 0x0000 /* @ECU_Address@KOPM_ACActTotPwrHi_kW@ */ Scalar_FLOAT32_IEEE 0 AppSwcOpm_CM_single_kW -100000.0 100000.0 /end CHARACTERISTIC
/begin CHARACTERISTIC KOPM_ACActTotPwrLo_kW "AC_2_State_BOD" VALUE 0x0000 /* @ECU_Address@KOPM_ACActTotPwrLo_kW@ */ Scalar_FLOAT32_IEEE 0 AppSwcOpm_CM_single_kW -100000.0 100000.0 /end CHARACTERISTIC
/begin CHARACTERISTIC KOPM_ACActTotPwr_kW_ovrdval "AC_2_State_BOD" VALUE 0x0000 /* @ECU_Address@KOPM_ACActTotPwr_kW_ovrdval@ */ Scalar_FLOAT32_IEEE 0 AppSwcOpm_CM_single_kW -100000.0 100000.0 /end CHARACTERISTIC
/begin CHARACTERISTIC KOPM_ACCompMaxAllowPwrCmspHi_kW "AC_1_Command_BOD" VALUE 0x0000 /* @ECU_Address@KOPM_ACCompMaxAllowPwrCmspHi_kW@ */ Scalar_FLOAT32_IEEE 0 AppSwcOpm_CM_single_kW -100000.0 100000.0 /end CHARACTERISTIC
/begin CHARACTERISTIC KOPM_ACCompMaxAllowPwrCmspLo_kW "AC_1_Command_BOD" VALUE 0x0000 /* @ECU_Address@KOPM_ACCompMaxAllowPwrCmspLo_kW@ */ Scalar_FLOAT32_IEEE 0 AppSwcOpm_CM_single_kW -100000.0 100000.0 /end CHARACTERISTIC
/begin CHARACTERISTIC KOPM_ACCompMaxAllowPwrCmsp_kW_ovrdval "AC_1_Command_BOD" VALUE 0x0000 /* @ECU_Address@KOPM_ACCompMaxAllowPwrCmsp_kW_ovrdval@ */ Scalar_FLOAT32_IEEE 0 AppSwcOpm_CM_single_kW -100000.0 100000.0 /end CHARACTERISTIC
/begin CHARACTERISTIC KOPM_ACCompTgtSpdHi_rpm "AC_1_Command_BOD" VALUE 0x0000 /* @ECU_Address@KOPM_ACCompTgtSpdHi_rpm@ */ Scalar_FLOAT32_IEEE 0 AppSwcOpm_CM_single_rpm -100000.0 100000.0 /end CHARACTERISTIC
/begin CHARACTERISTIC KOPM_ACCompTgtSpdLo_rpm "AC_1_Command_BOD" VALUE 0x0000 /* @ECU_Address@KOPM_ACCompTgtSpdLo_rpm@ */ Scalar_FLOAT32_IEEE 0 AppSwcOpm_CM_single_rpm -100000.0 100000.0 /end CHARACTERISTIC
/begin CHARACTERISTIC KOPM_ACCompTgtSpd_rpm_ovrdval "AC_1_Command_BOD" VALUE 0x0000 /* @ECU_Address@KOPM_ACCompTgtSpd_rpm_ovrdval@ */ Scalar_FLOAT32_IEEE 0 AppSwcOpm_CM_single_rpm -100000.0 100000.0 /end CHARACTERISTIC
/begin CHARACTERISTIC KOPM_ACEnvirTempHi_C "AC_3_State_BOD" VALUE 0x0000 /* @ECU_Address@KOPM_ACEnvirTempHi_C@ */ Scalar_FLOAT32_IEEE 0 AppSwcOpm_CM_single_C -100000.0 100000.0 /end CHARACTERISTIC
/begin CHARACTERISTIC KOPM_ACEnvirTempLo_C "AC_3_State_BOD" VALUE 0x0000 /* @ECU_Address@KOPM_ACEnvirTempLo_C@ */ Scalar_FLOAT32_IEEE 0 AppSwcOpm_CM_single_C -100000.0 100000.0 /end CHARACTERISTIC
/begin CHARACTERISTIC KOPM_ACEnvirTemp_C_ovrdval "AC_3_State_BOD" VALUE 0x0000 /* @ECU_Address@KOPM_ACEnvirTemp_C_ovrdval@ */ Scalar_FLOAT32_IEEE 0 AppSwcOpm_CM_single_C -100000.0 100000.0 /end CHARACTERISTIC
/begin CHARACTERISTIC KOPM_ACEvapTgtTempHi_C "AC_8_status_BOD" VALUE 0x0000 /* @ECU_Address@KOPM_ACEvapTgtTempHi_C@ */ Scalar_FLOAT32_IEEE 0 AppSwcOpm_CM_single_C -100000.0 100000.0 /end CHARACTERISTIC
/begin CHARACTERISTIC KOPM_ACEvapTgtTempLo_C "AC_8_status_BOD" VALUE 0x0000 /* @ECU_Address@KOPM_ACEvapTgtTempLo_C@ */ Scalar_FLOAT32_IEEE 0 AppSwcOpm_CM_single_C -100000.0 100000.0 /end CHARACTERISTIC
/begin CHARACTERISTIC KOPM_ACEvapTgtTemp_C_ovrdval "AC_8_status_BOD" VALUE 0x0000 /* @ECU_Address@KOPM_ACEvapTgtTemp_C_ovrdval@ */ Scalar_FLOAT32_IEEE 0 AppSwcOpm_CM_single_C -100000.0 100000.0 /end CHARACTERISTIC
/begin CHARACTERISTIC KOPM_ACHVHActlPwrHi_KW "AC_2_State_BOD" VALUE 0x0000 /* @ECU_Address@KOPM_ACHVHActlPwrHi_KW@ */ Scalar_FLOAT32_IEEE 0 AppSwcOpm_CM_single_kW -100000.0 100000.0 /end CHARACTERISTIC
/begin CHARACTERISTIC KOPM_ACHVHActlPwrLo_KW "AC_2_State_BOD" VALUE 0x0000 /* @ECU_Address@KOPM_ACHVHActlPwrLo_KW@ */ Scalar_FLOAT32_IEEE 0 AppSwcOpm_CM_single_kW -100000.0 100000.0 /end CHARACTERISTIC
/begin CHARACTERISTIC KOPM_ACHVHActlPwr_KW_ovrdval "AC_2_State_BOD" VALUE 0x0000 /* @ECU_Address@KOPM_ACHVHActlPwr_KW_ovrdval@ */ Scalar_FLOAT32_IEEE 0 AppSwcOpm_CM_single_kW -100000.0 100000.0 /end CHARACTERISTIC
/begin CHARACTERISTIC KOPM_ACHVHDevInternTempHi_C "AC_2_State_BOD" VALUE 0x0000 /* @ECU_Address@KOPM_ACHVHDevInternTempHi_C@ */ Scalar_FLOAT32_IEEE 0 AppSwcOpm_CM_single_C -100000.0 100000.0 /end CHARACTERISTIC
/begin CHARACTERISTIC KOPM_ACHVHDevInternTempLo_C "AC_2_State_BOD" VALUE 0x0000 /* @ECU_Address@KOPM_ACHVHDevInternTempLo_C@ */ Scalar_FLOAT32_IEEE 0 AppSwcOpm_CM_single_C -100000.0 100000.0 /end CHARACTERISTIC
/begin CHARACTERISTIC KOPM_ACHVHDevInternTemp_C_ovrdval "AC_2_State_BOD" VALUE 0x0000 /* @ECU_Address@KOPM_ACHVHDevInternTemp_C_ovrdval@ */ Scalar_FLOAT32_IEEE 0 AppSwcOpm_CM_single_C -100000.0 100000.0 /end CHARACTERISTIC
/begin CHARACTERISTIC KOPM_ACHighVolDCTotalPwrHi_kW "AC_1_Command_BOD" VALUE 0x0000 /* @ECU_Address@KOPM_ACHighVolDCTotalPwrHi_kW@ */ Scalar_FLOAT32_IEEE 0 AppSwcOpm_CM_single_kW -100000.0 100000.0 /end CHARACTERISTIC
/begin CHARACTERISTIC KOPM_ACHighVolDCTotalPwrLo_kW "AC_1_Command_BOD" VALUE 0x0000 /* @ECU_Address@KOPM_ACHighVolDCTotalPwrLo_kW@ */ Scalar_FLOAT32_IEEE 0 AppSwcOpm_CM_single_kW -100000.0 100000.0 /end CHARACTERISTIC
/begin CHARACTERISTIC KOPM_ACHighVolDCTotalPwr_kW_ovrdval "AC_1_Command_BOD" VALUE 0x0000 /* @ECU_Address@KOPM_ACHighVolDCTotalPwr_kW_ovrdval@ */ Scalar_FLOAT32_IEEE 0 AppSwcOpm_CM_single_kW -100000.0 100000.0 /end CHARACTERISTIC
/begin CHARACTERISTIC KOPM_ACIndoorTempHi_C "AC_3_State_BOD" VALUE 0x0000 /* @ECU_Address@KOPM_ACIndoorTempHi_C@ */ Scalar_FLOAT32_IEEE 0 AppSwcOpm_CM_single_C -100000.0 100000.0 /end CHARACTERISTIC
/begin CHARACTERISTIC KOPM_ACIndoorTempLo_C "AC_3_State_BOD" VALUE 0x0000 /* @ECU_Address@KOPM_ACIndoorTempLo_C@ */ Scalar_FLOAT32_IEEE 0 AppSwcOpm_CM_single_C -100000.0 100000.0 /end CHARACTERISTIC
/begin CHARACTERISTIC KOPM_ACIndoorTemp_C_ovrdval "AC_3_State_BOD" VALUE 0x0000 /* @ECU_Address@KOPM_ACIndoorTemp_C_ovrdval@ */ Scalar_FLOAT32_IEEE 0 AppSwcOpm_CM_single_C -100000.0 100000.0 /end CHARACTERISTIC
/begin CHARACTERISTIC KOPM_ACRefrgLoPresHi_kPa "AC_8_status_BOD" VALUE 0x0000 /* @ECU_Address@KOPM_ACRefrgLoPresHi_kPa@ */ Scalar_FLOAT32_IEEE 0 AppSwcOpm_CM_single_kPa -100000.0 100000.0 /end CHARACTERISTIC
/begin CHARACTERISTIC KOPM_ACRefrgLoPresLo_kPa "AC_8_status_BOD" VALUE 0x0000 /* @ECU_Address@KOPM_ACRefrgLoPresLo_kPa@ */ Scalar_FLOAT32_IEEE 0 AppSwcOpm_CM_single_kPa -100000.0 100000.0 /end CHARACTERISTIC
/begin CHARACTERISTIC KOPM_ACRefrgLoPres_kPa_ovrdval "AC_8_status_BOD" VALUE 0x0000 /* @ECU_Address@KOPM_ACRefrgLoPres_kPa_ovrdval@ */ Scalar_FLOAT32_IEEE 0 AppSwcOpm_CM_single_kPa -100000.0 100000.0 /end CHARACTERISTIC
/begin CHARACTERISTIC KOPM_ActWhlTqHi_Nm "VCU_10_Torque_CHA" VALUE 0x0000 /* @ECU_Address@KOPM_ActWhlTqHi_Nm@ */ Scalar_FLOAT32_IEEE 0 AppSwcOpm_CM_single_Nm -100000.0 100000.0 /end CHARACTERISTIC
/begin CHARACTERISTIC KOPM_ActWhlTqLo_Nm "VCU_10_Torque_CHA" VALUE 0x0000 /* @ECU_Address@KOPM_ActWhlTqLo_Nm@ */ Scalar_FLOAT32_IEEE 0 AppSwcOpm_CM_single_Nm -100000.0 100000.0 /end CHARACTERISTIC
/begin CHARACTERISTIC KOPM_ActWhlTq_Nm_ovrdval "VCU_10_Torque_CHA" VALUE 0x0000 /* @ECU_Address@KOPM_ActWhlTq_Nm_ovrdval@ */ Scalar_FLOAT32_IEEE 0 AppSwcOpm_CM_single_Nm -100000.0 100000.0 /end CHARACTERISTIC
/begin CHARACTERISTIC KOPM_ActlMotorRotateSpdHi_rpm "VCU_10_Torque_CHA" VALUE 0x0000 /* @ECU_Address@KOPM_ActlMotorRotateSpdHi_rpm@ */ Scalar_FLOAT32_IEEE 0 AppSwcOpm_CM_single_rpm -100000.0 100000.0 /end CHARACTERISTIC
/begin CHARACTERISTIC KOPM_ActlMotorRotateSpdLo_rpm "VCU_10_Torque_CHA" VALUE 0x0000 /* @ECU_Address@KOPM_ActlMotorRotateSpdLo_rpm@ */ Scalar_FLOAT32_IEEE 0 AppSwcOpm_CM_single_rpm -100000.0 100000.0 /end CHARACTERISTIC
/begin CHARACTERISTIC KOPM_ActlMotorRotateSpd_rpm_ovrdval "VCU_10_Torque_CHA" VALUE 0x0000 /* @ECU_Address@KOPM_ActlMotorRotateSpd_rpm_ovrdval@ */ Scalar_FLOAT32_IEEE 0 AppSwcOpm_CM_single_rpm -100000.0 100000.0 /end CHARACTERISTIC
/begin CHARACTERISTIC KOPM_ActlMotorTorqHi_Nm "VCU_10_Torque_CHA" VALUE 0x0000 /* @ECU_Address@KOPM_ActlMotorTorqHi_Nm@ */ Scalar_FLOAT32_IEEE 0 AppSwcOpm_CM_single_Nm -100000.0 100000.0 /end CHARACTERISTIC
/begin CHARACTERISTIC KOPM_ActlMotorTorqLo_Nm "VCU_10_Torque_CHA" VALUE 0x0000 /* @ECU_Address@KOPM_ActlMotorTorqLo_Nm@ */ Scalar_FLOAT32_IEEE 0 AppSwcOpm_CM_single_Nm -100000.0 100000.0 /end CHARACTERISTIC
/begin CHARACTERISTIC KOPM_ActlMotorTorq_Nm_ovrdval "VCU_10_Torque_CHA" VALUE 0x0000 /* @ECU_Address@KOPM_ActlMotorTorq_Nm_ovrdval@ */ Scalar_FLOAT32_IEEE 0 AppSwcOpm_CM_single_Nm -100000.0 100000.0 /end CHARACTERISTIC
/begin CHARACTERISTIC KOPM_BrkPwrRecupActWhlTqHi_Nm "VCU_10_Torque_CHA" VALUE 0x0000 /* @ECU_Address@KOPM_BrkPwrRecupActWhlTqHi_Nm@ */ Scalar_FLOAT32_IEEE 0 AppSwcOpm_CM_single_Nm -100000.0 100000.0 /end CHARACTERISTIC
/begin CHARACTERISTIC KOPM_BrkPwrRecupActWhlTqLo_Nm "VCU_10_Torque_CHA" VALUE 0x0000 /* @ECU_Address@KOPM_BrkPwrRecupActWhlTqLo_Nm@ */ Scalar_FLOAT32_IEEE 0 AppSwcOpm_CM_single_Nm -100000.0 100000.0 /end CHARACTERISTIC
/begin CHARACTERISTIC KOPM_BrkPwrRecupActWhlTq_Nm_ovrdval "VCU_10_Torque_CHA" VALUE 0x0000 /* @ECU_Address@KOPM_BrkPwrRecupActWhlTq_Nm_ovrdval@ */ Scalar_FLOAT32_IEEE 0 AppSwcOpm_CM_single_Nm -100000.0 100000.0 /end CHARACTERISTIC
/begin CHARACTERISTIC KOPM_BrkPwrRecupMaxAvlbWhlTqHi_Nm "VCU_10_Torque_CHA" VALUE 0x0000 /* @ECU_Address@KOPM_BrkPwrRecupMaxAvlbWhlTqHi_Nm@ */ Scalar_FLOAT32_IEEE 0 AppSwcOpm_CM_single_Nm -100000.0 100000.0 /end CHARACTERISTIC
/begin CHARACTERISTIC KOPM_BrkPwrRecupMaxAvlbWhlTqLo_Nm "VCU_10_Torque_CHA" VALUE 0x0000 /* @ECU_Address@KOPM_BrkPwrRecupMaxAvlbWhlTqLo_Nm@ */ Scalar_FLOAT32_IEEE 0 AppSwcOpm_CM_single_Nm -100000.0 100000.0 /end CHARACTERISTIC
/begin CHARACTERISTIC KOPM_BrkPwrRecupMaxAvlbWhlTq_Nm_ovrdval "VCU_10_Torque_CHA" VALUE 0x0000 /* @ECU_Address@KOPM_BrkPwrRecupMaxAvlbWhlTq_Nm_ovrdval@ */ Scalar_FLOAT32_IEEE 0 AppSwcOpm_CM_single_Nm -100000.0 100000.0 /end CHARACTERISTIC
/begin CHARACTERISTIC KOPM_COMPCompInPwrLimHi_W "AC_COMP_BOD" VALUE 0x0000 /* @ECU_Address@KOPM_COMPCompInPwrLimHi_W@ */ Scalar_FLOAT32_IEEE 0 AppSwcOpm_CM_single_W -100000.0 100000.0 /end CHARACTERISTIC
/begin CHARACTERISTIC KOPM_COMPCompInPwrLimLo_W "AC_COMP_BOD" VALUE 0x0000 /* @ECU_Address@KOPM_COMPCompInPwrLimLo_W@ */ Scalar_FLOAT32_IEEE 0 AppSwcOpm_CM_single_W -100000.0 100000.0 /end CHARACTERISTIC
/begin CHARACTERISTIC KOPM_COMPCompInPwrLim_W_ovrdval "AC_COMP_BOD" VALUE 0x0000 /* @ECU_Address@KOPM_COMPCompInPwrLim_W_ovrdval@ */ Scalar_FLOAT32_IEEE 0 AppSwcOpm_CM_single_W -100000.0 100000.0 /end CHARACTERISTIC
/begin CHARACTERISTIC KOPM_COMPEcompSpdCtrlHi_rpm "AC_COMP_BOD" VALUE 0x0000 /* @ECU_Address@KOPM_COMPEcompSpdCtrlHi_rpm@ */ Scalar_FLOAT32_IEEE 0 AppSwcOpm_CM_single_rpm -100000.0 100000.0 /end CHARACTERISTIC
/begin CHARACTERISTIC KOPM_COMPEcompSpdCtrlLo_rpm "AC_COMP_BOD" VALUE 0x0000 /* @ECU_Address@KOPM_COMPEcompSpdCtrlLo_rpm@ */ Scalar_FLOAT32_IEEE 0 AppSwcOpm_CM_single_rpm -100000.0 100000.0 /end CHARACTERISTIC
/begin CHARACTERISTIC KOPM_COMPEcompSpdCtrl_rpm_ovrdval "AC_COMP_BOD" VALUE 0x0000 /* @ECU_Address@KOPM_COMPEcompSpdCtrl_rpm_ovrdval@ */ Scalar_FLOAT32_IEEE 0 AppSwcOpm_CM_single_rpm -100000.0 100000.0 /end CHARACTERISTIC
/begin CHARACTERISTIC KOPM_HVCHReqPwrHi_kW "HVCH_Command_BOD" VALUE 0x0000 /* @ECU_Address@KOPM_HVCHReqPwrHi_kW@ */ Scalar_FLOAT32_IEEE 0 AppSwcOpm_CM_single_kW -100000.0 100000.0 /end CHARACTERISTIC
/begin CHARACTERISTIC KOPM_HVCHReqPwrLo_kW "HVCH_Command_BOD" VALUE 0x0000 /* @ECU_Address@KOPM_HVCHReqPwrLo_kW@ */ Scalar_FLOAT32_IEEE 0 AppSwcOpm_CM_single_kW -100000.0 100000.0 /end CHARACTERISTIC
/begin CHARACTERISTIC KOPM_HVCHReqPwr_kW_ovrdval "HVCH_Command_BOD" VALUE 0x0000 /* @ECU_Address@KOPM_HVCHReqPwr_kW_ovrdval@ */ Scalar_FLOAT32_IEEE 0 AppSwcOpm_CM_single_kW -100000.0 100000.0 /end CHARACTERISTIC
/begin CHARACTERISTIC KOPM_HVCHReqTempHi_C "HVCH_Command_BOD" VALUE 0x0000 /* @ECU_Address@KOPM_HVCHReqTempHi_C@ */ Scalar_FLOAT32_IEEE 0 AppSwcOpm_CM_single_C -100000.0 100000.0 /end CHARACTERISTIC
/begin CHARACTERISTIC KOPM_HVCHReqTempLo_C "HVCH_Command_BOD" VALUE 0x0000 /* @ECU_Address@KOPM_HVCHReqTempLo_C@ */ Scalar_FLOAT32_IEEE 0 AppSwcOpm_CM_single_C -100000.0 100000.0 /end CHARACTERISTIC
/begin CHARACTERISTIC KOPM_HVCHReqTemp_C_ovrdval "HVCH_Command_BOD" VALUE 0x0000 /* @ECU_Address@KOPM_HVCHReqTemp_C_ovrdval@ */ Scalar_FLOAT32_IEEE 0 AppSwcOpm_CM_single_C -100000.0 100000.0 /end CHARACTERISTIC
/begin CHARACTERISTIC KOPM_TMSACPExhtTmpHi_C "AC_COMP_BOD" VALUE 0x0000 /* @ECU_Address@KOPM_TMSACPExhtTmpHi_C@ */ Scalar_FLOAT32_IEEE 0 AppSwcOpm_CM_single_C -100000.0 100000.0 /end CHARACTERISTIC
/begin CHARACTERISTIC KOPM_TMSACPExhtTmpLo_C "AC_COMP_BOD" VALUE 0x0000 /* @ECU_Address@KOPM_TMSACPExhtTmpLo_C@ */ Scalar_FLOAT32_IEEE 0 AppSwcOpm_CM_single_C -100000.0 100000.0 /end CHARACTERISTIC
/begin CHARACTERISTIC KOPM_TMSACPExhtTmp_C_ovrdval "AC_COMP_BOD" VALUE 0x0000 /* @ECU_Address@KOPM_TMSACPExhtTmp_C_ovrdval@ */ Scalar_FLOAT32_IEEE 0 AppSwcOpm_CM_single_C -100000.0 100000.0 /end CHARACTERISTIC
/begin CHARACTERISTIC KOPM_TMSACPInletPresHi_kPa "AC_COMP_BOD" VALUE 0x0000 /* @ECU_Address@KOPM_TMSACPInletPresHi_kPa@ */ Scalar_FLOAT32_IEEE 0 AppSwcOpm_CM_single_kPa -100000.0 100000.0 /end CHARACTERISTIC
/begin CHARACTERISTIC KOPM_TMSACPInletPresLo_kPa "AC_COMP_BOD" VALUE 0x0000 /* @ECU_Address@KOPM_TMSACPInletPresLo_kPa@ */ Scalar_FLOAT32_IEEE 0 AppSwcOpm_CM_single_kPa -100000.0 100000.0 /end CHARACTERISTIC
/begin CHARACTERISTIC KOPM_TMSACPInletPres_kPa_ovrdval "AC_COMP_BOD" VALUE 0x0000 /* @ECU_Address@KOPM_TMSACPInletPres_kPa_ovrdval@ */ Scalar_FLOAT32_IEEE 0 AppSwcOpm_CM_single_kPa -100000.0 100000.0 /end CHARACTERISTIC
/begin CHARACTERISTIC KOPM_TMSAcPMPRealRPMHi_rpm "TMS_LINTestData1_BOD" VALUE 0x0000 /* @ECU_Address@KOPM_TMSAcPMPRealRPMHi_rpm@ */ Scalar_FLOAT32_IEEE 0 AppSwcOpm_CM_single_rpm -100000.0 100000.0 /end CHARACTERISTIC
/begin CHARACTERISTIC KOPM_TMSAcPMPRealRPMLo_rpm "TMS_LINTestData1_BOD" VALUE 0x0000 /* @ECU_Address@KOPM_TMSAcPMPRealRPMLo_rpm@ */ Scalar_FLOAT32_IEEE 0 AppSwcOpm_CM_single_rpm -100000.0 100000.0 /end CHARACTERISTIC
/begin CHARACTERISTIC KOPM_TMSAcPMPRealRPM_rpm_ovrdval "TMS_LINTestData1_BOD" VALUE 0x0000 /* @ECU_Address@KOPM_TMSAcPMPRealRPM_rpm_ovrdval@ */ Scalar_FLOAT32_IEEE 0 AppSwcOpm_CM_single_rpm -100000.0 100000.0 /end CHARACTERISTIC
/begin CHARACTERISTIC KOPM_TMSAcPMPSpdSetHi_rpm "TMS_LINTestData1_BOD" VALUE 0x0000 /* @ECU_Address@KOPM_TMSAcPMPSpdSetHi_rpm@ */ Scalar_FLOAT32_IEEE 0 AppSwcOpm_CM_single_rpm -100000.0 100000.0 /end CHARACTERISTIC
/begin CHARACTERISTIC KOPM_TMSAcPMPSpdSetLo_rpm "TMS_LINTestData1_BOD" VALUE 0x0000 /* @ECU_Address@KOPM_TMSAcPMPSpdSetLo_rpm@ */ Scalar_FLOAT32_IEEE 0 AppSwcOpm_CM_single_rpm -100000.0 100000.0 /end CHARACTERISTIC
/begin CHARACTERISTIC KOPM_TMSAcPMPSpdSet_rpm_ovrdval "TMS_LINTestData1_BOD" VALUE 0x0000 /* @ECU_Address@KOPM_TMSAcPMPSpdSet_rpm_ovrdval@ */ Scalar_FLOAT32_IEEE 0 AppSwcOpm_CM_single_rpm -100000.0 100000.0 /end CHARACTERISTIC
/begin CHARACTERISTIC KOPM_TMSBatPMPRealRPMHi_rpm "TMS_LINTestData1_BOD" VALUE 0x0000 /* @ECU_Address@KOPM_TMSBatPMPRealRPMHi_rpm@ */ Scalar_FLOAT32_IEEE 0 AppSwcOpm_CM_single_rpm -100000.0 100000.0 /end CHARACTERISTIC
/begin CHARACTERISTIC KOPM_TMSBatPMPRealRPMLo_rpm "TMS_LINTestData1_BOD" VALUE 0x0000 /* @ECU_Address@KOPM_TMSBatPMPRealRPMLo_rpm@ */ Scalar_FLOAT32_IEEE 0 AppSwcOpm_CM_single_rpm -100000.0 100000.0 /end CHARACTERISTIC
/begin CHARACTERISTIC KOPM_TMSBatPMPRealRPM_rpm_ovrdval "TMS_LINTestData1_BOD" VALUE 0x0000 /* @ECU_Address@KOPM_TMSBatPMPRealRPM_rpm_ovrdval@ */ Scalar_FLOAT32_IEEE 0 AppSwcOpm_CM_single_rpm -100000.0 100000.0 /end CHARACTERISTIC
/begin CHARACTERISTIC KOPM_TMSBatPMPSpdSetHi_rpm "TMS_LINTestData1_BOD" VALUE 0x0000 /* @ECU_Address@KOPM_TMSBatPMPSpdSetHi_rpm@ */ Scalar_FLOAT32_IEEE 0 AppSwcOpm_CM_single_rpm -100000.0 100000.0 /end CHARACTERISTIC
/begin CHARACTERISTIC KOPM_TMSBatPMPSpdSetLo_rpm "TMS_LINTestData1_BOD" VALUE 0x0000 /* @ECU_Address@KOPM_TMSBatPMPSpdSetLo_rpm@ */ Scalar_FLOAT32_IEEE 0 AppSwcOpm_CM_single_rpm -100000.0 100000.0 /end CHARACTERISTIC
/begin CHARACTERISTIC KOPM_TMSBatPMPSpdSet_rpm_ovrdval "TMS_LINTestData1_BOD" VALUE 0x0000 /* @ECU_Address@KOPM_TMSBatPMPSpdSet_rpm_ovrdval@ */ Scalar_FLOAT32_IEEE 0 AppSwcOpm_CM_single_rpm -100000.0 100000.0 /end CHARACTERISTIC
/begin CHARACTERISTIC KOPM_TMSChillerOutTmpHi_C "AC_3_State_BOD" VALUE 0x0000 /* @ECU_Address@KOPM_TMSChillerOutTmpHi_C@ */ Scalar_FLOAT32_IEEE 0 AppSwcOpm_CM_single_C -100000.0 100000.0 /end CHARACTERISTIC
/begin CHARACTERISTIC KOPM_TMSChillerOutTmpLo_C "AC_3_State_BOD" VALUE 0x0000 /* @ECU_Address@KOPM_TMSChillerOutTmpLo_C@ */ Scalar_FLOAT32_IEEE 0 AppSwcOpm_CM_single_C -100000.0 100000.0 /end CHARACTERISTIC
/begin CHARACTERISTIC KOPM_TMSChillerOutTmp_C_ovrdval "AC_3_State_BOD" VALUE 0x0000 /* @ECU_Address@KOPM_TMSChillerOutTmp_C_ovrdval@ */ Scalar_FLOAT32_IEEE 0 AppSwcOpm_CM_single_C -100000.0 100000.0 /end CHARACTERISTIC
/begin CHARACTERISTIC KOPM_TMSEvapOutTmpHi_C "AC_3_State_BOD" VALUE 0x0000 /* @ECU_Address@KOPM_TMSEvapOutTmpHi_C@ */ Scalar_FLOAT32_IEEE 0 AppSwcOpm_CM_single_C -100000.0 100000.0 /end CHARACTERISTIC
/begin CHARACTERISTIC KOPM_TMSEvapOutTmpLo_C "AC_3_State_BOD" VALUE 0x0000 /* @ECU_Address@KOPM_TMSEvapOutTmpLo_C@ */ Scalar_FLOAT32_IEEE 0 AppSwcOpm_CM_single_C -100000.0 100000.0 /end CHARACTERISTIC
/begin CHARACTERISTIC KOPM_TMSEvapOutTmp_C_ovrdval "AC_3_State_BOD" VALUE 0x0000 /* @ECU_Address@KOPM_TMSEvapOutTmp_C_ovrdval@ */ Scalar_FLOAT32_IEEE 0 AppSwcOpm_CM_single_C -100000.0 100000.0 /end CHARACTERISTIC
/begin CHARACTERISTIC KOPM_TMSEvapTmpHi_C "AC_3_State_BOD" VALUE 0x0000 /* @ECU_Address@KOPM_TMSEvapTmpHi_C@ */ Scalar_FLOAT32_IEEE 0 AppSwcOpm_CM_single_C -100000.0 100000.0 /end CHARACTERISTIC
/begin CHARACTERISTIC KOPM_TMSEvapTmpLo_C "AC_3_State_BOD" VALUE 0x0000 /* @ECU_Address@KOPM_TMSEvapTmpLo_C@ */ Scalar_FLOAT32_IEEE 0 AppSwcOpm_CM_single_C -100000.0 100000.0 /end CHARACTERISTIC
/begin CHARACTERISTIC KOPM_TMSEvapTmp_C_ovrdval "AC_3_State_BOD" VALUE 0x0000 /* @ECU_Address@KOPM_TMSEvapTmp_C_ovrdval@ */ Scalar_FLOAT32_IEEE 0 AppSwcOpm_CM_single_C -100000.0 100000.0 /end CHARACTERISTIC
/begin CHARACTERISTIC KOPM_TMSMotInletCooltTempHi_C "AC_8_status_BOD" VALUE 0x0000 /* @ECU_Address@KOPM_TMSMotInletCooltTempHi_C@ */ Scalar_FLOAT32_IEEE 0 AppSwcOpm_CM_single_C -100000.0 100000.0 /end CHARACTERISTIC
/begin CHARACTERISTIC KOPM_TMSMotInletCooltTempLo_C "AC_8_status_BOD" VALUE 0x0000 /* @ECU_Address@KOPM_TMSMotInletCooltTempLo_C@ */ Scalar_FLOAT32_IEEE 0 AppSwcOpm_CM_single_C -100000.0 100000.0 /end CHARACTERISTIC
/begin CHARACTERISTIC KOPM_TMSMotInletCooltTemp_C_ovrdval "AC_8_status_BOD" VALUE 0x0000 /* @ECU_Address@KOPM_TMSMotInletCooltTemp_C_ovrdval@ */ Scalar_FLOAT32_IEEE 0 AppSwcOpm_CM_single_C -100000.0 100000.0 /end CHARACTERISTIC
/begin CHARACTERISTIC KOPM_TMSMotPMPRealRPMHi_rpm "TMS_LINTestData1_BOD" VALUE 0x0000 /* @ECU_Address@KOPM_TMSMotPMPRealRPMHi_rpm@ */ Scalar_FLOAT32_IEEE 0 AppSwcOpm_CM_single_rpm -100000.0 100000.0 /end CHARACTERISTIC
/begin CHARACTERISTIC KOPM_TMSMotPMPRealRPMLo_rpm "TMS_LINTestData1_BOD" VALUE 0x0000 /* @ECU_Address@KOPM_TMSMotPMPRealRPMLo_rpm@ */ Scalar_FLOAT32_IEEE 0 AppSwcOpm_CM_single_rpm -100000.0 100000.0 /end CHARACTERISTIC
/begin CHARACTERISTIC KOPM_TMSMotPMPRealRPM_rpm_ovrdval "TMS_LINTestData1_BOD" VALUE 0x0000 /* @ECU_Address@KOPM_TMSMotPMPRealRPM_rpm_ovrdval@ */ Scalar_FLOAT32_IEEE 0 AppSwcOpm_CM_single_rpm -100000.0 100000.0 /end CHARACTERISTIC
/begin CHARACTERISTIC KOPM_TMSMotPMPSpdSetHi_rpm "TMS_LINTestData1_BOD" VALUE 0x0000 /* @ECU_Address@KOPM_TMSMotPMPSpdSetHi_rpm@ */ Scalar_FLOAT32_IEEE 0 AppSwcOpm_CM_single_rpm -100000.0 100000.0 /end CHARACTERISTIC
/begin CHARACTERISTIC KOPM_TMSMotPMPSpdSetLo_rpm "TMS_LINTestData1_BOD" VALUE 0x0000 /* @ECU_Address@KOPM_TMSMotPMPSpdSetLo_rpm@ */ Scalar_FLOAT32_IEEE 0 AppSwcOpm_CM_single_rpm -100000.0 100000.0 /end CHARACTERISTIC
/begin CHARACTERISTIC KOPM_TMSMotPMPSpdSet_rpm_ovrdval "TMS_LINTestData1_BOD" VALUE 0x0000 /* @ECU_Address@KOPM_TMSMotPMPSpdSet_rpm_ovrdval@ */ Scalar_FLOAT32_IEEE 0 AppSwcOpm_CM_single_rpm -100000.0 100000.0 /end CHARACTERISTIC
/begin CHARACTERISTIC KOPM_TMSOHXOutTmpHi_C "AC_3_State_BOD" VALUE 0x0000 /* @ECU_Address@KOPM_TMSOHXOutTmpHi_C@ */ Scalar_FLOAT32_IEEE 0 AppSwcOpm_CM_single_C -100000.0 100000.0 /end CHARACTERISTIC
/begin CHARACTERISTIC KOPM_TMSOHXOutTmpLo_C "AC_3_State_BOD" VALUE 0x0000 /* @ECU_Address@KOPM_TMSOHXOutTmpLo_C@ */ Scalar_FLOAT32_IEEE 0 AppSwcOpm_CM_single_C -100000.0 100000.0 /end CHARACTERISTIC
/begin CHARACTERISTIC KOPM_TMSOHXOutTmp_C_ovrdval "AC_3_State_BOD" VALUE 0x0000 /* @ECU_Address@KOPM_TMSOHXOutTmp_C_ovrdval@ */ Scalar_FLOAT32_IEEE 0 AppSwcOpm_CM_single_C -100000.0 100000.0 /end CHARACTERISTIC
/begin CHARACTERISTIC KOPM_TMSPTPresHi_kPa "AC_2_State_BOD" VALUE 0x0000 /* @ECU_Address@KOPM_TMSPTPresHi_kPa@ */ Scalar_FLOAT32_IEEE 0 AppSwcOpm_CM_single_kPa -100000.0 100000.0 /end CHARACTERISTIC
/begin CHARACTERISTIC KOPM_TMSPTPresLo_kPa "AC_2_State_BOD" VALUE 0x0000 /* @ECU_Address@KOPM_TMSPTPresLo_kPa@ */ Scalar_FLOAT32_IEEE 0 AppSwcOpm_CM_single_kPa -100000.0 100000.0 /end CHARACTERISTIC
/begin CHARACTERISTIC KOPM_TMSPTPres_kPa_ovrdval "AC_2_State_BOD" VALUE 0x0000 /* @ECU_Address@KOPM_TMSPTPres_kPa_ovrdval@ */ Scalar_FLOAT32_IEEE 0 AppSwcOpm_CM_single_kPa -100000.0 100000.0 /end CHARACTERISTIC
/begin CHARACTERISTIC KOPM_TMSPTTempHi_C "AC_2_State_BOD" VALUE 0x0000 /* @ECU_Address@KOPM_TMSPTTempHi_C@ */ Scalar_FLOAT32_IEEE 0 AppSwcOpm_CM_single_C -100000.0 100000.0 /end CHARACTERISTIC
/begin CHARACTERISTIC KOPM_TMSPTTempLo_C "AC_2_State_BOD" VALUE 0x0000 /* @ECU_Address@KOPM_TMSPTTempLo_C@ */ Scalar_FLOAT32_IEEE 0 AppSwcOpm_CM_single_C -100000.0 100000.0 /end CHARACTERISTIC
/begin CHARACTERISTIC KOPM_TMSPTTemp_C_ovrdval "AC_2_State_BOD" VALUE 0x0000 /* @ECU_Address@KOPM_TMSPTTemp_C_ovrdval@ */ Scalar_FLOAT32_IEEE 0 AppSwcOpm_CM_single_C -100000.0 100000.0 /end CHARACTERISTIC
/begin CHARACTERISTIC KOPM_TMSAEXVCurrentPstnHi_cnt "TMS_LINTestData2_BOD" VALUE 0x0000 /* @ECU_Address@KOPM_TMSAEXVCurrentPstnHi_cnt@ */ Scalar_UWORD 0 AppSwcOpm_CM_uint16_cnt 0.0 65535.0 /end CHARACTERISTIC
/begin CHARACTERISTIC KOPM_TMSAEXVCurrentPstnLo_cnt "TMS_LINTestData2_BOD" VALUE 0x0000 /* @ECU_Address@KOPM_TMSAEXVCurrentPstnLo_cnt@ */ Scalar_UWORD 0 AppSwcOpm_CM_uint16_cnt 0.0 65535.0 /end CHARACTERISTIC
/begin CHARACTERISTIC KOPM_TMSAEXVCurrentPstn_cnt_ovrdval "TMS_LINTestData2_BOD" VALUE 0x0000 /* @ECU_Address@KOPM_TMSAEXVCurrentPstn_cnt_ovrdval@ */ Scalar_UWORD 0 AppSwcOpm_CM_uint16_cnt 0.0 65535.0 /end CHARACTERISTIC
/begin CHARACTERISTIC KOPM_TMSAEXVPstnReqHi_cnt "TMS_LINTestData2_BOD" VALUE 0x0000 /* @ECU_Address@KOPM_TMSAEXVPstnReqHi_cnt@ */ Scalar_UWORD 0 AppSwcOpm_CM_uint16_cnt 0.0 65535.0 /end CHARACTERISTIC
/begin CHARACTERISTIC KOPM_TMSAEXVPstnReqLo_cnt "TMS_LINTestData2_BOD" VALUE 0x0000 /* @ECU_Address@KOPM_TMSAEXVPstnReqLo_cnt@ */ Scalar_UWORD 0 AppSwcOpm_CM_uint16_cnt 0.0 65535.0 /end CHARACTERISTIC
/begin CHARACTERISTIC KOPM_TMSAEXVPstnReq_cnt_ovrdval "TMS_LINTestData2_BOD" VALUE 0x0000 /* @ECU_Address@KOPM_TMSAEXVPstnReq_cnt_ovrdval@ */ Scalar_UWORD 0 AppSwcOpm_CM_uint16_cnt 0.0 65535.0 /end CHARACTERISTIC
/begin CHARACTERISTIC KOPM_TMSBEXVCurrentPstnHi_cnt "TMS_LINTestData2_BOD" VALUE 0x0000 /* @ECU_Address@KOPM_TMSBEXVCurrentPstnHi_cnt@ */ Scalar_UWORD 0 AppSwcOpm_CM_uint16_cnt 0.0 65535.0 /end CHARACTERISTIC
/begin CHARACTERISTIC KOPM_TMSBEXVCurrentPstnLo_cnt "TMS_LINTestData2_BOD" VALUE 0x0000 /* @ECU_Address@KOPM_TMSBEXVCurrentPstnLo_cnt@ */ Scalar_UWORD 0 AppSwcOpm_CM_uint16_cnt 0.0 65535.0 /end CHARACTERISTIC
/begin CHARACTERISTIC KOPM_TMSBEXVCurrentPstn_cnt_ovrdval "TMS_LINTestData2_BOD" VALUE 0x0000 /* @ECU_Address@KOPM_TMSBEXVCurrentPstn_cnt_ovrdval@ */ Scalar_UWORD 0 AppSwcOpm_CM_uint16_cnt 0.0 65535.0 /end CHARACTERISTIC
/begin CHARACTERISTIC KOPM_TMSBEXVPstnCmdHi_cnt "TMS_LINTestData2_BOD" VALUE 0x0000 /* @ECU_Address@KOPM_TMSBEXVPstnCmdHi_cnt@ */ Scalar_UWORD 0 AppSwcOpm_CM_uint16_cnt 0.0 65535.0 /end CHARACTERISTIC
/begin CHARACTERISTIC KOPM_TMSBEXVPstnCmdLo_cnt "TMS_LINTestData2_BOD" VALUE 0x0000 /* @ECU_Address@KOPM_TMSBEXVPstnCmdLo_cnt@ */ Scalar_UWORD 0 AppSwcOpm_CM_uint16_cnt 0.0 65535.0 /end CHARACTERISTIC
/begin CHARACTERISTIC KOPM_TMSBEXVPstnCmd_cnt_ovrdval "TMS_LINTestData2_BOD" VALUE 0x0000 /* @ECU_Address@KOPM_TMSBEXVPstnCmd_cnt_ovrdval@ */ Scalar_UWORD 0 AppSwcOpm_CM_uint16_cnt 0.0 65535.0 /end CHARACTERISTIC
/begin CHARACTERISTIC KOPM_TMSC3WVPosRecHi_enum "TMS_LINTestData3_BOD" VALUE 0x0000 /* @ECU_Address@KOPM_TMSC3WVPosRecHi_enum@ */ Scalar_UWORD 0 AppSwcOpm_CM_uint16_enum 0.0 65535.0 /end CHARACTERISTIC
/begin CHARACTERISTIC KOPM_TMSC3WVPosRecLo_enum "TMS_LINTestData3_BOD" VALUE 0x0000 /* @ECU_Address@KOPM_TMSC3WVPosRecLo_enum@ */ Scalar_UWORD 0 AppSwcOpm_CM_uint16_enum 0.0 65535.0 /end CHARACTERISTIC
/begin CHARACTERISTIC KOPM_TMSC3WVPosRec_enum_ovrdval "TMS_LINTestData3_BOD" VALUE 0x0000 /* @ECU_Address@KOPM_TMSC3WVPosRec_enum_ovrdval@ */ Scalar_UWORD 0 AppSwcOpm_CM_uint16_enum 0.0 65535.0 /end CHARACTERISTIC
/begin CHARACTERISTIC KOPM_TMSC5WVPosRecHi_enum "TMS_LINTestData3_BOD" VALUE 0x0000 /* @ECU_Address@KOPM_TMSC5WVPosRecHi_enum@ */ Scalar_UWORD 0 AppSwcOpm_CM_uint16_enum 0.0 65535.0 /end CHARACTERISTIC
/begin CHARACTERISTIC KOPM_TMSC5WVPosRecLo_enum "TMS_LINTestData3_BOD" VALUE 0x0000 /* @ECU_Address@KOPM_TMSC5WVPosRecLo_enum@ */ Scalar_UWORD 0 AppSwcOpm_CM_uint16_enum 0.0 65535.0 /end CHARACTERISTIC
/begin CHARACTERISTIC KOPM_TMSC5WVPosRec_enum_ovrdval "TMS_LINTestData3_BOD" VALUE 0x0000 /* @ECU_Address@KOPM_TMSC5WVPosRec_enum_ovrdval@ */ Scalar_UWORD 0 AppSwcOpm_CM_uint16_enum 0.0 65535.0 /end CHARACTERISTIC
/begin CHARACTERISTIC KOPM_TMSHPEXVCurrentPstnHi_cnt "TMS_LINTestData3_BOD" VALUE 0x0000 /* @ECU_Address@KOPM_TMSHPEXVCurrentPstnHi_cnt@ */ Scalar_UWORD 0 AppSwcOpm_CM_uint16_cnt 0.0 65535.0 /end CHARACTERISTIC
/begin CHARACTERISTIC KOPM_TMSHPEXVCurrentPstnLo_cnt "TMS_LINTestData3_BOD" VALUE 0x0000 /* @ECU_Address@KOPM_TMSHPEXVCurrentPstnLo_cnt@ */ Scalar_UWORD 0 AppSwcOpm_CM_uint16_cnt 0.0 65535.0 /end CHARACTERISTIC
/begin CHARACTERISTIC KOPM_TMSHPEXVCurrentPstn_cnt_ovrdval "TMS_LINTestData3_BOD" VALUE 0x0000 /* @ECU_Address@KOPM_TMSHPEXVCurrentPstn_cnt_ovrdval@ */ Scalar_UWORD 0 AppSwcOpm_CM_uint16_cnt 0.0 65535.0 /end CHARACTERISTIC
/begin CHARACTERISTIC KOPM_TMSHPEXVPstnCmdHi_cnt "TMS_LINTestData1_BOD" VALUE 0x0000 /* @ECU_Address@KOPM_TMSHPEXVPstnCmdHi_cnt@ */ Scalar_UWORD 0 AppSwcOpm_CM_uint16_cnt 0.0 65535.0 /end CHARACTERISTIC
/begin CHARACTERISTIC KOPM_TMSHPEXVPstnCmdLo_cnt "TMS_LINTestData1_BOD" VALUE 0x0000 /* @ECU_Address@KOPM_TMSHPEXVPstnCmdLo_cnt@ */ Scalar_UWORD 0 AppSwcOpm_CM_uint16_cnt 0.0 65535.0 /end CHARACTERISTIC
/begin CHARACTERISTIC KOPM_TMSHPEXVPstnCmd_cnt_ovrdval "TMS_LINTestData1_BOD" VALUE 0x0000 /* @ECU_Address@KOPM_TMSHPEXVPstnCmd_cnt_ovrdval@ */ Scalar_UWORD 0 AppSwcOpm_CM_uint16_cnt 0.0 65535.0 /end CHARACTERISTIC
/begin CHARACTERISTIC KOPM_ACActTotPwr_kW_ovrdflg "AC_2_State_BOD" VALUE 0x0000 /* @ECU_Address@KOPM_ACActTotPwr_kW_ovrdflg@ */ Scalar_BOOLEAN 0 AppSwcOpm_CM_boolean_flg 0.0 1.0 /end CHARACTERISTIC
/begin CHARACTERISTIC KOPM_ACActlOprtMode_enum_ovrdflg "AC_2_State_BOD" VALUE 0x0000 /* @ECU_Address@KOPM_ACActlOprtMode_enum_ovrdflg@ */ Scalar_BOOLEAN 0 AppSwcOpm_CM_boolean_flg 0.0 1.0 /end CHARACTERISTIC
/begin CHARACTERISTIC KOPM_ACAirInletModeSta_enum_ovrdflg "AC_ACStatuts_BOD" VALUE 0x0000 /* @ECU_Address@KOPM_ACAirInletModeSta_enum_ovrdflg@ */ Scalar_BOOLEAN 0 AppSwcOpm_CM_boolean_flg 0.0 1.0 /end CHARACTERISTIC
/begin CHARACTERISTIC KOPM_ACAutoBlwrModeSta_enum_ovrdflg "AC_ACStatuts_BOD" VALUE 0x0000 /* @ECU_Address@KOPM_ACAutoBlwrModeSta_enum_ovrdflg@ */ Scalar_BOOLEAN 0 AppSwcOpm_CM_boolean_flg 0.0 1.0 /end CHARACTERISTIC
/begin CHARACTERISTIC KOPM_ACAutoFb_flg_ovrdflg "AC_ACStatuts_BOD" VALUE 0x0000 /* @ECU_Address@KOPM_ACAutoFb_flg_ovrdflg@ */ Scalar_BOOLEAN 0 AppSwcOpm_CM_boolean_flg 0.0 1.0 /end CHARACTERISTIC
/begin CHARACTERISTIC KOPM_ACAutoFb_flg_ovrdval "AC_ACStatuts_BOD" VALUE 0x0000 /* @ECU_Address@KOPM_ACAutoFb_flg_ovrdval@ */ Scalar_BOOLEAN 0 AppSwcOpm_CM_boolean_flg 0.0 1.0 /end CHARACTERISTIC
/begin CHARACTERISTIC KOPM_ACAutoFrntFanSpd_enum_ovrdflg "AC_8_status_BOD" VALUE 0x0000 /* @ECU_Address@KOPM_ACAutoFrntFanSpd_enum_ovrdflg@ */ Scalar_BOOLEAN 0 AppSwcOpm_CM_boolean_flg 0.0 1.0 /end CHARACTERISTIC
/begin CHARACTERISTIC KOPM_ACBatPmpFailSta_flg_ovrdflg "AC_2_State_BOD" VALUE 0x0000 /* @ECU_Address@KOPM_ACBatPmpFailSta_flg_ovrdflg@ */ Scalar_BOOLEAN 0 AppSwcOpm_CM_boolean_flg 0.0 1.0 /end CHARACTERISTIC
/begin CHARACTERISTIC KOPM_ACBatPmpFailSta_flg_ovrdval "AC_2_State_BOD" VALUE 0x0000 /* @ECU_Address@KOPM_ACBatPmpFailSta_flg_ovrdval@ */ Scalar_BOOLEAN 0 AppSwcOpm_CM_boolean_flg 0.0 1.0 /end CHARACTERISTIC
/begin CHARACTERISTIC KOPM_ACBlwrModeSta_enum_ovrdflg "AC_ACStatuts_BOD" VALUE 0x0000 /* @ECU_Address@KOPM_ACBlwrModeSta_enum_ovrdflg@ */ Scalar_BOOLEAN 0 AppSwcOpm_CM_boolean_flg 0.0 1.0 /end CHARACTERISTIC
/begin CHARACTERISTIC KOPM_ACCompFailModeOprtSta_flg_ovrdflg "AC_1_Command_BOD" VALUE 0x0000 /* @ECU_Address@KOPM_ACCompFailModeOprtSta_flg_ovrdflg@ */ Scalar_BOOLEAN 0 AppSwcOpm_CM_boolean_flg 0.0 1.0 /end CHARACTERISTIC
/begin CHARACTERISTIC KOPM_ACCompFailModeOprtSta_flg_ovrdval "AC_1_Command_BOD" VALUE 0x0000 /* @ECU_Address@KOPM_ACCompFailModeOprtSta_flg_ovrdval@ */ Scalar_BOOLEAN 0 AppSwcOpm_CM_boolean_flg 0.0 1.0 /end CHARACTERISTIC
/begin CHARACTERISTIC KOPM_ACCompMaxAllowPwrCmsp_kW_ovrdflg "AC_1_Command_BOD" VALUE 0x0000 /* @ECU_Address@KOPM_ACCompMaxAllowPwrCmsp_kW_ovrdflg@ */ Scalar_BOOLEAN 0 AppSwcOpm_CM_boolean_flg 0.0 1.0 /end CHARACTERISTIC
/begin CHARACTERISTIC KOPM_ACCompOprtEnaCmd_flg_ovrdflg "AC_1_Command_BOD" VALUE 0x0000 /* @ECU_Address@KOPM_ACCompOprtEnaCmd_flg_ovrdflg@ */ Scalar_BOOLEAN 0 AppSwcOpm_CM_boolean_flg 0.0 1.0 /end CHARACTERISTIC
/begin CHARACTERISTIC KOPM_ACCompOprtEnaCmd_flg_ovrdval "AC_1_Command_BOD" VALUE 0x0000 /* @ECU_Address@KOPM_ACCompOprtEnaCmd_flg_ovrdval@ */ Scalar_BOOLEAN 0 AppSwcOpm_CM_boolean_flg 0.0 1.0 /end CHARACTERISTIC
/begin CHARACTERISTIC KOPM_ACCompOprtReq_flg_ovrdflg "AC_1_Command_BOD" VALUE 0x0000 /* @ECU_Address@KOPM_ACCompOprtReq_flg_ovrdflg@ */ Scalar_BOOLEAN 0 AppSwcOpm_CM_boolean_flg 0.0 1.0 /end CHARACTERISTIC
/begin CHARACTERISTIC KOPM_ACCompOprtReq_flg_ovrdval "AC_1_Command_BOD" VALUE 0x0000 /* @ECU_Address@KOPM_ACCompOprtReq_flg_ovrdval@ */ Scalar_BOOLEAN 0 AppSwcOpm_CM_boolean_flg 0.0 1.0 /end CHARACTERISTIC
/begin CHARACTERISTIC KOPM_ACCompTgtSpd_rpm_ovrdflg "AC_1_Command_BOD" VALUE 0x0000 /* @ECU_Address@KOPM_ACCompTgtSpd_rpm_ovrdflg@ */ Scalar_BOOLEAN 0 AppSwcOpm_CM_boolean_flg 0.0 1.0 /end CHARACTERISTIC
/begin CHARACTERISTIC KOPM_ACEnvirTempVld_flg_ovrdflg "AC_3_State_BOD" VALUE 0x0000 /* @ECU_Address@KOPM_ACEnvirTempVld_flg_ovrdflg@ */ Scalar_BOOLEAN 0 AppSwcOpm_CM_boolean_flg 0.0 1.0 /end CHARACTERISTIC
/begin CHARACTERISTIC KOPM_ACEnvirTempVld_flg_ovrdval "AC_3_State_BOD" VALUE 0x0000 /* @ECU_Address@KOPM_ACEnvirTempVld_flg_ovrdval@ */ Scalar_BOOLEAN 0 AppSwcOpm_CM_boolean_flg 0.0 1.0 /end CHARACTERISTIC
/begin CHARACTERISTIC KOPM_ACEnvirTemp_C_ovrdflg "AC_3_State_BOD" VALUE 0x0000 /* @ECU_Address@KOPM_ACEnvirTemp_C_ovrdflg@ */ Scalar_BOOLEAN 0 AppSwcOpm_CM_boolean_flg 0.0 1.0 /end CHARACTERISTIC
/begin CHARACTERISTIC KOPM_ACEvapTgtTemp_C_ovrdflg "AC_8_status_BOD" VALUE 0x0000 /* @ECU_Address@KOPM_ACEvapTgtTemp_C_ovrdflg@ */ Scalar_BOOLEAN 0 AppSwcOpm_CM_boolean_flg 0.0 1.0 /end CHARACTERISTIC
/begin CHARACTERISTIC KOPM_ACExtdDefrstActvReq_flg_ovrdflg "AC_3_State_BOD" VALUE 0x0000 /* @ECU_Address@KOPM_ACExtdDefrstActvReq_flg_ovrdflg@ */ Scalar_BOOLEAN 0 AppSwcOpm_CM_boolean_flg 0.0 1.0 /end CHARACTERISTIC
/begin CHARACTERISTIC KOPM_ACExtdDefrstActvReq_flg_ovrdval "AC_3_State_BOD" VALUE 0x0000 /* @ECU_Address@KOPM_ACExtdDefrstActvReq_flg_ovrdval@ */ Scalar_BOOLEAN 0 AppSwcOpm_CM_boolean_flg 0.0 1.0 /end CHARACTERISTIC
/begin CHARACTERISTIC KOPM_ACFailSta_flg_ovrdflg "AC_2_State_BOD" VALUE 0x0000 /* @ECU_Address@KOPM_ACFailSta_flg_ovrdflg@ */ Scalar_BOOLEAN 0 AppSwcOpm_CM_boolean_flg 0.0 1.0 /end CHARACTERISTIC
/begin CHARACTERISTIC KOPM_ACFailSta_flg_ovrdval "AC_2_State_BOD" VALUE 0x0000 /* @ECU_Address@KOPM_ACFailSta_flg_ovrdval@ */ Scalar_BOOLEAN 0 AppSwcOpm_CM_boolean_flg 0.0 1.0 /end CHARACTERISTIC
/begin CHARACTERISTIC KOPM_ACFrntFanSpdVal_enum_ovrdflg "AC_ACStatuts_BOD" VALUE 0x0000 /* @ECU_Address@KOPM_ACFrntFanSpdVal_enum_ovrdflg@ */ Scalar_BOOLEAN 0 AppSwcOpm_CM_boolean_flg 0.0 1.0 /end CHARACTERISTIC
/begin CHARACTERISTIC KOPM_ACHVHActlOprtMode_enum_ovrdflg "AC_2_State_BOD" VALUE 0x0000 /* @ECU_Address@KOPM_ACHVHActlOprtMode_enum_ovrdflg@ */ Scalar_BOOLEAN 0 AppSwcOpm_CM_boolean_flg 0.0 1.0 /end CHARACTERISTIC
/begin CHARACTERISTIC KOPM_ACHVHActlPwr_KW_ovrdflg "AC_2_State_BOD" VALUE 0x0000 /* @ECU_Address@KOPM_ACHVHActlPwr_KW_ovrdflg@ */ Scalar_BOOLEAN 0 AppSwcOpm_CM_boolean_flg 0.0 1.0 /end CHARACTERISTIC
/begin CHARACTERISTIC KOPM_ACHVHDevInternTemp_C_ovrdflg "AC_2_State_BOD" VALUE 0x0000 /* @ECU_Address@KOPM_ACHVHDevInternTemp_C_ovrdflg@ */ Scalar_BOOLEAN 0 AppSwcOpm_CM_boolean_flg 0.0 1.0 /end CHARACTERISTIC
/begin CHARACTERISTIC KOPM_ACHVHFailSta_flg_ovrdflg "AC_2_State_BOD" VALUE 0x0000 /* @ECU_Address@KOPM_ACHVHFailSta_flg_ovrdflg@ */ Scalar_BOOLEAN 0 AppSwcOpm_CM_boolean_flg 0.0 1.0 /end CHARACTERISTIC
/begin CHARACTERISTIC KOPM_ACHVHFailSta_flg_ovrdval "AC_2_State_BOD" VALUE 0x0000 /* @ECU_Address@KOPM_ACHVHFailSta_flg_ovrdval@ */ Scalar_BOOLEAN 0 AppSwcOpm_CM_boolean_flg 0.0 1.0 /end CHARACTERISTIC
/begin CHARACTERISTIC KOPM_ACHVPTCOnRq_enum_ovrdflg "AC_8_status_BOD" VALUE 0x0000 /* @ECU_Address@KOPM_ACHVPTCOnRq_enum_ovrdflg@ */ Scalar_BOOLEAN 0 AppSwcOpm_CM_boolean_flg 0.0 1.0 /end CHARACTERISTIC
/begin CHARACTERISTIC KOPM_ACHighVolDCTotalPwr_kW_ovrdflg "AC_1_Command_BOD" VALUE 0x0000 /* @ECU_Address@KOPM_ACHighVolDCTotalPwr_kW_ovrdflg@ */ Scalar_BOOLEAN 0 AppSwcOpm_CM_boolean_flg 0.0 1.0 /end CHARACTERISTIC
/begin CHARACTERISTIC KOPM_ACHybEcoModeSta_enum_ovrdflg "AC_ACStatuts_BOD" VALUE 0x0000 /* @ECU_Address@KOPM_ACHybEcoModeSta_enum_ovrdflg@ */ Scalar_BOOLEAN 0 AppSwcOpm_CM_boolean_flg 0.0 1.0 /end CHARACTERISTIC
/begin CHARACTERISTIC KOPM_ACIndoorTemp_C_ovrdflg "AC_3_State_BOD" VALUE 0x0000 /* @ECU_Address@KOPM_ACIndoorTemp_C_ovrdflg@ */ Scalar_BOOLEAN 0 AppSwcOpm_CM_boolean_flg 0.0 1.0 /end CHARACTERISTIC
/begin CHARACTERISTIC KOPM_ACLeftTempVal_enum_ovrdflg "AC_ACStatuts_BOD" VALUE 0x0000 /* @ECU_Address@KOPM_ACLeftTempVal_enum_ovrdflg@ */ Scalar_BOOLEAN 0 AppSwcOpm_CM_boolean_flg 0.0 1.0 /end CHARACTERISTIC
/begin CHARACTERISTIC KOPM_ACManlDefrstFb_flg_ovrdflg "AC_ACStatuts_BOD" VALUE 0x0000 /* @ECU_Address@KOPM_ACManlDefrstFb_flg_ovrdflg@ */ Scalar_BOOLEAN 0 AppSwcOpm_CM_boolean_flg 0.0 1.0 /end CHARACTERISTIC
/begin CHARACTERISTIC KOPM_ACManlDefrstFb_flg_ovrdval "AC_ACStatuts_BOD" VALUE 0x0000 /* @ECU_Address@KOPM_ACManlDefrstFb_flg_ovrdval@ */ Scalar_BOOLEAN 0 AppSwcOpm_CM_boolean_flg 0.0 1.0 /end CHARACTERISTIC
/begin CHARACTERISTIC KOPM_ACPumpActlSpdDutyVld_flg_ovrdflg "AC_1_Command_BOD" VALUE 0x0000 /* @ECU_Address@KOPM_ACPumpActlSpdDutyVld_flg_ovrdflg@ */ Scalar_BOOLEAN 0 AppSwcOpm_CM_boolean_flg 0.0 1.0 /end CHARACTERISTIC
/begin CHARACTERISTIC KOPM_ACPumpActlSpdDutyVld_flg_ovrdval "AC_1_Command_BOD" VALUE 0x0000 /* @ECU_Address@KOPM_ACPumpActlSpdDutyVld_flg_ovrdval@ */ Scalar_BOOLEAN 0 AppSwcOpm_CM_boolean_flg 0.0 1.0 /end CHARACTERISTIC
/begin CHARACTERISTIC KOPM_ACPumpActlSpdDuty_pct_ovrdflg "AC_1_Command_BOD" VALUE 0x0000 /* @ECU_Address@KOPM_ACPumpActlSpdDuty_pct_ovrdflg@ */ Scalar_BOOLEAN 0 AppSwcOpm_CM_boolean_flg 0.0 1.0 /end CHARACTERISTIC
/begin CHARACTERISTIC KOPM_ACPwrFb_flg_ovrdflg "AC_ACStatuts_BOD" VALUE 0x0000 /* @ECU_Address@KOPM_ACPwrFb_flg_ovrdflg@ */ Scalar_BOOLEAN 0 AppSwcOpm_CM_boolean_flg 0.0 1.0 /end CHARACTERISTIC
/begin CHARACTERISTIC KOPM_ACPwrFb_flg_ovrdval "AC_ACStatuts_BOD" VALUE 0x0000 /* @ECU_Address@KOPM_ACPwrFb_flg_ovrdval@ */ Scalar_BOOLEAN 0 AppSwcOpm_CM_boolean_flg 0.0 1.0 /end CHARACTERISTIC
/begin CHARACTERISTIC KOPM_ACRefrgLoPresVld_flg_ovrdflg "AC_8_status_BOD" VALUE 0x0000 /* @ECU_Address@KOPM_ACRefrgLoPresVld_flg_ovrdflg@ */ Scalar_BOOLEAN 0 AppSwcOpm_CM_boolean_flg 0.0 1.0 /end CHARACTERISTIC
/begin CHARACTERISTIC KOPM_ACRefrgLoPresVld_flg_ovrdval "AC_8_status_BOD" VALUE 0x0000 /* @ECU_Address@KOPM_ACRefrgLoPresVld_flg_ovrdval@ */ Scalar_BOOLEAN 0 AppSwcOpm_CM_boolean_flg 0.0 1.0 /end CHARACTERISTIC
/begin CHARACTERISTIC KOPM_ACRefrgLoPres_kPa_ovrdflg "AC_8_status_BOD" VALUE 0x0000 /* @ECU_Address@KOPM_ACRefrgLoPres_kPa_ovrdflg@ */ Scalar_BOOLEAN 0 AppSwcOpm_CM_boolean_flg 0.0 1.0 /end CHARACTERISTIC
/begin CHARACTERISTIC KOPM_ActWhlTqVld_flg_ovrdflg "VCU_10_Torque_CHA" VALUE 0x0000 /* @ECU_Address@KOPM_ActWhlTqVld_flg_ovrdflg@ */ Scalar_BOOLEAN 0 AppSwcOpm_CM_boolean_flg 0.0 1.0 /end CHARACTERISTIC
/begin CHARACTERISTIC KOPM_ActWhlTqVld_flg_ovrdval "VCU_10_Torque_CHA" VALUE 0x0000 /* @ECU_Address@KOPM_ActWhlTqVld_flg_ovrdval@ */ Scalar_BOOLEAN 0 AppSwcOpm_CM_boolean_flg 0.0 1.0 /end CHARACTERISTIC
/begin CHARACTERISTIC KOPM_ActWhlTq_Nm_ovrdflg "VCU_10_Torque_CHA" VALUE 0x0000 /* @ECU_Address@KOPM_ActWhlTq_Nm_ovrdflg@ */ Scalar_BOOLEAN 0 AppSwcOpm_CM_boolean_flg 0.0 1.0 /end CHARACTERISTIC
/begin CHARACTERISTIC KOPM_ActlMotorRotateSpdVld_flg_ovrdflg "VCU_10_Torque_CHA" VALUE 0x0000 /* @ECU_Address@KOPM_ActlMotorRotateSpdVld_flg_ovrdflg@ */ Scalar_BOOLEAN 0 AppSwcOpm_CM_boolean_flg 0.0 1.0 /end CHARACTERISTIC
/begin CHARACTERISTIC KOPM_ActlMotorRotateSpdVld_flg_ovrdval "VCU_10_Torque_CHA" VALUE 0x0000 /* @ECU_Address@KOPM_ActlMotorRotateSpdVld_flg_ovrdval@ */ Scalar_BOOLEAN 0 AppSwcOpm_CM_boolean_flg 0.0 1.0 /end CHARACTERISTIC
/begin CHARACTERISTIC KOPM_ActlMotorRotateSpd_rpm_ovrdflg "VCU_10_Torque_CHA" VALUE 0x0000 /* @ECU_Address@KOPM_ActlMotorRotateSpd_rpm_ovrdflg@ */ Scalar_BOOLEAN 0 AppSwcOpm_CM_boolean_flg 0.0 1.0 /end CHARACTERISTIC
/begin CHARACTERISTIC KOPM_ActlMotorTorqVld_flg_ovrdflg "VCU_10_Torque_CHA" VALUE 0x0000 /* @ECU_Address@KOPM_ActlMotorTorqVld_flg_ovrdflg@ */ Scalar_BOOLEAN 0 AppSwcOpm_CM_boolean_flg 0.0 1.0 /end CHARACTERISTIC
/begin CHARACTERISTIC KOPM_ActlMotorTorqVld_flg_ovrdval "VCU_10_Torque_CHA" VALUE 0x0000 /* @ECU_Address@KOPM_ActlMotorTorqVld_flg_ovrdval@ */ Scalar_BOOLEAN 0 AppSwcOpm_CM_boolean_flg 0.0 1.0 /end CHARACTERISTIC
/begin CHARACTERISTIC KOPM_ActlMotorTorq_Nm_ovrdflg "VCU_10_Torque_CHA" VALUE 0x0000 /* @ECU_Address@KOPM_ActlMotorTorq_Nm_ovrdflg@ */ Scalar_BOOLEAN 0 AppSwcOpm_CM_boolean_flg 0.0 1.0 /end CHARACTERISTIC
/begin CHARACTERISTIC KOPM_BCMHiFreqSigDataByte0_nu_ovrdflg "BCM_HFSData_BAC" VALUE 0x0000 /* @ECU_Address@KOPM_BCMHiFreqSigDataByte0_nu_ovrdflg@ */ Scalar_BOOLEAN 0 AppSwcOpm_CM_boolean_flg 0.0 1.0 /end CHARACTERISTIC
/begin CHARACTERISTIC KOPM_BCMHiFreqSigDataByte10_nu_ovrdflg "BCM_HFSData_BAC" VALUE 0x0000 /* @ECU_Address@KOPM_BCMHiFreqSigDataByte10_nu_ovrdflg@ */ Scalar_BOOLEAN 0 AppSwcOpm_CM_boolean_flg 0.0 1.0 /end CHARACTERISTIC
/begin CHARACTERISTIC KOPM_BCMHiFreqSigDataByte11_nu_ovrdflg "BCM_HFSData_BAC" VALUE 0x0000 /* @ECU_Address@KOPM_BCMHiFreqSigDataByte11_nu_ovrdflg@ */ Scalar_BOOLEAN 0 AppSwcOpm_CM_boolean_flg 0.0 1.0 /end CHARACTERISTIC
/begin CHARACTERISTIC KOPM_BCMHiFreqSigDataByte12_nu_ovrdflg "BCM_HFSData_BAC" VALUE 0x0000 /* @ECU_Address@KOPM_BCMHiFreqSigDataByte12_nu_ovrdflg@ */ Scalar_BOOLEAN 0 AppSwcOpm_CM_boolean_flg 0.0 1.0 /end CHARACTERISTIC
/begin CHARACTERISTIC KOPM_BCMHiFreqSigDataByte13_nu_ovrdflg "BCM_HFSData_BAC" VALUE 0x0000 /* @ECU_Address@KOPM_BCMHiFreqSigDataByte13_nu_ovrdflg@ */ Scalar_BOOLEAN 0 AppSwcOpm_CM_boolean_flg 0.0 1.0 /end CHARACTERISTIC
/begin CHARACTERISTIC KOPM_BCMHiFreqSigDataByte14_nu_ovrdflg "BCM_HFSData_BAC" VALUE 0x0000 /* @ECU_Address@KOPM_BCMHiFreqSigDataByte14_nu_ovrdflg@ */ Scalar_BOOLEAN 0 AppSwcOpm_CM_boolean_flg 0.0 1.0 /end CHARACTERISTIC
/begin CHARACTERISTIC KOPM_BCMHiFreqSigDataByte15_nu_ovrdflg "BCM_HFSData_BAC" VALUE 0x0000 /* @ECU_Address@KOPM_BCMHiFreqSigDataByte15_nu_ovrdflg@ */ Scalar_BOOLEAN 0 AppSwcOpm_CM_boolean_flg 0.0 1.0 /end CHARACTERISTIC
/begin CHARACTERISTIC KOPM_BCMHiFreqSigDataByte1_nu_ovrdflg "BCM_HFSData_BAC" VALUE 0x0000 /* @ECU_Address@KOPM_BCMHiFreqSigDataByte1_nu_ovrdflg@ */ Scalar_BOOLEAN 0 AppSwcOpm_CM_boolean_flg 0.0 1.0 /end CHARACTERISTIC
/begin CHARACTERISTIC KOPM_BCMHiFreqSigDataByte2_nu_ovrdflg "BCM_HFSData_BAC" VALUE 0x0000 /* @ECU_Address@KOPM_BCMHiFreqSigDataByte2_nu_ovrdflg@ */ Scalar_BOOLEAN 0 AppSwcOpm_CM_boolean_flg 0.0 1.0 /end CHARACTERISTIC
/begin CHARACTERISTIC KOPM_BCMHiFreqSigDataByte3_nu_ovrdflg "BCM_HFSData_BAC" VALUE 0x0000 /* @ECU_Address@KOPM_BCMHiFreqSigDataByte3_nu_ovrdflg@ */ Scalar_BOOLEAN 0 AppSwcOpm_CM_boolean_flg 0.0 1.0 /end CHARACTERISTIC
/begin CHARACTERISTIC KOPM_BCMHiFreqSigDataByte4_nu_ovrdflg "BCM_HFSData_BAC" VALUE 0x0000 /* @ECU_Address@KOPM_BCMHiFreqSigDataByte4_nu_ovrdflg@ */ Scalar_BOOLEAN 0 AppSwcOpm_CM_boolean_flg 0.0 1.0 /end CHARACTERISTIC
/begin CHARACTERISTIC KOPM_BCMHiFreqSigDataByte5_nu_ovrdflg "BCM_HFSData_BAC" VALUE 0x0000 /* @ECU_Address@KOPM_BCMHiFreqSigDataByte5_nu_ovrdflg@ */ Scalar_BOOLEAN 0 AppSwcOpm_CM_boolean_flg 0.0 1.0 /end CHARACTERISTIC
/begin CHARACTERISTIC KOPM_BCMHiFreqSigDataByte6_nu_ovrdflg "BCM_HFSData_BAC" VALUE 0x0000 /* @ECU_Address@KOPM_BCMHiFreqSigDataByte6_nu_ovrdflg@ */ Scalar_BOOLEAN 0 AppSwcOpm_CM_boolean_flg 0.0 1.0 /end CHARACTERISTIC
/begin CHARACTERISTIC KOPM_BCMHiFreqSigDataByte7_nu_ovrdflg "BCM_HFSData_BAC" VALUE 0x0000 /* @ECU_Address@KOPM_BCMHiFreqSigDataByte7_nu_ovrdflg@ */ Scalar_BOOLEAN 0 AppSwcOpm_CM_boolean_flg 0.0 1.0 /end CHARACTERISTIC
/begin CHARACTERISTIC KOPM_BCMHiFreqSigDataByte8_nu_ovrdflg "BCM_HFSData_BAC" VALUE 0x0000 /* @ECU_Address@KOPM_BCMHiFreqSigDataByte8_nu_ovrdflg@ */ Scalar_BOOLEAN 0 AppSwcOpm_CM_boolean_flg 0.0 1.0 /end CHARACTERISTIC
/begin CHARACTERISTIC KOPM_BCMHiFreqSigDataByte9_nu_ovrdflg "BCM_HFSData_BAC" VALUE 0x0000 /* @ECU_Address@KOPM_BCMHiFreqSigDataByte9_nu_ovrdflg@ */ Scalar_BOOLEAN 0 AppSwcOpm_CM_boolean_flg 0.0 1.0 /end CHARACTERISTIC
/begin CHARACTERISTIC KOPM_BCMLrngData02_nu_ovrdflg "BCM_IMMOAuthResp1_EPT" VALUE 0x0000 /* @ECU_Address@KOPM_BCMLrngData02_nu_ovrdflg@ */ Scalar_BOOLEAN 0 AppSwcOpm_CM_boolean_flg 0.0 1.0 /end CHARACTERISTIC
/begin CHARACTERISTIC KOPM_BCMLrngData03_nu_ovrdflg "BCM_IMMOAuthResp1_EPT" VALUE 0x0000 /* @ECU_Address@KOPM_BCMLrngData03_nu_ovrdflg@ */ Scalar_BOOLEAN 0 AppSwcOpm_CM_boolean_flg 0.0 1.0 /end CHARACTERISTIC
/begin CHARACTERISTIC KOPM_BCMLrngData04_nu_ovrdflg "BCM_IMMOAuthResp1_EPT" VALUE 0x0000 /* @ECU_Address@KOPM_BCMLrngData04_nu_ovrdflg@ */ Scalar_BOOLEAN 0 AppSwcOpm_CM_boolean_flg 0.0 1.0 /end CHARACTERISTIC
/begin CHARACTERISTIC KOPM_BCMLrngData05_nu_ovrdflg "BCM_IMMOAuthResp1_EPT" VALUE 0x0000 /* @ECU_Address@KOPM_BCMLrngData05_nu_ovrdflg@ */ Scalar_BOOLEAN 0 AppSwcOpm_CM_boolean_flg 0.0 1.0 /end CHARACTERISTIC
/begin CHARACTERISTIC KOPM_BCMLrngData06_nu_ovrdflg "BCM_IMMOAuthResp1_EPT" VALUE 0x0000 /* @ECU_Address@KOPM_BCMLrngData06_nu_ovrdflg@ */ Scalar_BOOLEAN 0 AppSwcOpm_CM_boolean_flg 0.0 1.0 /end CHARACTERISTIC
/begin CHARACTERISTIC KOPM_BCMLrngData07_nu_ovrdflg "BCM_IMMOAuthResp1_EPT" VALUE 0x0000 /* @ECU_Address@KOPM_BCMLrngData07_nu_ovrdflg@ */ Scalar_BOOLEAN 0 AppSwcOpm_CM_boolean_flg 0.0 1.0 /end CHARACTERISTIC
/begin CHARACTERISTIC KOPM_BCMLrngSts_enum_ovrdflg "BCM_IMMOAuthResp1_EPT" VALUE 0x0000 /* @ECU_Address@KOPM_BCMLrngSts_enum_ovrdflg@ */ Scalar_BOOLEAN 0 AppSwcOpm_CM_boolean_flg 0.0 1.0 /end CHARACTERISTIC
/begin CHARACTERISTIC KOPM_BCMLrngsubID_cnt_ovrdflg "BCM_IMMOAuthResp1_EPT" VALUE 0x0000 /* @ECU_Address@KOPM_BCMLrngsubID_cnt_ovrdflg@ */ Scalar_BOOLEAN 0 AppSwcOpm_CM_boolean_flg 0.0 1.0 /end CHARACTERISTIC
/begin CHARACTERISTIC KOPM_BCMRrViewMirrHeatgSts_flg_ovrdflg "AC_ACStatuts_BOD" VALUE 0x0000 /* @ECU_Address@KOPM_BCMRrViewMirrHeatgSts_flg_ovrdflg@ */ Scalar_BOOLEAN 0 AppSwcOpm_CM_boolean_flg 0.0 1.0 /end CHARACTERISTIC
/begin CHARACTERISTIC KOPM_BCMRrViewMirrHeatgSts_flg_ovrdval "AC_ACStatuts_BOD" VALUE 0x0000 /* @ECU_Address@KOPM_BCMRrViewMirrHeatgSts_flg_ovrdval@ */ Scalar_BOOLEAN 0 AppSwcOpm_CM_boolean_flg 0.0 1.0 /end CHARACTERISTIC
/begin CHARACTERISTIC KOPM_BrkPwrRecupActWhlTq_Nm_ovrdflg "VCU_10_Torque_CHA" VALUE 0x0000 /* @ECU_Address@KOPM_BrkPwrRecupActWhlTq_Nm_ovrdflg@ */ Scalar_BOOLEAN 0 AppSwcOpm_CM_boolean_flg 0.0 1.0 /end CHARACTERISTIC
/begin CHARACTERISTIC KOPM_BrkPwrRecupActlWhlTqSts_enum_ovrdflg "VCU_10_Torque_CHA" VALUE 0x0000 /* @ECU_Address@KOPM_BrkPwrRecupActlWhlTqSts_enum_ovrdflg@ */ Scalar_BOOLEAN 0 AppSwcOpm_CM_boolean_flg 0.0 1.0 /end CHARACTERISTIC
/begin CHARACTERISTIC KOPM_BrkPwrRecupMaxAvlbWhlTq_Nm_ovrdflg "VCU_10_Torque_CHA" VALUE 0x0000 /* @ECU_Address@KOPM_BrkPwrRecupMaxAvlbWhlTq_Nm_ovrdflg@ */ Scalar_BOOLEAN 0 AppSwcOpm_CM_boolean_flg 0.0 1.0 /end CHARACTERISTIC
/begin CHARACTERISTIC KOPM_COMPCompInPwrLim_W_ovrdflg "AC_COMP_BOD" VALUE 0x0000 /* @ECU_Address@KOPM_COMPCompInPwrLim_W_ovrdflg@ */ Scalar_BOOLEAN 0 AppSwcOpm_CM_boolean_flg 0.0 1.0 /end CHARACTERISTIC
/begin CHARACTERISTIC KOPM_COMPEcompEnbl_enum_ovrdflg "AC_COMP_BOD" VALUE 0x0000 /* @ECU_Address@KOPM_COMPEcompEnbl_enum_ovrdflg@ */ Scalar_BOOLEAN 0 AppSwcOpm_CM_boolean_flg 0.0 1.0 /end CHARACTERISTIC
/begin CHARACTERISTIC KOPM_COMPEcompErrClean_enum_ovrdflg "AC_COMP_BOD" VALUE 0x0000 /* @ECU_Address@KOPM_COMPEcompErrClean_enum_ovrdflg@ */ Scalar_BOOLEAN 0 AppSwcOpm_CM_boolean_flg 0.0 1.0 /end CHARACTERISTIC
/begin CHARACTERISTIC KOPM_COMPEcompHVSt_enum_ovrdflg "AC_COMP_BOD" VALUE 0x0000 /* @ECU_Address@KOPM_COMPEcompHVSt_enum_ovrdflg@ */ Scalar_BOOLEAN 0 AppSwcOpm_CM_boolean_flg 0.0 1.0 /end CHARACTERISTIC
/begin CHARACTERISTIC KOPM_COMPEcompSpdCtrl_rpm_ovrdflg "AC_COMP_BOD" VALUE 0x0000 /* @ECU_Address@KOPM_COMPEcompSpdCtrl_rpm_ovrdflg@ */ Scalar_BOOLEAN 0 AppSwcOpm_CM_boolean_flg 0.0 1.0 /end CHARACTERISTIC
/begin CHARACTERISTIC KOPM_ESCLUnOrLockCrtl_nu_ovrdflg "BCM_ESCLCommand_BOD" VALUE 0x0000 /* @ECU_Address@KOPM_ESCLUnOrLockCrtl_nu_ovrdflg@ */ Scalar_BOOLEAN 0 AppSwcOpm_CM_boolean_flg 0.0 1.0 /end CHARACTERISTIC
/begin CHARACTERISTIC KOPM_HVCHEnbld_enum_ovrdflg "HVCH_Command_BOD" VALUE 0x0000 /* @ECU_Address@KOPM_HVCHEnbld_enum_ovrdflg@ */ Scalar_BOOLEAN 0 AppSwcOpm_CM_boolean_flg 0.0 1.0 /end CHARACTERISTIC
/begin CHARACTERISTIC KOPM_HVCHReqPwr_kW_ovrdflg "HVCH_Command_BOD" VALUE 0x0000 /* @ECU_Address@KOPM_HVCHReqPwr_kW_ovrdflg@ */ Scalar_BOOLEAN 0 AppSwcOpm_CM_boolean_flg 0.0 1.0 /end CHARACTERISTIC
/begin CHARACTERISTIC KOPM_HVCHReqTemp_C_ovrdflg "HVCH_Command_BOD" VALUE 0x0000 /* @ECU_Address@KOPM_HVCHReqTemp_C_ovrdflg@ */ Scalar_BOOLEAN 0 AppSwcOpm_CM_boolean_flg 0.0 1.0 /end CHARACTERISTIC
/begin CHARACTERISTIC KOPM_TMSACPExhtTmp_C_ovrdflg "AC_COMP_BOD" VALUE 0x0000 /* @ECU_Address@KOPM_TMSACPExhtTmp_C_ovrdflg@ */ Scalar_BOOLEAN 0 AppSwcOpm_CM_boolean_flg 0.0 1.0 /end CHARACTERISTIC
/begin CHARACTERISTIC KOPM_TMSACPInletPres_kPa_ovrdflg "AC_COMP_BOD" VALUE 0x0000 /* @ECU_Address@KOPM_TMSACPInletPres_kPa_ovrdflg@ */ Scalar_BOOLEAN 0 AppSwcOpm_CM_boolean_flg 0.0 1.0 /end CHARACTERISTIC
/begin CHARACTERISTIC KOPM_TMSAEXVCurrentPstn_cnt_ovrdflg "TMS_LINTestData2_BOD" VALUE 0x0000 /* @ECU_Address@KOPM_TMSAEXVCurrentPstn_cnt_ovrdflg@ */ Scalar_BOOLEAN 0 AppSwcOpm_CM_boolean_flg 0.0 1.0 /end CHARACTERISTIC
/begin CHARACTERISTIC KOPM_TMSAEXVEnblReq_flg_ovrdflg "TMS_LINTestData3_BOD" VALUE 0x0000 /* @ECU_Address@KOPM_TMSAEXVEnblReq_flg_ovrdflg@ */ Scalar_BOOLEAN 0 AppSwcOpm_CM_boolean_flg 0.0 1.0 /end CHARACTERISTIC
/begin CHARACTERISTIC KOPM_TMSAEXVEnblReq_flg_ovrdval "TMS_LINTestData3_BOD" VALUE 0x0000 /* @ECU_Address@KOPM_TMSAEXVEnblReq_flg_ovrdval@ */ Scalar_BOOLEAN 0 AppSwcOpm_CM_boolean_flg 0.0 1.0 /end CHARACTERISTIC
/begin CHARACTERISTIC KOPM_TMSAEXVPstnReq_cnt_ovrdflg "TMS_LINTestData2_BOD" VALUE 0x0000 /* @ECU_Address@KOPM_TMSAEXVPstnReq_cnt_ovrdflg@ */ Scalar_BOOLEAN 0 AppSwcOpm_CM_boolean_flg 0.0 1.0 /end CHARACTERISTIC
/begin CHARACTERISTIC KOPM_TMSAcPMPRealRPM_rpm_ovrdflg "TMS_LINTestData1_BOD" VALUE 0x0000 /* @ECU_Address@KOPM_TMSAcPMPRealRPM_rpm_ovrdflg@ */ Scalar_BOOLEAN 0 AppSwcOpm_CM_boolean_flg 0.0 1.0 /end CHARACTERISTIC
/begin CHARACTERISTIC KOPM_TMSAcPMPSpdSet_rpm_ovrdflg "TMS_LINTestData1_BOD" VALUE 0x0000 /* @ECU_Address@KOPM_TMSAcPMPSpdSet_rpm_ovrdflg@ */ Scalar_BOOLEAN 0 AppSwcOpm_CM_boolean_flg 0.0 1.0 /end CHARACTERISTIC
/begin CHARACTERISTIC KOPM_TMSBATThermMod_enum_ovrdflg "AC_8_status_BOD" VALUE 0x0000 /* @ECU_Address@KOPM_TMSBATThermMod_enum_ovrdflg@ */ Scalar_BOOLEAN 0 AppSwcOpm_CM_boolean_flg 0.0 1.0 /end CHARACTERISTIC
/begin CHARACTERISTIC KOPM_TMSBEXVCurrentPstn_cnt_ovrdflg "TMS_LINTestData2_BOD" VALUE 0x0000 /* @ECU_Address@KOPM_TMSBEXVCurrentPstn_cnt_ovrdflg@ */ Scalar_BOOLEAN 0 AppSwcOpm_CM_boolean_flg 0.0 1.0 /end CHARACTERISTIC
/begin CHARACTERISTIC KOPM_TMSBEXVEnblCmd_flg_ovrdflg "TMS_LINTestData3_BOD" VALUE 0x0000 /* @ECU_Address@KOPM_TMSBEXVEnblCmd_flg_ovrdflg@ */ Scalar_BOOLEAN 0 AppSwcOpm_CM_boolean_flg 0.0 1.0 /end CHARACTERISTIC
/begin CHARACTERISTIC KOPM_TMSBEXVEnblCmd_flg_ovrdval "TMS_LINTestData3_BOD" VALUE 0x0000 /* @ECU_Address@KOPM_TMSBEXVEnblCmd_flg_ovrdval@ */ Scalar_BOOLEAN 0 AppSwcOpm_CM_boolean_flg 0.0 1.0 /end CHARACTERISTIC
/begin CHARACTERISTIC KOPM_TMSBEXVPstnCmd_cnt_ovrdflg "TMS_LINTestData2_BOD" VALUE 0x0000 /* @ECU_Address@KOPM_TMSBEXVPstnCmd_cnt_ovrdflg@ */ Scalar_BOOLEAN 0 AppSwcOpm_CM_boolean_flg 0.0 1.0 /end CHARACTERISTIC
/begin CHARACTERISTIC KOPM_TMSBatPMPRealRPM_rpm_ovrdflg "TMS_LINTestData1_BOD" VALUE 0x0000 /* @ECU_Address@KOPM_TMSBatPMPRealRPM_rpm_ovrdflg@ */ Scalar_BOOLEAN 0 AppSwcOpm_CM_boolean_flg 0.0 1.0 /end CHARACTERISTIC
/begin CHARACTERISTIC KOPM_TMSBatPMPSpdSet_rpm_ovrdflg "TMS_LINTestData1_BOD" VALUE 0x0000 /* @ECU_Address@KOPM_TMSBatPMPSpdSet_rpm_ovrdflg@ */ Scalar_BOOLEAN 0 AppSwcOpm_CM_boolean_flg 0.0 1.0 /end CHARACTERISTIC
/begin CHARACTERISTIC KOPM_TMSBattTempCtrlRmnSwFb_flg_ovrdflg "AC_2_State_BOD" VALUE 0x0000 /* @ECU_Address@KOPM_TMSBattTempCtrlRmnSwFb_flg_ovrdflg@ */ Scalar_BOOLEAN 0 AppSwcOpm_CM_boolean_flg 0.0 1.0 /end CHARACTERISTIC
/begin CHARACTERISTIC KOPM_TMSBattTempCtrlRmnSwFb_flg_ovrdval "AC_2_State_BOD" VALUE 0x0000 /* @ECU_Address@KOPM_TMSBattTempCtrlRmnSwFb_flg_ovrdval@ */ Scalar_BOOLEAN 0 AppSwcOpm_CM_boolean_flg 0.0 1.0 /end CHARACTERISTIC
/begin CHARACTERISTIC KOPM_TMSC3WVBPosSetReq_enum_ovrdflg "TMS_LINTestData3_BOD" VALUE 0x0000 /* @ECU_Address@KOPM_TMSC3WVBPosSetReq_enum_ovrdflg@ */ Scalar_BOOLEAN 0 AppSwcOpm_CM_boolean_flg 0.0 1.0 /end CHARACTERISTIC
/begin CHARACTERISTIC KOPM_TMSC3WVMode_enum_ovrdflg "TMS_LINTestData3_BOD" VALUE 0x0000 /* @ECU_Address@KOPM_TMSC3WVMode_enum_ovrdflg@ */ Scalar_BOOLEAN 0 AppSwcOpm_CM_boolean_flg 0.0 1.0 /end CHARACTERISTIC
/begin CHARACTERISTIC KOPM_TMSC3WVPosRec_enum_ovrdflg "TMS_LINTestData3_BOD" VALUE 0x0000 /* @ECU_Address@KOPM_TMSC3WVPosRec_enum_ovrdflg@ */ Scalar_BOOLEAN 0 AppSwcOpm_CM_boolean_flg 0.0 1.0 /end CHARACTERISTIC
/begin CHARACTERISTIC KOPM_TMSC5WVBPosSetReq_enum_ovrdflg "TMS_LINTestData3_BOD" VALUE 0x0000 /* @ECU_Address@KOPM_TMSC5WVBPosSetReq_enum_ovrdflg@ */ Scalar_BOOLEAN 0 AppSwcOpm_CM_boolean_flg 0.0 1.0 /end CHARACTERISTIC
/begin CHARACTERISTIC KOPM_TMSC5WVMode_enum_ovrdflg "TMS_LINTestData3_BOD" VALUE 0x0000 /* @ECU_Address@KOPM_TMSC5WVMode_enum_ovrdflg@ */ Scalar_BOOLEAN 0 AppSwcOpm_CM_boolean_flg 0.0 1.0 /end CHARACTERISTIC
/begin CHARACTERISTIC KOPM_TMSC5WVPosRec_enum_ovrdflg "TMS_LINTestData3_BOD" VALUE 0x0000 /* @ECU_Address@KOPM_TMSC5WVPosRec_enum_ovrdflg@ */ Scalar_BOOLEAN 0 AppSwcOpm_CM_boolean_flg 0.0 1.0 /end CHARACTERISTIC
/begin CHARACTERISTIC KOPM_TMSCabThermMod_enum_ovrdflg "AC_8_status_BOD" VALUE 0x0000 /* @ECU_Address@KOPM_TMSCabThermMod_enum_ovrdflg@ */ Scalar_BOOLEAN 0 AppSwcOpm_CM_boolean_flg 0.0 1.0 /end CHARACTERISTIC
/begin CHARACTERISTIC KOPM_TMSChillerOutTmp_C_ovrdflg "AC_3_State_BOD" VALUE 0x0000 /* @ECU_Address@KOPM_TMSChillerOutTmp_C_ovrdflg@ */ Scalar_BOOLEAN 0 AppSwcOpm_CM_boolean_flg 0.0 1.0 /end CHARACTERISTIC
/begin CHARACTERISTIC KOPM_TMSEvapOutTmp_C_ovrdflg "AC_3_State_BOD" VALUE 0x0000 /* @ECU_Address@KOPM_TMSEvapOutTmp_C_ovrdflg@ */ Scalar_BOOLEAN 0 AppSwcOpm_CM_boolean_flg 0.0 1.0 /end CHARACTERISTIC
/begin CHARACTERISTIC KOPM_TMSEvapTmp_C_ovrdflg "AC_3_State_BOD" VALUE 0x0000 /* @ECU_Address@KOPM_TMSEvapTmp_C_ovrdflg@ */ Scalar_BOOLEAN 0 AppSwcOpm_CM_boolean_flg 0.0 1.0 /end CHARACTERISTIC
/begin CHARACTERISTIC KOPM_TMSHPEXVCurrentPstn_cnt_ovrdflg "TMS_LINTestData3_BOD" VALUE 0x0000 /* @ECU_Address@KOPM_TMSHPEXVCurrentPstn_cnt_ovrdflg@ */ Scalar_BOOLEAN 0 AppSwcOpm_CM_boolean_flg 0.0 1.0 /end CHARACTERISTIC
/begin CHARACTERISTIC KOPM_TMSHPEXVEnblCmd_flg_ovrdflg "TMS_LINTestData3_BOD" VALUE 0x0000 /* @ECU_Address@KOPM_TMSHPEXVEnblCmd_flg_ovrdflg@ */ Scalar_BOOLEAN 0 AppSwcOpm_CM_boolean_flg 0.0 1.0 /end CHARACTERISTIC
/begin CHARACTERISTIC KOPM_TMSHPEXVEnblCmd_flg_ovrdval "TMS_LINTestData3_BOD" VALUE 0x0000 /* @ECU_Address@KOPM_TMSHPEXVEnblCmd_flg_ovrdval@ */ Scalar_BOOLEAN 0 AppSwcOpm_CM_boolean_flg 0.0 1.0 /end CHARACTERISTIC
/begin CHARACTERISTIC KOPM_TMSHPEXVPstnCmd_cnt_ovrdflg "TMS_LINTestData1_BOD" VALUE 0x0000 /* @ECU_Address@KOPM_TMSHPEXVPstnCmd_cnt_ovrdflg@ */ Scalar_BOOLEAN 0 AppSwcOpm_CM_boolean_flg 0.0 1.0 /end CHARACTERISTIC
/begin CHARACTERISTIC KOPM_TMSMotInletCooltTemp_C_ovrdflg "AC_8_status_BOD" VALUE 0x0000 /* @ECU_Address@KOPM_TMSMotInletCooltTemp_C_ovrdflg@ */ Scalar_BOOLEAN 0 AppSwcOpm_CM_boolean_flg 0.0 1.0 /end CHARACTERISTIC
/begin CHARACTERISTIC KOPM_TMSMotPMPRealRPM_rpm_ovrdflg "TMS_LINTestData1_BOD" VALUE 0x0000 /* @ECU_Address@KOPM_TMSMotPMPRealRPM_rpm_ovrdflg@ */ Scalar_BOOLEAN 0 AppSwcOpm_CM_boolean_flg 0.0 1.0 /end CHARACTERISTIC
/begin CHARACTERISTIC KOPM_TMSMotPMPSpdSet_rpm_ovrdflg "TMS_LINTestData1_BOD" VALUE 0x0000 /* @ECU_Address@KOPM_TMSMotPMPSpdSet_rpm_ovrdflg@ */ Scalar_BOOLEAN 0 AppSwcOpm_CM_boolean_flg 0.0 1.0 /end CHARACTERISTIC
/begin CHARACTERISTIC KOPM_TMSOHXOutTmp_C_ovrdflg "AC_3_State_BOD" VALUE 0x0000 /* @ECU_Address@KOPM_TMSOHXOutTmp_C_ovrdflg@ */ Scalar_BOOLEAN 0 AppSwcOpm_CM_boolean_flg 0.0 1.0 /end CHARACTERISTIC
/begin CHARACTERISTIC KOPM_TMSPTPres_kPa_ovrdflg "AC_2_State_BOD" VALUE 0x0000 /* @ECU_Address@KOPM_TMSPTPres_kPa_ovrdflg@ */ Scalar_BOOLEAN 0 AppSwcOpm_CM_boolean_flg 0.0 1.0 /end CHARACTERISTIC
/begin CHARACTERISTIC KOPM_TMSPTTemp_C_ovrdflg "AC_2_State_BOD" VALUE 0x0000 /* @ECU_Address@KOPM_TMSPTTemp_C_ovrdflg@ */ Scalar_BOOLEAN 0 AppSwcOpm_CM_boolean_flg 0.0 1.0 /end CHARACTERISTIC
/begin CHARACTERISTIC KOPM_TMSPwrCoolFanSpdDuty_pct_ovrdflg "AC_8_status_BOD" VALUE 0x0000 /* @ECU_Address@KOPM_TMSPwrCoolFanSpdDuty_pct_ovrdflg@ */ Scalar_BOOLEAN 0 AppSwcOpm_CM_boolean_flg 0.0 1.0 /end CHARACTERISTIC
/begin CHARACTERISTIC KOPM_ACActlOprtModeHi_enum "AC_2_State_BOD" VALUE 0x0000 /* @ECU_Address@KOPM_ACActlOprtModeHi_enum@ */ Scalar_UBYTE 0 AppSwcOpm_CM_uint8_enum 0.0 255.0 /end CHARACTERISTIC
/begin CHARACTERISTIC KOPM_ACActlOprtModeLo_enum "AC_2_State_BOD" VALUE 0x0000 /* @ECU_Address@KOPM_ACActlOprtModeLo_enum@ */ Scalar_UBYTE 0 AppSwcOpm_CM_uint8_enum 0.0 255.0 /end CHARACTERISTIC
/begin CHARACTERISTIC KOPM_ACActlOprtMode_enum_ovrdval "AC_2_State_BOD" VALUE 0x0000 /* @ECU_Address@KOPM_ACActlOprtMode_enum_ovrdval@ */ Scalar_UBYTE 0 AppSwcOpm_CM_uint8_enum 0.0 255.0 /end CHARACTERISTIC
/begin CHARACTERISTIC KOPM_ACAirInletModeStaHi_enum "AC_ACStatuts_BOD" VALUE 0x0000 /* @ECU_Address@KOPM_ACAirInletModeStaHi_enum@ */ Scalar_UBYTE 0 AppSwcOpm_CM_uint8_enum 0.0 255.0 /end CHARACTERISTIC
/begin CHARACTERISTIC KOPM_ACAirInletModeStaLo_enum "AC_ACStatuts_BOD" VALUE 0x0000 /* @ECU_Address@KOPM_ACAirInletModeStaLo_enum@ */ Scalar_UBYTE 0 AppSwcOpm_CM_uint8_enum 0.0 255.0 /end CHARACTERISTIC
/begin CHARACTERISTIC KOPM_ACAirInletModeSta_enum_ovrdval "AC_ACStatuts_BOD" VALUE 0x0000 /* @ECU_Address@KOPM_ACAirInletModeSta_enum_ovrdval@ */ Scalar_UBYTE 0 AppSwcOpm_CM_uint8_enum 0.0 255.0 /end CHARACTERISTIC
/begin CHARACTERISTIC KOPM_ACAutoBlwrModeStaHi_enum "AC_ACStatuts_BOD" VALUE 0x0000 /* @ECU_Address@KOPM_ACAutoBlwrModeStaHi_enum@ */ Scalar_UBYTE 0 AppSwcOpm_CM_uint8_enum 0.0 255.0 /end CHARACTERISTIC
/begin CHARACTERISTIC KOPM_ACAutoBlwrModeStaLo_enum "AC_ACStatuts_BOD" VALUE 0x0000 /* @ECU_Address@KOPM_ACAutoBlwrModeStaLo_enum@ */ Scalar_UBYTE 0 AppSwcOpm_CM_uint8_enum 0.0 255.0 /end CHARACTERISTIC
/begin CHARACTERISTIC KOPM_ACAutoBlwrModeSta_enum_ovrdval "AC_ACStatuts_BOD" VALUE 0x0000 /* @ECU_Address@KOPM_ACAutoBlwrModeSta_enum_ovrdval@ */ Scalar_UBYTE 0 AppSwcOpm_CM_uint8_enum 0.0 255.0 /end CHARACTERISTIC
/begin CHARACTERISTIC KOPM_ACAutoFrntFanSpdHi_enum "AC_8_status_BOD" VALUE 0x0000 /* @ECU_Address@KOPM_ACAutoFrntFanSpdHi_enum@ */ Scalar_UBYTE 0 AppSwcOpm_CM_uint8_enum 0.0 255.0 /end CHARACTERISTIC
/begin CHARACTERISTIC KOPM_ACAutoFrntFanSpdLo_enum "AC_8_status_BOD" VALUE 0x0000 /* @ECU_Address@KOPM_ACAutoFrntFanSpdLo_enum@ */ Scalar_UBYTE 0 AppSwcOpm_CM_uint8_enum 0.0 255.0 /end CHARACTERISTIC
/begin CHARACTERISTIC KOPM_ACAutoFrntFanSpd_enum_ovrdval "AC_8_status_BOD" VALUE 0x0000 /* @ECU_Address@KOPM_ACAutoFrntFanSpd_enum_ovrdval@ */ Scalar_UBYTE 0 AppSwcOpm_CM_uint8_enum 0.0 255.0 /end CHARACTERISTIC
/begin CHARACTERISTIC KOPM_ACBlwrModeStaHi_enum "AC_ACStatuts_BOD" VALUE 0x0000 /* @ECU_Address@KOPM_ACBlwrModeStaHi_enum@ */ Scalar_UBYTE 0 AppSwcOpm_CM_uint8_enum 0.0 255.0 /end CHARACTERISTIC
/begin CHARACTERISTIC KOPM_ACBlwrModeStaLo_enum "AC_ACStatuts_BOD" VALUE 0x0000 /* @ECU_Address@KOPM_ACBlwrModeStaLo_enum@ */ Scalar_UBYTE 0 AppSwcOpm_CM_uint8_enum 0.0 255.0 /end CHARACTERISTIC
/begin CHARACTERISTIC KOPM_ACBlwrModeSta_enum_ovrdval "AC_ACStatuts_BOD" VALUE 0x0000 /* @ECU_Address@KOPM_ACBlwrModeSta_enum_ovrdval@ */ Scalar_UBYTE 0 AppSwcOpm_CM_uint8_enum 0.0 255.0 /end CHARACTERISTIC
/begin CHARACTERISTIC KOPM_ACFrntFanSpdValHi_enum "AC_ACStatuts_BOD" VALUE 0x0000 /* @ECU_Address@KOPM_ACFrntFanSpdValHi_enum@ */ Scalar_UBYTE 0 AppSwcOpm_CM_uint8_enum 0.0 255.0 /end CHARACTERISTIC
/begin CHARACTERISTIC KOPM_ACFrntFanSpdValLo_enum "AC_ACStatuts_BOD" VALUE 0x0000 /* @ECU_Address@KOPM_ACFrntFanSpdValLo_enum@ */ Scalar_UBYTE 0 AppSwcOpm_CM_uint8_enum 0.0 255.0 /end CHARACTERISTIC
/begin CHARACTERISTIC KOPM_ACFrntFanSpdVal_enum_ovrdval "AC_ACStatuts_BOD" VALUE 0x0000 /* @ECU_Address@KOPM_ACFrntFanSpdVal_enum_ovrdval@ */ Scalar_UBYTE 0 AppSwcOpm_CM_uint8_enum 0.0 255.0 /end CHARACTERISTIC
/begin CHARACTERISTIC KOPM_ACHVHActlOprtModeHi_enum "AC_2_State_BOD" VALUE 0x0000 /* @ECU_Address@KOPM_ACHVHActlOprtModeHi_enum@ */ Scalar_UBYTE 0 AppSwcOpm_CM_uint8_enum 0.0 255.0 /end CHARACTERISTIC
/begin CHARACTERISTIC KOPM_ACHVHActlOprtModeLo_enum "AC_2_State_BOD" VALUE 0x0000 /* @ECU_Address@KOPM_ACHVHActlOprtModeLo_enum@ */ Scalar_UBYTE 0 AppSwcOpm_CM_uint8_enum 0.0 255.0 /end CHARACTERISTIC
/begin CHARACTERISTIC KOPM_ACHVHActlOprtMode_enum_ovrdval "AC_2_State_BOD" VALUE 0x0000 /* @ECU_Address@KOPM_ACHVHActlOprtMode_enum_ovrdval@ */ Scalar_UBYTE 0 AppSwcOpm_CM_uint8_enum 0.0 255.0 /end CHARACTERISTIC
/begin CHARACTERISTIC KOPM_ACHVPTCOnRqHi_enum "AC_8_status_BOD" VALUE 0x0000 /* @ECU_Address@KOPM_ACHVPTCOnRqHi_enum@ */ Scalar_UBYTE 0 AppSwcOpm_CM_uint8_enum 0.0 255.0 /end CHARACTERISTIC
/begin CHARACTERISTIC KOPM_ACHVPTCOnRqLo_enum "AC_8_status_BOD" VALUE 0x0000 /* @ECU_Address@KOPM_ACHVPTCOnRqLo_enum@ */ Scalar_UBYTE 0 AppSwcOpm_CM_uint8_enum 0.0 255.0 /end CHARACTERISTIC
/begin CHARACTERISTIC KOPM_ACHVPTCOnRq_enum_ovrdval "AC_8_status_BOD" VALUE 0x0000 /* @ECU_Address@KOPM_ACHVPTCOnRq_enum_ovrdval@ */ Scalar_UBYTE 0 AppSwcOpm_CM_uint8_enum 0.0 255.0 /end CHARACTERISTIC
/begin CHARACTERISTIC KOPM_ACHybEcoModeStaHi_enum "AC_ACStatuts_BOD" VALUE 0x0000 /* @ECU_Address@KOPM_ACHybEcoModeStaHi_enum@ */ Scalar_UBYTE 0 AppSwcOpm_CM_uint8_enum 0.0 255.0 /end CHARACTERISTIC
/begin CHARACTERISTIC KOPM_ACHybEcoModeStaLo_enum "AC_ACStatuts_BOD" VALUE 0x0000 /* @ECU_Address@KOPM_ACHybEcoModeStaLo_enum@ */ Scalar_UBYTE 0 AppSwcOpm_CM_uint8_enum 0.0 255.0 /end CHARACTERISTIC
/begin CHARACTERISTIC KOPM_ACHybEcoModeSta_enum_ovrdval "AC_ACStatuts_BOD" VALUE 0x0000 /* @ECU_Address@KOPM_ACHybEcoModeSta_enum_ovrdval@ */ Scalar_UBYTE 0 AppSwcOpm_CM_uint8_enum 0.0 255.0 /end CHARACTERISTIC
/begin CHARACTERISTIC KOPM_ACLeftTempValHi_enum "AC_ACStatuts_BOD" VALUE 0x0000 /* @ECU_Address@KOPM_ACLeftTempValHi_enum@ */ Scalar_UBYTE 0 AppSwcOpm_CM_uint8_enum 0.0 255.0 /end CHARACTERISTIC
/begin CHARACTERISTIC KOPM_ACLeftTempValLo_enum "AC_ACStatuts_BOD" VALUE 0x0000 /* @ECU_Address@KOPM_ACLeftTempValLo_enum@ */ Scalar_UBYTE 0 AppSwcOpm_CM_uint8_enum 0.0 255.0 /end CHARACTERISTIC
/begin CHARACTERISTIC KOPM_ACLeftTempVal_enum_ovrdval "AC_ACStatuts_BOD" VALUE 0x0000 /* @ECU_Address@KOPM_ACLeftTempVal_enum_ovrdval@ */ Scalar_UBYTE 0 AppSwcOpm_CM_uint8_enum 0.0 255.0 /end CHARACTERISTIC
/begin CHARACTERISTIC KOPM_ACPumpActlSpdDutyHi_pct "AC_1_Command_BOD" VALUE 0x0000 /* @ECU_Address@KOPM_ACPumpActlSpdDutyHi_pct@ */ Scalar_UBYTE 0 AppSwcOpm_CM_uint8_pct 0.0 255.0 /end CHARACTERISTIC
/begin CHARACTERISTIC KOPM_ACPumpActlSpdDutyLo_pct "AC_1_Command_BOD" VALUE 0x0000 /* @ECU_Address@KOPM_ACPumpActlSpdDutyLo_pct@ */ Scalar_UBYTE 0 AppSwcOpm_CM_uint8_pct 0.0 255.0 /end CHARACTERISTIC
/begin CHARACTERISTIC KOPM_ACPumpActlSpdDuty_pct_ovrdval "AC_1_Command_BOD" VALUE 0x0000 /* @ECU_Address@KOPM_ACPumpActlSpdDuty_pct_ovrdval@ */ Scalar_UBYTE 0 AppSwcOpm_CM_uint8_pct 0.0 255.0 /end CHARACTERISTIC
/begin CHARACTERISTIC KOPM_BCMHiFreqSigDataByte0Hi_nu "BCM_HFSData_BAC" VALUE 0x0000 /* @ECU_Address@KOPM_BCMHiFreqSigDataByte0Hi_nu@ */ Scalar_UBYTE 0 AppSwcOpm_CM_uint8_nu 0.0 255.0 /end CHARACTERISTIC
/begin CHARACTERISTIC KOPM_BCMHiFreqSigDataByte0Lo_nu "BCM_HFSData_BAC" VALUE 0x0000 /* @ECU_Address@KOPM_BCMHiFreqSigDataByte0Lo_nu@ */ Scalar_UBYTE 0 AppSwcOpm_CM_uint8_nu 0.0 255.0 /end CHARACTERISTIC
/begin CHARACTERISTIC KOPM_BCMHiFreqSigDataByte0_nu_ovrdval "BCM_HFSData_BAC" VALUE 0x0000 /* @ECU_Address@KOPM_BCMHiFreqSigDataByte0_nu_ovrdval@ */ Scalar_UBYTE 0 AppSwcOpm_CM_uint8_nu 0.0 255.0 /end CHARACTERISTIC
/begin CHARACTERISTIC KOPM_BCMHiFreqSigDataByte10Hi_nu "BCM_HFSData_BAC" VALUE 0x0000 /* @ECU_Address@KOPM_BCMHiFreqSigDataByte10Hi_nu@ */ Scalar_UBYTE 0 AppSwcOpm_CM_uint8_nu 0.0 255.0 /end CHARACTERISTIC
/begin CHARACTERISTIC KOPM_BCMHiFreqSigDataByte10Lo_nu "BCM_HFSData_BAC" VALUE 0x0000 /* @ECU_Address@KOPM_BCMHiFreqSigDataByte10Lo_nu@ */ Scalar_UBYTE 0 AppSwcOpm_CM_uint8_nu 0.0 255.0 /end CHARACTERISTIC
/begin CHARACTERISTIC KOPM_BCMHiFreqSigDataByte10_nu_ovrdval "BCM_HFSData_BAC" VALUE 0x0000 /* @ECU_Address@KOPM_BCMHiFreqSigDataByte10_nu_ovrdval@ */ Scalar_UBYTE 0 AppSwcOpm_CM_uint8_nu 0.0 255.0 /end CHARACTERISTIC
/begin CHARACTERISTIC KOPM_BCMHiFreqSigDataByte11Hi_nu "BCM_HFSData_BAC" VALUE 0x0000 /* @ECU_Address@KOPM_BCMHiFreqSigDataByte11Hi_nu@ */ Scalar_UBYTE 0 AppSwcOpm_CM_uint8_nu 0.0 255.0 /end CHARACTERISTIC
/begin CHARACTERISTIC KOPM_BCMHiFreqSigDataByte11Lo_nu "BCM_HFSData_BAC" VALUE 0x0000 /* @ECU_Address@KOPM_BCMHiFreqSigDataByte11Lo_nu@ */ Scalar_UBYTE 0 AppSwcOpm_CM_uint8_nu 0.0 255.0 /end CHARACTERISTIC
/begin CHARACTERISTIC KOPM_BCMHiFreqSigDataByte11_nu_ovrdval "BCM_HFSData_BAC" VALUE 0x0000 /* @ECU_Address@KOPM_BCMHiFreqSigDataByte11_nu_ovrdval@ */ Scalar_UBYTE 0 AppSwcOpm_CM_uint8_nu 0.0 255.0 /end CHARACTERISTIC
/begin CHARACTERISTIC KOPM_BCMHiFreqSigDataByte12Hi_nu "BCM_HFSData_BAC" VALUE 0x0000 /* @ECU_Address@KOPM_BCMHiFreqSigDataByte12Hi_nu@ */ Scalar_UBYTE 0 AppSwcOpm_CM_uint8_nu 0.0 255.0 /end CHARACTERISTIC
/begin CHARACTERISTIC KOPM_BCMHiFreqSigDataByte12Lo_nu "BCM_HFSData_BAC" VALUE 0x0000 /* @ECU_Address@KOPM_BCMHiFreqSigDataByte12Lo_nu@ */ Scalar_UBYTE 0 AppSwcOpm_CM_uint8_nu 0.0 255.0 /end CHARACTERISTIC
/begin CHARACTERISTIC KOPM_BCMHiFreqSigDataByte12_nu_ovrdval "BCM_HFSData_BAC" VALUE 0x0000 /* @ECU_Address@KOPM_BCMHiFreqSigDataByte12_nu_ovrdval@ */ Scalar_UBYTE 0 AppSwcOpm_CM_uint8_nu 0.0 255.0 /end CHARACTERISTIC
/begin CHARACTERISTIC KOPM_BCMHiFreqSigDataByte13Hi_nu "BCM_HFSData_BAC" VALUE 0x0000 /* @ECU_Address@KOPM_BCMHiFreqSigDataByte13Hi_nu@ */ Scalar_UBYTE 0 AppSwcOpm_CM_uint8_nu 0.0 255.0 /end CHARACTERISTIC
/begin CHARACTERISTIC KOPM_BCMHiFreqSigDataByte13Lo_nu "BCM_HFSData_BAC" VALUE 0x0000 /* @ECU_Address@KOPM_BCMHiFreqSigDataByte13Lo_nu@ */ Scalar_UBYTE 0 AppSwcOpm_CM_uint8_nu 0.0 255.0 /end CHARACTERISTIC
/begin CHARACTERISTIC KOPM_BCMHiFreqSigDataByte13_nu_ovrdval "BCM_HFSData_BAC" VALUE 0x0000 /* @ECU_Address@KOPM_BCMHiFreqSigDataByte13_nu_ovrdval@ */ Scalar_UBYTE 0 AppSwcOpm_CM_uint8_nu 0.0 255.0 /end CHARACTERISTIC
/begin CHARACTERISTIC KOPM_BCMHiFreqSigDataByte14Hi_nu "BCM_HFSData_BAC" VALUE 0x0000 /* @ECU_Address@KOPM_BCMHiFreqSigDataByte14Hi_nu@ */ Scalar_UBYTE 0 AppSwcOpm_CM_uint8_nu 0.0 255.0 /end CHARACTERISTIC
/begin CHARACTERISTIC KOPM_BCMHiFreqSigDataByte14Lo_nu "BCM_HFSData_BAC" VALUE 0x0000 /* @ECU_Address@KOPM_BCMHiFreqSigDataByte14Lo_nu@ */ Scalar_UBYTE 0 AppSwcOpm_CM_uint8_nu 0.0 255.0 /end CHARACTERISTIC
/begin CHARACTERISTIC KOPM_BCMHiFreqSigDataByte14_nu_ovrdval "BCM_HFSData_BAC" VALUE 0x0000 /* @ECU_Address@KOPM_BCMHiFreqSigDataByte14_nu_ovrdval@ */ Scalar_UBYTE 0 AppSwcOpm_CM_uint8_nu 0.0 255.0 /end CHARACTERISTIC
/begin CHARACTERISTIC KOPM_BCMHiFreqSigDataByte15Hi_nu "BCM_HFSData_BAC" VALUE 0x0000 /* @ECU_Address@KOPM_BCMHiFreqSigDataByte15Hi_nu@ */ Scalar_UBYTE 0 AppSwcOpm_CM_uint8_nu 0.0 255.0 /end CHARACTERISTIC
/begin CHARACTERISTIC KOPM_BCMHiFreqSigDataByte15Lo_nu "BCM_HFSData_BAC" VALUE 0x0000 /* @ECU_Address@KOPM_BCMHiFreqSigDataByte15Lo_nu@ */ Scalar_UBYTE 0 AppSwcOpm_CM_uint8_nu 0.0 255.0 /end CHARACTERISTIC
/begin CHARACTERISTIC KOPM_BCMHiFreqSigDataByte15_nu_ovrdval "BCM_HFSData_BAC" VALUE 0x0000 /* @ECU_Address@KOPM_BCMHiFreqSigDataByte15_nu_ovrdval@ */ Scalar_UBYTE 0 AppSwcOpm_CM_uint8_nu 0.0 255.0 /end CHARACTERISTIC
/begin CHARACTERISTIC KOPM_BCMHiFreqSigDataByte1Hi_nu "BCM_HFSData_BAC" VALUE 0x0000 /* @ECU_Address@KOPM_BCMHiFreqSigDataByte1Hi_nu@ */ Scalar_UBYTE 0 AppSwcOpm_CM_uint8_nu 0.0 255.0 /end CHARACTERISTIC
/begin CHARACTERISTIC KOPM_BCMHiFreqSigDataByte1Lo_nu "BCM_HFSData_BAC" VALUE 0x0000 /* @ECU_Address@KOPM_BCMHiFreqSigDataByte1Lo_nu@ */ Scalar_UBYTE 0 AppSwcOpm_CM_uint8_nu 0.0 255.0 /end CHARACTERISTIC
/begin CHARACTERISTIC KOPM_BCMHiFreqSigDataByte1_nu_ovrdval "BCM_HFSData_BAC" VALUE 0x0000 /* @ECU_Address@KOPM_BCMHiFreqSigDataByte1_nu_ovrdval@ */ Scalar_UBYTE 0 AppSwcOpm_CM_uint8_nu 0.0 255.0 /end CHARACTERISTIC
/begin CHARACTERISTIC KOPM_BCMHiFreqSigDataByte2Hi_nu "BCM_HFSData_BAC" VALUE 0x0000 /* @ECU_Address@KOPM_BCMHiFreqSigDataByte2Hi_nu@ */ Scalar_UBYTE 0 AppSwcOpm_CM_uint8_nu 0.0 255.0 /end CHARACTERISTIC
/begin CHARACTERISTIC KOPM_BCMHiFreqSigDataByte2Lo_nu "BCM_HFSData_BAC" VALUE 0x0000 /* @ECU_Address@KOPM_BCMHiFreqSigDataByte2Lo_nu@ */ Scalar_UBYTE 0 AppSwcOpm_CM_uint8_nu 0.0 255.0 /end CHARACTERISTIC
/begin CHARACTERISTIC KOPM_BCMHiFreqSigDataByte2_nu_ovrdval "BCM_HFSData_BAC" VALUE 0x0000 /* @ECU_Address@KOPM_BCMHiFreqSigDataByte2_nu_ovrdval@ */ Scalar_UBYTE 0 AppSwcOpm_CM_uint8_nu 0.0 255.0 /end CHARACTERISTIC
/begin CHARACTERISTIC KOPM_BCMHiFreqSigDataByte3Hi_nu "BCM_HFSData_BAC" VALUE 0x0000 /* @ECU_Address@KOPM_BCMHiFreqSigDataByte3Hi_nu@ */ Scalar_UBYTE 0 AppSwcOpm_CM_uint8_nu 0.0 255.0 /end CHARACTERISTIC
/begin CHARACTERISTIC KOPM_BCMHiFreqSigDataByte3Lo_nu "BCM_HFSData_BAC" VALUE 0x0000 /* @ECU_Address@KOPM_BCMHiFreqSigDataByte3Lo_nu@ */ Scalar_UBYTE 0 AppSwcOpm_CM_uint8_nu 0.0 255.0 /end CHARACTERISTIC
/begin CHARACTERISTIC KOPM_BCMHiFreqSigDataByte3_nu_ovrdval "BCM_HFSData_BAC" VALUE 0x0000 /* @ECU_Address@KOPM_BCMHiFreqSigDataByte3_nu_ovrdval@ */ Scalar_UBYTE 0 AppSwcOpm_CM_uint8_nu 0.0 255.0 /end CHARACTERISTIC
/begin CHARACTERISTIC KOPM_BCMHiFreqSigDataByte4Hi_nu "BCM_HFSData_BAC" VALUE 0x0000 /* @ECU_Address@KOPM_BCMHiFreqSigDataByte4Hi_nu@ */ Scalar_UBYTE 0 AppSwcOpm_CM_uint8_nu 0.0 255.0 /end CHARACTERISTIC
/begin CHARACTERISTIC KOPM_BCMHiFreqSigDataByte4Lo_nu "BCM_HFSData_BAC" VALUE 0x0000 /* @ECU_Address@KOPM_BCMHiFreqSigDataByte4Lo_nu@ */ Scalar_UBYTE 0 AppSwcOpm_CM_uint8_nu 0.0 255.0 /end CHARACTERISTIC
/begin CHARACTERISTIC KOPM_BCMHiFreqSigDataByte4_nu_ovrdval "BCM_HFSData_BAC" VALUE 0x0000 /* @ECU_Address@KOPM_BCMHiFreqSigDataByte4_nu_ovrdval@ */ Scalar_UBYTE 0 AppSwcOpm_CM_uint8_nu 0.0 255.0 /end CHARACTERISTIC
/begin CHARACTERISTIC KOPM_BCMHiFreqSigDataByte5Hi_nu "BCM_HFSData_BAC" VALUE 0x0000 /* @ECU_Address@KOPM_BCMHiFreqSigDataByte5Hi_nu@ */ Scalar_UBYTE 0 AppSwcOpm_CM_uint8_nu 0.0 255.0 /end CHARACTERISTIC
/begin CHARACTERISTIC KOPM_BCMHiFreqSigDataByte5Lo_nu "BCM_HFSData_BAC" VALUE 0x0000 /* @ECU_Address@KOPM_BCMHiFreqSigDataByte5Lo_nu@ */ Scalar_UBYTE 0 AppSwcOpm_CM_uint8_nu 0.0 255.0 /end CHARACTERISTIC
/begin CHARACTERISTIC KOPM_BCMHiFreqSigDataByte5_nu_ovrdval "BCM_HFSData_BAC" VALUE 0x0000 /* @ECU_Address@KOPM_BCMHiFreqSigDataByte5_nu_ovrdval@ */ Scalar_UBYTE 0 AppSwcOpm_CM_uint8_nu 0.0 255.0 /end CHARACTERISTIC
/begin CHARACTERISTIC KOPM_BCMHiFreqSigDataByte6Hi_nu "BCM_HFSData_BAC" VALUE 0x0000 /* @ECU_Address@KOPM_BCMHiFreqSigDataByte6Hi_nu@ */ Scalar_UBYTE 0 AppSwcOpm_CM_uint8_nu 0.0 255.0 /end CHARACTERISTIC
/begin CHARACTERISTIC KOPM_BCMHiFreqSigDataByte6Lo_nu "BCM_HFSData_BAC" VALUE 0x0000 /* @ECU_Address@KOPM_BCMHiFreqSigDataByte6Lo_nu@ */ Scalar_UBYTE 0 AppSwcOpm_CM_uint8_nu 0.0 255.0 /end CHARACTERISTIC
/begin CHARACTERISTIC KOPM_BCMHiFreqSigDataByte6_nu_ovrdval "BCM_HFSData_BAC" VALUE 0x0000 /* @ECU_Address@KOPM_BCMHiFreqSigDataByte6_nu_ovrdval@ */ Scalar_UBYTE 0 AppSwcOpm_CM_uint8_nu 0.0 255.0 /end CHARACTERISTIC
/begin CHARACTERISTIC KOPM_BCMHiFreqSigDataByte7Hi_nu "BCM_HFSData_BAC" VALUE 0x0000 /* @ECU_Address@KOPM_BCMHiFreqSigDataByte7Hi_nu@ */ Scalar_UBYTE 0 AppSwcOpm_CM_uint8_nu 0.0 255.0 /end CHARACTERISTIC
/begin CHARACTERISTIC KOPM_BCMHiFreqSigDataByte7Lo_nu "BCM_HFSData_BAC" VALUE 0x0000 /* @ECU_Address@KOPM_BCMHiFreqSigDataByte7Lo_nu@ */ Scalar_UBYTE 0 AppSwcOpm_CM_uint8_nu 0.0 255.0 /end CHARACTERISTIC
/begin CHARACTERISTIC KOPM_BCMHiFreqSigDataByte7_nu_ovrdval "BCM_HFSData_BAC" VALUE 0x0000 /* @ECU_Address@KOPM_BCMHiFreqSigDataByte7_nu_ovrdval@ */ Scalar_UBYTE 0 AppSwcOpm_CM_uint8_nu 0.0 255.0 /end CHARACTERISTIC
/begin CHARACTERISTIC KOPM_BCMHiFreqSigDataByte8Hi_nu "BCM_HFSData_BAC" VALUE 0x0000 /* @ECU_Address@KOPM_BCMHiFreqSigDataByte8Hi_nu@ */ Scalar_UBYTE 0 AppSwcOpm_CM_uint8_nu 0.0 255.0 /end CHARACTERISTIC
/begin CHARACTERISTIC KOPM_BCMHiFreqSigDataByte8Lo_nu "BCM_HFSData_BAC" VALUE 0x0000 /* @ECU_Address@KOPM_BCMHiFreqSigDataByte8Lo_nu@ */ Scalar_UBYTE 0 AppSwcOpm_CM_uint8_nu 0.0 255.0 /end CHARACTERISTIC
/begin CHARACTERISTIC KOPM_BCMHiFreqSigDataByte8_nu_ovrdval "BCM_HFSData_BAC" VALUE 0x0000 /* @ECU_Address@KOPM_BCMHiFreqSigDataByte8_nu_ovrdval@ */ Scalar_UBYTE 0 AppSwcOpm_CM_uint8_nu 0.0 255.0 /end CHARACTERISTIC
/begin CHARACTERISTIC KOPM_BCMHiFreqSigDataByte9Hi_nu "BCM_HFSData_BAC" VALUE 0x0000 /* @ECU_Address@KOPM_BCMHiFreqSigDataByte9Hi_nu@ */ Scalar_UBYTE 0 AppSwcOpm_CM_uint8_nu 0.0 255.0 /end CHARACTERISTIC
/begin CHARACTERISTIC KOPM_BCMHiFreqSigDataByte9Lo_nu "BCM_HFSData_BAC" VALUE 0x0000 /* @ECU_Address@KOPM_BCMHiFreqSigDataByte9Lo_nu@ */ Scalar_UBYTE 0 AppSwcOpm_CM_uint8_nu 0.0 255.0 /end CHARACTERISTIC
/begin CHARACTERISTIC KOPM_BCMHiFreqSigDataByte9_nu_ovrdval "BCM_HFSData_BAC" VALUE 0x0000 /* @ECU_Address@KOPM_BCMHiFreqSigDataByte9_nu_ovrdval@ */ Scalar_UBYTE 0 AppSwcOpm_CM_uint8_nu 0.0 255.0 /end CHARACTERISTIC
/begin CHARACTERISTIC KOPM_BCMLrngData02Hi_nu "BCM_IMMOAuthResp1_EPT" VALUE 0x0000 /* @ECU_Address@KOPM_BCMLrngData02Hi_nu@ */ Scalar_UBYTE 0 AppSwcOpm_CM_uint8_nu 0.0 255.0 /end CHARACTERISTIC
/begin CHARACTERISTIC KOPM_BCMLrngData02Lo_nu "BCM_IMMOAuthResp1_EPT" VALUE 0x0000 /* @ECU_Address@KOPM_BCMLrngData02Lo_nu@ */ Scalar_UBYTE 0 AppSwcOpm_CM_uint8_nu 0.0 255.0 /end CHARACTERISTIC
/begin CHARACTERISTIC KOPM_BCMLrngData02_nu_ovrdval "BCM_IMMOAuthResp1_EPT" VALUE 0x0000 /* @ECU_Address@KOPM_BCMLrngData02_nu_ovrdval@ */ Scalar_UBYTE 0 AppSwcOpm_CM_uint8_nu 0.0 255.0 /end CHARACTERISTIC
/begin CHARACTERISTIC KOPM_BCMLrngData03Hi_nu "BCM_IMMOAuthResp1_EPT" VALUE 0x0000 /* @ECU_Address@KOPM_BCMLrngData03Hi_nu@ */ Scalar_UBYTE 0 AppSwcOpm_CM_uint8_nu 0.0 255.0 /end CHARACTERISTIC
/begin CHARACTERISTIC KOPM_BCMLrngData03Lo_nu "BCM_IMMOAuthResp1_EPT" VALUE 0x0000 /* @ECU_Address@KOPM_BCMLrngData03Lo_nu@ */ Scalar_UBYTE 0 AppSwcOpm_CM_uint8_nu 0.0 255.0 /end CHARACTERISTIC
/begin CHARACTERISTIC KOPM_BCMLrngData03_nu_ovrdval "BCM_IMMOAuthResp1_EPT" VALUE 0x0000 /* @ECU_Address@KOPM_BCMLrngData03_nu_ovrdval@ */ Scalar_UBYTE 0 AppSwcOpm_CM_uint8_nu 0.0 255.0 /end CHARACTERISTIC
/begin CHARACTERISTIC KOPM_BCMLrngData04Hi_nu "BCM_IMMOAuthResp1_EPT" VALUE 0x0000 /* @ECU_Address@KOPM_BCMLrngData04Hi_nu@ */ Scalar_UBYTE 0 AppSwcOpm_CM_uint8_nu 0.0 255.0 /end CHARACTERISTIC
/begin CHARACTERISTIC KOPM_BCMLrngData04Lo_nu "BCM_IMMOAuthResp1_EPT" VALUE 0x0000 /* @ECU_Address@KOPM_BCMLrngData04Lo_nu@ */ Scalar_UBYTE 0 AppSwcOpm_CM_uint8_nu 0.0 255.0 /end CHARACTERISTIC
/begin CHARACTERISTIC KOPM_BCMLrngData04_nu_ovrdval "BCM_IMMOAuthResp1_EPT" VALUE 0x0000 /* @ECU_Address@KOPM_BCMLrngData04_nu_ovrdval@ */ Scalar_UBYTE 0 AppSwcOpm_CM_uint8_nu 0.0 255.0 /end CHARACTERISTIC
/begin CHARACTERISTIC KOPM_BCMLrngData05Hi_nu "BCM_IMMOAuthResp1_EPT" VALUE 0x0000 /* @ECU_Address@KOPM_BCMLrngData05Hi_nu@ */ Scalar_UBYTE 0 AppSwcOpm_CM_uint8_nu 0.0 255.0 /end CHARACTERISTIC
/begin CHARACTERISTIC KOPM_BCMLrngData05Lo_nu "BCM_IMMOAuthResp1_EPT" VALUE 0x0000 /* @ECU_Address@KOPM_BCMLrngData05Lo_nu@ */ Scalar_UBYTE 0 AppSwcOpm_CM_uint8_nu 0.0 255.0 /end CHARACTERISTIC
/begin CHARACTERISTIC KOPM_BCMLrngData05_nu_ovrdval "BCM_IMMOAuthResp1_EPT" VALUE 0x0000 /* @ECU_Address@KOPM_BCMLrngData05_nu_ovrdval@ */ Scalar_UBYTE 0 AppSwcOpm_CM_uint8_nu 0.0 255.0 /end CHARACTERISTIC
/begin CHARACTERISTIC KOPM_BCMLrngData06Hi_nu "BCM_IMMOAuthResp1_EPT" VALUE 0x0000 /* @ECU_Address@KOPM_BCMLrngData06Hi_nu@ */ Scalar_UBYTE 0 AppSwcOpm_CM_uint8_nu 0.0 255.0 /end CHARACTERISTIC
/begin CHARACTERISTIC KOPM_BCMLrngData06Lo_nu "BCM_IMMOAuthResp1_EPT" VALUE 0x0000 /* @ECU_Address@KOPM_BCMLrngData06Lo_nu@ */ Scalar_UBYTE 0 AppSwcOpm_CM_uint8_nu 0.0 255.0 /end CHARACTERISTIC
/begin CHARACTERISTIC KOPM_BCMLrngData06_nu_ovrdval "BCM_IMMOAuthResp1_EPT" VALUE 0x0000 /* @ECU_Address@KOPM_BCMLrngData06_nu_ovrdval@ */ Scalar_UBYTE 0 AppSwcOpm_CM_uint8_nu 0.0 255.0 /end CHARACTERISTIC
/begin CHARACTERISTIC KOPM_BCMLrngData07Hi_nu "BCM_IMMOAuthResp1_EPT" VALUE 0x0000 /* @ECU_Address@KOPM_BCMLrngData07Hi_nu@ */ Scalar_UBYTE 0 AppSwcOpm_CM_uint8_nu 0.0 255.0 /end CHARACTERISTIC
/begin CHARACTERISTIC KOPM_BCMLrngData07Lo_nu "BCM_IMMOAuthResp1_EPT" VALUE 0x0000 /* @ECU_Address@KOPM_BCMLrngData07Lo_nu@ */ Scalar_UBYTE 0 AppSwcOpm_CM_uint8_nu 0.0 255.0 /end CHARACTERISTIC
/begin CHARACTERISTIC KOPM_BCMLrngData07_nu_ovrdval "BCM_IMMOAuthResp1_EPT" VALUE 0x0000 /* @ECU_Address@KOPM_BCMLrngData07_nu_ovrdval@ */ Scalar_UBYTE 0 AppSwcOpm_CM_uint8_nu 0.0 255.0 /end CHARACTERISTIC
/begin CHARACTERISTIC KOPM_BCMLrngStsHi_enum "BCM_IMMOAuthResp1_EPT" VALUE 0x0000 /* @ECU_Address@KOPM_BCMLrngStsHi_enum@ */ Scalar_UBYTE 0 AppSwcOpm_CM_uint8_enum 0.0 255.0 /end CHARACTERISTIC
/begin CHARACTERISTIC KOPM_BCMLrngStsLo_enum "BCM_IMMOAuthResp1_EPT" VALUE 0x0000 /* @ECU_Address@KOPM_BCMLrngStsLo_enum@ */ Scalar_UBYTE 0 AppSwcOpm_CM_uint8_enum 0.0 255.0 /end CHARACTERISTIC
/begin CHARACTERISTIC KOPM_BCMLrngSts_enum_ovrdval "BCM_IMMOAuthResp1_EPT" VALUE 0x0000 /* @ECU_Address@KOPM_BCMLrngSts_enum_ovrdval@ */ Scalar_UBYTE 0 AppSwcOpm_CM_uint8_enum 0.0 255.0 /end CHARACTERISTIC
/begin CHARACTERISTIC KOPM_BCMLrngsubIDHi_cnt "BCM_IMMOAuthResp1_EPT" VALUE 0x0000 /* @ECU_Address@KOPM_BCMLrngsubIDHi_cnt@ */ Scalar_UBYTE 0 AppSwcOpm_CM_uint8_nu 0.0 255.0 /end CHARACTERISTIC
/begin CHARACTERISTIC KOPM_BCMLrngsubIDLo_cnt "BCM_IMMOAuthResp1_EPT" VALUE 0x0000 /* @ECU_Address@KOPM_BCMLrngsubIDLo_cnt@ */ Scalar_UBYTE 0 AppSwcOpm_CM_uint8_nu 0.0 255.0 /end CHARACTERISTIC
/begin CHARACTERISTIC KOPM_BCMLrngsubID_cnt_ovrdval "BCM_IMMOAuthResp1_EPT" VALUE 0x0000 /* @ECU_Address@KOPM_BCMLrngsubID_cnt_ovrdval@ */ Scalar_UBYTE 0 AppSwcOpm_CM_uint8_cnt 0.0 255.0 /end CHARACTERISTIC
/begin CHARACTERISTIC KOPM_BrkPwrRecupActlWhlTqStsHi_enum "VCU_10_Torque_CHA" VALUE 0x0000 /* @ECU_Address@KOPM_BrkPwrRecupActlWhlTqStsHi_enum@ */ Scalar_UBYTE 0 AppSwcOpm_CM_uint8_enum 0.0 255.0 /end CHARACTERISTIC
/begin CHARACTERISTIC KOPM_BrkPwrRecupActlWhlTqStsLo_enum "VCU_10_Torque_CHA" VALUE 0x0000 /* @ECU_Address@KOPM_BrkPwrRecupActlWhlTqStsLo_enum@ */ Scalar_UBYTE 0 AppSwcOpm_CM_uint8_enum 0.0 255.0 /end CHARACTERISTIC
/begin CHARACTERISTIC KOPM_BrkPwrRecupActlWhlTqSts_enum_ovrdval "VCU_10_Torque_CHA" VALUE 0x0000 /* @ECU_Address@KOPM_BrkPwrRecupActlWhlTqSts_enum_ovrdval@ */ Scalar_UBYTE 0 AppSwcOpm_CM_uint8_enum 0.0 255.0 /end CHARACTERISTIC
/begin CHARACTERISTIC KOPM_COMPEcompEnblHi_enum "AC_COMP_BOD" VALUE 0x0000 /* @ECU_Address@KOPM_COMPEcompEnblHi_enum@ */ Scalar_UBYTE 0 AppSwcOpm_CM_uint8_enum 0.0 255.0 /end CHARACTERISTIC
/begin CHARACTERISTIC KOPM_COMPEcompEnblLo_enum "AC_COMP_BOD" VALUE 0x0000 /* @ECU_Address@KOPM_COMPEcompEnblLo_enum@ */ Scalar_UBYTE 0 AppSwcOpm_CM_uint8_enum 0.0 255.0 /end CHARACTERISTIC
/begin CHARACTERISTIC KOPM_COMPEcompEnbl_enum_ovrdval "AC_COMP_BOD" VALUE 0x0000 /* @ECU_Address@KOPM_COMPEcompEnbl_enum_ovrdval@ */ Scalar_UBYTE 0 AppSwcOpm_CM_uint8_enum 0.0 255.0 /end CHARACTERISTIC
/begin CHARACTERISTIC KOPM_COMPEcompErrCleanHi_enum "AC_COMP_BOD" VALUE 0x0000 /* @ECU_Address@KOPM_COMPEcompErrCleanHi_enum@ */ Scalar_UBYTE 0 AppSwcOpm_CM_uint8_enum 0.0 255.0 /end CHARACTERISTIC
/begin CHARACTERISTIC KOPM_COMPEcompErrCleanLo_enum "AC_COMP_BOD" VALUE 0x0000 /* @ECU_Address@KOPM_COMPEcompErrCleanLo_enum@ */ Scalar_UBYTE 0 AppSwcOpm_CM_uint8_enum 0.0 255.0 /end CHARACTERISTIC
/begin CHARACTERISTIC KOPM_COMPEcompErrClean_enum_ovrdval "AC_COMP_BOD" VALUE 0x0000 /* @ECU_Address@KOPM_COMPEcompErrClean_enum_ovrdval@ */ Scalar_UBYTE 0 AppSwcOpm_CM_uint8_enum 0.0 255.0 /end CHARACTERISTIC
/begin CHARACTERISTIC KOPM_COMPEcompHVStHi_enum "AC_COMP_BOD" VALUE 0x0000 /* @ECU_Address@KOPM_COMPEcompHVStHi_enum@ */ Scalar_UBYTE 0 AppSwcOpm_CM_uint8_enum 0.0 255.0 /end CHARACTERISTIC
/begin CHARACTERISTIC KOPM_COMPEcompHVStLo_enum "AC_COMP_BOD" VALUE 0x0000 /* @ECU_Address@KOPM_COMPEcompHVStLo_enum@ */ Scalar_UBYTE 0 AppSwcOpm_CM_uint8_enum 0.0 255.0 /end CHARACTERISTIC
/begin CHARACTERISTIC KOPM_COMPEcompHVSt_enum_ovrdval "AC_COMP_BOD" VALUE 0x0000 /* @ECU_Address@KOPM_COMPEcompHVSt_enum_ovrdval@ */ Scalar_UBYTE 0 AppSwcOpm_CM_uint8_enum 0.0 255.0 /end CHARACTERISTIC
/begin CHARACTERISTIC KOPM_HVCHEnbldHi_enum "HVCH_Command_BOD" VALUE 0x0000 /* @ECU_Address@KOPM_HVCHEnbldHi_enum@ */ Scalar_UBYTE 0 AppSwcOpm_CM_uint8_enum 0.0 255.0 /end CHARACTERISTIC
/begin CHARACTERISTIC KOPM_HVCHEnbldLo_enum "HVCH_Command_BOD" VALUE 0x0000 /* @ECU_Address@KOPM_HVCHEnbldLo_enum@ */ Scalar_UBYTE 0 AppSwcOpm_CM_uint8_enum 0.0 255.0 /end CHARACTERISTIC
/begin CHARACTERISTIC KOPM_HVCHEnbld_enum_ovrdval "HVCH_Command_BOD" VALUE 0x0000 /* @ECU_Address@KOPM_HVCHEnbld_enum_ovrdval@ */ Scalar_UBYTE 0 AppSwcOpm_CM_uint8_enum 0.0 255.0 /end CHARACTERISTIC
/begin CHARACTERISTIC KOPM_TMSBATThermModHi_enum "AC_8_status_BOD" VALUE 0x0000 /* @ECU_Address@KOPM_TMSBATThermModHi_enum@ */ Scalar_UBYTE 0 AppSwcOpm_CM_uint8_enum 0.0 255.0 /end CHARACTERISTIC
/begin CHARACTERISTIC KOPM_TMSBATThermModLo_enum "AC_8_status_BOD" VALUE 0x0000 /* @ECU_Address@KOPM_TMSBATThermModLo_enum@ */ Scalar_UBYTE 0 AppSwcOpm_CM_uint8_enum 0.0 255.0 /end CHARACTERISTIC
/begin CHARACTERISTIC KOPM_TMSBATThermMod_enum_ovrdval "AC_8_status_BOD" VALUE 0x0000 /* @ECU_Address@KOPM_TMSBATThermMod_enum_ovrdval@ */ Scalar_UBYTE 0 AppSwcOpm_CM_uint8_enum 0.0 255.0 /end CHARACTERISTIC
/begin CHARACTERISTIC KOPM_TMSC3WVBPosSetReqHi_enum "TMS_LINTestData3_BOD" VALUE 0x0000 /* @ECU_Address@KOPM_TMSC3WVBPosSetReqHi_enum@ */ Scalar_UBYTE 0 AppSwcOpm_CM_uint8_enum 0.0 255.0 /end CHARACTERISTIC
/begin CHARACTERISTIC KOPM_TMSC3WVBPosSetReqLo_enum "TMS_LINTestData3_BOD" VALUE 0x0000 /* @ECU_Address@KOPM_TMSC3WVBPosSetReqLo_enum@ */ Scalar_UBYTE 0 AppSwcOpm_CM_uint8_enum 0.0 255.0 /end CHARACTERISTIC
/begin CHARACTERISTIC KOPM_TMSC3WVBPosSetReq_enum_ovrdval "TMS_LINTestData3_BOD" VALUE 0x0000 /* @ECU_Address@KOPM_TMSC3WVBPosSetReq_enum_ovrdval@ */ Scalar_UBYTE 0 AppSwcOpm_CM_uint8_enum 0.0 255.0 /end CHARACTERISTIC
/begin CHARACTERISTIC KOPM_TMSC3WVModeHi_enum "TMS_LINTestData3_BOD" VALUE 0x0000 /* @ECU_Address@KOPM_TMSC3WVModeHi_enum@ */ Scalar_UBYTE 0 AppSwcOpm_CM_uint8_enum 0.0 255.0 /end CHARACTERISTIC
/begin CHARACTERISTIC KOPM_TMSC3WVModeLo_enum "TMS_LINTestData3_BOD" VALUE 0x0000 /* @ECU_Address@KOPM_TMSC3WVModeLo_enum@ */ Scalar_UBYTE 0 AppSwcOpm_CM_uint8_enum 0.0 255.0 /end CHARACTERISTIC
/begin CHARACTERISTIC KOPM_TMSC3WVMode_enum_ovrdval "TMS_LINTestData3_BOD" VALUE 0x0000 /* @ECU_Address@KOPM_TMSC3WVMode_enum_ovrdval@ */ Scalar_UBYTE 0 AppSwcOpm_CM_uint8_enum 0.0 255.0 /end CHARACTERISTIC
/begin CHARACTERISTIC KOPM_TMSC5WVBPosSetReqHi_enum "TMS_LINTestData3_BOD" VALUE 0x0000 /* @ECU_Address@KOPM_TMSC5WVBPosSetReqHi_enum@ */ Scalar_UBYTE 0 AppSwcOpm_CM_uint8_enum 0.0 255.0 /end CHARACTERISTIC
/begin CHARACTERISTIC KOPM_TMSC5WVBPosSetReqLo_enum "TMS_LINTestData3_BOD" VALUE 0x0000 /* @ECU_Address@KOPM_TMSC5WVBPosSetReqLo_enum@ */ Scalar_UBYTE 0 AppSwcOpm_CM_uint8_enum 0.0 255.0 /end CHARACTERISTIC
/begin CHARACTERISTIC KOPM_TMSC5WVBPosSetReq_enum_ovrdval "TMS_LINTestData3_BOD" VALUE 0x0000 /* @ECU_Address@KOPM_TMSC5WVBPosSetReq_enum_ovrdval@ */ Scalar_UBYTE 0 AppSwcOpm_CM_uint8_enum 0.0 255.0 /end CHARACTERISTIC
/begin CHARACTERISTIC KOPM_TMSC5WVModeHi_enum "TMS_LINTestData3_BOD" VALUE 0x0000 /* @ECU_Address@KOPM_TMSC5WVModeHi_enum@ */ Scalar_UBYTE 0 AppSwcOpm_CM_uint8_enum 0.0 255.0 /end CHARACTERISTIC
/begin CHARACTERISTIC KOPM_TMSC5WVModeLo_enum "TMS_LINTestData3_BOD" VALUE 0x0000 /* @ECU_Address@KOPM_TMSC5WVModeLo_enum@ */ Scalar_UBYTE 0 AppSwcOpm_CM_uint8_enum 0.0 255.0 /end CHARACTERISTIC
/begin CHARACTERISTIC KOPM_TMSC5WVMode_enum_ovrdval "TMS_LINTestData3_BOD" VALUE 0x0000 /* @ECU_Address@KOPM_TMSC5WVMode_enum_ovrdval@ */ Scalar_UBYTE 0 AppSwcOpm_CM_uint8_enum 0.0 255.0 /end CHARACTERISTIC
/begin CHARACTERISTIC KOPM_TMSCabThermModHi_enum "AC_8_status_BOD" VALUE 0x0000 /* @ECU_Address@KOPM_TMSCabThermModHi_enum@ */ Scalar_UBYTE 0 AppSwcOpm_CM_uint8_enum 0.0 255.0 /end CHARACTERISTIC
/begin CHARACTERISTIC KOPM_TMSCabThermModLo_enum "AC_8_status_BOD" VALUE 0x0000 /* @ECU_Address@KOPM_TMSCabThermModLo_enum@ */ Scalar_UBYTE 0 AppSwcOpm_CM_uint8_enum 0.0 255.0 /end CHARACTERISTIC
/begin CHARACTERISTIC KOPM_TMSCabThermMod_enum_ovrdval "AC_8_status_BOD" VALUE 0x0000 /* @ECU_Address@KOPM_TMSCabThermMod_enum_ovrdval@ */ Scalar_UBYTE 0 AppSwcOpm_CM_uint8_enum 0.0 255.0 /end CHARACTERISTIC
/begin CHARACTERISTIC KOPM_TMSPwrCoolFanSpdDutyHi_pct "AC_8_status_BOD" VALUE 0x0000 /* @ECU_Address@KOPM_TMSPwrCoolFanSpdDutyHi_pct@ */ Scalar_UBYTE 0 AppSwcOpm_CM_uint8_pct 0.0 255.0 /end CHARACTERISTIC
/begin CHARACTERISTIC KOPM_TMSPwrCoolFanSpdDutyLo_pct "AC_8_status_BOD" VALUE 0x0000 /* @ECU_Address@KOPM_TMSPwrCoolFanSpdDutyLo_pct@ */ Scalar_UBYTE 0 AppSwcOpm_CM_uint8_pct 0.0 255.0 /end CHARACTERISTIC
/begin CHARACTERISTIC KOPM_TMSPwrCoolFanSpdDuty_pct_ovrdval "AC_8_status_BOD" VALUE 0x0000 /* @ECU_Address@KOPM_TMSPwrCoolFanSpdDuty_pct_ovrdval@ */ Scalar_UBYTE 0 AppSwcOpm_CM_uint8_pct 0.0 255.0 /end CHARACTERISTIC
/begin MEASUREMENT VOPM_BrkPwrRecupMaxAvlbWhlTq_Nm "VCU_10_Torque_CHA" FLOAT32_IEEE AppSwcOpm_CM_single_Nm 0 0 -100000.0 100000.0 ECU_ADDRESS 0x0000 /* @ECU_Address@VOPM_BrkPwrRecupMaxAvlbWhlTq_Nm@ */ /end MEASUREMENT
/begin MEASUREMENT VOPM_BrkPwrRecupActWhlTq_Nm "VCU_10_Torque_CHA" FLOAT32_IEEE AppSwcOpm_CM_single_Nm 0 0 -100000.0 100000.0 ECU_ADDRESS 0x0000 /* @ECU_Address@VOPM_BrkPwrRecupActWhlTq_Nm@ */ /end MEASUREMENT
/begin MEASUREMENT VOPM_ActlMotorTorq_Nm "VCU_10_Torque_CHA" FLOAT32_IEEE AppSwcOpm_CM_single_Nm 0 0 -100000.0 100000.0 ECU_ADDRESS 0x0000 /* @ECU_Address@VOPM_ActlMotorTorq_Nm@ */ /end MEASUREMENT
/begin MEASUREMENT VOPM_ActlMotorRotateSpd_rpm "VCU_10_Torque_CHA" FLOAT32_IEEE AppSwcOpm_CM_single_rpm 0 0 -100000.0 100000.0 ECU_ADDRESS 0x0000 /* @ECU_Address@VOPM_ActlMotorRotateSpd_rpm@ */ /end MEASUREMENT
/begin MEASUREMENT VOPM_ActWhlTq_Nm "VCU_10_Torque_CHA" FLOAT32_IEEE AppSwcOpm_CM_single_Nm 0 0 -100000.0 100000.0 ECU_ADDRESS 0x0000 /* @ECU_Address@VOPM_ActWhlTq_Nm@ */ /end MEASUREMENT
/begin MEASUREMENT VOPM_TMSMotPMPSpdSet_rpm "TMS_LINTestData1_BOD" FLOAT32_IEEE AppSwcOpm_CM_single_rpm 0 0 -100000.0 100000.0 ECU_ADDRESS 0x0000 /* @ECU_Address@VOPM_TMSMotPMPSpdSet_rpm@ */ /end MEASUREMENT
/begin MEASUREMENT VOPM_TMSMotPMPRealRPM_rpm "TMS_LINTestData1_BOD" FLOAT32_IEEE AppSwcOpm_CM_single_rpm 0 0 -100000.0 100000.0 ECU_ADDRESS 0x0000 /* @ECU_Address@VOPM_TMSMotPMPRealRPM_rpm@ */ /end MEASUREMENT
/begin MEASUREMENT VOPM_TMSBatPMPSpdSet_rpm "TMS_LINTestData1_BOD" FLOAT32_IEEE AppSwcOpm_CM_single_rpm 0 0 -100000.0 100000.0 ECU_ADDRESS 0x0000 /* @ECU_Address@VOPM_TMSBatPMPSpdSet_rpm@ */ /end MEASUREMENT
/begin MEASUREMENT VOPM_TMSBatPMPRealRPM_rpm "TMS_LINTestData1_BOD" FLOAT32_IEEE AppSwcOpm_CM_single_rpm 0 0 -100000.0 100000.0 ECU_ADDRESS 0x0000 /* @ECU_Address@VOPM_TMSBatPMPRealRPM_rpm@ */ /end MEASUREMENT
/begin MEASUREMENT VOPM_TMSAcPMPSpdSet_rpm "TMS_LINTestData1_BOD" FLOAT32_IEEE AppSwcOpm_CM_single_rpm 0 0 -100000.0 100000.0 ECU_ADDRESS 0x0000 /* @ECU_Address@VOPM_TMSAcPMPSpdSet_rpm@ */ /end MEASUREMENT
/begin MEASUREMENT VOPM_TMSAcPMPRealRPM_rpm "TMS_LINTestData1_BOD" FLOAT32_IEEE AppSwcOpm_CM_single_rpm 0 0 -100000.0 100000.0 ECU_ADDRESS 0x0000 /* @ECU_Address@VOPM_TMSAcPMPRealRPM_rpm@ */ /end MEASUREMENT
/begin MEASUREMENT VOPM_HVCHReqTemp_C "HVCH_Command_BOD" FLOAT32_IEEE AppSwcOpm_CM_single_C 0 0 -100000.0 100000.0 ECU_ADDRESS 0x0000 /* @ECU_Address@VOPM_HVCHReqTemp_C@ */ /end MEASUREMENT
/begin MEASUREMENT VOPM_HVCHReqPwr_kW "HVCH_Command_BOD" FLOAT32_IEEE AppSwcOpm_CM_single_kW 0 0 -100000.0 100000.0 ECU_ADDRESS 0x0000 /* @ECU_Address@VOPM_HVCHReqPwr_kW@ */ /end MEASUREMENT
/begin MEASUREMENT VOPM_TMSACPInletPres_kPa "AC_COMP_BOD" FLOAT32_IEEE AppSwcOpm_CM_single_kPa 0 0 -100000.0 100000.0 ECU_ADDRESS 0x0000 /* @ECU_Address@VOPM_TMSACPInletPres_kPa@ */ /end MEASUREMENT
/begin MEASUREMENT VOPM_TMSACPExhtTmp_C "AC_COMP_BOD" FLOAT32_IEEE AppSwcOpm_CM_single_C 0 0 -100000.0 100000.0 ECU_ADDRESS 0x0000 /* @ECU_Address@VOPM_TMSACPExhtTmp_C@ */ /end MEASUREMENT
/begin MEASUREMENT VOPM_COMPEcompSpdCtrl_rpm "AC_COMP_BOD" FLOAT32_IEEE AppSwcOpm_CM_single_rpm 0 0 -100000.0 100000.0 ECU_ADDRESS 0x0000 /* @ECU_Address@VOPM_COMPEcompSpdCtrl_rpm@ */ /end MEASUREMENT
/begin MEASUREMENT VOPM_COMPCompInPwrLim_W "AC_COMP_BOD" FLOAT32_IEEE AppSwcOpm_CM_single_W 0 0 -100000.0 100000.0 ECU_ADDRESS 0x0000 /* @ECU_Address@VOPM_COMPCompInPwrLim_W@ */ /end MEASUREMENT
/begin MEASUREMENT VOPM_TMSMotInletCooltTemp_C "AC_8_status_BOD" FLOAT32_IEEE AppSwcOpm_CM_single_C 0 0 -100000.0 100000.0 ECU_ADDRESS 0x0000 /* @ECU_Address@VOPM_TMSMotInletCooltTemp_C@ */ /end MEASUREMENT
/begin MEASUREMENT VOPM_ACRefrgLoPres_kPa "AC_8_status_BOD" FLOAT32_IEEE AppSwcOpm_CM_single_kPa 0 0 -100000.0 100000.0 ECU_ADDRESS 0x0000 /* @ECU_Address@VOPM_ACRefrgLoPres_kPa@ */ /end MEASUREMENT
/begin MEASUREMENT VOPM_ACEvapTgtTemp_C "AC_8_status_BOD" FLOAT32_IEEE AppSwcOpm_CM_single_C 0 0 -100000.0 100000.0 ECU_ADDRESS 0x0000 /* @ECU_Address@VOPM_ACEvapTgtTemp_C@ */ /end MEASUREMENT
/begin MEASUREMENT VOPM_TMSOHXOutTmp_C "AC_3_State_BOD" FLOAT32_IEEE AppSwcOpm_CM_single_C 0 0 -100000.0 100000.0 ECU_ADDRESS 0x0000 /* @ECU_Address@VOPM_TMSOHXOutTmp_C@ */ /end MEASUREMENT
/begin MEASUREMENT VOPM_TMSEvapTmp_C "AC_3_State_BOD" FLOAT32_IEEE AppSwcOpm_CM_single_C 0 0 -100000.0 100000.0 ECU_ADDRESS 0x0000 /* @ECU_Address@VOPM_TMSEvapTmp_C@ */ /end MEASUREMENT
/begin MEASUREMENT VOPM_TMSEvapOutTmp_C "AC_3_State_BOD" FLOAT32_IEEE AppSwcOpm_CM_single_C 0 0 -100000.0 100000.0 ECU_ADDRESS 0x0000 /* @ECU_Address@VOPM_TMSEvapOutTmp_C@ */ /end MEASUREMENT
/begin MEASUREMENT VOPM_TMSChillerOutTmp_C "AC_3_State_BOD" FLOAT32_IEEE AppSwcOpm_CM_single_C 0 0 -100000.0 100000.0 ECU_ADDRESS 0x0000 /* @ECU_Address@VOPM_TMSChillerOutTmp_C@ */ /end MEASUREMENT
/begin MEASUREMENT VOPM_ACIndoorTemp_C "AC_3_State_BOD" FLOAT32_IEEE AppSwcOpm_CM_single_C 0 0 -100000.0 100000.0 ECU_ADDRESS 0x0000 /* @ECU_Address@VOPM_ACIndoorTemp_C@ */ /end MEASUREMENT
/begin MEASUREMENT VOPM_ACEnvirTemp_C "AC_3_State_BOD" FLOAT32_IEEE AppSwcOpm_CM_single_C 0 0 -100000.0 100000.0 ECU_ADDRESS 0x0000 /* @ECU_Address@VOPM_ACEnvirTemp_C@ */ /end MEASUREMENT
/begin MEASUREMENT VOPM_TMSPTTemp_C "AC_2_State_BOD" FLOAT32_IEEE AppSwcOpm_CM_single_C 0 0 -100000.0 100000.0 ECU_ADDRESS 0x0000 /* @ECU_Address@VOPM_TMSPTTemp_C@ */ /end MEASUREMENT
/begin MEASUREMENT VOPM_TMSPTPres_kPa "AC_2_State_BOD" FLOAT32_IEEE AppSwcOpm_CM_single_kPa 0 0 -100000.0 100000.0 ECU_ADDRESS 0x0000 /* @ECU_Address@VOPM_TMSPTPres_kPa@ */ /end MEASUREMENT
/begin MEASUREMENT VOPM_ACHVHDevInternTemp_C "AC_2_State_BOD" FLOAT32_IEEE AppSwcOpm_CM_single_C 0 0 -100000.0 100000.0 ECU_ADDRESS 0x0000 /* @ECU_Address@VOPM_ACHVHDevInternTemp_C@ */ /end MEASUREMENT
/begin MEASUREMENT VOPM_ACHVHActlPwr_KW "AC_2_State_BOD" FLOAT32_IEEE AppSwcOpm_CM_single_kW 0 0 -100000.0 100000.0 ECU_ADDRESS 0x0000 /* @ECU_Address@VOPM_ACHVHActlPwr_KW@ */ /end MEASUREMENT
/begin MEASUREMENT VOPM_ACActTotPwr_kW "AC_2_State_BOD" FLOAT32_IEEE AppSwcOpm_CM_single_kW 0 0 -100000.0 100000.0 ECU_ADDRESS 0x0000 /* @ECU_Address@VOPM_ACActTotPwr_kW@ */ /end MEASUREMENT
/begin MEASUREMENT VOPM_ACHighVolDCTotalPwr_kW "AC_1_Command_BOD" FLOAT32_IEEE AppSwcOpm_CM_single_kW 0 0 -100000.0 100000.0 ECU_ADDRESS 0x0000 /* @ECU_Address@VOPM_ACHighVolDCTotalPwr_kW@ */ /end MEASUREMENT
/begin MEASUREMENT VOPM_ACCompTgtSpd_rpm "AC_1_Command_BOD" FLOAT32_IEEE AppSwcOpm_CM_single_rpm 0 0 -100000.0 100000.0 ECU_ADDRESS 0x0000 /* @ECU_Address@VOPM_ACCompTgtSpd_rpm@ */ /end MEASUREMENT
/begin MEASUREMENT VOPM_ACCompMaxAllowPwrCmsp_kW "AC_1_Command_BOD" FLOAT32_IEEE AppSwcOpm_CM_single_kW 0 0 -100000.0 100000.0 ECU_ADDRESS 0x0000 /* @ECU_Address@VOPM_ACCompMaxAllowPwrCmsp_kW@ */ /end MEASUREMENT
/begin MEASUREMENT VOPM_TMSHPEXVCurrentPstn_cnt "TMS_LINTestData3_BOD" UWORD AppSwcOpm_CM_uint16_cnt 0 0 0.0 65535.0 ECU_ADDRESS 0x0000 /* @ECU_Address@VOPM_TMSHPEXVCurrentPstn_cnt@ */ /end MEASUREMENT
/begin MEASUREMENT VOPM_TMSC5WVPosRec_enum "TMS_LINTestData3_BOD" UWORD AppSwcOpm_CM_uint16_enum 0 0 0.0 65535.0 ECU_ADDRESS 0x0000 /* @ECU_Address@VOPM_TMSC5WVPosRec_enum@ */ /end MEASUREMENT
/begin MEASUREMENT VOPM_TMSC3WVPosRec_enum "TMS_LINTestData3_BOD" UWORD AppSwcOpm_CM_uint16_enum 0 0 0.0 65535.0 ECU_ADDRESS 0x0000 /* @ECU_Address@VOPM_TMSC3WVPosRec_enum@ */ /end MEASUREMENT
/begin MEASUREMENT VOPM_TMSBEXVPstnCmd_cnt "TMS_LINTestData2_BOD" UWORD AppSwcOpm_CM_uint16_cnt 0 0 0.0 65535.0 ECU_ADDRESS 0x0000 /* @ECU_Address@VOPM_TMSBEXVPstnCmd_cnt@ */ /end MEASUREMENT
/begin MEASUREMENT VOPM_TMSBEXVCurrentPstn_cnt "TMS_LINTestData2_BOD" UWORD AppSwcOpm_CM_uint16_cnt 0 0 0.0 65535.0 ECU_ADDRESS 0x0000 /* @ECU_Address@VOPM_TMSBEXVCurrentPstn_cnt@ */ /end MEASUREMENT
/begin MEASUREMENT VOPM_TMSAEXVPstnReq_cnt "TMS_LINTestData2_BOD" UWORD AppSwcOpm_CM_uint16_cnt 0 0 0.0 65535.0 ECU_ADDRESS 0x0000 /* @ECU_Address@VOPM_TMSAEXVPstnReq_cnt@ */ /end MEASUREMENT
/begin MEASUREMENT VOPM_TMSAEXVCurrentPstn_cnt "TMS_LINTestData2_BOD" UWORD AppSwcOpm_CM_uint16_cnt 0 0 0.0 65535.0 ECU_ADDRESS 0x0000 /* @ECU_Address@VOPM_TMSAEXVCurrentPstn_cnt@ */ /end MEASUREMENT
/begin MEASUREMENT VOPM_TMSHPEXVPstnCmd_cnt "TMS_LINTestData1_BOD" UWORD AppSwcOpm_CM_uint16_cnt 0 0 0.0 65535.0 ECU_ADDRESS 0x0000 /* @ECU_Address@VOPM_TMSHPEXVPstnCmd_cnt@ */ /end MEASUREMENT
/begin MEASUREMENT VOPM_BrkPwrRecupActlWhlTqSts_enum "VCU_10_Torque_CHA" UBYTE AppSwcOpm_CM_uint8_enum 0 0 0.0 255.0 ECU_ADDRESS 0x0000 /* @ECU_Address@VOPM_BrkPwrRecupActlWhlTqSts_enum@ */ /end MEASUREMENT
/begin MEASUREMENT VOPM_BCMLrngsubID_cnt "BCM_IMMOAuthResp1_EPT" UBYTE AppSwcOpm_CM_uint8_cnt 0 0 0.0 255.0 ECU_ADDRESS 0x0000 /* @ECU_Address@VOPM_BCMLrngsubID_cnt@ */ /end MEASUREMENT
/begin MEASUREMENT VOPM_BCMLrngSts_enum "BCM_IMMOAuthResp1_EPT" UBYTE AppSwcOpm_CM_uint8_enum 0 0 0.0 255.0 ECU_ADDRESS 0x0000 /* @ECU_Address@VOPM_BCMLrngSts_enum@ */ /end MEASUREMENT
/begin MEASUREMENT VOPM_BCMLrngData07_nu "BCM_IMMOAuthResp1_EPT" UBYTE AppSwcOpm_CM_uint8_nu 0 0 0.0 255.0 ECU_ADDRESS 0x0000 /* @ECU_Address@VOPM_BCMLrngData07_nu@ */ /end MEASUREMENT
/begin MEASUREMENT VOPM_BCMLrngData06_nu "BCM_IMMOAuthResp1_EPT" UBYTE AppSwcOpm_CM_uint8_nu 0 0 0.0 255.0 ECU_ADDRESS 0x0000 /* @ECU_Address@VOPM_BCMLrngData06_nu@ */ /end MEASUREMENT
/begin MEASUREMENT VOPM_BCMLrngData05_nu "BCM_IMMOAuthResp1_EPT" UBYTE AppSwcOpm_CM_uint8_nu 0 0 0.0 255.0 ECU_ADDRESS 0x0000 /* @ECU_Address@VOPM_BCMLrngData05_nu@ */ /end MEASUREMENT
/begin MEASUREMENT VOPM_BCMLrngData04_nu "BCM_IMMOAuthResp1_EPT" UBYTE AppSwcOpm_CM_uint8_nu 0 0 0.0 255.0 ECU_ADDRESS 0x0000 /* @ECU_Address@VOPM_BCMLrngData04_nu@ */ /end MEASUREMENT
/begin MEASUREMENT VOPM_BCMLrngData03_nu "BCM_IMMOAuthResp1_EPT" UBYTE AppSwcOpm_CM_uint8_nu 0 0 0.0 255.0 ECU_ADDRESS 0x0000 /* @ECU_Address@VOPM_BCMLrngData03_nu@ */ /end MEASUREMENT
/begin MEASUREMENT VOPM_BCMLrngData02_nu "BCM_IMMOAuthResp1_EPT" UBYTE AppSwcOpm_CM_uint8_nu 0 0 0.0 255.0 ECU_ADDRESS 0x0000 /* @ECU_Address@VOPM_BCMLrngData02_nu@ */ /end MEASUREMENT
/begin MEASUREMENT VOPM_TMSC5WVMode_enum "TMS_LINTestData3_BOD" UBYTE AppSwcOpm_CM_uint8_enum 0 0 0.0 255.0 ECU_ADDRESS 0x0000 /* @ECU_Address@VOPM_TMSC5WVMode_enum@ */ /end MEASUREMENT
/begin MEASUREMENT VOPM_TMSC5WVBPosSetReq_enum "TMS_LINTestData3_BOD" UBYTE AppSwcOpm_CM_uint8_enum 0 0 0.0 255.0 ECU_ADDRESS 0x0000 /* @ECU_Address@VOPM_TMSC5WVBPosSetReq_enum@ */ /end MEASUREMENT
/begin MEASUREMENT VOPM_TMSC3WVMode_enum "TMS_LINTestData3_BOD" UBYTE AppSwcOpm_CM_uint8_enum 0 0 0.0 255.0 ECU_ADDRESS 0x0000 /* @ECU_Address@VOPM_TMSC3WVMode_enum@ */ /end MEASUREMENT
/begin MEASUREMENT VOPM_TMSC3WVBPosSetReq_enum "TMS_LINTestData3_BOD" UBYTE AppSwcOpm_CM_uint8_enum 0 0 0.0 255.0 ECU_ADDRESS 0x0000 /* @ECU_Address@VOPM_TMSC3WVBPosSetReq_enum@ */ /end MEASUREMENT
/begin MEASUREMENT VOPM_HVCHEnbld_enum "HVCH_Command_BOD" UBYTE AppSwcOpm_CM_uint8_enum 0 0 0.0 255.0 ECU_ADDRESS 0x0000 /* @ECU_Address@VOPM_HVCHEnbld_enum@ */ /end MEASUREMENT
/begin MEASUREMENT VOPM_COMPEcompHVSt_enum "AC_COMP_BOD" UBYTE AppSwcOpm_CM_uint8_enum 0 0 0.0 255.0 ECU_ADDRESS 0x0000 /* @ECU_Address@VOPM_COMPEcompHVSt_enum@ */ /end MEASUREMENT
/begin MEASUREMENT VOPM_COMPEcompErrClean_enum "AC_COMP_BOD" UBYTE AppSwcOpm_CM_uint8_enum 0 0 0.0 255.0 ECU_ADDRESS 0x0000 /* @ECU_Address@VOPM_COMPEcompErrClean_enum@ */ /end MEASUREMENT
/begin MEASUREMENT VOPM_COMPEcompEnbl_enum "AC_COMP_BOD" UBYTE AppSwcOpm_CM_uint8_enum 0 0 0.0 255.0 ECU_ADDRESS 0x0000 /* @ECU_Address@VOPM_COMPEcompEnbl_enum@ */ /end MEASUREMENT
/begin MEASUREMENT VOPM_ACLeftTempVal_enum "AC_ACStatuts_BOD" UBYTE AppSwcOpm_CM_uint8_enum 0 0 0.0 255.0 ECU_ADDRESS 0x0000 /* @ECU_Address@VOPM_ACLeftTempVal_enum@ */ /end MEASUREMENT
/begin MEASUREMENT VOPM_ACHybEcoModeSta_enum "AC_ACStatuts_BOD" UBYTE AppSwcOpm_CM_uint8_enum 0 0 0.0 255.0 ECU_ADDRESS 0x0000 /* @ECU_Address@VOPM_ACHybEcoModeSta_enum@ */ /end MEASUREMENT
/begin MEASUREMENT VOPM_ACFrntFanSpdVal_enum "AC_ACStatuts_BOD" UBYTE AppSwcOpm_CM_uint8_enum 0 0 0.0 255.0 ECU_ADDRESS 0x0000 /* @ECU_Address@VOPM_ACFrntFanSpdVal_enum@ */ /end MEASUREMENT
/begin MEASUREMENT VOPM_ACBlwrModeSta_enum "AC_ACStatuts_BOD" UBYTE AppSwcOpm_CM_uint8_enum 0 0 0.0 255.0 ECU_ADDRESS 0x0000 /* @ECU_Address@VOPM_ACBlwrModeSta_enum@ */ /end MEASUREMENT
/begin MEASUREMENT VOPM_ACAutoBlwrModeSta_enum "AC_ACStatuts_BOD" UBYTE AppSwcOpm_CM_uint8_enum 0 0 0.0 255.0 ECU_ADDRESS 0x0000 /* @ECU_Address@VOPM_ACAutoBlwrModeSta_enum@ */ /end MEASUREMENT
/begin MEASUREMENT VOPM_ACAirInletModeSta_enum "AC_ACStatuts_BOD" UBYTE AppSwcOpm_CM_uint8_enum 0 0 0.0 255.0 ECU_ADDRESS 0x0000 /* @ECU_Address@VOPM_ACAirInletModeSta_enum@ */ /end MEASUREMENT
/begin MEASUREMENT VOPM_TMSPwrCoolFanSpdDuty_pct "AC_8_status_BOD" UBYTE AppSwcOpm_CM_uint8_pct 0 0 0.0 255.0 ECU_ADDRESS 0x0000 /* @ECU_Address@VOPM_TMSPwrCoolFanSpdDuty_pct@ */ /end MEASUREMENT
/begin MEASUREMENT VOPM_TMSCabThermMod_enum "AC_8_status_BOD" UBYTE AppSwcOpm_CM_uint8_enum 0 0 0.0 255.0 ECU_ADDRESS 0x0000 /* @ECU_Address@VOPM_TMSCabThermMod_enum@ */ /end MEASUREMENT
/begin MEASUREMENT VOPM_TMSBATThermMod_enum "AC_8_status_BOD" UBYTE AppSwcOpm_CM_uint8_enum 0 0 0.0 255.0 ECU_ADDRESS 0x0000 /* @ECU_Address@VOPM_TMSBATThermMod_enum@ */ /end MEASUREMENT
/begin MEASUREMENT VOPM_ACHVPTCOnRq_enum "AC_8_status_BOD" UBYTE AppSwcOpm_CM_uint8_enum 0 0 0.0 255.0 ECU_ADDRESS 0x0000 /* @ECU_Address@VOPM_ACHVPTCOnRq_enum@ */ /end MEASUREMENT
/begin MEASUREMENT VOPM_ACAutoFrntFanSpd_enum "AC_8_status_BOD" UBYTE AppSwcOpm_CM_uint8_enum 0 0 0.0 255.0 ECU_ADDRESS 0x0000 /* @ECU_Address@VOPM_ACAutoFrntFanSpd_enum@ */ /end MEASUREMENT
/begin MEASUREMENT VOPM_ACHVHActlOprtMode_enum "AC_2_State_BOD" UBYTE AppSwcOpm_CM_uint8_enum 0 0 0.0 255.0 ECU_ADDRESS 0x0000 /* @ECU_Address@VOPM_ACHVHActlOprtMode_enum@ */ /end MEASUREMENT
/begin MEASUREMENT VOPM_ACActlOprtMode_enum "AC_2_State_BOD" UBYTE AppSwcOpm_CM_uint8_enum 0 0 0.0 255.0 ECU_ADDRESS 0x0000 /* @ECU_Address@VOPM_ACActlOprtMode_enum@ */ /end MEASUREMENT
/begin MEASUREMENT VOPM_ACPumpActlSpdDuty_pct "AC_1_Command_BOD" UBYTE AppSwcOpm_CM_uint8_pct 0 0 0.0 255.0 ECU_ADDRESS 0x0000 /* @ECU_Address@VOPM_ACPumpActlSpdDuty_pct@ */ /end MEASUREMENT
/begin MEASUREMENT VOPM_BCMHiFreqSigDataByte9_nu "BCM_HFSData_BAC" UBYTE AppSwcOpm_CM_uint8_nu 0 0 0.0 255.0 ECU_ADDRESS 0x0000 /* @ECU_Address@VOPM_BCMHiFreqSigDataByte9_nu@ */ /end MEASUREMENT
/begin MEASUREMENT VOPM_BCMHiFreqSigDataByte8_nu "BCM_HFSData_BAC" UBYTE AppSwcOpm_CM_uint8_nu 0 0 0.0 255.0 ECU_ADDRESS 0x0000 /* @ECU_Address@VOPM_BCMHiFreqSigDataByte8_nu@ */ /end MEASUREMENT
/begin MEASUREMENT VOPM_BCMHiFreqSigDataByte7_nu "BCM_HFSData_BAC" UBYTE AppSwcOpm_CM_uint8_nu 0 0 0.0 255.0 ECU_ADDRESS 0x0000 /* @ECU_Address@VOPM_BCMHiFreqSigDataByte7_nu@ */ /end MEASUREMENT
/begin MEASUREMENT VOPM_BCMHiFreqSigDataByte6_nu "BCM_HFSData_BAC" UBYTE AppSwcOpm_CM_uint8_nu 0 0 0.0 255.0 ECU_ADDRESS 0x0000 /* @ECU_Address@VOPM_BCMHiFreqSigDataByte6_nu@ */ /end MEASUREMENT
/begin MEASUREMENT VOPM_BCMHiFreqSigDataByte5_nu "BCM_HFSData_BAC" UBYTE AppSwcOpm_CM_uint8_nu 0 0 0.0 255.0 ECU_ADDRESS 0x0000 /* @ECU_Address@VOPM_BCMHiFreqSigDataByte5_nu@ */ /end MEASUREMENT
/begin MEASUREMENT VOPM_BCMHiFreqSigDataByte4_nu "BCM_HFSData_BAC" UBYTE AppSwcOpm_CM_uint8_nu 0 0 0.0 255.0 ECU_ADDRESS 0x0000 /* @ECU_Address@VOPM_BCMHiFreqSigDataByte4_nu@ */ /end MEASUREMENT
/begin MEASUREMENT VOPM_BCMHiFreqSigDataByte3_nu "BCM_HFSData_BAC" UBYTE AppSwcOpm_CM_uint8_nu 0 0 0.0 255.0 ECU_ADDRESS 0x0000 /* @ECU_Address@VOPM_BCMHiFreqSigDataByte3_nu@ */ /end MEASUREMENT
/begin MEASUREMENT VOPM_BCMHiFreqSigDataByte2_nu "BCM_HFSData_BAC" UBYTE AppSwcOpm_CM_uint8_nu 0 0 0.0 255.0 ECU_ADDRESS 0x0000 /* @ECU_Address@VOPM_BCMHiFreqSigDataByte2_nu@ */ /end MEASUREMENT
/begin MEASUREMENT VOPM_BCMHiFreqSigDataByte1_nu "BCM_HFSData_BAC" UBYTE AppSwcOpm_CM_uint8_nu 0 0 0.0 255.0 ECU_ADDRESS 0x0000 /* @ECU_Address@VOPM_BCMHiFreqSigDataByte1_nu@ */ /end MEASUREMENT
/begin MEASUREMENT VOPM_BCMHiFreqSigDataByte15_nu "BCM_HFSData_BAC" UBYTE AppSwcOpm_CM_uint8_nu 0 0 0.0 255.0 ECU_ADDRESS 0x0000 /* @ECU_Address@VOPM_BCMHiFreqSigDataByte15_nu@ */ /end MEASUREMENT
/begin MEASUREMENT VOPM_BCMHiFreqSigDataByte14_nu "BCM_HFSData_BAC" UBYTE AppSwcOpm_CM_uint8_nu 0 0 0.0 255.0 ECU_ADDRESS 0x0000 /* @ECU_Address@VOPM_BCMHiFreqSigDataByte14_nu@ */ /end MEASUREMENT
/begin MEASUREMENT VOPM_BCMHiFreqSigDataByte13_nu "BCM_HFSData_BAC" UBYTE AppSwcOpm_CM_uint8_nu 0 0 0.0 255.0 ECU_ADDRESS 0x0000 /* @ECU_Address@VOPM_BCMHiFreqSigDataByte13_nu@ */ /end MEASUREMENT
/begin MEASUREMENT VOPM_BCMHiFreqSigDataByte12_nu "BCM_HFSData_BAC" UBYTE AppSwcOpm_CM_uint8_nu 0 0 0.0 255.0 ECU_ADDRESS 0x0000 /* @ECU_Address@VOPM_BCMHiFreqSigDataByte12_nu@ */ /end MEASUREMENT
/begin MEASUREMENT VOPM_BCMHiFreqSigDataByte11_nu "BCM_HFSData_BAC" UBYTE AppSwcOpm_CM_uint8_nu 0 0 0.0 255.0 ECU_ADDRESS 0x0000 /* @ECU_Address@VOPM_BCMHiFreqSigDataByte11_nu@ */ /end MEASUREMENT
/begin MEASUREMENT VOPM_BCMHiFreqSigDataByte10_nu "BCM_HFSData_BAC" UBYTE AppSwcOpm_CM_uint8_nu 0 0 0.0 255.0 ECU_ADDRESS 0x0000 /* @ECU_Address@VOPM_BCMHiFreqSigDataByte10_nu@ */ /end MEASUREMENT
/begin MEASUREMENT VOPM_BCMHiFreqSigDataByte0_nu "BCM_HFSData_BAC" UBYTE AppSwcOpm_CM_uint8_nu 0 0 0.0 255.0 ECU_ADDRESS 0x0000 /* @ECU_Address@VOPM_BCMHiFreqSigDataByte0_nu@ */ /end MEASUREMENT
/begin MEASUREMENT VOPM_ActlMotorTorqVld_flg "VCU_10_Torque_CHA" UBYTE AppSwcOpm_CM_boolean_flg 0 0 0.0 1.0 ECU_ADDRESS 0x0000 /* @ECU_Address@VOPM_ActlMotorTorqVld_flg@ */ /end MEASUREMENT
/begin MEASUREMENT VOPM_ActlMotorRotateSpdVld_flg "VCU_10_Torque_CHA" UBYTE AppSwcOpm_CM_boolean_flg 0 0 0.0 1.0 ECU_ADDRESS 0x0000 /* @ECU_Address@VOPM_ActlMotorRotateSpdVld_flg@ */ /end MEASUREMENT
/begin MEASUREMENT VOPM_ActWhlTqVld_flg "VCU_10_Torque_CHA" UBYTE AppSwcOpm_CM_boolean_flg 0 0 0.0 1.0 ECU_ADDRESS 0x0000 /* @ECU_Address@VOPM_ActWhlTqVld_flg@ */ /end MEASUREMENT
/begin MEASUREMENT VOPM_TMSHPEXVEnblCmd_flg "TMS_LINTestData3_BOD" UBYTE AppSwcOpm_CM_boolean_flg 0 0 0.0 1.0 ECU_ADDRESS 0x0000 /* @ECU_Address@VOPM_TMSHPEXVEnblCmd_flg@ */ /end MEASUREMENT
/begin MEASUREMENT VOPM_TMSBEXVEnblCmd_flg "TMS_LINTestData3_BOD" UBYTE AppSwcOpm_CM_boolean_flg 0 0 0.0 1.0 ECU_ADDRESS 0x0000 /* @ECU_Address@VOPM_TMSBEXVEnblCmd_flg@ */ /end MEASUREMENT
/begin MEASUREMENT VOPM_TMSAEXVEnblReq_flg "TMS_LINTestData3_BOD" UBYTE AppSwcOpm_CM_boolean_flg 0 0 0.0 1.0 ECU_ADDRESS 0x0000 /* @ECU_Address@VOPM_TMSAEXVEnblReq_flg@ */ /end MEASUREMENT
/begin MEASUREMENT VOPM_BCMRrViewMirrHeatgSts_flg "AC_ACStatuts_BOD" UBYTE AppSwcOpm_CM_boolean_flg 0 0 0.0 1.0 ECU_ADDRESS 0x0000 /* @ECU_Address@VOPM_BCMRrViewMirrHeatgSts_flg@ */ /end MEASUREMENT
/begin MEASUREMENT VOPM_ACPwrFb_flg "AC_ACStatuts_BOD" UBYTE AppSwcOpm_CM_boolean_flg 0 0 0.0 1.0 ECU_ADDRESS 0x0000 /* @ECU_Address@VOPM_ACPwrFb_flg@ */ /end MEASUREMENT
/begin MEASUREMENT VOPM_ACManlDefrstFb_flg "AC_ACStatuts_BOD" UBYTE AppSwcOpm_CM_boolean_flg 0 0 0.0 1.0 ECU_ADDRESS 0x0000 /* @ECU_Address@VOPM_ACManlDefrstFb_flg@ */ /end MEASUREMENT
/begin MEASUREMENT VOPM_ACAutoFb_flg "AC_ACStatuts_BOD" UBYTE AppSwcOpm_CM_boolean_flg 0 0 0.0 1.0 ECU_ADDRESS 0x0000 /* @ECU_Address@VOPM_ACAutoFb_flg@ */ /end MEASUREMENT
/begin MEASUREMENT VOPM_ACRefrgLoPresVld_flg "AC_8_status_BOD" UBYTE AppSwcOpm_CM_boolean_flg 0 0 0.0 1.0 ECU_ADDRESS 0x0000 /* @ECU_Address@VOPM_ACRefrgLoPresVld_flg@ */ /end MEASUREMENT
/begin MEASUREMENT VOPM_ACExtdDefrstActvReq_flg "AC_3_State_BOD" UBYTE AppSwcOpm_CM_boolean_flg 0 0 0.0 1.0 ECU_ADDRESS 0x0000 /* @ECU_Address@VOPM_ACExtdDefrstActvReq_flg@ */ /end MEASUREMENT
/begin MEASUREMENT VOPM_ACEnvirTempVld_flg "AC_3_State_BOD" UBYTE AppSwcOpm_CM_boolean_flg 0 0 0.0 1.0 ECU_ADDRESS 0x0000 /* @ECU_Address@VOPM_ACEnvirTempVld_flg@ */ /end MEASUREMENT
/begin MEASUREMENT VOPM_TMSBattTempCtrlRmnSwFb_flg "AC_2_State_BOD" UBYTE AppSwcOpm_CM_boolean_flg 0 0 0.0 1.0 ECU_ADDRESS 0x0000 /* @ECU_Address@VOPM_TMSBattTempCtrlRmnSwFb_flg@ */ /end MEASUREMENT
/begin MEASUREMENT VOPM_ACHVHFailSta_flg "AC_2_State_BOD" UBYTE AppSwcOpm_CM_boolean_flg 0 0 0.0 1.0 ECU_ADDRESS 0x0000 /* @ECU_Address@VOPM_ACHVHFailSta_flg@ */ /end MEASUREMENT
/begin MEASUREMENT VOPM_ACFailSta_flg "AC_2_State_BOD" UBYTE AppSwcOpm_CM_boolean_flg 0 0 0.0 1.0 ECU_ADDRESS 0x0000 /* @ECU_Address@VOPM_ACFailSta_flg@ */ /end MEASUREMENT
/begin MEASUREMENT VOPM_ACBatPmpFailSta_flg "AC_2_State_BOD" UBYTE AppSwcOpm_CM_boolean_flg 0 0 0.0 1.0 ECU_ADDRESS 0x0000 /* @ECU_Address@VOPM_ACBatPmpFailSta_flg@ */ /end MEASUREMENT
/begin MEASUREMENT VOPM_ACPumpActlSpdDutyVld_flg "AC_1_Command_BOD" UBYTE AppSwcOpm_CM_boolean_flg 0 0 0.0 1.0 ECU_ADDRESS 0x0000 /* @ECU_Address@VOPM_ACPumpActlSpdDutyVld_flg@ */ /end MEASUREMENT
/begin MEASUREMENT VOPM_ACCompOprtReq_flg "AC_1_Command_BOD" UBYTE AppSwcOpm_CM_boolean_flg 0 0 0.0 1.0 ECU_ADDRESS 0x0000 /* @ECU_Address@VOPM_ACCompOprtReq_flg@ */ /end MEASUREMENT
/begin MEASUREMENT VOPM_ACCompOprtEnaCmd_flg "AC_1_Command_BOD" UBYTE AppSwcOpm_CM_boolean_flg 0 0 0.0 1.0 ECU_ADDRESS 0x0000 /* @ECU_Address@VOPM_ACCompOprtEnaCmd_flg@ */ /end MEASUREMENT
/begin MEASUREMENT VOPM_ACCompFailModeOprtSta_flg "AC_1_Command_BOD" UBYTE AppSwcOpm_CM_boolean_flg 0 0 0.0 1.0 ECU_ADDRESS 0x0000 /* @ECU_Address@VOPM_ACCompFailModeOprtSta_flg@ */ /end MEASUREMENT
/begin COMPU_METHOD AppSwcOpm_CM_single_kW "Q = V" RAT_FUNC "%8.6" "kW" COEFFS 0 1 0 0 0 1 /end COMPU_METHOD
/begin COMPU_METHOD AppSwcOpm_CM_single_rpm "Q = V" RAT_FUNC "%8.6" "rpm" COEFFS 0 1 0 0 0 1 /end COMPU_METHOD
/begin COMPU_METHOD AppSwcOpm_CM_single_C "Q = V" RAT_FUNC "%8.6" "C" COEFFS 0 1 0 0 0 1 /end COMPU_METHOD
/begin COMPU_METHOD AppSwcOpm_CM_single_kPa "Q = V" RAT_FUNC "%8.6" "kPa" COEFFS 0 1 0 0 0 1 /end COMPU_METHOD
/begin COMPU_METHOD AppSwcOpm_CM_single_Nm "Q = V" RAT_FUNC "%8.6" "Nm" COEFFS 0 1 0 0 0 1 /end COMPU_METHOD
/begin COMPU_METHOD AppSwcOpm_CM_single_W "Q = V" RAT_FUNC "%8.6" "W" COEFFS 0 1 0 0 0 1 /end COMPU_METHOD
/begin COMPU_METHOD AppSwcOpm_CM_uint16_cnt "Q = V" RAT_FUNC "%5.0" "cnt" COEFFS 0 1 0 0 0 1 /end COMPU_METHOD
/begin COMPU_METHOD AppSwcOpm_CM_uint16_enum "Q = V" RAT_FUNC "%5.0" "enum" COEFFS 0 1 0 0 0 1 /end COMPU_METHOD
/begin COMPU_METHOD AppSwcOpm_CM_boolean_flg "Q = V" RAT_FUNC "%1.0" "flg" COEFFS 0 1 0 0 0 1 /end COMPU_METHOD
/begin COMPU_METHOD AppSwcOpm_CM_uint8_enum "Q = V" RAT_FUNC "%3.0" "enum" COEFFS 0 1 0 0 0 1 /end COMPU_METHOD
/begin COMPU_METHOD AppSwcOpm_CM_uint8_pct "Q = V" RAT_FUNC "%3.0" "pct" COEFFS 0 1 0 0 0 1 /end COMPU_METHOD
/begin COMPU_METHOD AppSwcOpm_CM_uint8_nu "Q = V" RAT_FUNC "%3.0" "nu" COEFFS 0 1 0 0 0 1 /end COMPU_METHOD
/begin COMPU_METHOD AppSwcOpm_CM_uint8_cnt "Q = V" RAT_FUNC "%3.0" "cnt" COEFFS 0 1 0 0 0 1 /end COMPU_METHOD
/begin GROUP AppSwcOpm "AppSwcOpm" /* Root */ ROOT /begin SUB_GROUP Root_Opm100ms Root_Opm10ms Root_Opm20ms Root_Opm50ms /end SUB_GROUP /end GROUP
/begin GROUP Root_Opm100ms "AppSwcOpm/Opm100ms"
 /begin SUB_GROUP S2_BacCAN_OUT_500ms S2_BodCAN_OUT_100ms S2_EptCAN_OUT_100ms /end SUB_GROUP
/end GROUP
/begin GROUP Root_Opm10ms "AppSwcOpm/Opm10ms" /begin SUB_GROUP S3_CHACAN_OUT_10ms S3_EptCAN_OUT_10ms /end SUB_GROUP /end GROUP
/begin GROUP Root_Opm20ms "AppSwcOpm/Opm20ms" /begin SUB_GROUP S4_BacCAN_OUT_20ms S4_CHACAN_OUT_20ms S4_EptCAN_OUT_20ms /end SUB_GROUP /end GROUP
/begin GROUP Root_Opm50ms "AppSwcOpm/Opm50ms" /begin SUB_GROUP S5_BacCAN_OUT_50ms /end SUB_GROUP /end GROUP
/begin GROUP S2_BacCAN_OUT_500ms "AppSwcOpm/Opm100ms/BacCAN_OUT_500ms" /begin SUB_GROUP S7_Msg_BCM_HFSData_BAC /end SUB_GROUP /end GROUP
/begin GROUP S2_BodCAN_OUT_100ms "AppSwcOpm/Opm100ms/BodCAN_OUT_100ms"
 /begin SUB_GROUP S8_Msg_AC_1_Command_BOD S8_Msg_AC_2_State_BOD S8_Msg_AC_3_State_BOD S8_Msg_AC_8_status_BOD S8_Msg_AC_ACStatuts_BOD S8_Msg_AC_COMP_BOD S8_Msg_BCM_ESCLCommand_BOD S8_Msg_HVCH_Command_BOD S8_Msg_TMS_LINTestData1_BOD S8_Msg_TMS_LINTestData2_BOD S8_Msg_TMS_LINTestData3_BOD /end SUB_GROUP
/end GROUP
/begin GROUP S2_EptCAN_OUT_100ms "AppSwcOpm/Opm100ms/EptCAN_OUT_100ms" /begin SUB_GROUP S9_Msg_BCM_IMMOAuthResp1_EPT /end SUB_GROUP /end GROUP
/begin GROUP S3_CHACAN_OUT_10ms "AppSwcOpm/Opm10ms/CHACAN_OUT_10ms" /begin SUB_GROUP S154_Msg_VCU_10_Torque_CHA /end SUB_GROUP /end GROUP
/begin GROUP S3_EptCAN_OUT_10ms "AppSwcOpm/Opm10ms/EptCAN_OUT_10ms" /begin SUB_GROUP S155_Msg_VCU_0_Value_EPT S155_Msg_VCU_1_InvCmd_EPT /end SUB_GROUP /end GROUP
/begin GROUP S4_BacCAN_OUT_20ms "AppSwcOpm/Opm20ms/BacCAN_OUT_20ms" /begin SUB_GROUP S210_Msg_VCU_DispInfo_BAC /end SUB_GROUP /end GROUP
/begin GROUP S4_CHACAN_OUT_20ms "AppSwcOpm/Opm20ms/CHACAN_OUT_20ms" /begin SUB_GROUP S211_Msg_VCU_D_Status_CHA /end SUB_GROUP /end GROUP
/begin GROUP S4_EptCAN_OUT_20ms "AppSwcOpm/Opm20ms/EptCAN_OUT_20ms"
 /begin SUB_GROUP S212_Msg_VCU_3_OprtCmd_EPT S212_Msg_VCU_4_ChrgCmd_EPT S212_Msg_VCU_B_AcclPedal_EPT S212_Msg_VCU_C_OprtCmd_EPT /end SUB_GROUP
/end GROUP
/begin GROUP S5_BacCAN_OUT_50ms "AppSwcOpm/Opm50ms/BacCAN_OUT_50ms" /begin SUB_GROUP S341_Msg_BCML_B_Package S341_Msg_BCM_B_Package_BAC /end SUB_GROUP /end GROUP
/begin GROUP S7_Msg_BCM_HFSData_BAC "AppSwcOpm/Opm100ms/BacCAN_OUT_500ms/Msg_BCM_HFSData_BAC"
 /begin SUB_GROUP S10_Subsys_VOPM_BCMHiFreqSigDataByte0_nu S10_Subsys_VOPM_BCMHiFreqSigDataByte10_nu S10_Subsys_VOPM_BCMHiFreqSigDataByte11_nu S10_Subsys_VOPM_BCMHiFreqSigDataByte12_nu S10_Subsys_VOPM_BCMHiFreqSigDataByte13_nu S10_Subsys_VOPM_BCMHiFreqSigDataByte14_nu S10_Subsys_VOPM_BCMHiFreqSigDataByte15_nu S10_Subsys_VOPM_BCMHiFreqSigDataByte1_nu S10_Subsys_VOPM_BCMHiFreqSigDataByte2_nu S10_Subsys_VOPM_BCMHiFreqSigDataByte3_nu S10_Subsys_VOPM_BCMHiFreqSigDataByte4_nu S10_Subsys_VOPM_BCMHiFreqSigDataByte5_nu S10_Subsys_VOPM_BCMHiFreqSigDataByte6_nu S10_Subsys_VOPM_BCMHiFreqSigDataByte7_nu S10_Subsys_VOPM_BCMHiFreqSigDataByte8_nu S10_Subsys_VOPM_BCMHiFreqSigDataByte9_nu /end SUB_GROUP
/end GROUP
/begin GROUP S8_Msg_AC_1_Command_BOD "AppSwcOpm/Opm100ms/BodCAN_OUT_100ms/Msg_AC_1_Command_BOD"
 /begin SUB_GROUP S27_Subsys_VOPM_ACCompFailModeOprtSta_flg S27_Subsys_VOPM_ACCompMaxAllowPwrCmsp_kW S27_Subsys_VOPM_ACCompOprtEnaCmd_flg S27_Subsys_VOPM_ACCompOprtReq_flg S27_Subsys_VOPM_ACCompTgtSpd_rpm S27_Subsys_VOPM_ACHighVolDCTotalPwr_kW S27_Subsys_VOPM_ACPumpActlSpdDutyVld_flg S27_Subsys_VOPM_ACPumpActlSpdDuty_pct /end SUB_GROUP
/end GROUP
/begin GROUP S8_Msg_AC_2_State_BOD "AppSwcOpm/Opm100ms/BodCAN_OUT_100ms/Msg_AC_2_State_BOD"
 /begin SUB_GROUP S28_Subsys_VOPM_ACActTotPwr_kW S28_Subsys_VOPM_ACActlOprtMode_enum S28_Subsys_VOPM_ACBatPmpFailSta_flg S28_Subsys_VOPM_ACFailSta_flg S28_Subsys_VOPM_ACHVHActlOprtMode_enum S28_Subsys_VOPM_ACHVHActlPwr_KW S28_Subsys_VOPM_ACHVHDevInternTemp_C S28_Subsys_VOPM_ACHVHFailSta_flg S28_Subsys_VOPM_TMSBattTempCtrlRmnSwFb_flg S28_Subsys_VOPM_TMSPTPres_kPa S28_Subsys_VOPM_TMSPTTemp_C /end SUB_GROUP
/end GROUP
/begin GROUP S8_Msg_AC_3_State_BOD "AppSwcOpm/Opm100ms/BodCAN_OUT_100ms/Msg_AC_3_State_BOD"
 /begin SUB_GROUP S29_Subsys_VOPM_ACEnvirTempVld_flg S29_Subsys_VOPM_ACEnvirTemp_C S29_Subsys_VOPM_ACExtdDefrstActvReq_flg S29_Subsys_VOPM_ACIndoorTemp_C S29_Subsys_VOPM_TMSChillerOutTmp_C S29_Subsys_VOPM_TMSEvapOutTmp_C S29_Subsys_VOPM_TMSEvapTmp_C S29_Subsys_VOPM_TMSOHXOutTmp_C /end SUB_GROUP
/end GROUP
/begin GROUP S8_Msg_AC_8_status_BOD "AppSwcOpm/Opm100ms/BodCAN_OUT_100ms/Msg_AC_8_status_BOD"
 /begin SUB_GROUP S30_Subsys_VOPM_ACAutoFrntFanSpd_enum S30_Subsys_VOPM_ACEvapTgtTemp_C S30_Subsys_VOPM_ACHVPTCOnRq_enum S30_Subsys_VOPM_ACRefrgLoPresVld_flg S30_Subsys_VOPM_ACRefrgLoPres_kPa S30_Subsys_VOPM_TMSBATThermMod_enum S30_Subsys_VOPM_TMSCabThermMod_enum S30_Subsys_VOPM_TMSMotInletCooltTemp_C S30_Subsys_VOPM_TMSPwrCoolFanSpdDuty_pct /end SUB_GROUP
/end GROUP
/begin GROUP S8_Msg_AC_ACStatuts_BOD "AppSwcOpm/Opm100ms/BodCAN_OUT_100ms/Msg_AC_ACStatuts_BOD"
 /begin SUB_GROUP S31_Subsys_VOPM_ACAirInletModeSta_enum S31_Subsys_VOPM_ACAutoBlwrModeSta_enum S31_Subsys_VOPM_ACAutoFb_flg S31_Subsys_VOPM_ACBlwrModeSta_enum S31_Subsys_VOPM_ACFrntFanSpdVal_enum S31_Subsys_VOPM_ACHybEcoModeSta_enum S31_Subsys_VOPM_ACLeftTempVal_enum S31_Subsys_VOPM_ACManlDefrstFb_flg S31_Subsys_VOPM_ACPwrFb_flg S31_Subsys_VOPM_BCMRrViewMirrHeatgSts_flg /end SUB_GROUP
/end GROUP
/begin GROUP S8_Msg_AC_COMP_BOD "AppSwcOpm/Opm100ms/BodCAN_OUT_100ms/Msg_AC_COMP_BOD"
 /begin SUB_GROUP S32_Subsys_VOPM_COMPCompInPwrLim_W S32_Subsys_VOPM_COMPEcompEnbl_enum S32_Subsys_VOPM_COMPEcompErrClean_enum S32_Subsys_VOPM_COMPEcompHVSt_enum S32_Subsys_VOPM_COMPEcompSpdCtrl_rpm S32_Subsys_VOPM_TMSACPExhtTmp_C S32_Subsys_VOPM_TMSACPInletPres_kPa /end SUB_GROUP
/end GROUP
/begin GROUP S8_Msg_BCM_ESCLCommand_BOD "AppSwcOpm/Opm100ms/BodCAN_OUT_100ms/Msg_BCM_ESCLCommand_BOD" /begin SUB_GROUP S33_Subsys_VOPM_ESCLUnOrLockCrtl_nu /end SUB_GROUP /end GROUP
/begin GROUP S8_Msg_HVCH_Command_BOD "AppSwcOpm/Opm100ms/BodCAN_OUT_100ms/Msg_HVCH_Command_BOD"
 /begin SUB_GROUP S34_Subsys_VOPM_HVCHEnbld_enum S34_Subsys_VOPM_HVCHReqPwr_kW S34_Subsys_VOPM_HVCHReqTemp_C /end SUB_GROUP
/end GROUP
/begin GROUP S8_Msg_TMS_LINTestData1_BOD "AppSwcOpm/Opm100ms/BodCAN_OUT_100ms/Msg_TMS_LINTestData1_BOD"
 /begin SUB_GROUP S35_Subsys_VOPM_TMSAcPMPRealRPM_rpm S35_Subsys_VOPM_TMSAcPMPSpdSet_rpm S35_Subsys_VOPM_TMSBatPMPRealRPM_rpm S35_Subsys_VOPM_TMSBatPMPSpdSet_rpm S35_Subsys_VOPM_TMSHPEXVPstnCmd_cnt S35_Subsys_VOPM_TMSMotPMPRealRPM_rpm S35_Subsys_VOPM_TMSMotPMPSpdSet_rpm /end SUB_GROUP
/end GROUP
/begin GROUP S8_Msg_TMS_LINTestData2_BOD "AppSwcOpm/Opm100ms/BodCAN_OUT_100ms/Msg_TMS_LINTestData2_BOD"
 /begin SUB_GROUP S36_Subsys_VOPM_TMSAEXVCurrentPstn_cnt S36_Subsys_VOPM_TMSAEXVPstnReq_cnt S36_Subsys_VOPM_TMSBEXVCurrentPstn_cnt S36_Subsys_VOPM_TMSBEXVPstnCmd_cnt /end SUB_GROUP
/end GROUP
/begin GROUP S8_Msg_TMS_LINTestData3_BOD "AppSwcOpm/Opm100ms/BodCAN_OUT_100ms/Msg_TMS_LINTestData3_BOD"
 /begin SUB_GROUP S37_Subsys_VOPM_TMSAEXVEnblReq_flg S37_Subsys_VOPM_TMSBEXVEnblCmd_flg S37_Subsys_VOPM_TMSC3WVBPosSetReq_enum S37_Subsys_VOPM_TMSC3WVMode_enum S37_Subsys_VOPM_TMSC3WVPosRec_enum S37_Subsys_VOPM_TMSC5WVBPosSetReq_enum S37_Subsys_VOPM_TMSC5WVMode_enum S37_Subsys_VOPM_TMSC5WVPosRec_enum S37_Subsys_VOPM_TMSHPEXVCurrentPstn_cnt S37_Subsys_VOPM_TMSHPEXVEnblCmd_flg /end SUB_GROUP
/end GROUP
/begin GROUP S9_Msg_BCM_IMMOAuthResp1_EPT "AppSwcOpm/Opm100ms/EptCAN_OUT_100ms/Msg_BCM_IMMOAuthResp1_EPT"
 /begin SUB_GROUP S145_Subsys_VOPM_BCMLrngData02_nu S145_Subsys_VOPM_BCMLrngData03_nu S145_Subsys_VOPM_BCMLrngData04_nu S145_Subsys_VOPM_BCMLrngData05_nu S145_Subsys_VOPM_BCMLrngData06_nu S145_Subsys_VOPM_BCMLrngData07_nu S145_Subsys_VOPM_BCMLrngSts_enum S145_Subsys_VOPM_BCMLrngsubID_cnt /end SUB_GROUP
/end GROUP
/begin GROUP S154_Msg_VCU_10_Torque_CHA "AppSwcOpm/Opm10ms/CHACAN_OUT_10ms/Msg_VCU_10_Torque_CHA"
 /begin SUB_GROUP S156_Subsys_VOPM_ActWhlTqVld_flg S156_Subsys_VOPM_ActWhlTq_Nm S156_Subsys_VOPM_ActlMotorRotateSpdVld_flg S156_Subsys_VOPM_ActlMotorRotateSpd_rpm S156_Subsys_VOPM_ActlMotorTorqVld_flg S156_Subsys_VOPM_ActlMotorTorq_Nm S156_Subsys_VOPM_BrkPwrRecupActWhlTq_Nm S156_Subsys_VOPM_BrkPwrRecupActlWhlTqSts_enum S156_Subsys_VOPM_BrkPwrRecupMaxAvlbWhlTq_Nm S156_Subsys_VOPM_DrvReqMotorTorqVld_flg S156_Subsys_VOPM_DrvReqMotorTorq_Nm S156_Subsys_VOPM_DrvReqWhlTqVld_flg S156_Subsys_VOPM_DrvReqWhlTq_Nm S156_Subsys_VOPM_DrvWhlTqAllwdMax_Nm S156_Subsys_VOPM_PwrRecupActWhlTq_Nm S156_Subsys_VOPM_PwrRecupActlWhlTqSts_enum S156_Subsys_VOPM_PwrRecupMaxAvlbWhlTqSts_enum S156_Subsys_VOPM_VCUAccReqDrvOff_flg S156_Subsys_VOPM_VCUAccReqStandstill_flg S156_Subsys_VOPM_VCUEnaEHBBrkRun_flg S156_Subsys_VOPM_VCUMasterCylinderPreReq_Bar S156_Subsys_VOPM_VCUMotTorqueReqToEHB_Nm S156_Subsys_VOPM_VCUVehSpdFastWarn_flg /end SUB_GROUP
/end GROUP
/begin GROUP S155_Msg_VCU_0_Value_EPT "AppSwcOpm/Opm10ms/EptCAN_OUT_10ms/Msg_VCU_0_Value_EPT"
 /begin SUB_GROUP S190_Subsys_VOPM_AppSoftNumb_nu S190_Subsys_VOPM_BraSwi_flg S190_Subsys_VOPM_DrvPed_pct S190_Subsys_VOPM_DrvSwi_flg S190_Subsys_VOPM_MotDmpgLmt_Nm S190_Subsys_VOPM_Zdznswi_flg /end SUB_GROUP
/end GROUP
/begin GROUP S155_Msg_VCU_1_InvCmd_EPT "AppSwcOpm/Opm10ms/EptCAN_OUT_10ms/Msg_VCU_1_InvCmd_EPT"
 /begin SUB_GROUP S191_Subsys_VOPM_EmgcySdn_flg S191_Subsys_VOPM_EnaDisChg_flg S191_Subsys_VOPM_EnaInvRun_flg S191_Subsys_VOPM_MotDirReq_enum S191_Subsys_VOPM_MotModeReq_enum S191_Subsys_VOPM_MotSpdReq_rpm S191_Subsys_VOPM_MotTorqReq_Nm S191_Subsys_VOPM_VehTrgtGearPos_enum /end SUB_GROUP
/end GROUP
/begin GROUP S210_Msg_VCU_DispInfo_BAC "AppSwcOpm/Opm20ms/BacCAN_OUT_20ms/Msg_VCU_DispInfo_BAC"
 /begin SUB_GROUP S213_Subsys_VOPM_ACChrgMaxCurr_A S213_Subsys_VOPM_ACChrgMode_enum S213_Subsys_VOPM_ACRemtCtrlFb_enum S213_Subsys_VOPM_ACRmtDefrstCtlFb_enum S213_Subsys_VOPM_ACTempSetFb_enum S213_Subsys_VOPM_ACUnlckVentSetFB_enum S213_Subsys_VOPM_BCMIllmndLckStsFb_flg S213_Subsys_VOPM_BCMIllmndUnlckStsFb_flg S213_Subsys_VOPM_CCKeyStgntn_enum1 S213_Subsys_VOPM_CCUOpenVentnFb_enum S213_Subsys_VOPM_CCURmtCarSearchFb_enum S213_Subsys_VOPM_CCURmtLckFb_enum S213_Subsys_VOPM_CCURmtPwrLckFb_enum S213_Subsys_VOPM_CruiseCtrTgtSpd_kph S213_Subsys_VOPM_CruiseCtrlSta_enum S213_Subsys_VOPM_DrvModeKeyStgntn_enum1 S213_Subsys_VOPM_DrvMotorSta_enum1 S213_Subsys_VOPM_DrvRangeDistEstVld_flg1 S213_Subsys_VOPM_DrvRangeDistEst_km1 S213_Subsys_VOPM_InfoDisp_enum1 S213_Subsys_VOPM_LckVehWrm_enum S213_Subsys_VOPM_MCUHiTempWrning_flg1 S213_Subsys_VOPM_MotActPwrTyp_enum1 S213_Subsys_VOPM_MotActPwr_Kw1 S213_Subsys_VOPM_MotorHiTempWrning_flg1 S213_Subsys_VOPM_OBCOprtCmdToICU_enum1 S213_Subsys_VOPM_RsrvdPwr_kW1 S213_Subsys_VOPM_SIBSBMSBatSOCAllow_flg S213_Subsys_VOPM_SIBSChgNumAllow_flg S213_Subsys_VOPM_SIBSFbRTCWupFlg_flg S213_Subsys_VOPM_SIBSKL30Volt_V S213_Subsys_VOPM_SIBSRTCChrgSt_enum S213_Subsys_VOPM_SIBSRTCWUChgFailNum_cnt S213_Subsys_VOPM_SIBSRTCWUChgNum_cnt S213_Subsys_VOPM_SIBSWupVoltAllow_flg S213_Subsys_VOPM_ShftKeyStgntn_enum1 S213_Subsys_VOPM_VCUOprtLicFb_flg S213_Subsys_VOPM_VCUSpdLimLvlFb_enum S213_Subsys_VOPM_VCUSpdLimLvlSetFb_enum S213_Subsys_VOPM_VCUVerFb_flg S213_Subsys_VOPM_VCUVerSetFb_enum S213_Subsys_VOPM_VehActDrvPwr_pct S213_Subsys_VOPM_VehActRecupPwr_pct S213_Subsys_VOPM_VehPGearError_flg1 S213_Subsys_VOPM_VehPwrCnsmpAvrg_kWh1 S213_Subsys_VOPM_VhclActlCnsmPwr_kWh1 S213_Subsys_VOPM_VhclSpdFstWarn_flg1 S213_Subsys_VOPM_WLTPDrvgRngDstVld_flg1 S213_Subsys_VOPM_WLTPDrvgRngDst_km1 S213_Subsys_VOPM_WghConfdence_flg S213_Subsys_VOPM_WghDistb_enum S213_Subsys_VOPM_WghEst_kg /end SUB_GROUP
/end GROUP
/begin GROUP S211_Msg_VCU_D_Status_CHA "AppSwcOpm/Opm20ms/CHACAN_OUT_20ms/Msg_VCU_D_Status_CHA"
 /begin SUB_GROUP S272_Subsys_VOPM_ACCTrqCtrlAvl_flg1 S272_Subsys_VOPM_AccPedPosSnsrSta_enum1 S272_Subsys_VOPM_AccPedPosToESCSta_enum1 S272_Subsys_VOPM_AccPedPosToESC_pct1 S272_Subsys_VOPM_AcclPedalPos_pct1 S272_Subsys_VOPM_BrkPedSnsrPosVRsrvd_enum1 S272_Subsys_VOPM_BrkPedalPos_pct1 S272_Subsys_VOPM_DrvReqTorqOverrideFCM_flg1 S272_Subsys_VOPM_DrvReqTorqOvrdESC_flg1 S272_Subsys_VOPM_GearShiftInhibited_flg1 S272_Subsys_VOPM_OTAModeSts_flg1 S272_Subsys_VOPM_PGrSwcSt_enum S272_Subsys_VOPM_PwrRecupMaxAvlbMotorTorqSta_enum1 S272_Subsys_VOPM_StrgRecupReqBrkLampOn_flg1 S272_Subsys_VOPM_VCUACCStandstillReq_flg1 S272_Subsys_VOPM_VCUACCStat_enum S272_Subsys_VOPM_VCUAccTgtAxReq_flg1 S272_Subsys_VOPM_VCUAccTgtAx_mps1 S272_Subsys_VOPM_VCUBraTorReq_Nm1 S272_Subsys_VOPM_VCUCruiseCtrTgtSpd_kph1 S272_Subsys_VOPM_VCUCruiseCtrlSta_enum1 S272_Subsys_VOPM_VCUEPBApplyForbid_enum1 S272_Subsys_VOPM_VCUParkSwStaVld_flg1 S272_Subsys_VOPM_VCUParkSwSta_flg1 S272_Subsys_VOPM_VCUPreKeReq_flg1 S272_Subsys_VOPM_VCUReqAutoBrk_enum1 S272_Subsys_VOPM_VCUReqEPBVld_flg1 S272_Subsys_VOPM_VCUReqEPB_enum1 /end SUB_GROUP
/end GROUP
/begin GROUP S212_Msg_VCU_3_OprtCmd_EPT "AppSwcOpm/Opm20ms/EptCAN_OUT_20ms/Msg_VCU_3_OprtCmd_EPT"
 /begin SUB_GROUP S308_Subsys_VOPM_AllowHeatCoolMaxPwrCmsp_kW S308_Subsys_VOPM_BMSWakeupMode_enum S308_Subsys_VOPM_Bat2DrvTrainEnb_flg S308_Subsys_VOPM_ChrgEnaAC_enum S308_Subsys_VOPM_MotorOutputCooltTemp_C /end SUB_GROUP
/end GROUP
/begin GROUP S212_Msg_VCU_4_ChrgCmd_EPT "AppSwcOpm/Opm20ms/EptCAN_OUT_20ms/Msg_VCU_4_ChrgCmd_EPT"
 /begin SUB_GROUP S309_Subsys_VOPM_BMSShutdown_enum S309_Subsys_VOPM_ChrgAllowCmd_enum S309_Subsys_VOPM_ChrgEnaDC_flg S309_Subsys_VOPM_MaxChrgCurntAC_A S309_Subsys_VOPM_MaxChrgCurntDC_A S309_Subsys_VOPM_MaxChrgVoltDC_V S309_Subsys_VOPM_OBCOprtCmd_enum /end SUB_GROUP
/end GROUP
/begin GROUP S212_Msg_VCU_B_AcclPedal_EPT "AppSwcOpm/Opm20ms/EptCAN_OUT_20ms/Msg_VCU_B_AcclPedal_EPT"
 /begin SUB_GROUP S310_Subsys_VOPM_DCCOprtCmd_enum S310_Subsys_VOPM_ErrAmount_cnt S310_Subsys_VOPM_ErrBit_nu S310_Subsys_VOPM_SysFailSta_enum /end SUB_GROUP
/end GROUP
/begin GROUP S212_Msg_VCU_C_OprtCmd_EPT "AppSwcOpm/Opm20ms/EptCAN_OUT_20ms/Msg_VCU_C_OprtCmd_EPT"
 /begin SUB_GROUP S311_Subsys_VOPM_DCCBoostHvVolt_V S311_Subsys_VOPM_DCCBuckLVVolt_V S311_Subsys_VOPM_MaxHVDCCurntAC_A S311_Subsys_VOPM_MaxHVDCVoltAC_V S311_Subsys_VOPM_OBCIntDchrgEna_flg /end SUB_GROUP
/end GROUP
/begin GROUP S341_Msg_BCML_B_Package "AppSwcOpm/Opm50ms/BacCAN_OUT_50ms/Msg_BCML_B_Package"
 /begin SUB_GROUP S342_Subsys_VOPM_12VBatLowVolSta_enum S342_Subsys_VOPM_BCMBackLadjvalFb_enum S342_Subsys_VOPM_BCMBrkPedSta_flg S342_Subsys_VOPM_BCMCenLckSts_enum S342_Subsys_VOPM_BCMDoorLckStaFL_flg S342_Subsys_VOPM_BCMHazardLampSts_flg S342_Subsys_VOPM_BCMPosLampSta_flg S342_Subsys_VOPM_BCMSysPowerSts_enum S342_Subsys_VOPM_BCMSysPwrModeVld_flg S342_Subsys_VOPM_BCMSysPwrMode_enum S342_Subsys_VOPM_HDCStat_enum S342_Subsys_VOPM_LimpHomeSta_flg S342_Subsys_VOPM_PCUFailSta_flg S342_Subsys_VOPM_PTActlOprtMode_enum S342_Subsys_VOPM_PrstlsStaFb_enum S342_Subsys_VOPM_PwrRecupIntnsty_enum S342_Subsys_VOPM_VehActDrvMod1_enum S342_Subsys_VOPM_VehActlGearPosVld_flg S342_Subsys_VOPM_VehActlGearPos_enum /end SUB_GROUP
/end GROUP
/begin GROUP S341_Msg_BCM_B_Package_BAC "AppSwcOpm/Opm50ms/BacCAN_OUT_50ms/Msg_BCM_B_Package_BAC"
 /begin SUB_GROUP S343_Subsys_VOPM_BCMAjarStaHood_flg S343_Subsys_VOPM_BCMAjarStaTrunk_flg S343_Subsys_VOPM_BCMAjarStaVHoodVld_flg S343_Subsys_VOPM_BCMAlrmHornReq_flg S343_Subsys_VOPM_BCMAuthentKeyNr_enum S343_Subsys_VOPM_BCMAutoLampStatus_flg S343_Subsys_VOPM_BCMAvaluebleKeyInCar_flg S343_Subsys_VOPM_BCMBackLiFltFb_enum S343_Subsys_VOPM_BCMBassHornReq_enum S343_Subsys_VOPM_BCMBodyWarnSts_enum S343_Subsys_VOPM_BCMBrakeLampSta_flg S343_Subsys_VOPM_BCMBrkLiFltFb_enum S343_Subsys_VOPM_BCMChgWiprMtMdSwSetFb_enum S343_Subsys_VOPM_BCMChrgLidLockReq_enum S343_Subsys_VOPM_BCMDayRunLiFltFb_enum S343_Subsys_VOPM_BCMDayRunLiSwSig_flg S343_Subsys_VOPM_BCMDayRunLightSta_flg S343_Subsys_VOPM_BCMDoorAjarStaFL_flg S343_Subsys_VOPM_BCMDoorAjarStaFR_flg S343_Subsys_VOPM_BCMDoorAjarStaRL_flg S343_Subsys_VOPM_BCMDoorAjarStaRR_flg S343_Subsys_VOPM_BCMDoorLckOpRec_enum S343_Subsys_VOPM_BCMDrvPEAuthentAcsd_enum S343_Subsys_VOPM_BCMDrvPassWinSwSig_enum S343_Subsys_VOPM_BCMDrvSeatOccptSnsrSts_enum S343_Subsys_VOPM_BCMDrvrWinSwSig_enum S343_Subsys_VOPM_BCMFLWinSts_flg S343_Subsys_VOPM_BCMFLWinmotorSts_enum S343_Subsys_VOPM_BCMFLWinmotor_flg S343_Subsys_VOPM_BCMFRPEAuthentAcsd_enum S343_Subsys_VOPM_BCMFRWinSts_flg S343_Subsys_VOPM_BCMFRWinmotorSts_enum S343_Subsys_VOPM_BCMFRWinmotor_flg S343_Subsys_VOPM_BCMFlwrMeHmCtrlFb_enum S343_Subsys_VOPM_BCMFogLampStaFront_flg S343_Subsys_VOPM_BCMFogLampStaRear_flg S343_Subsys_VOPM_BCMFrbdnKeyNr_enum S343_Subsys_VOPM_BCMFrntFogLiFltFb_enum S343_Subsys_VOPM_BCMFrntFogLiSwSig_flg S343_Subsys_VOPM_BCMFrntLeDoorHndlSwt_enum S343_Subsys_VOPM_BCMFrntRiDoorHndlSwt_enum S343_Subsys_VOPM_BCMFrntWiprMotSts_enum S343_Subsys_VOPM_BCMFrntWshrSwSig_flg S343_Subsys_VOPM_BCMFrontWashSts_flg S343_Subsys_VOPM_BCMHiBeamLiFltFb_enum S343_Subsys_VOPM_BCMHiBeamSwSig_enum S343_Subsys_VOPM_BCMHighBeamSta_flg S343_Subsys_VOPM_BCMHvyRainInd_flg S343_Subsys_VOPM_BCMHzrdWrngLghtSwSig_flg S343_Subsys_VOPM_BCMIllmndEntryStsFb_flg S343_Subsys_VOPM_BCMIllmndLampReq_flg S343_Subsys_VOPM_BCMIllmndLockReq_enum S343_Subsys_VOPM_BCMIllmndSts_enum S343_Subsys_VOPM_BCMIndcnKeyClsr_flg S343_Subsys_VOPM_BCMIndcnShfttoNeut_flg S343_Subsys_VOPM_BCMKeyBattLvlSts_flg S343_Subsys_VOPM_BCMKeyBattLvl_pct S343_Subsys_VOPM_BCMKeyFrbdn_flg S343_Subsys_VOPM_BCMKeyIDFb_enum S343_Subsys_VOPM_BCMKeyInCarSta_flg S343_Subsys_VOPM_BCMKeyLoBattLvlWarn_flg S343_Subsys_VOPM_BCMKeyLocn_mm S343_Subsys_VOPM_BCMKeySta_enum S343_Subsys_VOPM_BCMLFInitSta_flg S343_Subsys_VOPM_BCMLckHornOnStFb_flg S343_Subsys_VOPM_BCMLeTrnLiFltFb_enum S343_Subsys_VOPM_BCMLghtSwSig_enum S343_Subsys_VOPM_BCMLightIntensity_enum S343_Subsys_VOPM_BCMLoBeamLiFltFb_enum S343_Subsys_VOPM_BCMLogoActvFlg_enum S343_Subsys_VOPM_BCMLowBeamSta_flg S343_Subsys_VOPM_BCMMaiDrvrSeatSts_enum S343_Subsys_VOPM_BCMMaiDrvrSeatTemp_C S343_Subsys_VOPM_BCMOvrspdCntrlLckSetFb_flg S343_Subsys_VOPM_BCMPSAuthentRes_enum S343_Subsys_VOPM_BCMPSReq_flg S343_Subsys_VOPM_BCMParkAutoUnlckSetFb_flg S343_Subsys_VOPM_BCMPassWinSwSig_enum S343_Subsys_VOPM_BCMPaswdwInit_flg S343_Subsys_VOPM_BCMPosLiFltFb_enum S343_Subsys_VOPM_BCMRFInitSta_flg S343_Subsys_VOPM_BCMRKEReq_enum S343_Subsys_VOPM_BCMReverseLampSta_flg S343_Subsys_VOPM_BCMRiTrnLiFltFb_enum S343_Subsys_VOPM_BCMRrFogLiFltFb_enum S343_Subsys_VOPM_BCMRrFogLiSwSig_flg S343_Subsys_VOPM_BCMRrMirrHeatSts_flg S343_Subsys_VOPM_BCMRvrsLiFltFb_enum S343_Subsys_VOPM_BCMStartReq_enum S343_Subsys_VOPM_BCMSteerWhlHeatSts_flg S343_Subsys_VOPM_BCMSteerWhlTemp_C S343_Subsys_VOPM_BCMTPMSRstSts_enum S343_Subsys_VOPM_BCMTrnkLckSta_flg S343_Subsys_VOPM_BCMTrnkLckSwCtrlFb_flg S343_Subsys_VOPM_BCMTrnngLiSwSig_enum S343_Subsys_VOPM_BCMTrunkSwtSig_flg S343_Subsys_VOPM_BCMTurnLampStaLeft_flg S343_Subsys_VOPM_BCMTurnLampStaRight_flg S343_Subsys_VOPM_BCMTurnLiSts_enum S343_Subsys_VOPM_BCMVehSeek_flg S343_Subsys_VOPM_BCMWarnKeyOutRmndr_flg S343_Subsys_VOPM_BCMWarnNoKeyFound_flg S343_Subsys_VOPM_BCMWashLiquidLvlWarn_flg S343_Subsys_VOPM_BCMWinLockSig_flg S343_Subsys_VOPM_BCMWinLockSts_flg S343_Subsys_VOPM_BCMWiperCtrlFront_enum S343_Subsys_VOPM_BCMWiperSwSig_enum S343_Subsys_VOPM_BCMWiprIntlGrSwtSig_enum S343_Subsys_VOPM_BCMWiprIntlTimeSetFb_enum S343_Subsys_VOPM_DrvLfAntDiagStat_enum S343_Subsys_VOPM_IntLfAntDiagStat_enum S343_Subsys_VOPM_PassLfAntDiagStat_enum S343_Subsys_VOPM_TMPSAbnmPrsrWarn_flg S343_Subsys_VOPM_TPMSPressureStaFL_enum S343_Subsys_VOPM_TPMSPressureStaFR_enum S343_Subsys_VOPM_TPMSPressureStaRL_enum S343_Subsys_VOPM_TPMSPressureStaRR_enum /end SUB_GROUP
/end GROUP
/begin GROUP S10_Subsys_VOPM_BCMHiFreqSigDataByte0_nu "AppSwcOpm/Opm100ms/BacCAN_OUT_500ms/Msg_BCM_HFSData_BAC/Subsys_VOPM_BCMHiFreqSigDataByte0_nu"
 /begin REF_CHARACTERISTIC KOPM_BCMHiFreqSigDataByte0Hi_nu KOPM_BCMHiFreqSigDataByte0Lo_nu KOPM_BCMHiFreqSigDataByte0_nu_ovrdflg KOPM_BCMHiFreqSigDataByte0_nu_ovrdval /end REF_CHARACTERISTIC
 /begin REF_MEASUREMENT VOPM_BCMHiFreqSigDataByte0_nu /end REF_MEASUREMENT
/end GROUP
/begin GROUP S10_Subsys_VOPM_BCMHiFreqSigDataByte10_nu "AppSwcOpm/Opm100ms/BacCAN_OUT_500ms/Msg_BCM_HFSData_BAC/Subsys_VOPM_BCMHiFreqSigDataByte10_nu"
 /begin REF_CHARACTERISTIC KOPM_BCMHiFreqSigDataByte10Hi_nu KOPM_BCMHiFreqSigDataByte10Lo_nu KOPM_BCMHiFreqSigDataByte10_nu_ovrdflg KOPM_BCMHiFreqSigDataByte10_nu_ovrdval /end REF_CHARACTERISTIC
 /begin REF_MEASUREMENT VOPM_BCMHiFreqSigDataByte10_nu /end REF_MEASUREMENT
/end GROUP
/begin GROUP S10_Subsys_VOPM_BCMHiFreqSigDataByte11_nu "AppSwcOpm/Opm100ms/BacCAN_OUT_500ms/Msg_BCM_HFSData_BAC/Subsys_VOPM_BCMHiFreqSigDataByte11_nu"
 /begin REF_CHARACTERISTIC KOPM_BCMHiFreqSigDataByte11Hi_nu KOPM_BCMHiFreqSigDataByte11Lo_nu KOPM_BCMHiFreqSigDataByte11_nu_ovrdflg KOPM_BCMHiFreqSigDataByte11_nu_ovrdval /end REF_CHARACTERISTIC
 /begin REF_MEASUREMENT VOPM_BCMHiFreqSigDataByte11_nu /end REF_MEASUREMENT
/end GROUP
/begin GROUP S10_Subsys_VOPM_BCMHiFreqSigDataByte12_nu "AppSwcOpm/Opm100ms/BacCAN_OUT_500ms/Msg_BCM_HFSData_BAC/Subsys_VOPM_BCMHiFreqSigDataByte12_nu"
 /begin REF_CHARACTERISTIC KOPM_BCMHiFreqSigDataByte12Hi_nu KOPM_BCMHiFreqSigDataByte12Lo_nu KOPM_BCMHiFreqSigDataByte12_nu_ovrdflg KOPM_BCMHiFreqSigDataByte12_nu_ovrdval /end REF_CHARACTERISTIC
 /begin REF_MEASUREMENT VOPM_BCMHiFreqSigDataByte12_nu /end REF_MEASUREMENT
/end GROUP
/begin GROUP S10_Subsys_VOPM_BCMHiFreqSigDataByte13_nu "AppSwcOpm/Opm100ms/BacCAN_OUT_500ms/Msg_BCM_HFSData_BAC/Subsys_VOPM_BCMHiFreqSigDataByte13_nu"
 /begin REF_CHARACTERISTIC KOPM_BCMHiFreqSigDataByte13Hi_nu KOPM_BCMHiFreqSigDataByte13Lo_nu KOPM_BCMHiFreqSigDataByte13_nu_ovrdflg KOPM_BCMHiFreqSigDataByte13_nu_ovrdval /end REF_CHARACTERISTIC
 /begin REF_MEASUREMENT VOPM_BCMHiFreqSigDataByte13_nu /end REF_MEASUREMENT
/end GROUP
/begin GROUP S10_Subsys_VOPM_BCMHiFreqSigDataByte14_nu "AppSwcOpm/Opm100ms/BacCAN_OUT_500ms/Msg_BCM_HFSData_BAC/Subsys_VOPM_BCMHiFreqSigDataByte14_nu"
 /begin REF_CHARACTERISTIC KOPM_BCMHiFreqSigDataByte14Hi_nu KOPM_BCMHiFreqSigDataByte14Lo_nu KOPM_BCMHiFreqSigDataByte14_nu_ovrdflg KOPM_BCMHiFreqSigDataByte14_nu_ovrdval /end REF_CHARACTERISTIC
 /begin REF_MEASUREMENT VOPM_BCMHiFreqSigDataByte14_nu /end REF_MEASUREMENT
/end GROUP
/begin GROUP S10_Subsys_VOPM_BCMHiFreqSigDataByte15_nu "AppSwcOpm/Opm100ms/BacCAN_OUT_500ms/Msg_BCM_HFSData_BAC/Subsys_VOPM_BCMHiFreqSigDataByte15_nu"
 /begin REF_CHARACTERISTIC KOPM_BCMHiFreqSigDataByte15Hi_nu KOPM_BCMHiFreqSigDataByte15Lo_nu KOPM_BCMHiFreqSigDataByte15_nu_ovrdflg KOPM_BCMHiFreqSigDataByte15_nu_ovrdval /end REF_CHARACTERISTIC
 /begin REF_MEASUREMENT VOPM_BCMHiFreqSigDataByte15_nu /end REF_MEASUREMENT
/end GROUP
/begin GROUP S10_Subsys_VOPM_BCMHiFreqSigDataByte1_nu "AppSwcOpm/Opm100ms/BacCAN_OUT_500ms/Msg_BCM_HFSData_BAC/Subsys_VOPM_BCMHiFreqSigDataByte1_nu"
 /begin REF_CHARACTERISTIC KOPM_BCMHiFreqSigDataByte1Hi_nu KOPM_BCMHiFreqSigDataByte1Lo_nu KOPM_BCMHiFreqSigDataByte1_nu_ovrdflg KOPM_BCMHiFreqSigDataByte1_nu_ovrdval /end REF_CHARACTERISTIC
 /begin REF_MEASUREMENT VOPM_BCMHiFreqSigDataByte1_nu /end REF_MEASUREMENT
/end GROUP
/begin GROUP S10_Subsys_VOPM_BCMHiFreqSigDataByte2_nu "AppSwcOpm/Opm100ms/BacCAN_OUT_500ms/Msg_BCM_HFSData_BAC/Subsys_VOPM_BCMHiFreqSigDataByte2_nu"
 /begin REF_CHARACTERISTIC KOPM_BCMHiFreqSigDataByte2Hi_nu KOPM_BCMHiFreqSigDataByte2Lo_nu KOPM_BCMHiFreqSigDataByte2_nu_ovrdflg KOPM_BCMHiFreqSigDataByte2_nu_ovrdval /end REF_CHARACTERISTIC
 /begin REF_MEASUREMENT VOPM_BCMHiFreqSigDataByte2_nu /end REF_MEASUREMENT
/end GROUP
/begin GROUP S10_Subsys_VOPM_BCMHiFreqSigDataByte3_nu "AppSwcOpm/Opm100ms/BacCAN_OUT_500ms/Msg_BCM_HFSData_BAC/Subsys_VOPM_BCMHiFreqSigDataByte3_nu"
 /begin REF_CHARACTERISTIC KOPM_BCMHiFreqSigDataByte3Hi_nu KOPM_BCMHiFreqSigDataByte3Lo_nu KOPM_BCMHiFreqSigDataByte3_nu_ovrdflg KOPM_BCMHiFreqSigDataByte3_nu_ovrdval /end REF_CHARACTERISTIC
 /begin REF_MEASUREMENT VOPM_BCMHiFreqSigDataByte3_nu /end REF_MEASUREMENT
/end GROUP
/begin GROUP S10_Subsys_VOPM_BCMHiFreqSigDataByte4_nu "AppSwcOpm/Opm100ms/BacCAN_OUT_500ms/Msg_BCM_HFSData_BAC/Subsys_VOPM_BCMHiFreqSigDataByte4_nu"
 /begin REF_CHARACTERISTIC KOPM_BCMHiFreqSigDataByte4Hi_nu KOPM_BCMHiFreqSigDataByte4Lo_nu KOPM_BCMHiFreqSigDataByte4_nu_ovrdflg KOPM_BCMHiFreqSigDataByte4_nu_ovrdval /end REF_CHARACTERISTIC
 /begin REF_MEASUREMENT VOPM_BCMHiFreqSigDataByte4_nu /end REF_MEASUREMENT
/end GROUP
/begin GROUP S10_Subsys_VOPM_BCMHiFreqSigDataByte5_nu "AppSwcOpm/Opm100ms/BacCAN_OUT_500ms/Msg_BCM_HFSData_BAC/Subsys_VOPM_BCMHiFreqSigDataByte5_nu"
 /begin REF_CHARACTERISTIC KOPM_BCMHiFreqSigDataByte5Hi_nu KOPM_BCMHiFreqSigDataByte5Lo_nu KOPM_BCMHiFreqSigDataByte5_nu_ovrdflg KOPM_BCMHiFreqSigDataByte5_nu_ovrdval /end REF_CHARACTERISTIC
 /begin REF_MEASUREMENT VOPM_BCMHiFreqSigDataByte5_nu /end REF_MEASUREMENT
/end GROUP
/begin GROUP S10_Subsys_VOPM_BCMHiFreqSigDataByte6_nu "AppSwcOpm/Opm100ms/BacCAN_OUT_500ms/Msg_BCM_HFSData_BAC/Subsys_VOPM_BCMHiFreqSigDataByte6_nu"
 /begin REF_CHARACTERISTIC KOPM_BCMHiFreqSigDataByte6Hi_nu KOPM_BCMHiFreqSigDataByte6Lo_nu KOPM_BCMHiFreqSigDataByte6_nu_ovrdflg KOPM_BCMHiFreqSigDataByte6_nu_ovrdval /end REF_CHARACTERISTIC
 /begin REF_MEASUREMENT VOPM_BCMHiFreqSigDataByte6_nu /end REF_MEASUREMENT
/end GROUP
/begin GROUP S10_Subsys_VOPM_BCMHiFreqSigDataByte7_nu "AppSwcOpm/Opm100ms/BacCAN_OUT_500ms/Msg_BCM_HFSData_BAC/Subsys_VOPM_BCMHiFreqSigDataByte7_nu"
 /begin REF_CHARACTERISTIC KOPM_BCMHiFreqSigDataByte7Hi_nu KOPM_BCMHiFreqSigDataByte7Lo_nu KOPM_BCMHiFreqSigDataByte7_nu_ovrdflg KOPM_BCMHiFreqSigDataByte7_nu_ovrdval /end REF_CHARACTERISTIC
 /begin REF_MEASUREMENT VOPM_BCMHiFreqSigDataByte7_nu /end REF_MEASUREMENT
/end GROUP
/begin GROUP S10_Subsys_VOPM_BCMHiFreqSigDataByte8_nu "AppSwcOpm/Opm100ms/BacCAN_OUT_500ms/Msg_BCM_HFSData_BAC/Subsys_VOPM_BCMHiFreqSigDataByte8_nu"
 /begin REF_CHARACTERISTIC KOPM_BCMHiFreqSigDataByte8Hi_nu KOPM_BCMHiFreqSigDataByte8Lo_nu KOPM_BCMHiFreqSigDataByte8_nu_ovrdflg KOPM_BCMHiFreqSigDataByte8_nu_ovrdval /end REF_CHARACTERISTIC
 /begin REF_MEASUREMENT VOPM_BCMHiFreqSigDataByte8_nu /end REF_MEASUREMENT
/end GROUP
/begin GROUP S10_Subsys_VOPM_BCMHiFreqSigDataByte9_nu "AppSwcOpm/Opm100ms/BacCAN_OUT_500ms/Msg_BCM_HFSData_BAC/Subsys_VOPM_BCMHiFreqSigDataByte9_nu"
 /begin REF_CHARACTERISTIC KOPM_BCMHiFreqSigDataByte9Hi_nu KOPM_BCMHiFreqSigDataByte9Lo_nu KOPM_BCMHiFreqSigDataByte9_nu_ovrdflg KOPM_BCMHiFreqSigDataByte9_nu_ovrdval /end REF_CHARACTERISTIC
 /begin REF_MEASUREMENT VOPM_BCMHiFreqSigDataByte9_nu /end REF_MEASUREMENT
/end GROUP
/begin GROUP S27_Subsys_VOPM_ACCompFailModeOprtSta_flg "AppSwcOpm/Opm100ms/BodCAN_OUT_100ms/Msg_AC_1_Command_BOD/Subsys_VOPM_ACCompFailModeOprtSta_flg"
 /begin REF_CHARACTERISTIC KOPM_ACCompFailModeOprtSta_flg_ovrdflg KOPM_ACCompFailModeOprtSta_flg_ovrdval /end REF_CHARACTERISTIC
 /begin REF_MEASUREMENT VOPM_ACCompFailModeOprtSta_flg /end REF_MEASUREMENT
/end GROUP
/begin GROUP S27_Subsys_VOPM_ACCompMaxAllowPwrCmsp_kW "AppSwcOpm/Opm100ms/BodCAN_OUT_100ms/Msg_AC_1_Command_BOD/Subsys_VOPM_ACCompMaxAllowPwrCmsp_kW"
 /begin REF_CHARACTERISTIC KOPM_ACCompMaxAllowPwrCmspHi_kW KOPM_ACCompMaxAllowPwrCmspLo_kW KOPM_ACCompMaxAllowPwrCmsp_kW_ovrdflg KOPM_ACCompMaxAllowPwrCmsp_kW_ovrdval /end REF_CHARACTERISTIC
 /begin REF_MEASUREMENT VOPM_ACCompMaxAllowPwrCmsp_kW /end REF_MEASUREMENT
/end GROUP
/begin GROUP S27_Subsys_VOPM_ACCompOprtEnaCmd_flg "AppSwcOpm/Opm100ms/BodCAN_OUT_100ms/Msg_AC_1_Command_BOD/Subsys_VOPM_ACCompOprtEnaCmd_flg"
 /begin REF_CHARACTERISTIC KOPM_ACCompOprtEnaCmd_flg_ovrdflg KOPM_ACCompOprtEnaCmd_flg_ovrdval /end REF_CHARACTERISTIC
 /begin REF_MEASUREMENT VOPM_ACCompOprtEnaCmd_flg /end REF_MEASUREMENT
/end GROUP
/begin GROUP S27_Subsys_VOPM_ACCompOprtReq_flg "AppSwcOpm/Opm100ms/BodCAN_OUT_100ms/Msg_AC_1_Command_BOD/Subsys_VOPM_ACCompOprtReq_flg"
 /begin REF_CHARACTERISTIC KOPM_ACCompOprtReq_flg_ovrdflg KOPM_ACCompOprtReq_flg_ovrdval /end REF_CHARACTERISTIC
 /begin REF_MEASUREMENT VOPM_ACCompOprtReq_flg /end REF_MEASUREMENT
/end GROUP
/begin GROUP S27_Subsys_VOPM_ACCompTgtSpd_rpm "AppSwcOpm/Opm100ms/BodCAN_OUT_100ms/Msg_AC_1_Command_BOD/Subsys_VOPM_ACCompTgtSpd_rpm"
 /begin REF_CHARACTERISTIC KOPM_ACCompTgtSpdHi_rpm KOPM_ACCompTgtSpdLo_rpm KOPM_ACCompTgtSpd_rpm_ovrdflg KOPM_ACCompTgtSpd_rpm_ovrdval /end REF_CHARACTERISTIC
 /begin REF_MEASUREMENT VOPM_ACCompTgtSpd_rpm /end REF_MEASUREMENT
/end GROUP
/begin GROUP S27_Subsys_VOPM_ACHighVolDCTotalPwr_kW "AppSwcOpm/Opm100ms/BodCAN_OUT_100ms/Msg_AC_1_Command_BOD/Subsys_VOPM_ACHighVolDCTotalPwr_kW"
 /begin REF_CHARACTERISTIC KOPM_ACHighVolDCTotalPwrHi_kW KOPM_ACHighVolDCTotalPwrLo_kW KOPM_ACHighVolDCTotalPwr_kW_ovrdflg KOPM_ACHighVolDCTotalPwr_kW_ovrdval /end REF_CHARACTERISTIC
 /begin REF_MEASUREMENT VOPM_ACHighVolDCTotalPwr_kW /end REF_MEASUREMENT
/end GROUP
/begin GROUP S27_Subsys_VOPM_ACPumpActlSpdDutyVld_flg "AppSwcOpm/Opm100ms/BodCAN_OUT_100ms/Msg_AC_1_Command_BOD/Subsys_VOPM_ACPumpActlSpdDutyVld_flg"
 /begin REF_CHARACTERISTIC KOPM_ACPumpActlSpdDutyVld_flg_ovrdflg KOPM_ACPumpActlSpdDutyVld_flg_ovrdval /end REF_CHARACTERISTIC
 /begin REF_MEASUREMENT VOPM_ACPumpActlSpdDutyVld_flg /end REF_MEASUREMENT
/end GROUP
/begin GROUP S27_Subsys_VOPM_ACPumpActlSpdDuty_pct "AppSwcOpm/Opm100ms/BodCAN_OUT_100ms/Msg_AC_1_Command_BOD/Subsys_VOPM_ACPumpActlSpdDuty_pct"
 /begin REF_CHARACTERISTIC KOPM_ACPumpActlSpdDutyHi_pct KOPM_ACPumpActlSpdDutyLo_pct KOPM_ACPumpActlSpdDuty_pct_ovrdflg KOPM_ACPumpActlSpdDuty_pct_ovrdval /end REF_CHARACTERISTIC
 /begin REF_MEASUREMENT VOPM_ACPumpActlSpdDuty_pct /end REF_MEASUREMENT
/end GROUP
/begin GROUP S28_Subsys_VOPM_ACActTotPwr_kW "AppSwcOpm/Opm100ms/BodCAN_OUT_100ms/Msg_AC_2_State_BOD/Subsys_VOPM_ACActTotPwr_kW"
 /begin REF_CHARACTERISTIC KOPM_ACActTotPwrHi_kW KOPM_ACActTotPwrLo_kW KOPM_ACActTotPwr_kW_ovrdflg KOPM_ACActTotPwr_kW_ovrdval /end REF_CHARACTERISTIC
 /begin REF_MEASUREMENT VOPM_ACActTotPwr_kW /end REF_MEASUREMENT
/end GROUP
/begin GROUP S28_Subsys_VOPM_ACActlOprtMode_enum "AppSwcOpm/Opm100ms/BodCAN_OUT_100ms/Msg_AC_2_State_BOD/Subsys_VOPM_ACActlOprtMode_enum"
 /begin REF_CHARACTERISTIC KOPM_ACActlOprtModeHi_enum KOPM_ACActlOprtModeLo_enum KOPM_ACActlOprtMode_enum_ovrdflg KOPM_ACActlOprtMode_enum_ovrdval /end REF_CHARACTERISTIC
 /begin REF_MEASUREMENT VOPM_ACActlOprtMode_enum /end REF_MEASUREMENT
/end GROUP
/begin GROUP S28_Subsys_VOPM_ACBatPmpFailSta_flg "AppSwcOpm/Opm100ms/BodCAN_OUT_100ms/Msg_AC_2_State_BOD/Subsys_VOPM_ACBatPmpFailSta_flg"
 /begin REF_CHARACTERISTIC KOPM_ACBatPmpFailSta_flg_ovrdflg KOPM_ACBatPmpFailSta_flg_ovrdval /end REF_CHARACTERISTIC
 /begin REF_MEASUREMENT VOPM_ACBatPmpFailSta_flg /end REF_MEASUREMENT
/end GROUP
/begin GROUP S28_Subsys_VOPM_ACFailSta_flg "AppSwcOpm/Opm100ms/BodCAN_OUT_100ms/Msg_AC_2_State_BOD/Subsys_VOPM_ACFailSta_flg" /begin REF_CHARACTERISTIC KOPM_ACFailSta_flg_ovrdflg KOPM_ACFailSta_flg_ovrdval /end REF_CHARACTERISTIC /begin REF_MEASUREMENT VOPM_ACFailSta_flg /end REF_MEASUREMENT /end GROUP
/begin GROUP S28_Subsys_VOPM_ACHVHActlOprtMode_enum "AppSwcOpm/Opm100ms/BodCAN_OUT_100ms/Msg_AC_2_State_BOD/Subsys_VOPM_ACHVHActlOprtMode_enum"
 /begin REF_CHARACTERISTIC KOPM_ACHVHActlOprtModeHi_enum KOPM_ACHVHActlOprtModeLo_enum KOPM_ACHVHActlOprtMode_enum_ovrdflg KOPM_ACHVHActlOprtMode_enum_ovrdval /end REF_CHARACTERISTIC
 /begin REF_MEASUREMENT VOPM_ACHVHActlOprtMode_enum /end REF_MEASUREMENT
/end GROUP
/begin GROUP S28_Subsys_VOPM_ACHVHActlPwr_KW "AppSwcOpm/Opm100ms/BodCAN_OUT_100ms/Msg_AC_2_State_BOD/Subsys_VOPM_ACHVHActlPwr_KW"
 /begin REF_CHARACTERISTIC KOPM_ACHVHActlPwrHi_KW KOPM_ACHVHActlPwrLo_KW KOPM_ACHVHActlPwr_KW_ovrdflg KOPM_ACHVHActlPwr_KW_ovrdval /end REF_CHARACTERISTIC
 /begin REF_MEASUREMENT VOPM_ACHVHActlPwr_KW /end REF_MEASUREMENT
/end GROUP
/begin GROUP S28_Subsys_VOPM_ACHVHDevInternTemp_C "AppSwcOpm/Opm100ms/BodCAN_OUT_100ms/Msg_AC_2_State_BOD/Subsys_VOPM_ACHVHDevInternTemp_C"
 /begin REF_CHARACTERISTIC KOPM_ACHVHDevInternTempHi_C KOPM_ACHVHDevInternTempLo_C KOPM_ACHVHDevInternTemp_C_ovrdflg KOPM_ACHVHDevInternTemp_C_ovrdval /end REF_CHARACTERISTIC
 /begin REF_MEASUREMENT VOPM_ACHVHDevInternTemp_C /end REF_MEASUREMENT
/end GROUP
/begin GROUP S28_Subsys_VOPM_ACHVHFailSta_flg "AppSwcOpm/Opm100ms/BodCAN_OUT_100ms/Msg_AC_2_State_BOD/Subsys_VOPM_ACHVHFailSta_flg"
 /begin REF_CHARACTERISTIC KOPM_ACHVHFailSta_flg_ovrdflg KOPM_ACHVHFailSta_flg_ovrdval /end REF_CHARACTERISTIC
 /begin REF_MEASUREMENT VOPM_ACHVHFailSta_flg /end REF_MEASUREMENT
/end GROUP
/begin GROUP S28_Subsys_VOPM_TMSBattTempCtrlRmnSwFb_flg "AppSwcOpm/Opm100ms/BodCAN_OUT_100ms/Msg_AC_2_State_BOD/Subsys_VOPM_TMSBattTempCtrlRmnSwFb_flg"
 /begin REF_CHARACTERISTIC KOPM_TMSBattTempCtrlRmnSwFb_flg_ovrdflg KOPM_TMSBattTempCtrlRmnSwFb_flg_ovrdval /end REF_CHARACTERISTIC
 /begin REF_MEASUREMENT VOPM_TMSBattTempCtrlRmnSwFb_flg /end REF_MEASUREMENT
/end GROUP
/begin GROUP S28_Subsys_VOPM_TMSPTPres_kPa "AppSwcOpm/Opm100ms/BodCAN_OUT_100ms/Msg_AC_2_State_BOD/Subsys_VOPM_TMSPTPres_kPa"
 /begin REF_CHARACTERISTIC KOPM_TMSPTPresHi_kPa KOPM_TMSPTPresLo_kPa KOPM_TMSPTPres_kPa_ovrdflg KOPM_TMSPTPres_kPa_ovrdval /end REF_CHARACTERISTIC
 /begin REF_MEASUREMENT VOPM_TMSPTPres_kPa /end REF_MEASUREMENT
/end GROUP
/begin GROUP S28_Subsys_VOPM_TMSPTTemp_C "AppSwcOpm/Opm100ms/BodCAN_OUT_100ms/Msg_AC_2_State_BOD/Subsys_VOPM_TMSPTTemp_C"
 /begin REF_CHARACTERISTIC KOPM_TMSPTTempHi_C KOPM_TMSPTTempLo_C KOPM_TMSPTTemp_C_ovrdflg KOPM_TMSPTTemp_C_ovrdval /end REF_CHARACTERISTIC
 /begin REF_MEASUREMENT VOPM_TMSPTTemp_C /end REF_MEASUREMENT
/end GROUP
/begin GROUP S29_Subsys_VOPM_ACEnvirTempVld_flg "AppSwcOpm/Opm100ms/BodCAN_OUT_100ms/Msg_AC_3_State_BOD/Subsys_VOPM_ACEnvirTempVld_flg"
 /begin REF_CHARACTERISTIC KOPM_ACEnvirTempVld_flg_ovrdflg KOPM_ACEnvirTempVld_flg_ovrdval /end REF_CHARACTERISTIC
 /begin REF_MEASUREMENT VOPM_ACEnvirTempVld_flg /end REF_MEASUREMENT
/end GROUP
/begin GROUP S29_Subsys_VOPM_ACEnvirTemp_C "AppSwcOpm/Opm100ms/BodCAN_OUT_100ms/Msg_AC_3_State_BOD/Subsys_VOPM_ACEnvirTemp_C"
 /begin REF_CHARACTERISTIC KOPM_ACEnvirTempHi_C KOPM_ACEnvirTempLo_C KOPM_ACEnvirTemp_C_ovrdflg KOPM_ACEnvirTemp_C_ovrdval /end REF_CHARACTERISTIC
 /begin REF_MEASUREMENT VOPM_ACEnvirTemp_C /end REF_MEASUREMENT
/end GROUP
/begin GROUP S29_Subsys_VOPM_ACExtdDefrstActvReq_flg "AppSwcOpm/Opm100ms/BodCAN_OUT_100ms/Msg_AC_3_State_BOD/Subsys_VOPM_ACExtdDefrstActvReq_flg"
 /begin REF_CHARACTERISTIC KOPM_ACExtdDefrstActvReq_flg_ovrdflg KOPM_ACExtdDefrstActvReq_flg_ovrdval /end REF_CHARACTERISTIC
 /begin REF_MEASUREMENT VOPM_ACExtdDefrstActvReq_flg /end REF_MEASUREMENT
/end GROUP
/begin GROUP S29_Subsys_VOPM_ACIndoorTemp_C "AppSwcOpm/Opm100ms/BodCAN_OUT_100ms/Msg_AC_3_State_BOD/Subsys_VOPM_ACIndoorTemp_C"
 /begin REF_CHARACTERISTIC KOPM_ACIndoorTempHi_C KOPM_ACIndoorTempLo_C KOPM_ACIndoorTemp_C_ovrdflg KOPM_ACIndoorTemp_C_ovrdval /end REF_CHARACTERISTIC
 /begin REF_MEASUREMENT VOPM_ACIndoorTemp_C /end REF_MEASUREMENT
/end GROUP
/begin GROUP S29_Subsys_VOPM_TMSChillerOutTmp_C "AppSwcOpm/Opm100ms/BodCAN_OUT_100ms/Msg_AC_3_State_BOD/Subsys_VOPM_TMSChillerOutTmp_C"
 /begin REF_CHARACTERISTIC KOPM_TMSChillerOutTmpHi_C KOPM_TMSChillerOutTmpLo_C KOPM_TMSChillerOutTmp_C_ovrdflg KOPM_TMSChillerOutTmp_C_ovrdval /end REF_CHARACTERISTIC
 /begin REF_MEASUREMENT VOPM_TMSChillerOutTmp_C /end REF_MEASUREMENT
/end GROUP
/begin GROUP S29_Subsys_VOPM_TMSEvapOutTmp_C "AppSwcOpm/Opm100ms/BodCAN_OUT_100ms/Msg_AC_3_State_BOD/Subsys_VOPM_TMSEvapOutTmp_C"
 /begin REF_CHARACTERISTIC KOPM_TMSEvapOutTmpHi_C KOPM_TMSEvapOutTmpLo_C KOPM_TMSEvapOutTmp_C_ovrdflg KOPM_TMSEvapOutTmp_C_ovrdval /end REF_CHARACTERISTIC
 /begin REF_MEASUREMENT VOPM_TMSEvapOutTmp_C /end REF_MEASUREMENT
/end GROUP
/begin GROUP S29_Subsys_VOPM_TMSEvapTmp_C "AppSwcOpm/Opm100ms/BodCAN_OUT_100ms/Msg_AC_3_State_BOD/Subsys_VOPM_TMSEvapTmp_C"
 /begin REF_CHARACTERISTIC KOPM_TMSEvapTmpHi_C KOPM_TMSEvapTmpLo_C KOPM_TMSEvapTmp_C_ovrdflg KOPM_TMSEvapTmp_C_ovrdval /end REF_CHARACTERISTIC
 /begin REF_MEASUREMENT VOPM_TMSEvapTmp_C /end REF_MEASUREMENT
/end GROUP
/begin GROUP S29_Subsys_VOPM_TMSOHXOutTmp_C "AppSwcOpm/Opm100ms/BodCAN_OUT_100ms/Msg_AC_3_State_BOD/Subsys_VOPM_TMSOHXOutTmp_C"
 /begin REF_CHARACTERISTIC KOPM_TMSOHXOutTmpHi_C KOPM_TMSOHXOutTmpLo_C KOPM_TMSOHXOutTmp_C_ovrdflg KOPM_TMSOHXOutTmp_C_ovrdval /end REF_CHARACTERISTIC
 /begin REF_MEASUREMENT VOPM_TMSOHXOutTmp_C /end REF_MEASUREMENT
/end GROUP
/begin GROUP S30_Subsys_VOPM_ACAutoFrntFanSpd_enum "AppSwcOpm/Opm100ms/BodCAN_OUT_100ms/Msg_AC_8_status_BOD/Subsys_VOPM_ACAutoFrntFanSpd_enum"
 /begin REF_CHARACTERISTIC KOPM_ACAutoFrntFanSpdHi_enum KOPM_ACAutoFrntFanSpdLo_enum KOPM_ACAutoFrntFanSpd_enum_ovrdflg KOPM_ACAutoFrntFanSpd_enum_ovrdval /end REF_CHARACTERISTIC
 /begin REF_MEASUREMENT VOPM_ACAutoFrntFanSpd_enum /end REF_MEASUREMENT
/end GROUP
/begin GROUP S30_Subsys_VOPM_ACEvapTgtTemp_C "AppSwcOpm/Opm100ms/BodCAN_OUT_100ms/Msg_AC_8_status_BOD/Subsys_VOPM_ACEvapTgtTemp_C"
 /begin REF_CHARACTERISTIC KOPM_ACEvapTgtTempHi_C KOPM_ACEvapTgtTempLo_C KOPM_ACEvapTgtTemp_C_ovrdflg KOPM_ACEvapTgtTemp_C_ovrdval /end REF_CHARACTERISTIC
 /begin REF_MEASUREMENT VOPM_ACEvapTgtTemp_C /end REF_MEASUREMENT
/end GROUP
/begin GROUP S30_Subsys_VOPM_ACHVPTCOnRq_enum "AppSwcOpm/Opm100ms/BodCAN_OUT_100ms/Msg_AC_8_status_BOD/Subsys_VOPM_ACHVPTCOnRq_enum"
 /begin REF_CHARACTERISTIC KOPM_ACHVPTCOnRqHi_enum KOPM_ACHVPTCOnRqLo_enum KOPM_ACHVPTCOnRq_enum_ovrdflg KOPM_ACHVPTCOnRq_enum_ovrdval /end REF_CHARACTERISTIC
 /begin REF_MEASUREMENT VOPM_ACHVPTCOnRq_enum /end REF_MEASUREMENT
/end GROUP
/begin GROUP S30_Subsys_VOPM_ACRefrgLoPresVld_flg "AppSwcOpm/Opm100ms/BodCAN_OUT_100ms/Msg_AC_8_status_BOD/Subsys_VOPM_ACRefrgLoPresVld_flg"
 /begin REF_CHARACTERISTIC KOPM_ACRefrgLoPresVld_flg_ovrdflg KOPM_ACRefrgLoPresVld_flg_ovrdval /end REF_CHARACTERISTIC
 /begin REF_MEASUREMENT VOPM_ACRefrgLoPresVld_flg /end REF_MEASUREMENT
/end GROUP
/begin GROUP S30_Subsys_VOPM_ACRefrgLoPres_kPa "AppSwcOpm/Opm100ms/BodCAN_OUT_100ms/Msg_AC_8_status_BOD/Subsys_VOPM_ACRefrgLoPres_kPa"
 /begin REF_CHARACTERISTIC KOPM_ACRefrgLoPresHi_kPa KOPM_ACRefrgLoPresLo_kPa KOPM_ACRefrgLoPres_kPa_ovrdflg KOPM_ACRefrgLoPres_kPa_ovrdval /end REF_CHARACTERISTIC
 /begin REF_MEASUREMENT VOPM_ACRefrgLoPres_kPa /end REF_MEASUREMENT
/end GROUP
/begin GROUP S30_Subsys_VOPM_TMSBATThermMod_enum "AppSwcOpm/Opm100ms/BodCAN_OUT_100ms/Msg_AC_8_status_BOD/Subsys_VOPM_TMSBATThermMod_enum"
 /begin REF_CHARACTERISTIC KOPM_TMSBATThermModHi_enum KOPM_TMSBATThermModLo_enum KOPM_TMSBATThermMod_enum_ovrdflg KOPM_TMSBATThermMod_enum_ovrdval /end REF_CHARACTERISTIC
 /begin REF_MEASUREMENT VOPM_TMSBATThermMod_enum /end REF_MEASUREMENT
/end GROUP
/begin GROUP S30_Subsys_VOPM_TMSCabThermMod_enum "AppSwcOpm/Opm100ms/BodCAN_OUT_100ms/Msg_AC_8_status_BOD/Subsys_VOPM_TMSCabThermMod_enum"
 /begin REF_CHARACTERISTIC KOPM_TMSCabThermModHi_enum KOPM_TMSCabThermModLo_enum KOPM_TMSCabThermMod_enum_ovrdflg KOPM_TMSCabThermMod_enum_ovrdval /end REF_CHARACTERISTIC
 /begin REF_MEASUREMENT VOPM_TMSCabThermMod_enum /end REF_MEASUREMENT
/end GROUP
/begin GROUP S30_Subsys_VOPM_TMSMotInletCooltTemp_C "AppSwcOpm/Opm100ms/BodCAN_OUT_100ms/Msg_AC_8_status_BOD/Subsys_VOPM_TMSMotInletCooltTemp_C"
 /begin REF_CHARACTERISTIC KOPM_TMSMotInletCooltTempHi_C KOPM_TMSMotInletCooltTempLo_C KOPM_TMSMotInletCooltTemp_C_ovrdflg KOPM_TMSMotInletCooltTemp_C_ovrdval /end REF_CHARACTERISTIC
 /begin REF_MEASUREMENT VOPM_TMSMotInletCooltTemp_C /end REF_MEASUREMENT
/end GROUP
/begin GROUP S30_Subsys_VOPM_TMSPwrCoolFanSpdDuty_pct "AppSwcOpm/Opm100ms/BodCAN_OUT_100ms/Msg_AC_8_status_BOD/Subsys_VOPM_TMSPwrCoolFanSpdDuty_pct"
 /begin REF_CHARACTERISTIC KOPM_TMSPwrCoolFanSpdDutyHi_pct KOPM_TMSPwrCoolFanSpdDutyLo_pct KOPM_TMSPwrCoolFanSpdDuty_pct_ovrdflg KOPM_TMSPwrCoolFanSpdDuty_pct_ovrdval /end REF_CHARACTERISTIC
 /begin REF_MEASUREMENT VOPM_TMSPwrCoolFanSpdDuty_pct /end REF_MEASUREMENT
/end GROUP
/begin GROUP S31_Subsys_VOPM_ACAirInletModeSta_enum "AppSwcOpm/Opm100ms/BodCAN_OUT_100ms/Msg_AC_ACStatuts_BOD/Subsys_VOPM_ACAirInletModeSta_enum"
 /begin REF_CHARACTERISTIC KOPM_ACAirInletModeStaHi_enum KOPM_ACAirInletModeStaLo_enum KOPM_ACAirInletModeSta_enum_ovrdflg KOPM_ACAirInletModeSta_enum_ovrdval /end REF_CHARACTERISTIC
 /begin REF_MEASUREMENT VOPM_ACAirInletModeSta_enum /end REF_MEASUREMENT
/end GROUP
/begin GROUP S31_Subsys_VOPM_ACAutoBlwrModeSta_enum "AppSwcOpm/Opm100ms/BodCAN_OUT_100ms/Msg_AC_ACStatuts_BOD/Subsys_VOPM_ACAutoBlwrModeSta_enum"
 /begin REF_CHARACTERISTIC KOPM_ACAutoBlwrModeStaHi_enum KOPM_ACAutoBlwrModeStaLo_enum KOPM_ACAutoBlwrModeSta_enum_ovrdflg KOPM_ACAutoBlwrModeSta_enum_ovrdval /end REF_CHARACTERISTIC
 /begin REF_MEASUREMENT VOPM_ACAutoBlwrModeSta_enum /end REF_MEASUREMENT
/end GROUP
/begin GROUP S31_Subsys_VOPM_ACAutoFb_flg "AppSwcOpm/Opm100ms/BodCAN_OUT_100ms/Msg_AC_ACStatuts_BOD/Subsys_VOPM_ACAutoFb_flg" /begin REF_CHARACTERISTIC KOPM_ACAutoFb_flg_ovrdflg KOPM_ACAutoFb_flg_ovrdval /end REF_CHARACTERISTIC /begin REF_MEASUREMENT VOPM_ACAutoFb_flg /end REF_MEASUREMENT /end GROUP
/begin GROUP S31_Subsys_VOPM_ACBlwrModeSta_enum "AppSwcOpm/Opm100ms/BodCAN_OUT_100ms/Msg_AC_ACStatuts_BOD/Subsys_VOPM_ACBlwrModeSta_enum"
 /begin REF_CHARACTERISTIC KOPM_ACBlwrModeStaHi_enum KOPM_ACBlwrModeStaLo_enum KOPM_ACBlwrModeSta_enum_ovrdflg KOPM_ACBlwrModeSta_enum_ovrdval /end REF_CHARACTERISTIC
 /begin REF_MEASUREMENT VOPM_ACBlwrModeSta_enum /end REF_MEASUREMENT
/end GROUP
/begin GROUP S31_Subsys_VOPM_ACFrntFanSpdVal_enum "AppSwcOpm/Opm100ms/BodCAN_OUT_100ms/Msg_AC_ACStatuts_BOD/Subsys_VOPM_ACFrntFanSpdVal_enum"
 /begin REF_CHARACTERISTIC KOPM_ACFrntFanSpdValHi_enum KOPM_ACFrntFanSpdValLo_enum KOPM_ACFrntFanSpdVal_enum_ovrdflg KOPM_ACFrntFanSpdVal_enum_ovrdval /end REF_CHARACTERISTIC
 /begin REF_MEASUREMENT VOPM_ACFrntFanSpdVal_enum /end REF_MEASUREMENT
/end GROUP
/begin GROUP S31_Subsys_VOPM_ACHybEcoModeSta_enum "AppSwcOpm/Opm100ms/BodCAN_OUT_100ms/Msg_AC_ACStatuts_BOD/Subsys_VOPM_ACHybEcoModeSta_enum"
 /begin REF_CHARACTERISTIC KOPM_ACHybEcoModeStaHi_enum KOPM_ACHybEcoModeStaLo_enum KOPM_ACHybEcoModeSta_enum_ovrdflg KOPM_ACHybEcoModeSta_enum_ovrdval /end REF_CHARACTERISTIC
 /begin REF_MEASUREMENT VOPM_ACHybEcoModeSta_enum /end REF_MEASUREMENT
/end GROUP
/begin GROUP S31_Subsys_VOPM_ACLeftTempVal_enum "AppSwcOpm/Opm100ms/BodCAN_OUT_100ms/Msg_AC_ACStatuts_BOD/Subsys_VOPM_ACLeftTempVal_enum"
 /begin REF_CHARACTERISTIC KOPM_ACLeftTempValHi_enum KOPM_ACLeftTempValLo_enum KOPM_ACLeftTempVal_enum_ovrdflg KOPM_ACLeftTempVal_enum_ovrdval /end REF_CHARACTERISTIC
 /begin REF_MEASUREMENT VOPM_ACLeftTempVal_enum /end REF_MEASUREMENT
/end GROUP
/begin GROUP S31_Subsys_VOPM_ACManlDefrstFb_flg "AppSwcOpm/Opm100ms/BodCAN_OUT_100ms/Msg_AC_ACStatuts_BOD/Subsys_VOPM_ACManlDefrstFb_flg"
 /begin REF_CHARACTERISTIC KOPM_ACManlDefrstFb_flg_ovrdflg KOPM_ACManlDefrstFb_flg_ovrdval /end REF_CHARACTERISTIC
 /begin REF_MEASUREMENT VOPM_ACManlDefrstFb_flg /end REF_MEASUREMENT
/end GROUP
/begin GROUP S31_Subsys_VOPM_ACPwrFb_flg "AppSwcOpm/Opm100ms/BodCAN_OUT_100ms/Msg_AC_ACStatuts_BOD/Subsys_VOPM_ACPwrFb_flg" /begin REF_CHARACTERISTIC KOPM_ACPwrFb_flg_ovrdflg KOPM_ACPwrFb_flg_ovrdval /end REF_CHARACTERISTIC /begin REF_MEASUREMENT VOPM_ACPwrFb_flg /end REF_MEASUREMENT /end GROUP
/begin GROUP S31_Subsys_VOPM_BCMRrViewMirrHeatgSts_flg "AppSwcOpm/Opm100ms/BodCAN_OUT_100ms/Msg_AC_ACStatuts_BOD/Subsys_VOPM_BCMRrViewMirrHeatgSts_flg"
 /begin REF_CHARACTERISTIC KOPM_BCMRrViewMirrHeatgSts_flg_ovrdflg KOPM_BCMRrViewMirrHeatgSts_flg_ovrdval /end REF_CHARACTERISTIC
 /begin REF_MEASUREMENT VOPM_BCMRrViewMirrHeatgSts_flg /end REF_MEASUREMENT
/end GROUP
/begin GROUP S32_Subsys_VOPM_COMPCompInPwrLim_W "AppSwcOpm/Opm100ms/BodCAN_OUT_100ms/Msg_AC_COMP_BOD/Subsys_VOPM_COMPCompInPwrLim_W"
 /begin REF_CHARACTERISTIC KOPM_COMPCompInPwrLimHi_W KOPM_COMPCompInPwrLimLo_W KOPM_COMPCompInPwrLim_W_ovrdflg KOPM_COMPCompInPwrLim_W_ovrdval /end REF_CHARACTERISTIC
 /begin REF_MEASUREMENT VOPM_COMPCompInPwrLim_W /end REF_MEASUREMENT
/end GROUP
/begin GROUP S32_Subsys_VOPM_COMPEcompEnbl_enum "AppSwcOpm/Opm100ms/BodCAN_OUT_100ms/Msg_AC_COMP_BOD/Subsys_VOPM_COMPEcompEnbl_enum"
 /begin REF_CHARACTERISTIC KOPM_COMPEcompEnblHi_enum KOPM_COMPEcompEnblLo_enum KOPM_COMPEcompEnbl_enum_ovrdflg KOPM_COMPEcompEnbl_enum_ovrdval /end REF_CHARACTERISTIC
 /begin REF_MEASUREMENT VOPM_COMPEcompEnbl_enum /end REF_MEASUREMENT
/end GROUP
/begin GROUP S32_Subsys_VOPM_COMPEcompErrClean_enum "AppSwcOpm/Opm100ms/BodCAN_OUT_100ms/Msg_AC_COMP_BOD/Subsys_VOPM_COMPEcompErrClean_enum"
 /begin REF_CHARACTERISTIC KOPM_COMPEcompErrCleanHi_enum KOPM_COMPEcompErrCleanLo_enum KOPM_COMPEcompErrClean_enum_ovrdflg KOPM_COMPEcompErrClean_enum_ovrdval /end REF_CHARACTERISTIC
 /begin REF_MEASUREMENT VOPM_COMPEcompErrClean_enum /end REF_MEASUREMENT
/end GROUP
/begin GROUP S32_Subsys_VOPM_COMPEcompHVSt_enum "AppSwcOpm/Opm100ms/BodCAN_OUT_100ms/Msg_AC_COMP_BOD/Subsys_VOPM_COMPEcompHVSt_enum"
 /begin REF_CHARACTERISTIC KOPM_COMPEcompHVStHi_enum KOPM_COMPEcompHVStLo_enum KOPM_COMPEcompHVSt_enum_ovrdflg KOPM_COMPEcompHVSt_enum_ovrdval /end REF_CHARACTERISTIC
 /begin REF_MEASUREMENT VOPM_COMPEcompHVSt_enum /end REF_MEASUREMENT
/end GROUP
/begin GROUP S32_Subsys_VOPM_COMPEcompSpdCtrl_rpm "AppSwcOpm/Opm100ms/BodCAN_OUT_100ms/Msg_AC_COMP_BOD/Subsys_VOPM_COMPEcompSpdCtrl_rpm"
 /begin REF_CHARACTERISTIC KOPM_COMPEcompSpdCtrlHi_rpm KOPM_COMPEcompSpdCtrlLo_rpm KOPM_COMPEcompSpdCtrl_rpm_ovrdflg KOPM_COMPEcompSpdCtrl_rpm_ovrdval /end REF_CHARACTERISTIC
 /begin REF_MEASUREMENT VOPM_COMPEcompSpdCtrl_rpm /end REF_MEASUREMENT
/end GROUP
/begin GROUP S32_Subsys_VOPM_TMSACPExhtTmp_C "AppSwcOpm/Opm100ms/BodCAN_OUT_100ms/Msg_AC_COMP_BOD/Subsys_VOPM_TMSACPExhtTmp_C"
 /begin REF_CHARACTERISTIC KOPM_TMSACPExhtTmpHi_C KOPM_TMSACPExhtTmpLo_C KOPM_TMSACPExhtTmp_C_ovrdflg KOPM_TMSACPExhtTmp_C_ovrdval /end REF_CHARACTERISTIC
 /begin REF_MEASUREMENT VOPM_TMSACPExhtTmp_C /end REF_MEASUREMENT
/end GROUP
/begin GROUP S32_Subsys_VOPM_TMSACPInletPres_kPa "AppSwcOpm/Opm100ms/BodCAN_OUT_100ms/Msg_AC_COMP_BOD/Subsys_VOPM_TMSACPInletPres_kPa"
 /begin REF_CHARACTERISTIC KOPM_TMSACPInletPresHi_kPa KOPM_TMSACPInletPresLo_kPa KOPM_TMSACPInletPres_kPa_ovrdflg KOPM_TMSACPInletPres_kPa_ovrdval /end REF_CHARACTERISTIC
 /begin REF_MEASUREMENT VOPM_TMSACPInletPres_kPa /end REF_MEASUREMENT
/end GROUP
/begin GROUP S33_Subsys_VOPM_ESCLUnOrLockCrtl_nu "AppSwcOpm/Opm100ms/BodCAN_OUT_100ms/Msg_BCM_ESCLCommand_BOD/Subsys_VOPM_ESCLUnOrLockCrtl_nu" /begin REF_CHARACTERISTIC KOPM_ESCLUnOrLockCrtl_nu_ovrdflg /end REF_CHARACTERISTIC /end GROUP
/begin GROUP S34_Subsys_VOPM_HVCHEnbld_enum "AppSwcOpm/Opm100ms/BodCAN_OUT_100ms/Msg_HVCH_Command_BOD/Subsys_VOPM_HVCHEnbld_enum"
 /begin REF_CHARACTERISTIC KOPM_HVCHEnbldHi_enum KOPM_HVCHEnbldLo_enum KOPM_HVCHEnbld_enum_ovrdflg KOPM_HVCHEnbld_enum_ovrdval /end REF_CHARACTERISTIC
 /begin REF_MEASUREMENT VOPM_HVCHEnbld_enum /end REF_MEASUREMENT
/end GROUP
/begin GROUP S34_Subsys_VOPM_HVCHReqPwr_kW "AppSwcOpm/Opm100ms/BodCAN_OUT_100ms/Msg_HVCH_Command_BOD/Subsys_VOPM_HVCHReqPwr_kW"
 /begin REF_CHARACTERISTIC KOPM_HVCHReqPwrHi_kW KOPM_HVCHReqPwrLo_kW KOPM_HVCHReqPwr_kW_ovrdflg KOPM_HVCHReqPwr_kW_ovrdval /end REF_CHARACTERISTIC
 /begin REF_MEASUREMENT VOPM_HVCHReqPwr_kW /end REF_MEASUREMENT
/end GROUP
/begin GROUP S34_Subsys_VOPM_HVCHReqTemp_C "AppSwcOpm/Opm100ms/BodCAN_OUT_100ms/Msg_HVCH_Command_BOD/Subsys_VOPM_HVCHReqTemp_C"
 /begin REF_CHARACTERISTIC KOPM_HVCHReqTempHi_C KOPM_HVCHReqTempLo_C KOPM_HVCHReqTemp_C_ovrdflg KOPM_HVCHReqTemp_C_ovrdval /end REF_CHARACTERISTIC
 /begin REF_MEASUREMENT VOPM_HVCHReqTemp_C /end REF_MEASUREMENT
/end GROUP
/begin GROUP S35_Subsys_VOPM_TMSAcPMPRealRPM_rpm "AppSwcOpm/Opm100ms/BodCAN_OUT_100ms/Msg_TMS_LINTestData1_BOD/Subsys_VOPM_TMSAcPMPRealRPM_rpm"
 /begin REF_CHARACTERISTIC KOPM_TMSAcPMPRealRPMHi_rpm KOPM_TMSAcPMPRealRPMLo_rpm KOPM_TMSAcPMPRealRPM_rpm_ovrdflg KOPM_TMSAcPMPRealRPM_rpm_ovrdval /end REF_CHARACTERISTIC
 /begin REF_MEASUREMENT VOPM_TMSAcPMPRealRPM_rpm /end REF_MEASUREMENT
/end GROUP
/begin GROUP S35_Subsys_VOPM_TMSAcPMPSpdSet_rpm "AppSwcOpm/Opm100ms/BodCAN_OUT_100ms/Msg_TMS_LINTestData1_BOD/Subsys_VOPM_TMSAcPMPSpdSet_rpm"
 /begin REF_CHARACTERISTIC KOPM_TMSAcPMPSpdSetHi_rpm KOPM_TMSAcPMPSpdSetLo_rpm KOPM_TMSAcPMPSpdSet_rpm_ovrdflg KOPM_TMSAcPMPSpdSet_rpm_ovrdval /end REF_CHARACTERISTIC
 /begin REF_MEASUREMENT VOPM_TMSAcPMPSpdSet_rpm /end REF_MEASUREMENT
/end GROUP
/begin GROUP S35_Subsys_VOPM_TMSBatPMPRealRPM_rpm "AppSwcOpm/Opm100ms/BodCAN_OUT_100ms/Msg_TMS_LINTestData1_BOD/Subsys_VOPM_TMSBatPMPRealRPM_rpm"
 /begin REF_CHARACTERISTIC KOPM_TMSBatPMPRealRPMHi_rpm KOPM_TMSBatPMPRealRPMLo_rpm KOPM_TMSBatPMPRealRPM_rpm_ovrdflg KOPM_TMSBatPMPRealRPM_rpm_ovrdval /end REF_CHARACTERISTIC
 /begin REF_MEASUREMENT VOPM_TMSBatPMPRealRPM_rpm /end REF_MEASUREMENT
/end GROUP
/begin GROUP S35_Subsys_VOPM_TMSBatPMPSpdSet_rpm "AppSwcOpm/Opm100ms/BodCAN_OUT_100ms/Msg_TMS_LINTestData1_BOD/Subsys_VOPM_TMSBatPMPSpdSet_rpm"
 /begin REF_CHARACTERISTIC KOPM_TMSBatPMPSpdSetHi_rpm KOPM_TMSBatPMPSpdSetLo_rpm KOPM_TMSBatPMPSpdSet_rpm_ovrdflg KOPM_TMSBatPMPSpdSet_rpm_ovrdval /end REF_CHARACTERISTIC
 /begin REF_MEASUREMENT VOPM_TMSBatPMPSpdSet_rpm /end REF_MEASUREMENT
/end GROUP
/begin GROUP S35_Subsys_VOPM_TMSHPEXVPstnCmd_cnt "AppSwcOpm/Opm100ms/BodCAN_OUT_100ms/Msg_TMS_LINTestData1_BOD/Subsys_VOPM_TMSHPEXVPstnCmd_cnt"
 /begin REF_CHARACTERISTIC KOPM_TMSHPEXVPstnCmdHi_cnt KOPM_TMSHPEXVPstnCmdLo_cnt KOPM_TMSHPEXVPstnCmd_cnt_ovrdflg KOPM_TMSHPEXVPstnCmd_cnt_ovrdval /end REF_CHARACTERISTIC
 /begin REF_MEASUREMENT VOPM_TMSHPEXVPstnCmd_cnt /end REF_MEASUREMENT
/end GROUP
/begin GROUP S35_Subsys_VOPM_TMSMotPMPRealRPM_rpm "AppSwcOpm/Opm100ms/BodCAN_OUT_100ms/Msg_TMS_LINTestData1_BOD/Subsys_VOPM_TMSMotPMPRealRPM_rpm"
 /begin REF_CHARACTERISTIC KOPM_TMSMotPMPRealRPMHi_rpm KOPM_TMSMotPMPRealRPMLo_rpm KOPM_TMSMotPMPRealRPM_rpm_ovrdflg KOPM_TMSMotPMPRealRPM_rpm_ovrdval /end REF_CHARACTERISTIC
 /begin REF_MEASUREMENT VOPM_TMSMotPMPRealRPM_rpm /end REF_MEASUREMENT
/end GROUP
/begin GROUP S35_Subsys_VOPM_TMSMotPMPSpdSet_rpm "AppSwcOpm/Opm100ms/BodCAN_OUT_100ms/Msg_TMS_LINTestData1_BOD/Subsys_VOPM_TMSMotPMPSpdSet_rpm"
 /begin REF_CHARACTERISTIC KOPM_TMSMotPMPSpdSetHi_rpm KOPM_TMSMotPMPSpdSetLo_rpm KOPM_TMSMotPMPSpdSet_rpm_ovrdflg KOPM_TMSMotPMPSpdSet_rpm_ovrdval /end REF_CHARACTERISTIC
 /begin REF_MEASUREMENT VOPM_TMSMotPMPSpdSet_rpm /end REF_MEASUREMENT
/end GROUP
/begin GROUP S36_Subsys_VOPM_TMSAEXVCurrentPstn_cnt "AppSwcOpm/Opm100ms/BodCAN_OUT_100ms/Msg_TMS_LINTestData2_BOD/Subsys_VOPM_TMSAEXVCurrentPstn_cnt"
 /begin REF_CHARACTERISTIC KOPM_TMSAEXVCurrentPstnHi_cnt KOPM_TMSAEXVCurrentPstnLo_cnt KOPM_TMSAEXVCurrentPstn_cnt_ovrdflg KOPM_TMSAEXVCurrentPstn_cnt_ovrdval /end REF_CHARACTERISTIC
 /begin REF_MEASUREMENT VOPM_TMSAEXVCurrentPstn_cnt /end REF_MEASUREMENT
/end GROUP
/begin GROUP S36_Subsys_VOPM_TMSAEXVPstnReq_cnt "AppSwcOpm/Opm100ms/BodCAN_OUT_100ms/Msg_TMS_LINTestData2_BOD/Subsys_VOPM_TMSAEXVPstnReq_cnt"
 /begin REF_CHARACTERISTIC KOPM_TMSAEXVPstnReqHi_cnt KOPM_TMSAEXVPstnReqLo_cnt KOPM_TMSAEXVPstnReq_cnt_ovrdflg KOPM_TMSAEXVPstnReq_cnt_ovrdval /end REF_CHARACTERISTIC
 /begin REF_MEASUREMENT VOPM_TMSAEXVPstnReq_cnt /end REF_MEASUREMENT
/end GROUP
/begin GROUP S36_Subsys_VOPM_TMSBEXVCurrentPstn_cnt "AppSwcOpm/Opm100ms/BodCAN_OUT_100ms/Msg_TMS_LINTestData2_BOD/Subsys_VOPM_TMSBEXVCurrentPstn_cnt"
 /begin REF_CHARACTERISTIC KOPM_TMSBEXVCurrentPstnHi_cnt KOPM_TMSBEXVCurrentPstnLo_cnt KOPM_TMSBEXVCurrentPstn_cnt_ovrdflg KOPM_TMSBEXVCurrentPstn_cnt_ovrdval /end REF_CHARACTERISTIC
 /begin REF_MEASUREMENT VOPM_TMSBEXVCurrentPstn_cnt /end REF_MEASUREMENT
/end GROUP
/begin GROUP S36_Subsys_VOPM_TMSBEXVPstnCmd_cnt "AppSwcOpm/Opm100ms/BodCAN_OUT_100ms/Msg_TMS_LINTestData2_BOD/Subsys_VOPM_TMSBEXVPstnCmd_cnt"
 /begin REF_CHARACTERISTIC KOPM_TMSBEXVPstnCmdHi_cnt KOPM_TMSBEXVPstnCmdLo_cnt KOPM_TMSBEXVPstnCmd_cnt_ovrdflg KOPM_TMSBEXVPstnCmd_cnt_ovrdval /end REF_CHARACTERISTIC
 /begin REF_MEASUREMENT VOPM_TMSBEXVPstnCmd_cnt /end REF_MEASUREMENT
/end GROUP
/begin GROUP S37_Subsys_VOPM_TMSAEXVEnblReq_flg "AppSwcOpm/Opm100ms/BodCAN_OUT_100ms/Msg_TMS_LINTestData3_BOD/Subsys_VOPM_TMSAEXVEnblReq_flg"
 /begin REF_CHARACTERISTIC KOPM_TMSAEXVEnblReq_flg_ovrdflg KOPM_TMSAEXVEnblReq_flg_ovrdval /end REF_CHARACTERISTIC
 /begin REF_MEASUREMENT VOPM_TMSAEXVEnblReq_flg /end REF_MEASUREMENT
/end GROUP
/begin GROUP S37_Subsys_VOPM_TMSBEXVEnblCmd_flg "AppSwcOpm/Opm100ms/BodCAN_OUT_100ms/Msg_TMS_LINTestData3_BOD/Subsys_VOPM_TMSBEXVEnblCmd_flg"
 /begin REF_CHARACTERISTIC KOPM_TMSBEXVEnblCmd_flg_ovrdflg KOPM_TMSBEXVEnblCmd_flg_ovrdval /end REF_CHARACTERISTIC
 /begin REF_MEASUREMENT VOPM_TMSBEXVEnblCmd_flg /end REF_MEASUREMENT
/end GROUP
/begin GROUP S37_Subsys_VOPM_TMSC3WVBPosSetReq_enum "AppSwcOpm/Opm100ms/BodCAN_OUT_100ms/Msg_TMS_LINTestData3_BOD/Subsys_VOPM_TMSC3WVBPosSetReq_enum"
 /begin REF_CHARACTERISTIC KOPM_TMSC3WVBPosSetReqHi_enum KOPM_TMSC3WVBPosSetReqLo_enum KOPM_TMSC3WVBPosSetReq_enum_ovrdflg KOPM_TMSC3WVBPosSetReq_enum_ovrdval /end REF_CHARACTERISTIC
 /begin REF_MEASUREMENT VOPM_TMSC3WVBPosSetReq_enum /end REF_MEASUREMENT
/end GROUP
/begin GROUP S37_Subsys_VOPM_TMSC3WVMode_enum "AppSwcOpm/Opm100ms/BodCAN_OUT_100ms/Msg_TMS_LINTestData3_BOD/Subsys_VOPM_TMSC3WVMode_enum"
 /begin REF_CHARACTERISTIC KOPM_TMSC3WVModeHi_enum KOPM_TMSC3WVModeLo_enum KOPM_TMSC3WVMode_enum_ovrdflg KOPM_TMSC3WVMode_enum_ovrdval /end REF_CHARACTERISTIC
 /begin REF_MEASUREMENT VOPM_TMSC3WVMode_enum /end REF_MEASUREMENT
/end GROUP
/begin GROUP S37_Subsys_VOPM_TMSC3WVPosRec_enum "AppSwcOpm/Opm100ms/BodCAN_OUT_100ms/Msg_TMS_LINTestData3_BOD/Subsys_VOPM_TMSC3WVPosRec_enum"
 /begin REF_CHARACTERISTIC KOPM_TMSC3WVPosRecHi_enum KOPM_TMSC3WVPosRecLo_enum KOPM_TMSC3WVPosRec_enum_ovrdflg KOPM_TMSC3WVPosRec_enum_ovrdval /end REF_CHARACTERISTIC
 /begin REF_MEASUREMENT VOPM_TMSC3WVPosRec_enum /end REF_MEASUREMENT
/end GROUP
/begin GROUP S37_Subsys_VOPM_TMSC5WVBPosSetReq_enum "AppSwcOpm/Opm100ms/BodCAN_OUT_100ms/Msg_TMS_LINTestData3_BOD/Subsys_VOPM_TMSC5WVBPosSetReq_enum"
 /begin REF_CHARACTERISTIC KOPM_TMSC5WVBPosSetReqHi_enum KOPM_TMSC5WVBPosSetReqLo_enum KOPM_TMSC5WVBPosSetReq_enum_ovrdflg KOPM_TMSC5WVBPosSetReq_enum_ovrdval /end REF_CHARACTERISTIC
 /begin REF_MEASUREMENT VOPM_TMSC5WVBPosSetReq_enum /end REF_MEASUREMENT
/end GROUP
/begin GROUP S37_Subsys_VOPM_TMSC5WVMode_enum "AppSwcOpm/Opm100ms/BodCAN_OUT_100ms/Msg_TMS_LINTestData3_BOD/Subsys_VOPM_TMSC5WVMode_enum"
 /begin REF_CHARACTERISTIC KOPM_TMSC5WVModeHi_enum KOPM_TMSC5WVModeLo_enum KOPM_TMSC5WVMode_enum_ovrdflg KOPM_TMSC5WVMode_enum_ovrdval /end REF_CHARACTERISTIC
 /begin REF_MEASUREMENT VOPM_TMSC5WVMode_enum /end REF_MEASUREMENT
/end GROUP
/begin GROUP S37_Subsys_VOPM_TMSC5WVPosRec_enum "AppSwcOpm/Opm100ms/BodCAN_OUT_100ms/Msg_TMS_LINTestData3_BOD/Subsys_VOPM_TMSC5WVPosRec_enum"
 /begin REF_CHARACTERISTIC KOPM_TMSC5WVPosRecHi_enum KOPM_TMSC5WVPosRecLo_enum KOPM_TMSC5WVPosRec_enum_ovrdflg KOPM_TMSC5WVPosRec_enum_ovrdval /end REF_CHARACTERISTIC
 /begin REF_MEASUREMENT VOPM_TMSC5WVPosRec_enum /end REF_MEASUREMENT
/end GROUP
/begin GROUP S37_Subsys_VOPM_TMSHPEXVCurrentPstn_cnt "AppSwcOpm/Opm100ms/BodCAN_OUT_100ms/Msg_TMS_LINTestData3_BOD/Subsys_VOPM_TMSHPEXVCurrentPstn_cnt"
 /begin REF_CHARACTERISTIC KOPM_TMSHPEXVCurrentPstnHi_cnt KOPM_TMSHPEXVCurrentPstnLo_cnt KOPM_TMSHPEXVCurrentPstn_cnt_ovrdflg KOPM_TMSHPEXVCurrentPstn_cnt_ovrdval /end REF_CHARACTERISTIC
 /begin REF_MEASUREMENT VOPM_TMSHPEXVCurrentPstn_cnt /end REF_MEASUREMENT
/end GROUP
/begin GROUP S37_Subsys_VOPM_TMSHPEXVEnblCmd_flg "AppSwcOpm/Opm100ms/BodCAN_OUT_100ms/Msg_TMS_LINTestData3_BOD/Subsys_VOPM_TMSHPEXVEnblCmd_flg"
 /begin REF_CHARACTERISTIC KOPM_TMSHPEXVEnblCmd_flg_ovrdflg KOPM_TMSHPEXVEnblCmd_flg_ovrdval /end REF_CHARACTERISTIC
 /begin REF_MEASUREMENT VOPM_TMSHPEXVEnblCmd_flg /end REF_MEASUREMENT
/end GROUP
/begin GROUP S145_Subsys_VOPM_BCMLrngData02_nu "AppSwcOpm/Opm100ms/EptCAN_OUT_100ms/Msg_BCM_IMMOAuthResp1_EPT/Subsys_VOPM_BCMLrngData02_nu"
 /begin REF_CHARACTERISTIC KOPM_BCMLrngData02Hi_nu KOPM_BCMLrngData02Lo_nu KOPM_BCMLrngData02_nu_ovrdflg KOPM_BCMLrngData02_nu_ovrdval /end REF_CHARACTERISTIC
 /begin REF_MEASUREMENT VOPM_BCMLrngData02_nu /end REF_MEASUREMENT
/end GROUP
/begin GROUP S145_Subsys_VOPM_BCMLrngData03_nu "AppSwcOpm/Opm100ms/EptCAN_OUT_100ms/Msg_BCM_IMMOAuthResp1_EPT/Subsys_VOPM_BCMLrngData03_nu"
 /begin REF_CHARACTERISTIC KOPM_BCMLrngData03Hi_nu KOPM_BCMLrngData03Lo_nu KOPM_BCMLrngData03_nu_ovrdflg KOPM_BCMLrngData03_nu_ovrdval /end REF_CHARACTERISTIC
 /begin REF_MEASUREMENT VOPM_BCMLrngData03_nu /end REF_MEASUREMENT
/end GROUP
/begin GROUP S145_Subsys_VOPM_BCMLrngData04_nu "AppSwcOpm/Opm100ms/EptCAN_OUT_100ms/Msg_BCM_IMMOAuthResp1_EPT/Subsys_VOPM_BCMLrngData04_nu"
 /begin REF_CHARACTERISTIC KOPM_BCMLrngData04Hi_nu KOPM_BCMLrngData04Lo_nu KOPM_BCMLrngData04_nu_ovrdflg KOPM_BCMLrngData04_nu_ovrdval /end REF_CHARACTERISTIC
 /begin REF_MEASUREMENT VOPM_BCMLrngData04_nu /end REF_MEASUREMENT
/end GROUP
/begin GROUP S145_Subsys_VOPM_BCMLrngData05_nu "AppSwcOpm/Opm100ms/EptCAN_OUT_100ms/Msg_BCM_IMMOAuthResp1_EPT/Subsys_VOPM_BCMLrngData05_nu"
 /begin REF_CHARACTERISTIC KOPM_BCMLrngData05Hi_nu KOPM_BCMLrngData05Lo_nu KOPM_BCMLrngData05_nu_ovrdflg KOPM_BCMLrngData05_nu_ovrdval /end REF_CHARACTERISTIC
 /begin REF_MEASUREMENT VOPM_BCMLrngData05_nu /end REF_MEASUREMENT
/end GROUP
/begin GROUP S145_Subsys_VOPM_BCMLrngData06_nu "AppSwcOpm/Opm100ms/EptCAN_OUT_100ms/Msg_BCM_IMMOAuthResp1_EPT/Subsys_VOPM_BCMLrngData06_nu"
 /begin REF_CHARACTERISTIC KOPM_BCMLrngData06Hi_nu KOPM_BCMLrngData06Lo_nu KOPM_BCMLrngData06_nu_ovrdflg KOPM_BCMLrngData06_nu_ovrdval /end REF_CHARACTERISTIC
 /begin REF_MEASUREMENT VOPM_BCMLrngData06_nu /end REF_MEASUREMENT
/end GROUP
/begin GROUP S145_Subsys_VOPM_BCMLrngData07_nu "AppSwcOpm/Opm100ms/EptCAN_OUT_100ms/Msg_BCM_IMMOAuthResp1_EPT/Subsys_VOPM_BCMLrngData07_nu"
 /begin REF_CHARACTERISTIC KOPM_BCMLrngData07Hi_nu KOPM_BCMLrngData07Lo_nu KOPM_BCMLrngData07_nu_ovrdflg KOPM_BCMLrngData07_nu_ovrdval /end REF_CHARACTERISTIC
 /begin REF_MEASUREMENT VOPM_BCMLrngData07_nu /end REF_MEASUREMENT
/end GROUP
/begin GROUP S145_Subsys_VOPM_BCMLrngSts_enum "AppSwcOpm/Opm100ms/EptCAN_OUT_100ms/Msg_BCM_IMMOAuthResp1_EPT/Subsys_VOPM_BCMLrngSts_enum"
 /begin REF_CHARACTERISTIC KOPM_BCMLrngStsHi_enum KOPM_BCMLrngStsLo_enum KOPM_BCMLrngSts_enum_ovrdflg KOPM_BCMLrngSts_enum_ovrdval /end REF_CHARACTERISTIC
 /begin REF_MEASUREMENT VOPM_BCMLrngSts_enum /end REF_MEASUREMENT
/end GROUP
/begin GROUP S145_Subsys_VOPM_BCMLrngsubID_cnt "AppSwcOpm/Opm100ms/EptCAN_OUT_100ms/Msg_BCM_IMMOAuthResp1_EPT/Subsys_VOPM_BCMLrngsubID_cnt"
 /begin REF_CHARACTERISTIC KOPM_BCMLrngsubIDHi_cnt KOPM_BCMLrngsubIDLo_cnt KOPM_BCMLrngsubID_cnt_ovrdflg KOPM_BCMLrngsubID_cnt_ovrdval /end REF_CHARACTERISTIC
 /begin REF_MEASUREMENT VOPM_BCMLrngsubID_cnt /end REF_MEASUREMENT
/end GROUP
/begin GROUP S156_Subsys_VOPM_ActWhlTqVld_flg "AppSwcOpm/Opm10ms/CHACAN_OUT_10ms/Msg_VCU_10_Torque_CHA/Subsys_VOPM_ActWhlTqVld_flg" /begin REF_CHARACTERISTIC KOPM_ActWhlTqVld_flg_ovrdflg KOPM_ActWhlTqVld_flg_ovrdval /end REF_CHARACTERISTIC /begin REF_MEASUREMENT VOPM_ActWhlTqVld_flg /end REF_MEASUREMENT /end GROUP
/begin GROUP S156_Subsys_VOPM_ActWhlTq_Nm "AppSwcOpm/Opm10ms/CHACAN_OUT_10ms/Msg_VCU_10_Torque_CHA/Subsys_VOPM_ActWhlTq_Nm"
 /begin REF_CHARACTERISTIC KOPM_ActWhlTqHi_Nm KOPM_ActWhlTqLo_Nm KOPM_ActWhlTq_Nm_ovrdflg KOPM_ActWhlTq_Nm_ovrdval /end REF_CHARACTERISTIC
 /begin REF_MEASUREMENT VOPM_ActWhlTq_Nm /end REF_MEASUREMENT
/end GROUP
/begin GROUP S156_Subsys_VOPM_ActlMotorRotateSpdVld_flg "AppSwcOpm/Opm10ms/CHACAN_OUT_10ms/Msg_VCU_10_Torque_CHA/Subsys_VOPM_ActlMotorRotateSpdVld_flg"
 /begin REF_CHARACTERISTIC KOPM_ActlMotorRotateSpdVld_flg_ovrdflg KOPM_ActlMotorRotateSpdVld_flg_ovrdval /end REF_CHARACTERISTIC
 /begin REF_MEASUREMENT VOPM_ActlMotorRotateSpdVld_flg /end REF_MEASUREMENT
/end GROUP
/begin GROUP S156_Subsys_VOPM_ActlMotorRotateSpd_rpm "AppSwcOpm/Opm10ms/CHACAN_OUT_10ms/Msg_VCU_10_Torque_CHA/Subsys_VOPM_ActlMotorRotateSpd_rpm"
 /begin REF_CHARACTERISTIC KOPM_ActlMotorRotateSpdHi_rpm KOPM_ActlMotorRotateSpdLo_rpm KOPM_ActlMotorRotateSpd_rpm_ovrdflg KOPM_ActlMotorRotateSpd_rpm_ovrdval /end REF_CHARACTERISTIC
 /begin REF_MEASUREMENT VOPM_ActlMotorRotateSpd_rpm /end REF_MEASUREMENT
/end GROUP
/begin GROUP S156_Subsys_VOPM_ActlMotorTorqVld_flg "AppSwcOpm/Opm10ms/CHACAN_OUT_10ms/Msg_VCU_10_Torque_CHA/Subsys_VOPM_ActlMotorTorqVld_flg"
 /begin REF_CHARACTERISTIC KOPM_ActlMotorTorqVld_flg_ovrdflg KOPM_ActlMotorTorqVld_flg_ovrdval /end REF_CHARACTERISTIC
 /begin REF_MEASUREMENT VOPM_ActlMotorTorqVld_flg /end REF_MEASUREMENT
/end GROUP
/begin GROUP S156_Subsys_VOPM_ActlMotorTorq_Nm "AppSwcOpm/Opm10ms/CHACAN_OUT_10ms/Msg_VCU_10_Torque_CHA/Subsys_VOPM_ActlMotorTorq_Nm"
 /begin REF_CHARACTERISTIC KOPM_ActlMotorTorqHi_Nm KOPM_ActlMotorTorqLo_Nm KOPM_ActlMotorTorq_Nm_ovrdflg KOPM_ActlMotorTorq_Nm_ovrdval /end REF_CHARACTERISTIC
 /begin REF_MEASUREMENT VOPM_ActlMotorTorq_Nm /end REF_MEASUREMENT
/end GROUP
/begin GROUP S156_Subsys_VOPM_BrkPwrRecupActWhlTq_Nm "AppSwcOpm/Opm10ms/CHACAN_OUT_10ms/Msg_VCU_10_Torque_CHA/Subsys_VOPM_BrkPwrRecupActWhlTq_Nm"
 /begin REF_CHARACTERISTIC KOPM_BrkPwrRecupActWhlTqHi_Nm KOPM_BrkPwrRecupActWhlTqLo_Nm KOPM_BrkPwrRecupActWhlTq_Nm_ovrdflg KOPM_BrkPwrRecupActWhlTq_Nm_ovrdval /end REF_CHARACTERISTIC
 /begin REF_MEASUREMENT VOPM_BrkPwrRecupActWhlTq_Nm /end REF_MEASUREMENT
/end GROUP
/begin GROUP S156_Subsys_VOPM_BrkPwrRecupActlWhlTqSts_enum "AppSwcOpm/Opm10ms/CHACAN_OUT_10ms/Msg_VCU_10_Torque_CHA/Subsys_VOPM_BrkPwrRecupActlWhlTqSts_enum"
 /begin REF_CHARACTERISTIC KOPM_BrkPwrRecupActlWhlTqStsHi_enum KOPM_BrkPwrRecupActlWhlTqStsLo_enum KOPM_BrkPwrRecupActlWhlTqSts_enum_ovrdflg KOPM_BrkPwrRecupActlWhlTqSts_enum_ovrdval /end REF_CHARACTERISTIC
 /begin REF_MEASUREMENT VOPM_BrkPwrRecupActlWhlTqSts_enum /end REF_MEASUREMENT
/end GROUP
/begin GROUP S156_Subsys_VOPM_BrkPwrRecupMaxAvlbWhlTq_Nm "AppSwcOpm/Opm10ms/CHACAN_OUT_10ms/Msg_VCU_10_Torque_CHA/Subsys_VOPM_BrkPwrRecupMaxAvlbWhlTq_Nm"
 /begin REF_CHARACTERISTIC KOPM_BrkPwrRecupMaxAvlbWhlTqHi_Nm KOPM_BrkPwrRecupMaxAvlbWhlTqLo_Nm KOPM_BrkPwrRecupMaxAvlbWhlTq_Nm_ovrdflg KOPM_BrkPwrRecupMaxAvlbWhlTq_Nm_ovrdval /end REF_CHARACTERISTIC
 /begin REF_MEASUREMENT VOPM_BrkPwrRecupMaxAvlbWhlTq_Nm /end REF_MEASUREMENT
/end GROUP
/end MODULE
/end PROJECT
/* (add any file trailer comments here) */ /* EOF AppSwcOpm.a2l */
