/begin MOD_COMMON "Mod Common Comment Here" BYTE_ORDER MSB_LAST /end MOD_COMMON
/begin RECORD_LAYOUT Scalar_BOOLEAN FNC_VALUES 1 UBYTE COLUMN_DIR DIRECT /end RECORD_LAYOUT
/begin RECORD_LAYOUT Scalar_UBYTE FNC_VALUES 1 UBYTE COLUMN_DIR DIRECT /end RECORD_LAYOUT
/begin RECORD_LAYOUT Scalar_UWORD FNC_VALUES 1 UWORD COLUMN_DIR DIRECT /end RECORD_LAYOUT
/begin RECORD_LAYOUT Scalar_FLOAT32_IEEE FNC_VALUES 1 FLOAT32_IEEE COLUMN_DIR DIRECT /end RECORD_LAYOUT
/begin RECORD_LAYOUT Lookup1D_UBYTE FNC_VALUES 1 UBYTE COLUMN_DIR DIRECT /end RECORD_LAYOUT
/begin RECORD_LAYOUT Lookup1D_X_UBYTE AXIS_PTS_X 1 UBYTE INDEX_INCR DIRECT /end RECORD_LAYOUT
/begin RECORD_LAYOUT Lookup1D_FLOAT32_IEEE FNC_VALUES 1 FLOAT32_IEEE COLUMN_DIR DIRECT /end RECORD_LAYOUT
/begin RECORD_LAYOUT Lookup1D_X_FLOAT32_IEEE AXIS_PTS_X 1 FLOAT32_IEEE INDEX_INCR DIRECT /end RECORD_LAYOUT
/begin RECORD_LAYOUT Lookup2D_X_UWORD AXIS_PTS_X 1 UWORD INDEX_INCR DIRECT /end RECORD_LAYOUT
/begin RECORD_LAYOUT Lookup2D_X_WORD AXIS_PTS_X 1 SWORD INDEX_INCR DIRECT /end RECORD_LAYOUT
/begin RECORD_LAYOUT Lookup2D_ULONG FNC_VALUES 1 ULONG COLUMN_DIR DIRECT /end RECORD_LAYOUT
/begin RECORD_LAYOUT Lookup2D_X_ULONG AXIS_PTS_X 1 ULONG INDEX_INCR DIRECT /end RECORD_LAYOUT
/begin RECORD_LAYOUT Lookup2D_LONG FNC_VALUES 1 SLONG COLUMN_DIR DIRECT /end RECORD_LAYOUT
/begin RECORD_LAYOUT Lookup2D_X_LONG AXIS_PTS_X 1 SLONG INDEX_INCR DIRECT /end RECORD_LAYOUT
/begin RECORD_LAYOUT Lookup2D_FLOAT32_IEEE FNC_VALUES 1 FLOAT32_IEEE COLUMN_DIR DIRECT /end RECORD_LAYOUT
/begin RECORD_LAYOUT Lookup2D_X_FLOAT32_IEEE AXIS_PTS_X 1 FLOAT32_IEEE INDEX_INCR DIRECT /end RECORD_LAYOUT
/begin RECORD_LAYOUT Lookup2D_FLOAT64_IEEE FNC_VALUES 1 FLOAT64_IEEE COLUMN_DIR DIRECT /end RECORD_LAYOUT
/begin RECORD_LAYOUT Lookup2D_X_FLOAT64_IEEE AXIS_PTS_X 1 FLOAT64_IEEE INDEX_INCR DIRECT /end RECORD_LAYOUT
/begin CHARACTERISTIC cal_HPEXVCtrlCFF_CUR "" CURVE 0x0000 /* @ECU_Address@cal_HPEXVCtrlCFF_CUR@ */ Lookup1D_FLOAT32_IEEE 0 ME11_CM_single_percent_ 0.0 100.0
 /begin AXIS_DESCR COM_AXIS ACTCtl_sACCMCtlSpd ME11_CM_single_rpm 5 0.0 10000.0 AXIS_PTS_REF cal_HPEXVCtrlCFF_1X /end AXIS_DESCR
/end CHARACTERISTIC
/begin AXIS_PTS cal_HPEXVCtrlCFF_1X "" 0x0000 /* @ECU_Address@cal_HPEXVCtrlCFF_1X@ */ ACTCtl_sACCMCtlSpd Lookup1D_X_FLOAT32_IEEE 0 ME11_CM_single_rpm 5 0.0 10000.0 /end AXIS_PTS
/begin CHARACTERISTIC cal_HPEXVCtrlCKi_CUR "" CURVE 0x0000 /* @ECU_Address@cal_HPEXVCtrlCKi_CUR@ */ Lookup1D_FLOAT32_IEEE 0 ME11_CM_single_r 0.0 50.0
 /begin AXIS_DESCR COM_AXIS NO_INPUT_QUANTITY ME11_CM_single_C 8 -50.0 50.0 AXIS_PTS_REF cal_HPEXVCtrlCKi_1X /end AXIS_DESCR
/end CHARACTERISTIC
/begin AXIS_PTS cal_HPEXVCtrlCKi_1X "" 0x0000 /* @ECU_Address@cal_HPEXVCtrlCKi_1X@ */ NO_INPUT_QUANTITY Lookup1D_X_FLOAT32_IEEE 0 ME11_CM_single_C 8 -50.0 50.0 /end AXIS_PTS
/begin CHARACTERISTIC cal_HPEXVCtrlCKp_CUR "" CURVE 0x0000 /* @ECU_Address@cal_HPEXVCtrlCKp_CUR@ */ Lookup1D_FLOAT32_IEEE 0 ME11_CM_single_r 0.0 50.0
 /begin AXIS_DESCR COM_AXIS NO_INPUT_QUANTITY ME11_CM_single_C 8 -50.0 50.0 AXIS_PTS_REF cal_HPEXVCtrlCKp_1X /end AXIS_DESCR
/end CHARACTERISTIC
/begin AXIS_PTS cal_HPEXVCtrlCKp_1X "" 0x0000 /* @ECU_Address@cal_HPEXVCtrlCKp_1X@ */ NO_INPUT_QUANTITY Lookup1D_X_FLOAT32_IEEE 0 ME11_CM_single_C 8 -50.0 50.0 /end AXIS_PTS
/begin CHARACTERISTIC cal_HPEXVCtrlDFF_CUR "" CURVE 0x0000 /* @ECU_Address@cal_HPEXVCtrlDFF_CUR@ */ Lookup1D_FLOAT32_IEEE 0 ME11_CM_single_percent_ 0.0 100.0
 /begin AXIS_DESCR COM_AXIS ACTCtl_sACCMCtlSpd ME11_CM_single_rpm 5 0.0 10000.0 AXIS_PTS_REF cal_HPEXVCtrlDFF_1X /end AXIS_DESCR
/end CHARACTERISTIC
/begin AXIS_PTS cal_HPEXVCtrlDFF_1X "" 0x0000 /* @ECU_Address@cal_HPEXVCtrlDFF_1X@ */ ACTCtl_sACCMCtlSpd Lookup1D_X_FLOAT32_IEEE 0 ME11_CM_single_rpm 5 0.0 10000.0 /end AXIS_PTS
/begin CHARACTERISTIC cal_HPEXVCtrlDKi_CUR "" CURVE 0x0000 /* @ECU_Address@cal_HPEXVCtrlDKi_CUR@ */ Lookup1D_FLOAT32_IEEE 0 ME11_CM_single_null 0.0 10.0
 /begin AXIS_DESCR COM_AXIS NO_INPUT_QUANTITY ME11_CM_single_C 8 -50.0 50.0 AXIS_PTS_REF cal_HPEXVCtrlDKi_1X /end AXIS_DESCR
/end CHARACTERISTIC
/begin AXIS_PTS cal_HPEXVCtrlDKi_1X "" 0x0000 /* @ECU_Address@cal_HPEXVCtrlDKi_1X@ */ NO_INPUT_QUANTITY Lookup1D_X_FLOAT32_IEEE 0 ME11_CM_single_C 8 -50.0 50.0 /end AXIS_PTS
/begin CHARACTERISTIC cal_HPEXVCtrlDKp_CUR "" CURVE 0x0000 /* @ECU_Address@cal_HPEXVCtrlDKp_CUR@ */ Lookup1D_FLOAT32_IEEE 0 ME11_CM_single_null 0.0 100.0
 /begin AXIS_DESCR COM_AXIS NO_INPUT_QUANTITY ME11_CM_single_C 8 -50.0 50.0 AXIS_PTS_REF cal_HPEXVCtrlDKp_1X /end AXIS_DESCR
/end CHARACTERISTIC
/begin AXIS_PTS cal_HPEXVCtrlDKp_1X "" 0x0000 /* @ECU_Address@cal_HPEXVCtrlDKp_1X@ */ NO_INPUT_QUANTITY Lookup1D_X_FLOAT32_IEEE 0 ME11_CM_single_C 8 -50.0 50.0 /end AXIS_PTS
/begin CHARACTERISTIC cal_HPEXVCtrlDTrgtSubcool_CUR "" CURVE 0x0000 /* @ECU_Address@cal_HPEXVCtrlDTrgtSubcool_CUR@ */ Lookup1D_FLOAT32_IEEE 0 ME11_CM_single_null 0.0 18.0
 /begin AXIS_DESCR COM_AXIS ACTCtl_sACCMCtlSpd ME11_CM_single_rpm 5 0.0 10000.0 AXIS_PTS_REF cal_HPEXVCtrlDTrgtSubcool_1X /end AXIS_DESCR
/end CHARACTERISTIC
/begin AXIS_PTS cal_HPEXVCtrlDTrgtSubcool_1X "" 0x0000 /* @ECU_Address@cal_HPEXVCtrlDTrgtSubcool_1X@ */ ACTCtl_sACCMCtlSpd Lookup1D_X_FLOAT32_IEEE 0 ME11_CM_single_rpm 5 0.0 10000.0 /end AXIS_PTS
/begin CHARACTERISTIC cal_HPEXVCtrlEFF_CUR "" CURVE 0x0000 /* @ECU_Address@cal_HPEXVCtrlEFF_CUR@ */ Lookup1D_FLOAT32_IEEE 0 ME11_CM_single_percent_ 0.0 100.0
 /begin AXIS_DESCR COM_AXIS ACTCtl_sACCMCtlSpd ME11_CM_single_rpm 5 0.0 10000.0 AXIS_PTS_REF cal_HPEXVCtrlEFF_1X /end AXIS_DESCR
/end CHARACTERISTIC
/begin AXIS_PTS cal_HPEXVCtrlEFF_1X "" 0x0000 /* @ECU_Address@cal_HPEXVCtrlEFF_1X@ */ ACTCtl_sACCMCtlSpd Lookup1D_X_FLOAT32_IEEE 0 ME11_CM_single_rpm 5 0.0 10000.0 /end AXIS_PTS
/begin CHARACTERISTIC cal_HPEXVCtrlEKi_CUR "" CURVE 0x0000 /* @ECU_Address@cal_HPEXVCtrlEKi_CUR@ */ Lookup1D_FLOAT32_IEEE 0 ME11_CM_single_r 0.0 50.0
 /begin AXIS_DESCR COM_AXIS NO_INPUT_QUANTITY ME11_CM_single_C 6 0.0 50.0 AXIS_PTS_REF cal_HPEXVCtrlEKi_1X /end AXIS_DESCR
/end CHARACTERISTIC
/begin AXIS_PTS cal_HPEXVCtrlEKi_1X "" 0x0000 /* @ECU_Address@cal_HPEXVCtrlEKi_1X@ */ NO_INPUT_QUANTITY Lookup1D_X_FLOAT32_IEEE 0 ME11_CM_single_C 6 0.0 50.0 /end AXIS_PTS
/begin CHARACTERISTIC cal_HPEXVCtrlEKp_CUR "" CURVE 0x0000 /* @ECU_Address@cal_HPEXVCtrlEKp_CUR@ */ Lookup1D_FLOAT32_IEEE 0 ME11_CM_single_r 0.0 50.0
 /begin AXIS_DESCR COM_AXIS NO_INPUT_QUANTITY ME11_CM_single_C 6 0.0 50.0 AXIS_PTS_REF cal_HPEXVCtrlEKp_1X /end AXIS_DESCR
/end CHARACTERISTIC
/begin AXIS_PTS cal_HPEXVCtrlEKp_1X "" 0x0000 /* @ECU_Address@cal_HPEXVCtrlEKp_1X@ */ NO_INPUT_QUANTITY Lookup1D_X_FLOAT32_IEEE 0 ME11_CM_single_C 6 0.0 50.0 /end AXIS_PTS
/begin CHARACTERISTIC cal_HPEXVCtrlETrgtSubcool_CUR "" CURVE 0x0000 /* @ECU_Address@cal_HPEXVCtrlETrgtSubcool_CUR@ */ Lookup1D_FLOAT32_IEEE 0 ME11_CM_single_C 0.0 100.0
 /begin AXIS_DESCR COM_AXIS ACTCtl_sACCMCtlSpd ME11_CM_single_rpm 5 0.0 10000.0 AXIS_PTS_REF cal_HPEXVCtrlETrgtSubcool_1X /end AXIS_DESCR
/end CHARACTERISTIC
/begin AXIS_PTS cal_HPEXVCtrlETrgtSubcool_1X "" 0x0000 /* @ECU_Address@cal_HPEXVCtrlETrgtSubcool_1X@ */ ACTCtl_sACCMCtlSpd Lookup1D_X_FLOAT32_IEEE 0 ME11_CM_single_rpm 5 0.0 10000.0 /end AXIS_PTS
/begin CHARACTERISTIC cal_TSBatMaxTempForEnvExitC_CUR "" CURVE 0x0000 /* @ECU_Address@cal_TSBatMaxTempForEnvExitC_CUR@ */ Lookup1D_FLOAT32_IEEE 0 ME11_CM_single_C -40.0 80.0
 /begin AXIS_DESCR COM_AXIS ACSen_sEnvTempCor ME11_CM_single_C 5 -40.0 80.0 AXIS_PTS_REF cal_TSBatMaxTempForEnvExitC_1X /end AXIS_DESCR
/end CHARACTERISTIC
/begin AXIS_PTS cal_TSBatMaxTempForEnvExitC_1X "" 0x0000 /* @ECU_Address@cal_TSBatMaxTempForEnvExitC_1X@ */ ACSen_sEnvTempCor Lookup1D_X_FLOAT32_IEEE 0 ME11_CM_single_C 5 -40.0 80.0 /end AXIS_PTS
/begin CHARACTERISTIC cal_ACChrgBatHeatTrgTemp_CUR "" CURVE 0x0000 /* @ECU_Address@cal_ACChrgBatHeatTrgTemp_CUR@ */ Lookup1D_FLOAT32_IEEE 0 ME11_CM_single_C 0.0 100.0
 /begin AXIS_DESCR COM_AXIS ACSen_sEnvTempCor ME11_CM_single_C 7 -40.0 40.0 AXIS_PTS_REF cal_ACChrgBatHeatTrgTemp_1X /end AXIS_DESCR
/end CHARACTERISTIC
/begin AXIS_PTS cal_ACChrgBatHeatTrgTemp_1X "" 0x0000 /* @ECU_Address@cal_ACChrgBatHeatTrgTemp_1X@ */ ACSen_sEnvTempCor Lookup1D_X_FLOAT32_IEEE 0 ME11_CM_single_C 7 -40.0 40.0 /end AXIS_PTS
/begin CHARACTERISTIC cal_BatHeatTrgTempComp_CUR "" CURVE 0x0000 /* @ECU_Address@cal_BatHeatTrgTempComp_CUR@ */ Lookup1D_FLOAT32_IEEE 0 ME11_CM_single_C -40.0 40.0
 /begin AXIS_DESCR COM_AXIS NO_INPUT_QUANTITY ME11_CM_single_C 11 -40.0 40.0 AXIS_PTS_REF cal_BatHeatTrgTempComp_1X /end AXIS_DESCR
/end CHARACTERISTIC
/begin AXIS_PTS cal_BatHeatTrgTempComp_1X "" 0x0000 /* @ECU_Address@cal_BatHeatTrgTempComp_1X@ */ NO_INPUT_QUANTITY Lookup1D_X_FLOAT32_IEEE 0 ME11_CM_single_C 11 -40.0 40.0 /end AXIS_PTS
/begin CHARACTERISTIC cal_DCChrgBatHeatTrgTemp_CUR "" CURVE 0x0000 /* @ECU_Address@cal_DCChrgBatHeatTrgTemp_CUR@ */ Lookup1D_FLOAT32_IEEE 0 ME11_CM_single_C 0.0 100.0
 /begin AXIS_DESCR COM_AXIS ACSen_sEnvTempCor ME11_CM_single_C 7 -40.0 40.0 AXIS_PTS_REF cal_DCChrgBatHeatTrgTemp_1X /end AXIS_DESCR
/end CHARACTERISTIC
/begin AXIS_PTS cal_DCChrgBatHeatTrgTemp_1X "" 0x0000 /* @ECU_Address@cal_DCChrgBatHeatTrgTemp_1X@ */ ACSen_sEnvTempCor Lookup1D_X_FLOAT32_IEEE 0 ME11_CM_single_C 7 -40.0 40.0 /end AXIS_PTS
/begin CHARACTERISTIC cal_DisChrgBatHeatTrgTemp_CUR "" CURVE 0x0000 /* @ECU_Address@cal_DisChrgBatHeatTrgTemp_CUR@ */ Lookup1D_FLOAT32_IEEE 0 ME11_CM_single_C 0.0 100.0
 /begin AXIS_DESCR COM_AXIS ACSen_sEnvTempCor ME11_CM_single_C 7 -40.0 40.0 AXIS_PTS_REF cal_DisChrgBatHeatTrgTemp_1X /end AXIS_DESCR
/end CHARACTERISTIC
/begin AXIS_PTS cal_DisChrgBatHeatTrgTemp_1X "" 0x0000 /* @ECU_Address@cal_DisChrgBatHeatTrgTemp_1X@ */ ACSen_sEnvTempCor Lookup1D_X_FLOAT32_IEEE 0 ME11_CM_single_C 7 -40.0 40.0 /end AXIS_PTS
/begin CHARACTERISTIC cal_DLTRDCBatMaxEntTempB_CUR "" CURVE 0x0000 /* @ECU_Address@cal_DLTRDCBatMaxEntTempB_CUR@ */ Lookup1D_FLOAT32_IEEE 0 ME11_CM_single_C -40.0 80.0
 /begin AXIS_DESCR COM_AXIS ACSen_sEnvTempCor ME11_CM_single_C 5 -40.0 80.0 AXIS_PTS_REF cal_DLTRDCBatMaxEntTempB_1X /end AXIS_DESCR
/end CHARACTERISTIC
/begin AXIS_PTS cal_DLTRDCBatMaxEntTempB_1X "" 0x0000 /* @ECU_Address@cal_DLTRDCBatMaxEntTempB_1X@ */ ACSen_sEnvTempCor Lookup1D_X_FLOAT32_IEEE 0 ME11_CM_single_C 5 -40.0 80.0 /end AXIS_PTS
/begin CHARACTERISTIC cal_DLTRBatMaxEntTempB_CUR "" CURVE 0x0000 /* @ECU_Address@cal_DLTRBatMaxEntTempB_CUR@ */ Lookup1D_FLOAT32_IEEE 0 ME11_CM_single_C -40.0 80.0
 /begin AXIS_DESCR COM_AXIS ACSen_sEnvTempCor ME11_CM_single_C 5 -40.0 80.0 AXIS_PTS_REF cal_DLTRBatMaxEntTempB_1X /end AXIS_DESCR
/end CHARACTERISTIC
/begin AXIS_PTS cal_DLTRBatMaxEntTempB_1X "" 0x0000 /* @ECU_Address@cal_DLTRBatMaxEntTempB_1X@ */ ACSen_sEnvTempCor Lookup1D_X_FLOAT32_IEEE 0 ME11_CM_single_C 5 -40.0 80.0 /end AXIS_PTS
/begin CHARACTERISTIC cal_DLTRDCBatMaxExitTempB_CUR "" CURVE 0x0000 /* @ECU_Address@cal_DLTRDCBatMaxExitTempB_CUR@ */ Lookup1D_FLOAT32_IEEE 0 ME11_CM_single_C -40.0 80.0
 /begin AXIS_DESCR COM_AXIS ACSen_sEnvTempCor ME11_CM_single_C 5 -40.0 80.0 AXIS_PTS_REF cal_DLTRDCBatMaxExitTempB_1X /end AXIS_DESCR
/end CHARACTERISTIC
/begin AXIS_PTS cal_DLTRDCBatMaxExitTempB_1X "" 0x0000 /* @ECU_Address@cal_DLTRDCBatMaxExitTempB_1X@ */ ACSen_sEnvTempCor Lookup1D_X_FLOAT32_IEEE 0 ME11_CM_single_C 5 -40.0 80.0 /end AXIS_PTS
/begin CHARACTERISTIC cal_DLTRNotDCBatMaxExitTempC_CUR "" CURVE 0x0000 /* @ECU_Address@cal_DLTRNotDCBatMaxExitTempC_CUR@ */ Lookup1D_FLOAT32_IEEE 0 ME11_CM_single_C -40.0 80.0
 /begin AXIS_DESCR COM_AXIS BMS_HVBatCellTempMax ME11_CM_single_C 5 -40.0 80.0 AXIS_PTS_REF cal_DLTRNotDCBatMaxExitTempC_1X /end AXIS_DESCR
/end CHARACTERISTIC
/begin AXIS_PTS cal_DLTRNotDCBatMaxExitTempC_1X "" 0x0000 /* @ECU_Address@cal_DLTRNotDCBatMaxExitTempC_1X@ */ BMS_HVBatCellTempMax Lookup1D_X_FLOAT32_IEEE 0 ME11_CM_single_C 5 -40.0 80.0 /end AXIS_PTS
/begin CHARACTERISTIC cal_ACFanLevel0EnvCor_CUR "" CURVE 0x0000 /* @ECU_Address@cal_ACFanLevel0EnvCor_CUR@ */ Lookup1D_FLOAT32_IEEE 0 ME11_CM_single_percent_ -100.0 100.0
 /begin AXIS_DESCR COM_AXIS ACSen_sEnvTempCor ME11_CM_single_C 2 -40.0 80.0 AXIS_PTS_REF cal_ACFanLevel0EnvCor_1X /end AXIS_DESCR
/end CHARACTERISTIC
/begin AXIS_PTS cal_ACFanLevel0EnvCor_1X "" 0x0000 /* @ECU_Address@cal_ACFanLevel0EnvCor_1X@ */ ACSen_sEnvTempCor Lookup1D_X_FLOAT32_IEEE 0 ME11_CM_single_C 2 -40.0 80.0 /end AXIS_PTS
/begin CHARACTERISTIC cal_ACFanLevel1EnvCor_CUR "" CURVE 0x0000 /* @ECU_Address@cal_ACFanLevel1EnvCor_CUR@ */ Lookup1D_FLOAT32_IEEE 0 ME11_CM_single_percent_ -100.0 100.0
 /begin AXIS_DESCR COM_AXIS ACSen_sEnvTempCor ME11_CM_single_C 2 -40.0 80.0 AXIS_PTS_REF cal_ACFanLevel1EnvCor_1X /end AXIS_DESCR
/end CHARACTERISTIC
/begin AXIS_PTS cal_ACFanLevel1EnvCor_1X "" 0x0000 /* @ECU_Address@cal_ACFanLevel1EnvCor_1X@ */ ACSen_sEnvTempCor Lookup1D_X_FLOAT32_IEEE 0 ME11_CM_single_C 2 -40.0 80.0 /end AXIS_PTS
/begin CHARACTERISTIC cal_ACFanLevel2EnvCor_CUR "" CURVE 0x0000 /* @ECU_Address@cal_ACFanLevel2EnvCor_CUR@ */ Lookup1D_FLOAT32_IEEE 0 ME11_CM_single_percent_ -100.0 100.0
 /begin AXIS_DESCR COM_AXIS ACSen_sEnvTempCor ME11_CM_single_C 2 -40.0 80.0 AXIS_PTS_REF cal_ACFanLevel2EnvCor_1X /end AXIS_DESCR
/end CHARACTERISTIC
/begin AXIS_PTS cal_ACFanLevel2EnvCor_1X "" 0x0000 /* @ECU_Address@cal_ACFanLevel2EnvCor_1X@ */ ACSen_sEnvTempCor Lookup1D_X_FLOAT32_IEEE 0 ME11_CM_single_C 2 -40.0 80.0 /end AXIS_PTS
/begin CHARACTERISTIC cal_ACFanLevel3EnvCor_CUR "" CURVE 0x0000 /* @ECU_Address@cal_ACFanLevel3EnvCor_CUR@ */ Lookup1D_FLOAT32_IEEE 0 ME11_CM_single_percent_ -100.0 100.0
 /begin AXIS_DESCR COM_AXIS ACSen_sEnvTempCor ME11_CM_single_C 2 -40.0 80.0 AXIS_PTS_REF cal_ACFanLevel3EnvCor_1X /end AXIS_DESCR
/end CHARACTERISTIC
/begin AXIS_PTS cal_ACFanLevel3EnvCor_1X "" 0x0000 /* @ECU_Address@cal_ACFanLevel3EnvCor_1X@ */ ACSen_sEnvTempCor Lookup1D_X_FLOAT32_IEEE 0 ME11_CM_single_C 2 -40.0 80.0 /end AXIS_PTS
/begin CHARACTERISTIC cal_ACFanLevel4EnvCor_CUR "" CURVE 0x0000 /* @ECU_Address@cal_ACFanLevel4EnvCor_CUR@ */ Lookup1D_FLOAT32_IEEE 0 ME11_CM_single_percent_ -100.0 100.0
 /begin AXIS_DESCR COM_AXIS ACSen_sEnvTempCor ME11_CM_single_C 2 -40.0 80.0 AXIS_PTS_REF cal_ACFanLevel4EnvCor_1X /end AXIS_DESCR
/end CHARACTERISTIC
/begin AXIS_PTS cal_ACFanLevel4EnvCor_1X "" 0x0000 /* @ECU_Address@cal_ACFanLevel4EnvCor_1X@ */ ACSen_sEnvTempCor Lookup1D_X_FLOAT32_IEEE 0 ME11_CM_single_C 2 -40.0 80.0 /end AXIS_PTS
/begin CHARACTERISTIC cal_ACFanLevel5EnvCor_CUR "" CURVE 0x0000 /* @ECU_Address@cal_ACFanLevel5EnvCor_CUR@ */ Lookup1D_FLOAT32_IEEE 0 ME11_CM_single_percent_ -100.0 100.0
 /begin AXIS_DESCR COM_AXIS ACSen_sEnvTempCor ME11_CM_single_C 2 -40.0 80.0 AXIS_PTS_REF cal_ACFanLevel5EnvCor_1X /end AXIS_DESCR
/end CHARACTERISTIC
/begin AXIS_PTS cal_ACFanLevel5EnvCor_1X "" 0x0000 /* @ECU_Address@cal_ACFanLevel5EnvCor_1X@ */ ACSen_sEnvTempCor Lookup1D_X_FLOAT32_IEEE 0 ME11_CM_single_C 2 -40.0 80.0 /end AXIS_PTS
/begin CHARACTERISTIC cal_ACFanLevel6EnvCor_CUR "" CURVE 0x0000 /* @ECU_Address@cal_ACFanLevel6EnvCor_CUR@ */ Lookup1D_FLOAT32_IEEE 0 ME11_CM_single_percent_ -100.0 100.0
 /begin AXIS_DESCR COM_AXIS ACSen_sEnvTempCor ME11_CM_single_C 2 -40.0 80.0 AXIS_PTS_REF cal_ACFanLevel6EnvCor_1X /end AXIS_DESCR
/end CHARACTERISTIC
/begin AXIS_PTS cal_ACFanLevel6EnvCor_1X "" 0x0000 /* @ECU_Address@cal_ACFanLevel6EnvCor_1X@ */ ACSen_sEnvTempCor Lookup1D_X_FLOAT32_IEEE 0 ME11_CM_single_C 2 -40.0 80.0 /end AXIS_PTS
/begin CHARACTERISTIC cal_ACFanLevel7EnvCor_CUR "" CURVE 0x0000 /* @ECU_Address@cal_ACFanLevel7EnvCor_CUR@ */ Lookup1D_FLOAT32_IEEE 0 ME11_CM_single_percent_ -100.0 100.0
 /begin AXIS_DESCR COM_AXIS ACSen_sEnvTempCor ME11_CM_single_C 2 -40.0 80.0 AXIS_PTS_REF cal_ACFanLevel7EnvCor_1X /end AXIS_DESCR
/end CHARACTERISTIC
/begin AXIS_PTS cal_ACFanLevel7EnvCor_1X "" 0x0000 /* @ECU_Address@cal_ACFanLevel7EnvCor_1X@ */ ACSen_sEnvTempCor Lookup1D_X_FLOAT32_IEEE 0 ME11_CM_single_C 2 -40.0 80.0 /end AXIS_PTS
/begin CHARACTERISTIC cal_ACFanLevel8EnvCor_CUR "" CURVE 0x0000 /* @ECU_Address@cal_ACFanLevel8EnvCor_CUR@ */ Lookup1D_FLOAT32_IEEE 0 ME11_CM_single_percent_ -100.0 100.0
 /begin AXIS_DESCR COM_AXIS ACSen_sEnvTempCor ME11_CM_single_C 2 -40.0 80.0 AXIS_PTS_REF cal_ACFanLevel8EnvCor_1X /end AXIS_DESCR
/end CHARACTERISTIC
/begin AXIS_PTS cal_ACFanLevel8EnvCor_1X "" 0x0000 /* @ECU_Address@cal_ACFanLevel8EnvCor_1X@ */ ACSen_sEnvTempCor Lookup1D_X_FLOAT32_IEEE 0 ME11_CM_single_C 2 -40.0 80.0 /end AXIS_PTS
/begin CHARACTERISTIC cal_ACInletAutoDefogPrtEnvCor_CUR "" CURVE 0x0000 /* @ECU_Address@cal_ACInletAutoDefogPrtEnvCor_CUR@ */ Lookup1D_UBYTE 0 ME11_CM_uint8_percent_ 0.0 100.0
 /begin AXIS_DESCR COM_AXIS ACSen_sEnvTempCor ME11_CM_single_C 10 -40.0 100.0 AXIS_PTS_REF cal_ACInletAutoDefogPrtEnvCor_1X /end AXIS_DESCR
/end CHARACTERISTIC
/begin AXIS_PTS cal_ACInletAutoDefogPrtEnvCor_1X "" 0x0000 /* @ECU_Address@cal_ACInletAutoDefogPrtEnvCor_1X@ */ ACSen_sEnvTempCor Lookup1D_X_FLOAT32_IEEE 0 ME11_CM_single_C 10 -40.0 100.0 /end AXIS_PTS
/begin CHARACTERISTIC cal_ACInletDefogPrtEnvCor_CUR "" CURVE 0x0000 /* @ECU_Address@cal_ACInletDefogPrtEnvCor_CUR@ */ Lookup1D_UBYTE 0 ME11_CM_uint8_percent_ 0.0 100.0
 /begin AXIS_DESCR COM_AXIS ACSen_sEnvTempCor ME11_CM_single_C 10 -40.0 100.0 AXIS_PTS_REF cal_ACInletDefogPrtEnvCor_1X /end AXIS_DESCR
/end CHARACTERISTIC
/begin AXIS_PTS cal_ACInletDefogPrtEnvCor_1X "" 0x0000 /* @ECU_Address@cal_ACInletDefogPrtEnvCor_1X@ */ ACSen_sEnvTempCor Lookup1D_X_FLOAT32_IEEE 0 ME11_CM_single_C 10 -40.0 100.0 /end AXIS_PTS
/begin CHARACTERISTIC cal_ACInletDefogRiskCor_CUR "" CURVE 0x0000 /* @ECU_Address@cal_ACInletDefogRiskCor_CUR@ */ Lookup1D_UBYTE 0 ME11_CM_uint8_percent_ 0.0 100.0
 /begin AXIS_DESCR COM_AXIS NO_INPUT_QUANTITY ME11_CM_uint8_null 2 0.0 15.0 AXIS_PTS_REF cal_ACInletDefogRiskCor_1X /end AXIS_DESCR
/end CHARACTERISTIC
/begin AXIS_PTS cal_ACInletDefogRiskCor_1X "" 0x0000 /* @ECU_Address@cal_ACInletDefogRiskCor_1X@ */ NO_INPUT_QUANTITY Lookup1D_X_UBYTE 0 ME11_CM_uint8_null 2 0.0 15.0 /end AXIS_PTS
/begin CHARACTERISTIC cal_ACCabinPreSetByEnvECO_MAP "" MAP 0x0000 /* @ECU_Address@cal_ACCabinPreSetByEnvECO_MAP@ */ Lookup2D_FLOAT32_IEEE 0 ME11_CM_single_C -40.0 80.0
 /begin AXIS_DESCR COM_AXIS HMICtl_sLeftSetPoint ME11_CM_single_C 12 -40.0 80.0 AXIS_PTS_REF cal_ACCabinPreSetByEnvECO_2Y /end AXIS_DESCR
 /begin AXIS_DESCR COM_AXIS AC_tEnvInvent ME11_CM_single_C 12 -40.0 80.0 AXIS_PTS_REF cal_ACCabinPreSetByEnvECO_2X /end AXIS_DESCR
/end CHARACTERISTIC
/begin AXIS_PTS cal_ACCabinPreSetByEnvECO_2X "" 0x0000 /* @ECU_Address@cal_ACCabinPreSetByEnvECO_2X@ */ AC_tEnvInvent Lookup2D_X_FLOAT32_IEEE 0 ME11_CM_single_C 12 -40.0 80.0 /end AXIS_PTS
/begin AXIS_PTS cal_ACCabinPreSetByEnvECO_2Y "" 0x0000 /* @ECU_Address@cal_ACCabinPreSetByEnvECO_2Y@ */ HMICtl_sLeftSetPoint Lookup2D_X_FLOAT32_IEEE 0 ME11_CM_single_C 12 -40.0 80.0 /end AXIS_PTS
/begin CHARACTERISTIC cal_ACCabinPreSetByEnv_MAP "" MAP 0x0000 /* @ECU_Address@cal_ACCabinPreSetByEnv_MAP@ */ Lookup2D_FLOAT32_IEEE 0 ME11_CM_single_C -40.0 80.0
 /begin AXIS_DESCR COM_AXIS HMICtl_sLeftSetPoint ME11_CM_single_C 12 -40.0 80.0 AXIS_PTS_REF cal_ACCabinPreSetByEnv_2Y /end AXIS_DESCR
 /begin AXIS_DESCR COM_AXIS AC_tEnvInvent ME11_CM_single_C 12 -40.0 80.0 AXIS_PTS_REF cal_ACCabinPreSetByEnv_2X /end AXIS_DESCR
/end CHARACTERISTIC
/begin AXIS_PTS cal_ACCabinPreSetByEnv_2X "" 0x0000 /* @ECU_Address@cal_ACCabinPreSetByEnv_2X@ */ AC_tEnvInvent Lookup2D_X_FLOAT32_IEEE 0 ME11_CM_single_C 12 -40.0 80.0 /end AXIS_PTS
/begin AXIS_PTS cal_ACCabinPreSetByEnv_2Y "" 0x0000 /* @ECU_Address@cal_ACCabinPreSetByEnv_2Y@ */ HMICtl_sLeftSetPoint Lookup2D_X_FLOAT32_IEEE 0 ME11_CM_single_C 12 -40.0 80.0 /end AXIS_PTS
/begin CHARACTERISTIC cal_ACDVTPreSetByEnv_MAP "" MAP 0x0000 /* @ECU_Address@cal_ACDVTPreSetByEnv_MAP@ */ Lookup2D_FLOAT32_IEEE 0 ME11_CM_single_C -40.0 80.0
 /begin AXIS_DESCR COM_AXIS AC_tEnvInvent ME11_CM_single_C 10 -40.0 80.0 AXIS_PTS_REF cal_ACDVTPreSetByEnv_2Y /end AXIS_DESCR
 /begin AXIS_DESCR COM_AXIS ACCtl_tDesFrontCabin ME11_CM_single_C 10 -40.0 80.0 AXIS_PTS_REF cal_ACDVTPreSetByEnv_2X /end AXIS_DESCR
/end CHARACTERISTIC
/begin AXIS_PTS cal_ACDVTPreSetByEnv_2X "" 0x0000 /* @ECU_Address@cal_ACDVTPreSetByEnv_2X@ */ ACCtl_tDesFrontCabin Lookup2D_X_FLOAT32_IEEE 0 ME11_CM_single_C 10 -40.0 80.0 /end AXIS_PTS
/begin AXIS_PTS cal_ACDVTPreSetByEnv_2Y "" 0x0000 /* @ECU_Address@cal_ACDVTPreSetByEnv_2Y@ */ AC_tEnvInvent Lookup2D_X_FLOAT32_IEEE 0 ME11_CM_single_C 10 -40.0 80.0 /end AXIS_PTS
/begin CHARACTERISTIC cal_ACDVTPreSetEnvCor_CUR "" CURVE 0x0000 /* @ECU_Address@cal_ACDVTPreSetEnvCor_CUR@ */ Lookup1D_FLOAT32_IEEE 0 ME11_CM_single_C -40.0 80.0
 /begin AXIS_DESCR COM_AXIS AC_tEnvInvent ME11_CM_single_C 16 -40.0 80.0 AXIS_PTS_REF cal_ACDVTPreSetEnvCor_1X /end AXIS_DESCR
/end CHARACTERISTIC
/begin AXIS_PTS cal_ACDVTPreSetEnvCor_1X "" 0x0000 /* @ECU_Address@cal_ACDVTPreSetEnvCor_1X@ */ AC_tEnvInvent Lookup1D_X_FLOAT32_IEEE 0 ME11_CM_single_C 16 -40.0 80.0 /end AXIS_PTS
/begin CHARACTERISTIC cal_ACDVTPreSetSolarCorByVx_MAP "" MAP 0x0000 /* @ECU_Address@cal_ACDVTPreSetSolarCorByVx_MAP@ */ Lookup2D_FLOAT32_IEEE 0 ME11_CM_single_C -40.0 80.0
 /begin AXIS_DESCR COM_AXIS NO_INPUT_QUANTITY ME11_CM_single_km_per_h 6 -40.0 200.0 AXIS_PTS_REF cal_ACDVTPreSetSolarCorByVx_2Y /end AXIS_DESCR
 /begin AXIS_DESCR COM_AXIS AC_rSunloadFlt ME11_CM_uint16_w_per_m_2 6 0.0 1300.0 AXIS_PTS_REF cal_ACDVTPreSetSolarCorByVx_2X /end AXIS_DESCR
/end CHARACTERISTIC
/begin AXIS_PTS cal_ACDVTPreSetSolarCorByVx_2X "" 0x0000 /* @ECU_Address@cal_ACDVTPreSetSolarCorByVx_2X@ */ AC_rSunloadFlt Lookup2D_X_UWORD 0 ME11_CM_uint16_w_per_m_2 6 0.0 1300.0 /end AXIS_PTS
/begin AXIS_PTS cal_ACDVTPreSetSolarCorByVx_2Y "" 0x0000 /* @ECU_Address@cal_ACDVTPreSetSolarCorByVx_2Y@ */ NO_INPUT_QUANTITY Lookup2D_X_FLOAT32_IEEE 0 ME11_CM_single_km_per_h 6 -40.0 200.0 /end AXIS_PTS
/begin CHARACTERISTIC cal_ACDVTPreSetSolarCor_MAP "" MAP 0x0000 /* @ECU_Address@cal_ACDVTPreSetSolarCor_MAP@ */ Lookup2D_FLOAT32_IEEE 0 ME11_CM_single_C -40.0 80.0
 /begin AXIS_DESCR COM_AXIS AC_tEnvInvent ME11_CM_single_C 8 -40.0 80.0 AXIS_PTS_REF cal_ACDVTPreSetSolarCor_2Y /end AXIS_DESCR
 /begin AXIS_DESCR COM_AXIS AC_rSunloadFlt ME11_CM_uint16_w_per_m_2 8 0.0 1300.0 AXIS_PTS_REF cal_ACDVTPreSetSolarCor_2X /end AXIS_DESCR
/end CHARACTERISTIC
/begin AXIS_PTS cal_ACDVTPreSetSolarCor_2X "" 0x0000 /* @ECU_Address@cal_ACDVTPreSetSolarCor_2X@ */ AC_rSunloadFlt Lookup2D_X_UWORD 0 ME11_CM_uint16_w_per_m_2 8 0.0 1300.0 /end AXIS_PTS
/begin AXIS_PTS cal_ACDVTPreSetSolarCor_2Y "" 0x0000 /* @ECU_Address@cal_ACDVTPreSetSolarCor_2Y@ */ AC_tEnvInvent Lookup2D_X_FLOAT32_IEEE 0 ME11_CM_single_C 8 -40.0 80.0 /end AXIS_PTS
/begin CHARACTERISTIC cal_CabinDesTempSolarCorECO_MAP "" MAP 0x0000 /* @ECU_Address@cal_CabinDesTempSolarCorECO_MAP@ */ Lookup2D_FLOAT32_IEEE 0 ME11_CM_single_C -40.0 80.0
 /begin AXIS_DESCR COM_AXIS AC_tEnvInvent ME11_CM_single_C 14 -40.0 80.0 AXIS_PTS_REF cal_CabinDesTempSolarCorECO_2Y /end AXIS_DESCR
 /begin AXIS_DESCR COM_AXIS AC_rSunloadFlt ME11_CM_uint16_w_per_m_2 14 0.0 1300.0 AXIS_PTS_REF cal_CabinDesTempSolarCorECO_2X /end AXIS_DESCR
/end CHARACTERISTIC
/begin AXIS_PTS cal_CabinDesTempSolarCorECO_2X "" 0x0000 /* @ECU_Address@cal_CabinDesTempSolarCorECO_2X@ */ AC_rSunloadFlt Lookup2D_X_UWORD 0 ME11_CM_uint16_w_per_m_2 14 0.0 1300.0 /end AXIS_PTS
/begin AXIS_PTS cal_CabinDesTempSolarCorECO_2Y "" 0x0000 /* @ECU_Address@cal_CabinDesTempSolarCorECO_2Y@ */ AC_tEnvInvent Lookup2D_X_FLOAT32_IEEE 0 ME11_CM_single_C 14 -40.0 80.0 /end AXIS_PTS
/begin CHARACTERISTIC cal_CabinDesTempSolarCor_MAP "" MAP 0x0000 /* @ECU_Address@cal_CabinDesTempSolarCor_MAP@ */ Lookup2D_FLOAT32_IEEE 0 ME11_CM_single_C -40.0 80.0
 /begin AXIS_DESCR COM_AXIS AC_tEnvInvent ME11_CM_single_C 14 -40.0 80.0 AXIS_PTS_REF cal_CabinDesTempSolarCor_2Y /end AXIS_DESCR
 /begin AXIS_DESCR COM_AXIS AC_rSunloadFlt ME11_CM_uint16_w_per_m_2 14 0.0 1300.0 AXIS_PTS_REF cal_CabinDesTempSolarCor_2X /end AXIS_DESCR
/end CHARACTERISTIC
/begin AXIS_PTS cal_CabinDesTempSolarCor_2X "" 0x0000 /* @ECU_Address@cal_CabinDesTempSolarCor_2X@ */ AC_rSunloadFlt Lookup2D_X_UWORD 0 ME11_CM_uint16_w_per_m_2 14 0.0 1300.0 /end AXIS_PTS
/begin AXIS_PTS cal_CabinDesTempSolarCor_2Y "" 0x0000 /* @ECU_Address@cal_CabinDesTempSolarCor_2Y@ */ AC_tEnvInvent Lookup2D_X_FLOAT32_IEEE 0 ME11_CM_single_C 14 -40.0 80.0 /end AXIS_PTS
/begin CHARACTERISTIC cal_DrEvapDesFilterByDvt_CUR "" CURVE 0x0000 /* @ECU_Address@cal_DrEvapDesFilterByDvt_CUR@ */ Lookup1D_FLOAT32_IEEE 0 ME11_CM_single_C -40.0 80.0
 /begin AXIS_DESCR COM_AXIS ACCtl_tErrDrDVT2Duct ME11_CM_single_C 4 -40.0 80.0 AXIS_PTS_REF cal_DrEvapDesFilterByDvt_1X /end AXIS_DESCR
/end CHARACTERISTIC
/begin AXIS_PTS cal_DrEvapDesFilterByDvt_1X "" 0x0000 /* @ECU_Address@cal_DrEvapDesFilterByDvt_1X@ */ ACCtl_tErrDrDVT2Duct Lookup1D_X_FLOAT32_IEEE 0 ME11_CM_single_C 4 -40.0 80.0 /end AXIS_PTS
/begin CHARACTERISTIC cal_EvapBacTempDesACBi_CUR "" CURVE 0x0000 /* @ECU_Address@cal_EvapBacTempDesACBi_CUR@ */ Lookup1D_FLOAT32_IEEE 0 ME11_CM_single_C -40.0 80.0
 /begin AXIS_DESCR COM_AXIS ACCtl_tDrDVT ME11_CM_single_C 6 -40.0 80.0 AXIS_PTS_REF cal_EvapBacTempDesACBi_1X /end AXIS_DESCR
/end CHARACTERISTIC
/begin AXIS_PTS cal_EvapBacTempDesACBi_1X "" 0x0000 /* @ECU_Address@cal_EvapBacTempDesACBi_1X@ */ ACCtl_tDrDVT Lookup1D_X_FLOAT32_IEEE 0 ME11_CM_single_C 6 -40.0 80.0 /end AXIS_PTS
/begin CHARACTERISTIC cal_EvapBacTempDesAC_CUR "" CURVE 0x0000 /* @ECU_Address@cal_EvapBacTempDesAC_CUR@ */ Lookup1D_FLOAT32_IEEE 0 ME11_CM_single_C -40.0 80.0
 /begin AXIS_DESCR COM_AXIS ACCtl_tDrDVT ME11_CM_single_C 6 -40.0 80.0 AXIS_PTS_REF cal_EvapBacTempDesAC_1X /end AXIS_DESCR
/end CHARACTERISTIC
/begin AXIS_PTS cal_EvapBacTempDesAC_1X "" 0x0000 /* @ECU_Address@cal_EvapBacTempDesAC_1X@ */ ACCtl_tDrDVT Lookup1D_X_FLOAT32_IEEE 0 ME11_CM_single_C 6 -40.0 80.0 /end AXIS_PTS
/begin CHARACTERISTIC cal_EvapBacTempDesDefog_CUR "" CURVE 0x0000 /* @ECU_Address@cal_EvapBacTempDesDefog_CUR@ */ Lookup1D_FLOAT32_IEEE 0 ME11_CM_single_C -40.0 80.0
 /begin AXIS_DESCR COM_AXIS ACCtl_tDrDVT ME11_CM_single_C 6 -40.0 80.0 AXIS_PTS_REF cal_EvapBacTempDesDefog_1X /end AXIS_DESCR
/end CHARACTERISTIC
/begin AXIS_PTS cal_EvapBacTempDesDefog_1X "" 0x0000 /* @ECU_Address@cal_EvapBacTempDesDefog_1X@ */ ACCtl_tDrDVT Lookup1D_X_FLOAT32_IEEE 0 ME11_CM_single_C 6 -40.0 80.0 /end AXIS_PTS
/begin CHARACTERISTIC cal_EvapBacTempDesFootDe_CUR "" CURVE 0x0000 /* @ECU_Address@cal_EvapBacTempDesFootDe_CUR@ */ Lookup1D_FLOAT32_IEEE 0 ME11_CM_single_C -40.0 80.0
 /begin AXIS_DESCR COM_AXIS ACCtl_tDrDVT ME11_CM_single_C 6 -40.0 80.0 AXIS_PTS_REF cal_EvapBacTempDesFootDe_1X /end AXIS_DESCR
/end CHARACTERISTIC
/begin AXIS_PTS cal_EvapBacTempDesFootDe_1X "" 0x0000 /* @ECU_Address@cal_EvapBacTempDesFootDe_1X@ */ ACCtl_tDrDVT Lookup1D_X_FLOAT32_IEEE 0 ME11_CM_single_C 6 -40.0 80.0 /end AXIS_PTS
/begin CHARACTERISTIC cal_EvapBacTempDesFoot_CUR "" CURVE 0x0000 /* @ECU_Address@cal_EvapBacTempDesFoot_CUR@ */ Lookup1D_FLOAT32_IEEE 0 ME11_CM_single_C -40.0 80.0
 /begin AXIS_DESCR COM_AXIS ACCtl_tDrDVT ME11_CM_single_C 6 -40.0 80.0 AXIS_PTS_REF cal_EvapBacTempDesFoot_1X /end AXIS_DESCR
/end CHARACTERISTIC
/begin AXIS_PTS cal_EvapBacTempDesFoot_1X "" 0x0000 /* @ECU_Address@cal_EvapBacTempDesFoot_1X@ */ ACCtl_tDrDVT Lookup1D_X_FLOAT32_IEEE 0 ME11_CM_single_C 6 -40.0 80.0 /end AXIS_PTS
/begin CHARACTERISTIC cal_EvapDesTempCabinCor_CUR "" CURVE 0x0000 /* @ECU_Address@cal_EvapDesTempCabinCor_CUR@ */ Lookup1D_FLOAT32_IEEE 0 ME11_CM_single_C -40.0 80.0
 /begin AXIS_DESCR COM_AXIS GlbDa_tCabinInvent ME11_CM_single_C 6 -40.0 80.0 AXIS_PTS_REF cal_EvapDesTempCabinCor_1X /end AXIS_DESCR
/end CHARACTERISTIC
/begin AXIS_PTS cal_EvapDesTempCabinCor_1X "" 0x0000 /* @ECU_Address@cal_EvapDesTempCabinCor_1X@ */ GlbDa_tCabinInvent Lookup1D_X_FLOAT32_IEEE 0 ME11_CM_single_C 6 -40.0 80.0 /end AXIS_PTS
/begin CHARACTERISTIC cal_EvapDesTempEnvCor_MAP "" MAP 0x0000 /* @ECU_Address@cal_EvapDesTempEnvCor_MAP@ */ Lookup2D_FLOAT32_IEEE 0 ME11_CM_single_C -40.0 80.0
 /begin AXIS_DESCR COM_AXIS NO_INPUT_QUANTITY ME11_CM_single_km_per_h 6 -40.0 200.0 AXIS_PTS_REF cal_EvapDesTempEnvCor_2Y /end AXIS_DESCR
 /begin AXIS_DESCR COM_AXIS ACSen_sEnvTempCor ME11_CM_single_C 6 -40.0 80.0 AXIS_PTS_REF cal_EvapDesTempEnvCor_2X /end AXIS_DESCR
/end CHARACTERISTIC
/begin AXIS_PTS cal_EvapDesTempEnvCor_2X "" 0x0000 /* @ECU_Address@cal_EvapDesTempEnvCor_2X@ */ ACSen_sEnvTempCor Lookup2D_X_FLOAT32_IEEE 0 ME11_CM_single_C 6 -40.0 80.0 /end AXIS_PTS
/begin AXIS_PTS cal_EvapDesTempEnvCor_2Y "" 0x0000 /* @ECU_Address@cal_EvapDesTempEnvCor_2Y@ */ NO_INPUT_QUANTITY Lookup2D_X_FLOAT32_IEEE 0 ME11_CM_single_km_per_h 6 -40.0 200.0 /end AXIS_PTS
/begin CHARACTERISTIC cal_EvapDesTempFanCor_CUR "" CURVE 0x0000 /* @ECU_Address@cal_EvapDesTempFanCor_CUR@ */ Lookup1D_FLOAT32_IEEE 0 ME11_CM_single_C -40.0 80.0
 /begin AXIS_DESCR COM_AXIS NO_INPUT_QUANTITY ME11_CM_uint8_null 4 0.0 10.0 AXIS_PTS_REF cal_EvapDesTempFanCor_1X /end AXIS_DESCR
/end CHARACTERISTIC
/begin AXIS_PTS cal_EvapDesTempFanCor_1X "" 0x0000 /* @ECU_Address@cal_EvapDesTempFanCor_1X@ */ NO_INPUT_QUANTITY Lookup1D_X_UBYTE 0 ME11_CM_uint8_null 4 0.0 10.0 /end AXIS_PTS
/begin CHARACTERISTIC cal_PsEvapDesFilterByDvt_CUR "" CURVE 0x0000 /* @ECU_Address@cal_PsEvapDesFilterByDvt_CUR@ */ Lookup1D_FLOAT32_IEEE 0 ME11_CM_single_C -40.0 80.0
 /begin AXIS_DESCR COM_AXIS ACCtl_tErrPsDVT2Duct ME11_CM_single_C 4 -40.0 80.0 AXIS_PTS_REF cal_PsEvapDesFilterByDvt_1X /end AXIS_DESCR
/end CHARACTERISTIC
/begin AXIS_PTS cal_PsEvapDesFilterByDvt_1X "" 0x0000 /* @ECU_Address@cal_PsEvapDesFilterByDvt_1X@ */ ACCtl_tErrPsDVT2Duct Lookup1D_X_FLOAT32_IEEE 0 ME11_CM_single_C 4 -40.0 80.0 /end AXIS_PTS
/begin CHARACTERISTIC cal_EvapBacTempPsDesACBi_CUR "" CURVE 0x0000 /* @ECU_Address@cal_EvapBacTempPsDesACBi_CUR@ */ Lookup1D_FLOAT32_IEEE 0 ME11_CM_single_C -40.0 80.0
 /begin AXIS_DESCR COM_AXIS ACCtl_tPsDVT ME11_CM_single_C 6 -40.0 80.0 AXIS_PTS_REF cal_EvapBacTempPsDesACBi_1X /end AXIS_DESCR
/end CHARACTERISTIC
/begin AXIS_PTS cal_EvapBacTempPsDesACBi_1X "" 0x0000 /* @ECU_Address@cal_EvapBacTempPsDesACBi_1X@ */ ACCtl_tPsDVT Lookup1D_X_FLOAT32_IEEE 0 ME11_CM_single_C 6 -40.0 80.0 /end AXIS_PTS
/begin CHARACTERISTIC cal_EvapBacTempPsDesAC_CUR "" CURVE 0x0000 /* @ECU_Address@cal_EvapBacTempPsDesAC_CUR@ */ Lookup1D_FLOAT32_IEEE 0 ME11_CM_single_C -40.0 80.0
 /begin AXIS_DESCR COM_AXIS ACCtl_tPsDVT ME11_CM_single_C 6 -40.0 80.0 AXIS_PTS_REF cal_EvapBacTempPsDesAC_1X /end AXIS_DESCR
/end CHARACTERISTIC
/begin AXIS_PTS cal_EvapBacTempPsDesAC_1X "" 0x0000 /* @ECU_Address@cal_EvapBacTempPsDesAC_1X@ */ ACCtl_tPsDVT Lookup1D_X_FLOAT32_IEEE 0 ME11_CM_single_C 6 -40.0 80.0 /end AXIS_PTS
/begin CHARACTERISTIC cal_EvapBacTempPsDesDefog_CUR "" CURVE 0x0000 /* @ECU_Address@cal_EvapBacTempPsDesDefog_CUR@ */ Lookup1D_FLOAT32_IEEE 0 ME11_CM_single_C -40.0 80.0
 /begin AXIS_DESCR COM_AXIS ACCtl_tPsDVT ME11_CM_single_C 6 -40.0 80.0 AXIS_PTS_REF cal_EvapBacTempPsDesDefog_1X /end AXIS_DESCR
/end CHARACTERISTIC
/begin AXIS_PTS cal_EvapBacTempPsDesDefog_1X "" 0x0000 /* @ECU_Address@cal_EvapBacTempPsDesDefog_1X@ */ ACCtl_tPsDVT Lookup1D_X_FLOAT32_IEEE 0 ME11_CM_single_C 6 -40.0 80.0 /end AXIS_PTS
/begin CHARACTERISTIC cal_EvapBacTempPsDesFootDe_CUR "" CURVE 0x0000 /* @ECU_Address@cal_EvapBacTempPsDesFootDe_CUR@ */ Lookup1D_FLOAT32_IEEE 0 ME11_CM_single_C -40.0 80.0
 /begin AXIS_DESCR COM_AXIS ACCtl_tPsDVT ME11_CM_single_C 6 -40.0 80.0 AXIS_PTS_REF cal_EvapBacTempPsDesFootDe_1X /end AXIS_DESCR
/end CHARACTERISTIC
/begin AXIS_PTS cal_EvapBacTempPsDesFootDe_1X "" 0x0000 /* @ECU_Address@cal_EvapBacTempPsDesFootDe_1X@ */ ACCtl_tPsDVT Lookup1D_X_FLOAT32_IEEE 0 ME11_CM_single_C 6 -40.0 80.0 /end AXIS_PTS
/begin CHARACTERISTIC cal_EvapBacTempPsDesFoot_CUR "" CURVE 0x0000 /* @ECU_Address@cal_EvapBacTempPsDesFoot_CUR@ */ Lookup1D_FLOAT32_IEEE 0 ME11_CM_single_C -40.0 80.0
 /begin AXIS_DESCR COM_AXIS ACCtl_tPsDVT ME11_CM_single_C 6 -40.0 80.0 AXIS_PTS_REF cal_EvapBacTempPsDesFoot_1X /end AXIS_DESCR
/end CHARACTERISTIC
/begin AXIS_PTS cal_EvapBacTempPsDesFoot_1X "" 0x0000 /* @ECU_Address@cal_EvapBacTempPsDesFoot_1X@ */ ACCtl_tPsDVT Lookup1D_X_FLOAT32_IEEE 0 ME11_CM_single_C 6 -40.0 80.0 /end AXIS_PTS
/begin CHARACTERISTIC cal_EvapDesTempPsCabinCor_CUR "" CURVE 0x0000 /* @ECU_Address@cal_EvapDesTempPsCabinCor_CUR@ */ Lookup1D_FLOAT32_IEEE 0 ME11_CM_single_C -40.0 80.0
 /begin AXIS_DESCR COM_AXIS GlbDa_tCabinInvent ME11_CM_single_C 6 -40.0 80.0 AXIS_PTS_REF cal_EvapDesTempPsCabinCor_1X /end AXIS_DESCR
/end CHARACTERISTIC
/begin AXIS_PTS cal_EvapDesTempPsCabinCor_1X "" 0x0000 /* @ECU_Address@cal_EvapDesTempPsCabinCor_1X@ */ GlbDa_tCabinInvent Lookup1D_X_FLOAT32_IEEE 0 ME11_CM_single_C 6 -40.0 80.0 /end AXIS_PTS
/begin CHARACTERISTIC cal_EvapDesTempPsEnvCor_MAP "" MAP 0x0000 /* @ECU_Address@cal_EvapDesTempPsEnvCor_MAP@ */ Lookup2D_FLOAT32_IEEE 0 ME11_CM_single_C -40.0 80.0
 /begin AXIS_DESCR COM_AXIS NO_INPUT_QUANTITY ME11_CM_single_km_per_h 6 -40.0 200.0 AXIS_PTS_REF cal_EvapDesTempPsEnvCor_2Y /end AXIS_DESCR
 /begin AXIS_DESCR COM_AXIS ACSen_sEnvTempCor ME11_CM_single_C 6 -40.0 80.0 AXIS_PTS_REF cal_EvapDesTempPsEnvCor_2X /end AXIS_DESCR
/end CHARACTERISTIC
/begin AXIS_PTS cal_EvapDesTempPsEnvCor_2X "" 0x0000 /* @ECU_Address@cal_EvapDesTempPsEnvCor_2X@ */ ACSen_sEnvTempCor Lookup2D_X_FLOAT32_IEEE 0 ME11_CM_single_C 6 -40.0 80.0 /end AXIS_PTS
/begin AXIS_PTS cal_EvapDesTempPsEnvCor_2Y "" 0x0000 /* @ECU_Address@cal_EvapDesTempPsEnvCor_2Y@ */ NO_INPUT_QUANTITY Lookup2D_X_FLOAT32_IEEE 0 ME11_CM_single_km_per_h 6 -40.0 200.0 /end AXIS_PTS
/begin CHARACTERISTIC cal_EvapDesTempPsFanCor_CUR "" CURVE 0x0000 /* @ECU_Address@cal_EvapDesTempPsFanCor_CUR@ */ Lookup1D_FLOAT32_IEEE 0 ME11_CM_single_C -40.0 80.0
 /begin AXIS_DESCR COM_AXIS NO_INPUT_QUANTITY ME11_CM_uint8_null 4 0.0 10.0 AXIS_PTS_REF cal_EvapDesTempPsFanCor_1X /end AXIS_DESCR
/end CHARACTERISTIC
/begin AXIS_PTS cal_EvapDesTempPsFanCor_1X "" 0x0000 /* @ECU_Address@cal_EvapDesTempPsFanCor_1X@ */ NO_INPUT_QUANTITY Lookup1D_X_UBYTE 0 ME11_CM_uint8_null 4 0.0 10.0 /end AXIS_PTS
/begin CHARACTERISTIC cal_ACPTCDesBacAC_CUR "" CURVE 0x0000 /* @ECU_Address@cal_ACPTCDesBacAC_CUR@ */ Lookup1D_FLOAT32_IEEE 0 ME11_CM_single_C -40.0 80.0
 /begin AXIS_DESCR COM_AXIS ACCtl_tDrDVT ME11_CM_single_C 12 -40.0 100.0 AXIS_PTS_REF cal_ACPTCDesBacAC_1X /end AXIS_DESCR
/end CHARACTERISTIC
/begin AXIS_PTS cal_ACPTCDesBacAC_1X "" 0x0000 /* @ECU_Address@cal_ACPTCDesBacAC_1X@ */ ACCtl_tDrDVT Lookup1D_X_FLOAT32_IEEE 0 ME11_CM_single_C 12 -40.0 100.0 /end AXIS_PTS
/begin CHARACTERISTIC cal_ACPTCDesBacBi_CUR "" CURVE 0x0000 /* @ECU_Address@cal_ACPTCDesBacBi_CUR@ */ Lookup1D_FLOAT32_IEEE 0 ME11_CM_single_C -40.0 80.0
 /begin AXIS_DESCR COM_AXIS ACCtl_tDrDVT ME11_CM_single_C 12 -40.0 100.0 AXIS_PTS_REF cal_ACPTCDesBacBi_1X /end AXIS_DESCR
/end CHARACTERISTIC
/begin AXIS_PTS cal_ACPTCDesBacBi_1X "" 0x0000 /* @ECU_Address@cal_ACPTCDesBacBi_1X@ */ ACCtl_tDrDVT Lookup1D_X_FLOAT32_IEEE 0 ME11_CM_single_C 12 -40.0 100.0 /end AXIS_PTS
/begin CHARACTERISTIC cal_ACPTCDesBacDefog_CUR "" CURVE 0x0000 /* @ECU_Address@cal_ACPTCDesBacDefog_CUR@ */ Lookup1D_FLOAT32_IEEE 0 ME11_CM_single_C -40.0 80.0
 /begin AXIS_DESCR COM_AXIS ACCtl_tDrDVT ME11_CM_single_C 12 -40.0 100.0 AXIS_PTS_REF cal_ACPTCDesBacDefog_1X /end AXIS_DESCR
/end CHARACTERISTIC
/begin AXIS_PTS cal_ACPTCDesBacDefog_1X "" 0x0000 /* @ECU_Address@cal_ACPTCDesBacDefog_1X@ */ ACCtl_tDrDVT Lookup1D_X_FLOAT32_IEEE 0 ME11_CM_single_C 12 -40.0 100.0 /end AXIS_PTS
/begin CHARACTERISTIC cal_ACPTCDesBacFootDe_CUR "" CURVE 0x0000 /* @ECU_Address@cal_ACPTCDesBacFootDe_CUR@ */ Lookup1D_FLOAT32_IEEE 0 ME11_CM_single_C -40.0 80.0
 /begin AXIS_DESCR COM_AXIS ACCtl_tDrDVT ME11_CM_single_C 12 -40.0 100.0 AXIS_PTS_REF cal_ACPTCDesBacFootDe_1X /end AXIS_DESCR
/end CHARACTERISTIC
/begin AXIS_PTS cal_ACPTCDesBacFootDe_1X "" 0x0000 /* @ECU_Address@cal_ACPTCDesBacFootDe_1X@ */ ACCtl_tDrDVT Lookup1D_X_FLOAT32_IEEE 0 ME11_CM_single_C 12 -40.0 100.0 /end AXIS_PTS
/begin CHARACTERISTIC cal_ACPTCDesBacFoot_CUR "" CURVE 0x0000 /* @ECU_Address@cal_ACPTCDesBacFoot_CUR@ */ Lookup1D_FLOAT32_IEEE 0 ME11_CM_single_C -40.0 80.0
 /begin AXIS_DESCR COM_AXIS ACCtl_tDrDVT ME11_CM_single_C 12 -40.0 100.0 AXIS_PTS_REF cal_ACPTCDesBacFoot_1X /end AXIS_DESCR
/end CHARACTERISTIC
/begin AXIS_PTS cal_ACPTCDesBacFoot_1X "" 0x0000 /* @ECU_Address@cal_ACPTCDesBacFoot_1X@ */ ACCtl_tDrDVT Lookup1D_X_FLOAT32_IEEE 0 ME11_CM_single_C 12 -40.0 100.0 /end AXIS_PTS
/begin CHARACTERISTIC cal_ACPTCDesCabinCor_CUR "" CURVE 0x0000 /* @ECU_Address@cal_ACPTCDesCabinCor_CUR@ */ Lookup1D_FLOAT32_IEEE 0 ME11_CM_single_C -40.0 80.0
 /begin AXIS_DESCR COM_AXIS GlbDa_tCabinInvent ME11_CM_single_C 8 -40.0 80.0 AXIS_PTS_REF cal_ACPTCDesCabinCor_1X /end AXIS_DESCR
/end CHARACTERISTIC
/begin AXIS_PTS cal_ACPTCDesCabinCor_1X "" 0x0000 /* @ECU_Address@cal_ACPTCDesCabinCor_1X@ */ GlbDa_tCabinInvent Lookup1D_X_FLOAT32_IEEE 0 ME11_CM_single_C 8 -40.0 80.0 /end AXIS_PTS
/begin CHARACTERISTIC cal_ACPTCDesEnvCor_MAP "" MAP 0x0000 /* @ECU_Address@cal_ACPTCDesEnvCor_MAP@ */ Lookup2D_FLOAT32_IEEE 0 ME11_CM_single_C -40.0 80.0
 /begin AXIS_DESCR COM_AXIS NO_INPUT_QUANTITY ME11_CM_single_km_per_h 6 -40.0 200.0 AXIS_PTS_REF cal_ACPTCDesEnvCor_2Y /end AXIS_DESCR
 /begin AXIS_DESCR COM_AXIS ACSen_sEnvTempCor ME11_CM_single_C 6 -40.0 80.0 AXIS_PTS_REF cal_ACPTCDesEnvCor_2X /end AXIS_DESCR
/end CHARACTERISTIC
/begin AXIS_PTS cal_ACPTCDesEnvCor_2X "" 0x0000 /* @ECU_Address@cal_ACPTCDesEnvCor_2X@ */ ACSen_sEnvTempCor Lookup2D_X_FLOAT32_IEEE 0 ME11_CM_single_C 6 -40.0 80.0 /end AXIS_PTS
/begin AXIS_PTS cal_ACPTCDesEnvCor_2Y "" 0x0000 /* @ECU_Address@cal_ACPTCDesEnvCor_2Y@ */ NO_INPUT_QUANTITY Lookup2D_X_FLOAT32_IEEE 0 ME11_CM_single_km_per_h 6 -40.0 200.0 /end AXIS_PTS
/begin CHARACTERISTIC cal_ACPTCDesFanCor_CUR "" CURVE 0x0000 /* @ECU_Address@cal_ACPTCDesFanCor_CUR@ */ Lookup1D_FLOAT32_IEEE 0 ME11_CM_single_C -40.0 80.0
 /begin AXIS_DESCR COM_AXIS NO_INPUT_QUANTITY ME11_CM_uint8_null 4 0.0 10.0 AXIS_PTS_REF cal_ACPTCDesFanCor_1X /end AXIS_DESCR
/end CHARACTERISTIC
/begin AXIS_PTS cal_ACPTCDesFanCor_1X "" 0x0000 /* @ECU_Address@cal_ACPTCDesFanCor_1X@ */ NO_INPUT_QUANTITY Lookup1D_X_UBYTE 0 ME11_CM_uint8_null 4 0.0 10.0 /end AXIS_PTS
/begin CHARACTERISTIC cal_ACPTCPsDesBacAC_CUR "" CURVE 0x0000 /* @ECU_Address@cal_ACPTCPsDesBacAC_CUR@ */ Lookup1D_FLOAT32_IEEE 0 ME11_CM_single_C -40.0 100.0
 /begin AXIS_DESCR COM_AXIS ACCtl_tPsDVT ME11_CM_single_C 12 -40.0 100.0 AXIS_PTS_REF cal_ACPTCPsDesBacAC_1X /end AXIS_DESCR
/end CHARACTERISTIC
/begin AXIS_PTS cal_ACPTCPsDesBacAC_1X "" 0x0000 /* @ECU_Address@cal_ACPTCPsDesBacAC_1X@ */ ACCtl_tPsDVT Lookup1D_X_FLOAT32_IEEE 0 ME11_CM_single_C 12 -40.0 100.0 /end AXIS_PTS
/begin CHARACTERISTIC cal_ACPTCPsDesBacBi_CUR "" CURVE 0x0000 /* @ECU_Address@cal_ACPTCPsDesBacBi_CUR@ */ Lookup1D_FLOAT32_IEEE 0 ME11_CM_single_C -40.0 100.0
 /begin AXIS_DESCR COM_AXIS ACCtl_tPsDVT ME11_CM_single_C 12 -40.0 100.0 AXIS_PTS_REF cal_ACPTCPsDesBacBi_1X /end AXIS_DESCR
/end CHARACTERISTIC
/begin AXIS_PTS cal_ACPTCPsDesBacBi_1X "" 0x0000 /* @ECU_Address@cal_ACPTCPsDesBacBi_1X@ */ ACCtl_tPsDVT Lookup1D_X_FLOAT32_IEEE 0 ME11_CM_single_C 12 -40.0 100.0 /end AXIS_PTS
/begin CHARACTERISTIC cal_ACPTCPsDesBacDefog_CUR "" CURVE 0x0000 /* @ECU_Address@cal_ACPTCPsDesBacDefog_CUR@ */ Lookup1D_FLOAT32_IEEE 0 ME11_CM_single_C -40.0 100.0
 /begin AXIS_DESCR COM_AXIS ACCtl_tPsDVT ME11_CM_single_C 12 -40.0 100.0 AXIS_PTS_REF cal_ACPTCPsDesBacDefog_1X /end AXIS_DESCR
/end CHARACTERISTIC
/begin AXIS_PTS cal_ACPTCPsDesBacDefog_1X "" 0x0000 /* @ECU_Address@cal_ACPTCPsDesBacDefog_1X@ */ ACCtl_tPsDVT Lookup1D_X_FLOAT32_IEEE 0 ME11_CM_single_C 12 -40.0 100.0 /end AXIS_PTS
/begin CHARACTERISTIC cal_ACPTCPsDesBacFootDe_CUR "" CURVE 0x0000 /* @ECU_Address@cal_ACPTCPsDesBacFootDe_CUR@ */ Lookup1D_FLOAT32_IEEE 0 ME11_CM_single_C -40.0 100.0
 /begin AXIS_DESCR COM_AXIS ACCtl_tPsDVT ME11_CM_single_C 12 -40.0 100.0 AXIS_PTS_REF cal_ACPTCPsDesBacFootDe_1X /end AXIS_DESCR
/end CHARACTERISTIC
/begin AXIS_PTS cal_ACPTCPsDesBacFootDe_1X "" 0x0000 /* @ECU_Address@cal_ACPTCPsDesBacFootDe_1X@ */ ACCtl_tPsDVT Lookup1D_X_FLOAT32_IEEE 0 ME11_CM_single_C 12 -40.0 100.0 /end AXIS_PTS
/begin CHARACTERISTIC cal_ACPTCPsDesBacFoot_CUR "" CURVE 0x0000 /* @ECU_Address@cal_ACPTCPsDesBacFoot_CUR@ */ Lookup1D_FLOAT32_IEEE 0 ME11_CM_single_C -40.0 100.0
 /begin AXIS_DESCR COM_AXIS ACCtl_tPsDVT ME11_CM_single_C 12 -40.0 100.0 AXIS_PTS_REF cal_ACPTCPsDesBacFoot_1X /end AXIS_DESCR
/end CHARACTERISTIC
/begin AXIS_PTS cal_ACPTCPsDesBacFoot_1X "" 0x0000 /* @ECU_Address@cal_ACPTCPsDesBacFoot_1X@ */ ACCtl_tPsDVT Lookup1D_X_FLOAT32_IEEE 0 ME11_CM_single_C 12 -40.0 100.0 /end AXIS_PTS
/begin CHARACTERISTIC cal_ACPTCPsDesCabinCor_CUR "" CURVE 0x0000 /* @ECU_Address@cal_ACPTCPsDesCabinCor_CUR@ */ Lookup1D_FLOAT32_IEEE 0 ME11_CM_single_C -40.0 100.0
 /begin AXIS_DESCR COM_AXIS GlbDa_tCabinInvent ME11_CM_single_C 8 -40.0 100.0 AXIS_PTS_REF cal_ACPTCPsDesCabinCor_1X /end AXIS_DESCR
/end CHARACTERISTIC
/begin AXIS_PTS cal_ACPTCPsDesCabinCor_1X "" 0x0000 /* @ECU_Address@cal_ACPTCPsDesCabinCor_1X@ */ GlbDa_tCabinInvent Lookup1D_X_FLOAT32_IEEE 0 ME11_CM_single_C 8 -40.0 100.0 /end AXIS_PTS
/begin CHARACTERISTIC cal_ACPTCPsDesEnvCor_MAP "" MAP 0x0000 /* @ECU_Address@cal_ACPTCPsDesEnvCor_MAP@ */ Lookup2D_FLOAT32_IEEE 0 ME11_CM_single_C -40.0 80.0
 /begin AXIS_DESCR COM_AXIS NO_INPUT_QUANTITY ME11_CM_single_km_per_h 6 -40.0 200.0 AXIS_PTS_REF cal_ACPTCPsDesEnvCor_2Y /end AXIS_DESCR
 /begin AXIS_DESCR COM_AXIS ACSen_sEnvTempCor ME11_CM_single_C 6 -40.0 80.0 AXIS_PTS_REF cal_ACPTCPsDesEnvCor_2X /end AXIS_DESCR
/end CHARACTERISTIC
/begin AXIS_PTS cal_ACPTCPsDesEnvCor_2X "" 0x0000 /* @ECU_Address@cal_ACPTCPsDesEnvCor_2X@ */ ACSen_sEnvTempCor Lookup2D_X_FLOAT32_IEEE 0 ME11_CM_single_C 6 -40.0 80.0 /end AXIS_PTS
/begin AXIS_PTS cal_ACPTCPsDesEnvCor_2Y "" 0x0000 /* @ECU_Address@cal_ACPTCPsDesEnvCor_2Y@ */ NO_INPUT_QUANTITY Lookup2D_X_FLOAT32_IEEE 0 ME11_CM_single_km_per_h 6 -40.0 200.0 /end AXIS_PTS
/begin CHARACTERISTIC cal_ACPTCPsDesFanCor_CUR "" CURVE 0x0000 /* @ECU_Address@cal_ACPTCPsDesFanCor_CUR@ */ Lookup1D_FLOAT32_IEEE 0 ME11_CM_single_C -40.0 80.0
 /begin AXIS_DESCR COM_AXIS NO_INPUT_QUANTITY ME11_CM_uint8_null 4 0.0 10.0 AXIS_PTS_REF cal_ACPTCPsDesFanCor_1X /end AXIS_DESCR
/end CHARACTERISTIC
/begin AXIS_PTS cal_ACPTCPsDesFanCor_1X "" 0x0000 /* @ECU_Address@cal_ACPTCPsDesFanCor_1X@ */ NO_INPUT_QUANTITY Lookup1D_X_UBYTE 0 ME11_CM_uint8_null 4 0.0 10.0 /end AXIS_PTS
/begin CHARACTERISTIC cal_RFace2FaceFloorByEnv_CUR "" CURVE 0x0000 /* @ECU_Address@cal_RFace2FaceFloorByEnv_CUR@ */ Lookup1D_FLOAT32_IEEE 0 ME11_CM_single_C -40.0 80.0
 /begin AXIS_DESCR COM_AXIS ACSen_sEnvTempCor ME11_CM_single_C 14 -40.0 80.0 AXIS_PTS_REF cal_RFace2FaceFloorByEnv_1X /end AXIS_DESCR
/end CHARACTERISTIC
/begin AXIS_PTS cal_RFace2FaceFloorByEnv_1X "" 0x0000 /* @ECU_Address@cal_RFace2FaceFloorByEnv_1X@ */ ACSen_sEnvTempCor Lookup1D_X_FLOAT32_IEEE 0 ME11_CM_single_C 14 -40.0 80.0 /end AXIS_PTS
/begin CHARACTERISTIC cal_RFaceFloor2FaceByEnv_CUR "" CURVE 0x0000 /* @ECU_Address@cal_RFaceFloor2FaceByEnv_CUR@ */ Lookup1D_FLOAT32_IEEE 0 ME11_CM_single_C -40.0 80.0
 /begin AXIS_DESCR COM_AXIS ACSen_sEnvTempCor ME11_CM_single_C 14 -40.0 80.0 AXIS_PTS_REF cal_RFaceFloor2FaceByEnv_1X /end AXIS_DESCR
/end CHARACTERISTIC
/begin AXIS_PTS cal_RFaceFloor2FaceByEnv_1X "" 0x0000 /* @ECU_Address@cal_RFaceFloor2FaceByEnv_1X@ */ ACSen_sEnvTempCor Lookup1D_X_FLOAT32_IEEE 0 ME11_CM_single_C 14 -40.0 80.0 /end AXIS_PTS
/begin CHARACTERISTIC cal_RFaceFloor2FloorByEnv_CUR "" CURVE 0x0000 /* @ECU_Address@cal_RFaceFloor2FloorByEnv_CUR@ */ Lookup1D_FLOAT32_IEEE 0 ME11_CM_single_C -40.0 80.0
 /begin AXIS_DESCR COM_AXIS ACSen_sEnvTempCor ME11_CM_single_C 14 -40.0 80.0 AXIS_PTS_REF cal_RFaceFloor2FloorByEnv_1X /end AXIS_DESCR
/end CHARACTERISTIC
/begin AXIS_PTS cal_RFaceFloor2FloorByEnv_1X "" 0x0000 /* @ECU_Address@cal_RFaceFloor2FloorByEnv_1X@ */ ACSen_sEnvTempCor Lookup1D_X_FLOAT32_IEEE 0 ME11_CM_single_C 14 -40.0 80.0 /end AXIS_PTS
/begin CHARACTERISTIC cal_RFloor2FaceFloorByEnv_CUR "" CURVE 0x0000 /* @ECU_Address@cal_RFloor2FaceFloorByEnv_CUR@ */ Lookup1D_FLOAT32_IEEE 0 ME11_CM_single_C -40.0 80.0
 /begin AXIS_DESCR COM_AXIS ACSen_sEnvTempCor ME11_CM_single_C 14 -40.0 80.0 AXIS_PTS_REF cal_RFloor2FaceFloorByEnv_1X /end AXIS_DESCR
/end CHARACTERISTIC
/begin AXIS_PTS cal_RFloor2FaceFloorByEnv_1X "" 0x0000 /* @ECU_Address@cal_RFloor2FaceFloorByEnv_1X@ */ ACSen_sEnvTempCor Lookup1D_X_FLOAT32_IEEE 0 ME11_CM_single_C 14 -40.0 80.0 /end AXIS_PTS
/begin CHARACTERISTIC cal_DvtDesLmtByCabinTDiff_MAP "" MAP 0x0000 /* @ECU_Address@cal_DvtDesLmtByCabinTDiff_MAP@ */ Lookup2D_FLOAT32_IEEE 0 ME11_CM_single_C -40.0 100.0
 /begin AXIS_DESCR COM_AXIS ACSen_sEnvTempCor ME11_CM_single_C 10 -40.0 80.0 AXIS_PTS_REF cal_DvtDesLmtByCabinTDiff_2Y /end AXIS_DESCR
 /begin AXIS_DESCR COM_AXIS NO_INPUT_QUANTITY ME11_CM_single_C 10 -40.0 80.0 AXIS_PTS_REF cal_DvtDesLmtByCabinTDiff_2X /end AXIS_DESCR
/end CHARACTERISTIC
/begin AXIS_PTS cal_DvtDesLmtByCabinTDiff_2X "" 0x0000 /* @ECU_Address@cal_DvtDesLmtByCabinTDiff_2X@ */ NO_INPUT_QUANTITY Lookup2D_X_FLOAT32_IEEE 0 ME11_CM_single_C 10 -40.0 80.0 /end AXIS_PTS
/begin AXIS_PTS cal_DvtDesLmtByCabinTDiff_2Y "" 0x0000 /* @ECU_Address@cal_DvtDesLmtByCabinTDiff_2Y@ */ ACSen_sEnvTempCor Lookup2D_X_FLOAT32_IEEE 0 ME11_CM_single_C 10 -40.0 80.0 /end AXIS_PTS
/begin CHARACTERISTIC cal_DvtDesValPIDKi_CUR "" CURVE 0x0000 /* @ECU_Address@cal_DvtDesValPIDKi_CUR@ */ Lookup1D_FLOAT32_IEEE 0 ME11_CM_single_null 0.0 100.0
 /begin AXIS_DESCR COM_AXIS NO_INPUT_QUANTITY ME11_CM_single_C 9 -40.0 100.0 AXIS_PTS_REF cal_DvtDesValPIDKi_1X /end AXIS_DESCR
/end CHARACTERISTIC
/begin AXIS_PTS cal_DvtDesValPIDKi_1X "" 0x0000 /* @ECU_Address@cal_DvtDesValPIDKi_1X@ */ NO_INPUT_QUANTITY Lookup1D_X_FLOAT32_IEEE 0 ME11_CM_single_C 9 -40.0 100.0 /end AXIS_PTS
/begin CHARACTERISTIC cal_DvtDesValPIDKp_CUR "" CURVE 0x0000 /* @ECU_Address@cal_DvtDesValPIDKp_CUR@ */ Lookup1D_FLOAT32_IEEE 0 ME11_CM_single_null 0.0 100.0
 /begin AXIS_DESCR COM_AXIS NO_INPUT_QUANTITY ME11_CM_single_C 9 -40.0 100.0 AXIS_PTS_REF cal_DvtDesValPIDKp_1X /end AXIS_DESCR
/end CHARACTERISTIC
/begin AXIS_PTS cal_DvtDesValPIDKp_1X "" 0x0000 /* @ECU_Address@cal_DvtDesValPIDKp_1X@ */ NO_INPUT_QUANTITY Lookup1D_X_FLOAT32_IEEE 0 ME11_CM_single_C 9 -40.0 100.0 /end AXIS_PTS
/begin CHARACTERISTIC cal_DvtDesIsumMaxByCabinTDiff_CUR "" CURVE 0x0000 /* @ECU_Address@cal_DvtDesIsumMaxByCabinTDiff_CUR@ */ Lookup1D_FLOAT32_IEEE 0 ME11_CM_single_C -40.0 80.0
 /begin AXIS_DESCR COM_AXIS NO_INPUT_QUANTITY ME11_CM_single_C 8 -40.0 80.0 AXIS_PTS_REF cal_DvtDesIsumMaxByCabinTDiff_1X /end AXIS_DESCR
/end CHARACTERISTIC
/begin AXIS_PTS cal_DvtDesIsumMaxByCabinTDiff_1X "" 0x0000 /* @ECU_Address@cal_DvtDesIsumMaxByCabinTDiff_1X@ */ NO_INPUT_QUANTITY Lookup1D_X_FLOAT32_IEEE 0 ME11_CM_single_C 8 -40.0 80.0 /end AXIS_PTS
/begin CHARACTERISTIC cal_DvtDesIsumMinByCabinTDiff_CUR "" CURVE 0x0000 /* @ECU_Address@cal_DvtDesIsumMinByCabinTDiff_CUR@ */ Lookup1D_FLOAT32_IEEE 0 ME11_CM_single_C -40.0 80.0
 /begin AXIS_DESCR COM_AXIS NO_INPUT_QUANTITY ME11_CM_single_C 8 -40.0 80.0 AXIS_PTS_REF cal_DvtDesIsumMinByCabinTDiff_1X /end AXIS_DESCR
/end CHARACTERISTIC
/begin AXIS_PTS cal_DvtDesIsumMinByCabinTDiff_1X "" 0x0000 /* @ECU_Address@cal_DvtDesIsumMinByCabinTDiff_1X@ */ NO_INPUT_QUANTITY Lookup1D_X_FLOAT32_IEEE 0 ME11_CM_single_C 8 -40.0 80.0 /end AXIS_PTS
/begin CHARACTERISTIC cal_ACFanSpdBatCor_CUR "" CURVE 0x0000 /* @ECU_Address@cal_ACFanSpdBatCor_CUR@ */ Lookup1D_FLOAT32_IEEE 0 ME11_CM_single_percent_ -100.0 100.0
 /begin AXIS_DESCR COM_AXIS GlbDa_uBat ME11_CM_single_v 3 0.0 20.0 AXIS_PTS_REF cal_ACFanSpdBatCor_1X /end AXIS_DESCR
/end CHARACTERISTIC
/begin AXIS_PTS cal_ACFanSpdBatCor_1X "" 0x0000 /* @ECU_Address@cal_ACFanSpdBatCor_1X@ */ GlbDa_uBat Lookup1D_X_FLOAT32_IEEE 0 ME11_CM_single_v 3 0.0 20.0 /end AXIS_PTS
/begin CHARACTERISTIC cal_ACFanSpdDvtSet_CUR "" CURVE 0x0000 /* @ECU_Address@cal_ACFanSpdDvtSet_CUR@ */ Lookup1D_FLOAT32_IEEE 0 ME11_CM_single_percent_ -100.0 100.0
 /begin AXIS_DESCR COM_AXIS ACCtl_tDVTFlt ME11_CM_single_C 14 -40.0 80.0 AXIS_PTS_REF cal_ACFanSpdDvtSet_1X /end AXIS_DESCR
/end CHARACTERISTIC
/begin AXIS_PTS cal_ACFanSpdDvtSet_1X "" 0x0000 /* @ECU_Address@cal_ACFanSpdDvtSet_1X@ */ ACCtl_tDVTFlt Lookup1D_X_FLOAT32_IEEE 0 ME11_CM_single_C 14 -40.0 80.0 /end AXIS_PTS
/begin CHARACTERISTIC cal_ACFanSpdRecircCor_CUR "" CURVE 0x0000 /* @ECU_Address@cal_ACFanSpdRecircCor_CUR@ */ Lookup1D_FLOAT32_IEEE 0 ME11_CM_single_percent_ -100.0 100.0
 /begin AXIS_DESCR COM_AXIS AC_rRecircInc ME11_CM_single_percent_ 4 -100.0 100.0 AXIS_PTS_REF cal_ACFanSpdRecircCor_1X /end AXIS_DESCR
/end CHARACTERISTIC
/begin AXIS_PTS cal_ACFanSpdRecircCor_1X "" 0x0000 /* @ECU_Address@cal_ACFanSpdRecircCor_1X@ */ AC_rRecircInc Lookup1D_X_FLOAT32_IEEE 0 ME11_CM_single_percent_ 4 -100.0 100.0 /end AXIS_PTS
/begin CHARACTERISTIC cal_ACFanSpdSolarCorByEnv_MAP "" MAP 0x0000 /* @ECU_Address@cal_ACFanSpdSolarCorByEnv_MAP@ */ Lookup2D_FLOAT32_IEEE 0 ME11_CM_single_percent_ 0.0 100.0
 /begin AXIS_DESCR COM_AXIS ACSen_sEnvTempCor ME11_CM_single_C 15 -40.0 80.0 AXIS_PTS_REF cal_ACFanSpdSolarCorByEnv_2Y /end AXIS_DESCR
 /begin AXIS_DESCR COM_AXIS GlbDa_LeftSolarAvr ME11_CM_uint16_w_per_m_2 15 0.0 1300.0 AXIS_PTS_REF cal_ACFanSpdSolarCorByEnv_2X /end AXIS_DESCR
/end CHARACTERISTIC
/begin AXIS_PTS cal_ACFanSpdSolarCorByEnv_2X "" 0x0000 /* @ECU_Address@cal_ACFanSpdSolarCorByEnv_2X@ */ GlbDa_LeftSolarAvr Lookup2D_X_UWORD 0 ME11_CM_uint16_w_per_m_2 15 0.0 1300.0 /end AXIS_PTS
/begin AXIS_PTS cal_ACFanSpdSolarCorByEnv_2Y "" 0x0000 /* @ECU_Address@cal_ACFanSpdSolarCorByEnv_2Y@ */ ACSen_sEnvTempCor Lookup2D_X_FLOAT32_IEEE 0 ME11_CM_single_C 15 -40.0 80.0 /end AXIS_PTS
/begin CHARACTERISTIC cal_ACFanSpdSolarCor_MAP "" MAP 0x0000 /* @ECU_Address@cal_ACFanSpdSolarCor_MAP@ */ Lookup2D_FLOAT32_IEEE 0 ME11_CM_single_percent_ -100.0 100.0
 /begin AXIS_DESCR COM_AXIS ACCtl_tDVTFlt ME11_CM_single_C 15 -40.0 80.0 AXIS_PTS_REF cal_ACFanSpdSolarCor_2Y /end AXIS_DESCR
 /begin AXIS_DESCR COM_AXIS GlbDa_LeftSolarAvr ME11_CM_uint16_w_per_m_2 15 0.0 1300.0 AXIS_PTS_REF cal_ACFanSpdSolarCor_2X /end AXIS_DESCR
/end CHARACTERISTIC
/begin AXIS_PTS cal_ACFanSpdSolarCor_2X "" 0x0000 /* @ECU_Address@cal_ACFanSpdSolarCor_2X@ */ GlbDa_LeftSolarAvr Lookup2D_X_UWORD 0 ME11_CM_uint16_w_per_m_2 15 0.0 1300.0 /end AXIS_PTS
/begin AXIS_PTS cal_ACFanSpdSolarCor_2Y "" 0x0000 /* @ECU_Address@cal_ACFanSpdSolarCor_2Y@ */ ACCtl_tDVTFlt Lookup2D_X_FLOAT32_IEEE 0 ME11_CM_single_C 15 -40.0 80.0 /end AXIS_PTS
/begin CHARACTERISTIC cal_ACFanSpdVssCor_CUR "" CURVE 0x0000 /* @ECU_Address@cal_ACFanSpdVssCor_CUR@ */ Lookup1D_FLOAT32_IEEE 0 ME11_CM_single_percent_ -100.0 100.0
 /begin AXIS_DESCR COM_AXIS NO_INPUT_QUANTITY ME11_CM_single_km_per_h 3 -40.0 200.0 AXIS_PTS_REF cal_ACFanSpdVssCor_1X /end AXIS_DESCR
/end CHARACTERISTIC
/begin AXIS_PTS cal_ACFanSpdVssCor_1X "" 0x0000 /* @ECU_Address@cal_ACFanSpdVssCor_1X@ */ NO_INPUT_QUANTITY Lookup1D_X_FLOAT32_IEEE 0 ME11_CM_single_km_per_h 3 -40.0 200.0 /end AXIS_PTS
/begin CHARACTERISTIC cal_ACBatHeatEnvTemp "" VAL_BLK 0x0000 /* @ECU_Address@cal_ACBatHeatEnvTemp@ */ Scalar_FLOAT32_IEEE 0 ME11_CM_single_C -5.0 30.0 NUMBER 2 /end CHARACTERISTIC
/begin CHARACTERISTIC cal_ACBatHeatT1 "" VAL_BLK 0x0000 /* @ECU_Address@cal_ACBatHeatT1@ */ Scalar_FLOAT32_IEEE 0 ME11_CM_single_C -5.0 49.0 NUMBER 3 /end CHARACTERISTIC
/begin CHARACTERISTIC cal_ACBatHeatT2 "" VAL_BLK 0x0000 /* @ECU_Address@cal_ACBatHeatT2@ */ Scalar_FLOAT32_IEEE 0 ME11_CM_single_C -5.0 49.0 NUMBER 3 /end CHARACTERISTIC
/begin CHARACTERISTIC cal_ACBatHeatTave "" VAL_BLK 0x0000 /* @ECU_Address@cal_ACBatHeatTave@ */ Scalar_FLOAT32_IEEE 0 ME11_CM_single_C -5.0 49.0 NUMBER 3 /end CHARACTERISTIC
/begin CHARACTERISTIC cal_ACChgBatHighSOCHeat "" VALUE 0x0000 /* @ECU_Address@cal_ACChgBatHighSOCHeat@ */ Scalar_FLOAT32_IEEE 0 ME11_CM_single_percent_ 0.0 100.0 /end CHARACTERISTIC
/begin CHARACTERISTIC cal_ACChgBatLowSOCHeat "" VALUE 0x0000 /* @ECU_Address@cal_ACChgBatLowSOCHeat@ */ Scalar_FLOAT32_IEEE 0 ME11_CM_single_percent_ 0.0 100.0 /end CHARACTERISTIC
/begin CHARACTERISTIC cal_AEXVDownSpdLmt "" VALUE 0x0000 /* @ECU_Address@cal_AEXVDownSpdLmt@ */ Scalar_FLOAT32_IEEE 0 ME11_CM_single_percent_ 0.0 10.0 /end CHARACTERISTIC
/begin CHARACTERISTIC cal_AEXVOpenCtrlDownSpdLmt "" VALUE 0x0000 /* @ECU_Address@cal_AEXVOpenCtrlDownSpdLmt@ */ Scalar_FLOAT32_IEEE 0 ME11_CM_single_percent_ 0.0 100.0 /end CHARACTERISTIC
/begin CHARACTERISTIC cal_AEXVOpenCtrlUpSpdLmt "" VALUE 0x0000 /* @ECU_Address@cal_AEXVOpenCtrlUpSpdLmt@ */ Scalar_FLOAT32_IEEE 0 ME11_CM_single_percent_ 0.0 100.0 /end CHARACTERISTIC
/begin CHARACTERISTIC cal_AEXVUpSpdLmt "" VALUE 0x0000 /* @ECU_Address@cal_AEXVUpSpdLmt@ */ Scalar_FLOAT32_IEEE 0 ME11_CM_single_percent_ 0.0 10.0 /end CHARACTERISTIC
/begin CHARACTERISTIC cal_BEXVDownSpdLmt "" VALUE 0x0000 /* @ECU_Address@cal_BEXVDownSpdLmt@ */ Scalar_FLOAT32_IEEE 0 ME11_CM_single_percent_ 0.0 10.0 /end CHARACTERISTIC
/begin CHARACTERISTIC cal_BEXVFloorDiff1 "" VALUE 0x0000 /* @ECU_Address@cal_BEXVFloorDiff1@ */ Scalar_FLOAT32_IEEE 0 ME11_CM_single_percent_ 0.0 1.0 /end CHARACTERISTIC
/begin CHARACTERISTIC cal_BEXVFloorDiff2 "" VALUE 0x0000 /* @ECU_Address@cal_BEXVFloorDiff2@ */ Scalar_FLOAT32_IEEE 0 ME11_CM_single_percent_ 0.0 1.0 /end CHARACTERISTIC
/begin CHARACTERISTIC cal_BEXVOpenCtrlDownSpdLmt "" VALUE 0x0000 /* @ECU_Address@cal_BEXVOpenCtrlDownSpdLmt@ */ Scalar_FLOAT32_IEEE 0 ME11_CM_single_percent_ 0.0 100.0 /end CHARACTERISTIC
/begin CHARACTERISTIC cal_BEXVOpenCtrlUpSpdLmt "" VALUE 0x0000 /* @ECU_Address@cal_BEXVOpenCtrlUpSpdLmt@ */ Scalar_FLOAT32_IEEE 0 ME11_CM_single_percent_ 0.0 100.0 /end CHARACTERISTIC
/begin CHARACTERISTIC cal_BEXVPosData "" VALUE 0x0000 /* @ECU_Address@cal_BEXVPosData@ */ Scalar_FLOAT32_IEEE 0 ME11_CM_single_percent_ 0.0 100.0 /end CHARACTERISTIC
/begin CHARACTERISTIC cal_BEXVUpSpdLmt "" VALUE 0x0000 /* @ECU_Address@cal_BEXVUpSpdLmt@ */ Scalar_FLOAT32_IEEE 0 ME11_CM_single_percent_ 0.0 10.0 /end CHARACTERISTIC
/begin CHARACTERISTIC cal_BatHeatPwrLoLmt "" VALUE 0x0000 /* @ECU_Address@cal_BatHeatPwrLoLmt@ */ Scalar_FLOAT32_IEEE 0 ME11_CM_single_kw 0.0 2.0 /end CHARACTERISTIC
/begin CHARACTERISTIC cal_DCBatHeatEnvTemp "" VAL_BLK 0x0000 /* @ECU_Address@cal_DCBatHeatEnvTemp@ */ Scalar_FLOAT32_IEEE 0 ME11_CM_single_C -5.0 30.0 NUMBER 2 /end CHARACTERISTIC
/begin CHARACTERISTIC cal_DCBatHeatT1 "" VAL_BLK 0x0000 /* @ECU_Address@cal_DCBatHeatT1@ */ Scalar_FLOAT32_IEEE 0 ME11_CM_single_C -5.0 49.0 NUMBER 3 /end CHARACTERISTIC
/begin CHARACTERISTIC cal_DCBatHeatT2 "" VAL_BLK 0x0000 /* @ECU_Address@cal_DCBatHeatT2@ */ Scalar_FLOAT32_IEEE 0 ME11_CM_single_C -5.0 49.0 NUMBER 3 /end CHARACTERISTIC
/begin CHARACTERISTIC cal_DCBatHeatTave "" VAL_BLK 0x0000 /* @ECU_Address@cal_DCBatHeatTave@ */ Scalar_FLOAT32_IEEE 0 ME11_CM_single_C -5.0 49.0 NUMBER 3 /end CHARACTERISTIC
/begin CHARACTERISTIC cal_DLTRBatInlet2MaxTempDiff "" VALUE 0x0000 /* @ECU_Address@cal_DLTRBatInlet2MaxTempDiff@ */ Scalar_FLOAT32_IEEE 0 ME11_CM_single_C -40.0 80.0 /end CHARACTERISTIC
/begin CHARACTERISTIC cal_DefaultSetTemp "" VALUE 0x0000 /* @ECU_Address@cal_DefaultSetTemp@ */ Scalar_FLOAT32_IEEE 0 ME11_CM_single_C -40.0 80.0 /end CHARACTERISTIC
/begin CHARACTERISTIC cal_DrEvaDesValPIDIntegDeadBandNeg "" VALUE 0x0000 /* @ECU_Address@cal_DrEvaDesValPIDIntegDeadBandNeg@ */ Scalar_FLOAT32_IEEE 0 ME11_CM_single_per_ -3.4E+38 3.4E+38 /end CHARACTERISTIC
/begin CHARACTERISTIC cal_DrEvaDesValPIDIntegDeadBandPos "" VALUE 0x0000 /* @ECU_Address@cal_DrEvaDesValPIDIntegDeadBandPos@ */ Scalar_FLOAT32_IEEE 0 ME11_CM_single_per_ -3.4E+38 3.4E+38 /end CHARACTERISTIC
/begin CHARACTERISTIC cal_DrEvaDesValPIDKi "" VALUE 0x0000 /* @ECU_Address@cal_DrEvaDesValPIDKi@ */ Scalar_FLOAT32_IEEE 0 ME11_CM_single_per_ -3.4E+38 3.4E+38 /end CHARACTERISTIC
/begin CHARACTERISTIC cal_DrEvaDesValPIDKiNeg "" VALUE 0x0000 /* @ECU_Address@cal_DrEvaDesValPIDKiNeg@ */ Scalar_FLOAT32_IEEE 0 ME11_CM_single_per_ -3.4E+38 3.4E+38 /end CHARACTERISTIC
/begin CHARACTERISTIC cal_DrEvaDesValPIDKiPos "" VALUE 0x0000 /* @ECU_Address@cal_DrEvaDesValPIDKiPos@ */ Scalar_FLOAT32_IEEE 0 ME11_CM_single_per_ -3.4E+38 3.4E+38 /end CHARACTERISTIC
/begin CHARACTERISTIC cal_DrEvaDesValPIDKp "" VALUE 0x0000 /* @ECU_Address@cal_DrEvaDesValPIDKp@ */ Scalar_FLOAT32_IEEE 0 ME11_CM_single_per_ -3.4E+38 3.4E+38 /end CHARACTERISTIC
/begin CHARACTERISTIC cal_DrEvaDesValPIDKpNeg "" VALUE 0x0000 /* @ECU_Address@cal_DrEvaDesValPIDKpNeg@ */ Scalar_FLOAT32_IEEE 0 ME11_CM_single_per_ -3.4E+38 3.4E+38 /end CHARACTERISTIC
/begin CHARACTERISTIC cal_DrEvaDesValPIDKpPos "" VALUE 0x0000 /* @ECU_Address@cal_DrEvaDesValPIDKpPos@ */ Scalar_FLOAT32_IEEE 0 ME11_CM_single_per_ -3.4E+38 3.4E+38 /end CHARACTERISTIC
/begin CHARACTERISTIC cal_DrEvaDesValPIDLL "" VALUE 0x0000 /* @ECU_Address@cal_DrEvaDesValPIDLL@ */ Scalar_FLOAT32_IEEE 0 ME11_CM_single_per_ -3.4E+38 3.4E+38 /end CHARACTERISTIC
/begin CHARACTERISTIC cal_DrEvaDesValPIDUL "" VALUE 0x0000 /* @ECU_Address@cal_DrEvaDesValPIDUL@ */ Scalar_FLOAT32_IEEE 0 ME11_CM_single_per_ -3.4E+38 3.4E+38 /end CHARACTERISTIC
/begin CHARACTERISTIC cal_DrEvaDesValPID_IsumMax "" VALUE 0x0000 /* @ECU_Address@cal_DrEvaDesValPID_IsumMax@ */ Scalar_FLOAT32_IEEE 0 ME11_CM_single_per_ -3.4E+38 3.4E+38 /end CHARACTERISTIC
/begin CHARACTERISTIC cal_DrEvaDesValPID_IsumMin "" VALUE 0x0000 /* @ECU_Address@cal_DrEvaDesValPID_IsumMin@ */ Scalar_FLOAT32_IEEE 0 ME11_CM_single_per_ -3.4E+38 3.4E+38 /end CHARACTERISTIC
/begin CHARACTERISTIC cal_DrEvaDesValPID_pWinNeg "" VALUE 0x0000 /* @ECU_Address@cal_DrEvaDesValPID_pWinNeg@ */ Scalar_FLOAT32_IEEE 0 ME11_CM_single_per_ -3.4E+38 3.4E+38 /end CHARACTERISTIC
/begin CHARACTERISTIC cal_DrEvaDesValPID_pWinPos "" VALUE 0x0000 /* @ECU_Address@cal_DrEvaDesValPID_pWinPos@ */ Scalar_FLOAT32_IEEE 0 ME11_CM_single_per_ -3.4E+38 3.4E+38 /end CHARACTERISTIC
/begin CHARACTERISTIC cal_DrPtcDesValPIDIntegDeadBand4InHeat "" VALUE 0x0000 /* @ECU_Address@cal_DrPtcDesValPIDIntegDeadBand4InHeat@ */ Scalar_FLOAT32_IEEE 0 ME11_CM_single_per_ -3.4E+38 3.4E+38 /end CHARACTERISTIC
/begin CHARACTERISTIC cal_DrPtcDesValPIDIntegDeadBand4OutHeat "" VALUE 0x0000 /* @ECU_Address@cal_DrPtcDesValPIDIntegDeadBand4OutHeat@ */ Scalar_FLOAT32_IEEE 0 ME11_CM_single_per_ -3.4E+38 3.4E+38 /end CHARACTERISTIC
/begin CHARACTERISTIC cal_DrPtcDesValPIDKi "" VALUE 0x0000 /* @ECU_Address@cal_DrPtcDesValPIDKi@ */ Scalar_FLOAT32_IEEE 0 ME11_CM_single_per_ -3.4E+38 3.4E+38 /end CHARACTERISTIC
/begin CHARACTERISTIC cal_DrPtcDesValPIDKiNeg "" VALUE 0x0000 /* @ECU_Address@cal_DrPtcDesValPIDKiNeg@ */ Scalar_FLOAT32_IEEE 0 ME11_CM_single_per_ -3.4E+38 3.4E+38 /end CHARACTERISTIC
/begin CHARACTERISTIC cal_DrPtcDesValPIDKiPos "" VALUE 0x0000 /* @ECU_Address@cal_DrPtcDesValPIDKiPos@ */ Scalar_FLOAT32_IEEE 0 ME11_CM_single_per_ -3.4E+38 3.4E+38 /end CHARACTERISTIC
/begin CHARACTERISTIC cal_DrPtcDesValPIDKp "" VALUE 0x0000 /* @ECU_Address@cal_DrPtcDesValPIDKp@ */ Scalar_FLOAT32_IEEE 0 ME11_CM_single_per_ -3.4E+38 3.4E+38 /end CHARACTERISTIC
/begin CHARACTERISTIC cal_DrPtcDesValPIDKpNeg "" VALUE 0x0000 /* @ECU_Address@cal_DrPtcDesValPIDKpNeg@ */ Scalar_FLOAT32_IEEE 0 ME11_CM_single_per_ -3.4E+38 3.4E+38 /end CHARACTERISTIC
/begin CHARACTERISTIC cal_DrPtcDesValPIDKpPos "" VALUE 0x0000 /* @ECU_Address@cal_DrPtcDesValPIDKpPos@ */ Scalar_FLOAT32_IEEE 0 ME11_CM_single_per_ -3.4E+38 3.4E+38 /end CHARACTERISTIC
/begin CHARACTERISTIC cal_DrPtcDesValPIDLL "" VALUE 0x0000 /* @ECU_Address@cal_DrPtcDesValPIDLL@ */ Scalar_FLOAT32_IEEE 0 ME11_CM_single_per_ -3.4E+38 3.4E+38 /end CHARACTERISTIC
/begin CHARACTERISTIC cal_DrPtcDesValPIDUL "" VALUE 0x0000 /* @ECU_Address@cal_DrPtcDesValPIDUL@ */ Scalar_FLOAT32_IEEE 0 ME11_CM_single_per_ -3.4E+38 3.4E+38 /end CHARACTERISTIC
/begin CHARACTERISTIC cal_DrPtcDesValPID_IsumMax "" VALUE 0x0000 /* @ECU_Address@cal_DrPtcDesValPID_IsumMax@ */ Scalar_FLOAT32_IEEE 0 ME11_CM_single_per_ -3.4E+38 3.4E+38 /end CHARACTERISTIC
/begin CHARACTERISTIC cal_DrPtcDesValPID_IsumMin "" VALUE 0x0000 /* @ECU_Address@cal_DrPtcDesValPID_IsumMin@ */ Scalar_FLOAT32_IEEE 0 ME11_CM_single_per_ -3.4E+38 3.4E+38 /end CHARACTERISTIC
/begin CHARACTERISTIC cal_DrPtcDesValPID_pWinNeg "" VALUE 0x0000 /* @ECU_Address@cal_DrPtcDesValPID_pWinNeg@ */ Scalar_FLOAT32_IEEE 0 ME11_CM_single_per_ -3.4E+38 3.4E+38 /end CHARACTERISTIC
/begin CHARACTERISTIC cal_DrPtcDesValPID_pWinPos "" VALUE 0x0000 /* @ECU_Address@cal_DrPtcDesValPID_pWinPos@ */ Scalar_FLOAT32_IEEE 0 ME11_CM_single_per_ -3.4E+38 3.4E+38 /end CHARACTERISTIC
/begin CHARACTERISTIC cal_DvtDesValPIDIntegDeadBand "" VALUE 0x0000 /* @ECU_Address@cal_DvtDesValPIDIntegDeadBand@ */ Scalar_FLOAT32_IEEE 0 ME11_CM_single_per_ -3.4E+38 3.4E+38 /end CHARACTERISTIC
/begin CHARACTERISTIC cal_DvtDesValPID_Ki "" VALUE 0x0000 /* @ECU_Address@cal_DvtDesValPID_Ki@ */ Scalar_FLOAT32_IEEE 0 ME11_CM_single_per_ -3.4E+38 3.4E+38 /end CHARACTERISTIC
/begin CHARACTERISTIC cal_DvtDesValPID_Kp "" VALUE 0x0000 /* @ECU_Address@cal_DvtDesValPID_Kp@ */ Scalar_FLOAT32_IEEE 0 ME11_CM_single_per_ -3.4E+38 3.4E+38 /end CHARACTERISTIC
/begin CHARACTERISTIC cal_DvtDesValPID_pWinNeg "" VALUE 0x0000 /* @ECU_Address@cal_DvtDesValPID_pWinNeg@ */ Scalar_FLOAT32_IEEE 0 ME11_CM_single_per_ -3.4E+38 3.4E+38 /end CHARACTERISTIC
/begin CHARACTERISTIC cal_DvtDesValPID_pWinPos "" VALUE 0x0000 /* @ECU_Address@cal_DvtDesValPID_pWinPos@ */ Scalar_FLOAT32_IEEE 0 ME11_CM_single_per_ -3.4E+38 3.4E+38 /end CHARACTERISTIC
/begin CHARACTERISTIC cal_ErrOfEvaActTargInComf_OFF "" VALUE 0x0000 /* @ECU_Address@cal_ErrOfEvaActTargInComf_OFF@ */ Scalar_FLOAT32_IEEE 0 ME11_CM_single_per_ -40.0 100.0 /end CHARACTERISTIC
/begin CHARACTERISTIC cal_ErrOfEvaActTargInComf_ON "" VALUE 0x0000 /* @ECU_Address@cal_ErrOfEvaActTargInComf_ON@ */ Scalar_FLOAT32_IEEE 0 ME11_CM_single_per_ -40.0 100.0 /end CHARACTERISTIC
/begin CHARACTERISTIC cal_ErrOfEvaActTargInDefog_OFF "" VALUE 0x0000 /* @ECU_Address@cal_ErrOfEvaActTargInDefog_OFF@ */ Scalar_FLOAT32_IEEE 0 ME11_CM_single_per_ -40.0 100.0 /end CHARACTERISTIC
/begin CHARACTERISTIC cal_ErrOfEvaActTargInDefog_ON "" VALUE 0x0000 /* @ECU_Address@cal_ErrOfEvaActTargInDefog_ON@ */ Scalar_FLOAT32_IEEE 0 ME11_CM_single_per_ -40.0 100.0 /end CHARACTERISTIC
/begin CHARACTERISTIC cal_ErrOfEvaActTargInEcon_OFF "" VALUE 0x0000 /* @ECU_Address@cal_ErrOfEvaActTargInEcon_OFF@ */ Scalar_FLOAT32_IEEE 0 ME11_CM_single_per_ -40.0 100.0 /end CHARACTERISTIC
/begin CHARACTERISTIC cal_ErrOfEvaActTargInEcon_ON "" VALUE 0x0000 /* @ECU_Address@cal_ErrOfEvaActTargInEcon_ON@ */ Scalar_FLOAT32_IEEE 0 ME11_CM_single_per_ -40.0 100.0 /end CHARACTERISTIC
/begin CHARACTERISTIC cal_ErrOfPTCActTargInComf_OFF "" VALUE 0x0000 /* @ECU_Address@cal_ErrOfPTCActTargInComf_OFF@ */ Scalar_FLOAT32_IEEE 0 ME11_CM_single_per_ -40.0 100.0 /end CHARACTERISTIC
/begin CHARACTERISTIC cal_ErrOfPTCActTargInComf_ON "" VALUE 0x0000 /* @ECU_Address@cal_ErrOfPTCActTargInComf_ON@ */ Scalar_FLOAT32_IEEE 0 ME11_CM_single_per_ -40.0 100.0 /end CHARACTERISTIC
/begin CHARACTERISTIC cal_ErrOfPTCActTargInEcon_OFF "" VALUE 0x0000 /* @ECU_Address@cal_ErrOfPTCActTargInEcon_OFF@ */ Scalar_FLOAT32_IEEE 0 ME11_CM_single_per_ -40.0 100.0 /end CHARACTERISTIC
/begin CHARACTERISTIC cal_ErrOfPTCActTargInEcon_ON "" VALUE 0x0000 /* @ECU_Address@cal_ErrOfPTCActTargInEcon_ON@ */ Scalar_FLOAT32_IEEE 0 ME11_CM_single_per_ -40.0 100.0 /end CHARACTERISTIC
/begin CHARACTERISTIC cal_HPEXVCtrlCDeadzone "" VALUE 0x0000 /* @ECU_Address@cal_HPEXVCtrlCDeadzone@ */ Scalar_FLOAT32_IEEE 0 ME11_CM_single_C 0.0 5.0 /end CHARACTERISTIC
/begin CHARACTERISTIC cal_HPEXVCtrlCDelayTime "" VALUE 0x0000 /* @ECU_Address@cal_HPEXVCtrlCDelayTime@ */ Scalar_FLOAT32_IEEE 0 ME11_CM_single_s 0.0 100.0 /end CHARACTERISTIC
/begin CHARACTERISTIC cal_HPEXVCtrlCMax "" VALUE 0x0000 /* @ECU_Address@cal_HPEXVCtrlCMax@ */ Scalar_FLOAT32_IEEE 0 ME11_CM_single_percent_ 0.0 100.0 /end CHARACTERISTIC
/begin CHARACTERISTIC cal_HPEXVCtrlCMin "" VALUE 0x0000 /* @ECU_Address@cal_HPEXVCtrlCMin@ */ Scalar_FLOAT32_IEEE 0 ME11_CM_single_percent_ 0.0 100.0 /end CHARACTERISTIC
/begin CHARACTERISTIC cal_HPEXVCtrlCOpenVal "" VALUE 0x0000 /* @ECU_Address@cal_HPEXVCtrlCOpenVal@ */ Scalar_FLOAT32_IEEE 0 ME11_CM_single_percent_ 0.0 100.0 /end CHARACTERISTIC
/begin CHARACTERISTIC cal_HPEXVCtrlDDeadzone "" VALUE 0x0000 /* @ECU_Address@cal_HPEXVCtrlDDeadzone@ */ Scalar_FLOAT32_IEEE 0 ME11_CM_single_C 0.0 10.0 /end CHARACTERISTIC
/begin CHARACTERISTIC cal_HPEXVCtrlDDelayTime "" VALUE 0x0000 /* @ECU_Address@cal_HPEXVCtrlDDelayTime@ */ Scalar_FLOAT32_IEEE 0 ME11_CM_single_s 0.0 100.0 /end CHARACTERISTIC
/begin CHARACTERISTIC cal_HPEXVCtrlDFFLolmt "" VALUE 0x0000 /* @ECU_Address@cal_HPEXVCtrlDFFLolmt@ */ Scalar_FLOAT32_IEEE 0 ME11_CM_single_percent_ 0.0 100.0 /end CHARACTERISTIC
/begin CHARACTERISTIC cal_HPEXVCtrlDFFUplmt "" VALUE 0x0000 /* @ECU_Address@cal_HPEXVCtrlDFFUplmt@ */ Scalar_FLOAT32_IEEE 0 ME11_CM_single_percent_ 0.0 100.0 /end CHARACTERISTIC
/begin CHARACTERISTIC cal_HPEXVCtrlDMax "" VALUE 0x0000 /* @ECU_Address@cal_HPEXVCtrlDMax@ */ Scalar_FLOAT32_IEEE 0 ME11_CM_single_percent_ 0.0 100.0 /end CHARACTERISTIC
/begin CHARACTERISTIC cal_HPEXVCtrlDMin "" VALUE 0x0000 /* @ECU_Address@cal_HPEXVCtrlDMin@ */ Scalar_FLOAT32_IEEE 0 ME11_CM_single_percent_ 0.0 100.0 /end CHARACTERISTIC
/begin CHARACTERISTIC cal_HPEXVCtrlDOpenVal "" VALUE 0x0000 /* @ECU_Address@cal_HPEXVCtrlDOpenVal@ */ Scalar_FLOAT32_IEEE 0 ME11_CM_single_percent_ 0.0 100.0 /end CHARACTERISTIC
/begin CHARACTERISTIC cal_HPEXVCtrlEDeadzone "" VALUE 0x0000 /* @ECU_Address@cal_HPEXVCtrlEDeadzone@ */ Scalar_FLOAT32_IEEE 0 ME11_CM_single_C 0.0 10.0 /end CHARACTERISTIC
/begin CHARACTERISTIC cal_HPEXVCtrlEDelayTime "" VALUE 0x0000 /* @ECU_Address@cal_HPEXVCtrlEDelayTime@ */ Scalar_FLOAT32_IEEE 0 ME11_CM_single_s 0.0 200.0 /end CHARACTERISTIC
/begin CHARACTERISTIC cal_HPEXVCtrlEFFLolmt "" VALUE 0x0000 /* @ECU_Address@cal_HPEXVCtrlEFFLolmt@ */ Scalar_FLOAT32_IEEE 0 ME11_CM_single_percent_ 0.0 100.0 /end CHARACTERISTIC
/begin CHARACTERISTIC cal_HPEXVCtrlEFFUplmt "" VALUE 0x0000 /* @ECU_Address@cal_HPEXVCtrlEFFUplmt@ */ Scalar_FLOAT32_IEEE 0 ME11_CM_single_percent_ 0.0 100.0 /end CHARACTERISTIC
/begin CHARACTERISTIC cal_HPEXVCtrlEMax "" VALUE 0x0000 /* @ECU_Address@cal_HPEXVCtrlEMax@ */ Scalar_FLOAT32_IEEE 0 ME11_CM_single_percent_ 0.0 100.0 /end CHARACTERISTIC
/begin CHARACTERISTIC cal_HPEXVCtrlEMin "" VALUE 0x0000 /* @ECU_Address@cal_HPEXVCtrlEMin@ */ Scalar_FLOAT32_IEEE 0 ME11_CM_single_percent_ 0.0 100.0 /end CHARACTERISTIC
/begin CHARACTERISTIC cal_HPEXVCtrlEOpenVal "" VALUE 0x0000 /* @ECU_Address@cal_HPEXVCtrlEOpenVal@ */ Scalar_FLOAT32_IEEE 0 ME11_CM_single_percent_ 0.0 100.0 /end CHARACTERISTIC
/begin CHARACTERISTIC cal_HPEXVDownSpdLmt "" VALUE 0x0000 /* @ECU_Address@cal_HPEXVDownSpdLmt@ */ Scalar_FLOAT32_IEEE 0 ME11_CM_single_percent_ 0.0 10.0 /end CHARACTERISTIC
/begin CHARACTERISTIC cal_HPEXVHiPressLmtOff "" VALUE 0x0000 /* @ECU_Address@cal_HPEXVHiPressLmtOff@ */ Scalar_FLOAT32_IEEE 0 ME11_CM_single_Mpa 0.0 30.0 /end CHARACTERISTIC
/begin CHARACTERISTIC cal_HPEXVHiPressLmtOn "" VALUE 0x0000 /* @ECU_Address@cal_HPEXVHiPressLmtOn@ */ Scalar_FLOAT32_IEEE 0 ME11_CM_single_Mpa 0.0 30.0 /end CHARACTERISTIC
/begin CHARACTERISTIC cal_HPEXVLowPressLmtOff "" VALUE 0x0000 /* @ECU_Address@cal_HPEXVLowPressLmtOff@ */ Scalar_FLOAT32_IEEE 0 ME11_CM_single_Mpa 0.0 1.0 /end CHARACTERISTIC
/begin CHARACTERISTIC cal_HPEXVLowPressLmtOn "" VALUE 0x0000 /* @ECU_Address@cal_HPEXVLowPressLmtOn@ */ Scalar_FLOAT32_IEEE 0 ME11_CM_single_Mpa 0.0 1.0 /end CHARACTERISTIC
/begin CHARACTERISTIC cal_HPEXVOpenCtrlDownSpdLmt "" VALUE 0x0000 /* @ECU_Address@cal_HPEXVOpenCtrlDownSpdLmt@ */ Scalar_FLOAT32_IEEE 0 ME11_CM_single_percent_ 0.0 100.0 /end CHARACTERISTIC
/begin CHARACTERISTIC cal_HPEXVOpenCtrlUpSpdLmt "" VALUE 0x0000 /* @ECU_Address@cal_HPEXVOpenCtrlUpSpdLmt@ */ Scalar_FLOAT32_IEEE 0 ME11_CM_single_percent_ 0.0 100.0 /end CHARACTERISTIC
/begin CHARACTERISTIC cal_HPEXVUpSpdLmt "" VALUE 0x0000 /* @ECU_Address@cal_HPEXVUpSpdLmt@ */ Scalar_FLOAT32_IEEE 0 ME11_CM_single_percent_ 0.0 10.0 /end CHARACTERISTIC
/begin CHARACTERISTIC cal_HeatPwrOn "" VALUE 0x0000 /* @ECU_Address@cal_HeatPwrOn@ */ Scalar_FLOAT32_IEEE 0 ME11_CM_single_kw 0.0 15.0 /end CHARACTERISTIC
/begin CHARACTERISTIC cal_LAirmixNomOutWaterT "" VALUE 0x0000 /* @ECU_Address@cal_LAirmixNomOutWaterT@ */ Scalar_FLOAT32_IEEE 0 ME11_CM_single_per_ -3.4E+38 3.4E+38 /end CHARACTERISTIC
/begin CHARACTERISTIC cal_LTRExitBatMaxCellTemp "" VALUE 0x0000 /* @ECU_Address@cal_LTRExitBatMaxCellTemp@ */ Scalar_FLOAT32_IEEE 0 ME11_CM_single_C -40.0 50.0 /end CHARACTERISTIC
/begin CHARACTERISTIC cal_NmlBatHeatEnvTemp "" VAL_BLK 0x0000 /* @ECU_Address@cal_NmlBatHeatEnvTemp@ */ Scalar_FLOAT32_IEEE 0 ME11_CM_single_C -5.0 30.0 NUMBER 2 /end CHARACTERISTIC
/begin CHARACTERISTIC cal_NmlBatHeatT1 "" VAL_BLK 0x0000 /* @ECU_Address@cal_NmlBatHeatT1@ */ Scalar_FLOAT32_IEEE 0 ME11_CM_single_C -30.0 49.0 NUMBER 3 /end CHARACTERISTIC
/begin CHARACTERISTIC cal_NmlBatHeatT2 "" VAL_BLK 0x0000 /* @ECU_Address@cal_NmlBatHeatT2@ */ Scalar_FLOAT32_IEEE 0 ME11_CM_single_C -5.0 49.0 NUMBER 3 /end CHARACTERISTIC
/begin CHARACTERISTIC cal_NmlBatHeatTave "" VAL_BLK 0x0000 /* @ECU_Address@cal_NmlBatHeatTave@ */ Scalar_FLOAT32_IEEE 0 ME11_CM_single_C -5.0 49.0 NUMBER 3 /end CHARACTERISTIC
/begin CHARACTERISTIC cal_PsDVTWeight "" VALUE 0x0000 /* @ECU_Address@cal_PsDVTWeight@ */ Scalar_FLOAT32_IEEE 0 ME11_CM_single_per_ -3.4E+38 3.4E+38 /end CHARACTERISTIC
/begin CHARACTERISTIC cal_PsEnv4SetSelect "" VALUE 0x0000 /* @ECU_Address@cal_PsEnv4SetSelect@ */ Scalar_FLOAT32_IEEE 0 ME11_CM_single_per_ -3.4E+38 3.4E+38 /end CHARACTERISTIC
/begin CHARACTERISTIC cal_PsEvaDesValPIDIntegDeadBandNeg "" VALUE 0x0000 /* @ECU_Address@cal_PsEvaDesValPIDIntegDeadBandNeg@ */ Scalar_FLOAT32_IEEE 0 ME11_CM_single_per_ -3.4E+38 3.4E+38 /end CHARACTERISTIC
/begin CHARACTERISTIC cal_PsEvaDesValPIDIntegDeadBandPos "" VALUE 0x0000 /* @ECU_Address@cal_PsEvaDesValPIDIntegDeadBandPos@ */ Scalar_FLOAT32_IEEE 0 ME11_CM_single_per_ -3.4E+38 3.4E+38 /end CHARACTERISTIC
/begin CHARACTERISTIC cal_PsEvaDesValPIDKi "" VALUE 0x0000 /* @ECU_Address@cal_PsEvaDesValPIDKi@ */ Scalar_FLOAT32_IEEE 0 ME11_CM_single_per_ -3.4E+38 3.4E+38 /end CHARACTERISTIC
/begin CHARACTERISTIC cal_PsEvaDesValPIDKiNeg "" VALUE 0x0000 /* @ECU_Address@cal_PsEvaDesValPIDKiNeg@ */ Scalar_FLOAT32_IEEE 0 ME11_CM_single_per_ -3.4E+38 3.4E+38 /end CHARACTERISTIC
/begin CHARACTERISTIC cal_PsEvaDesValPIDKiPos "" VALUE 0x0000 /* @ECU_Address@cal_PsEvaDesValPIDKiPos@ */ Scalar_FLOAT32_IEEE 0 ME11_CM_single_per_ -3.4E+38 3.4E+38 /end CHARACTERISTIC
/begin CHARACTERISTIC cal_PsEvaDesValPIDKp "" VALUE 0x0000 /* @ECU_Address@cal_PsEvaDesValPIDKp@ */ Scalar_FLOAT32_IEEE 0 ME11_CM_single_per_ -3.4E+38 3.4E+38 /end CHARACTERISTIC
/begin CHARACTERISTIC cal_PsEvaDesValPIDKpNeg "" VALUE 0x0000 /* @ECU_Address@cal_PsEvaDesValPIDKpNeg@ */ Scalar_FLOAT32_IEEE 0 ME11_CM_single_per_ -3.4E+38 3.4E+38 /end CHARACTERISTIC
/begin CHARACTERISTIC cal_PsEvaDesValPIDKpPos "" VALUE 0x0000 /* @ECU_Address@cal_PsEvaDesValPIDKpPos@ */ Scalar_FLOAT32_IEEE 0 ME11_CM_single_per_ -3.4E+38 3.4E+38 /end CHARACTERISTIC
/begin CHARACTERISTIC cal_PsEvaDesValPIDLL "" VALUE 0x0000 /* @ECU_Address@cal_PsEvaDesValPIDLL@ */ Scalar_FLOAT32_IEEE 0 ME11_CM_single_per_ -3.4E+38 3.4E+38 /end CHARACTERISTIC
/begin CHARACTERISTIC cal_PsEvaDesValPIDUL "" VALUE 0x0000 /* @ECU_Address@cal_PsEvaDesValPIDUL@ */ Scalar_FLOAT32_IEEE 0 ME11_CM_single_per_ -3.4E+38 3.4E+38 /end CHARACTERISTIC
/begin CHARACTERISTIC cal_PsEvaDesValPID_IsumMax "" VALUE 0x0000 /* @ECU_Address@cal_PsEvaDesValPID_IsumMax@ */ Scalar_FLOAT32_IEEE 0 ME11_CM_single_per_ -3.4E+38 3.4E+38 /end CHARACTERISTIC
/begin CHARACTERISTIC cal_PsEvaDesValPID_IsumMin "" VALUE 0x0000 /* @ECU_Address@cal_PsEvaDesValPID_IsumMin@ */ Scalar_FLOAT32_IEEE 0 ME11_CM_single_per_ -3.4E+38 3.4E+38 /end CHARACTERISTIC
/begin CHARACTERISTIC cal_PsEvaDesValPID_pWinNeg "" VALUE 0x0000 /* @ECU_Address@cal_PsEvaDesValPID_pWinNeg@ */ Scalar_FLOAT32_IEEE 0 ME11_CM_single_per_ -3.4E+38 3.4E+38 /end CHARACTERISTIC
/begin CHARACTERISTIC cal_PsEvaDesValPID_pWinPos "" VALUE 0x0000 /* @ECU_Address@cal_PsEvaDesValPID_pWinPos@ */ Scalar_FLOAT32_IEEE 0 ME11_CM_single_per_ -3.4E+38 3.4E+38 /end CHARACTERISTIC
/begin CHARACTERISTIC cal_PsPtcDesValPIDIntegDeadBand4InHeat "" VALUE 0x0000 /* @ECU_Address@cal_PsPtcDesValPIDIntegDeadBand4InHeat@ */ Scalar_FLOAT32_IEEE 0 ME11_CM_single_per_ -3.4E+38 3.4E+38 /end CHARACTERISTIC
/begin CHARACTERISTIC cal_PsPtcDesValPIDIntegDeadBand4OutHeat "" VALUE 0x0000 /* @ECU_Address@cal_PsPtcDesValPIDIntegDeadBand4OutHeat@ */ Scalar_FLOAT32_IEEE 0 ME11_CM_single_per_ -3.4E+38 3.4E+38 /end CHARACTERISTIC
/begin CHARACTERISTIC cal_PsPtcDesValPIDKi "" VALUE 0x0000 /* @ECU_Address@cal_PsPtcDesValPIDKi@ */ Scalar_FLOAT32_IEEE 0 ME11_CM_single_per_ -3.4E+38 3.4E+38 /end CHARACTERISTIC
/begin CHARACTERISTIC cal_PsPtcDesValPIDKiNeg "" VALUE 0x0000 /* @ECU_Address@cal_PsPtcDesValPIDKiNeg@ */ Scalar_FLOAT32_IEEE 0 ME11_CM_single_per_ -3.4E+38 3.4E+38 /end CHARACTERISTIC
/begin CHARACTERISTIC cal_PsPtcDesValPIDKiPos "" VALUE 0x0000 /* @ECU_Address@cal_PsPtcDesValPIDKiPos@ */ Scalar_FLOAT32_IEEE 0 ME11_CM_single_per_ -3.4E+38 3.4E+38 /end CHARACTERISTIC
/begin CHARACTERISTIC cal_PsPtcDesValPIDKp "" VALUE 0x0000 /* @ECU_Address@cal_PsPtcDesValPIDKp@ */ Scalar_FLOAT32_IEEE 0 ME11_CM_single_per_ -3.4E+38 3.4E+38 /end CHARACTERISTIC
/begin CHARACTERISTIC cal_PsPtcDesValPIDKpNeg "" VALUE 0x0000 /* @ECU_Address@cal_PsPtcDesValPIDKpNeg@ */ Scalar_FLOAT32_IEEE 0 ME11_CM_single_per_ -3.4E+38 3.4E+38 /end CHARACTERISTIC
/begin CHARACTERISTIC cal_PsPtcDesValPIDKpPos "" VALUE 0x0000 /* @ECU_Address@cal_PsPtcDesValPIDKpPos@ */ Scalar_FLOAT32_IEEE 0 ME11_CM_single_per_ -3.4E+38 3.4E+38 /end CHARACTERISTIC
/begin CHARACTERISTIC cal_PsPtcDesValPIDLL "" VALUE 0x0000 /* @ECU_Address@cal_PsPtcDesValPIDLL@ */ Scalar_FLOAT32_IEEE 0 ME11_CM_single_per_ -3.4E+38 3.4E+38 /end CHARACTERISTIC
/begin CHARACTERISTIC cal_PsPtcDesValPIDUL "" VALUE 0x0000 /* @ECU_Address@cal_PsPtcDesValPIDUL@ */ Scalar_FLOAT32_IEEE 0 ME11_CM_single_per_ -3.4E+38 3.4E+38 /end CHARACTERISTIC
/begin CHARACTERISTIC cal_PsPtcDesValPID_IsumMax "" VALUE 0x0000 /* @ECU_Address@cal_PsPtcDesValPID_IsumMax@ */ Scalar_FLOAT32_IEEE 0 ME11_CM_single_per_ -3.4E+38 3.4E+38 /end CHARACTERISTIC
/begin CHARACTERISTIC cal_PsPtcDesValPID_IsumMin "" VALUE 0x0000 /* @ECU_Address@cal_PsPtcDesValPID_IsumMin@ */ Scalar_FLOAT32_IEEE 0 ME11_CM_single_per_ -3.4E+38 3.4E+38 /end CHARACTERISTIC
/begin CHARACTERISTIC cal_PsPtcDesValPID_pWinNeg "" VALUE 0x0000 /* @ECU_Address@cal_PsPtcDesValPID_pWinNeg@ */ Scalar_FLOAT32_IEEE 0 ME11_CM_single_per_ -3.4E+38 3.4E+38 /end CHARACTERISTIC
/begin CHARACTERISTIC cal_PsPtcDesValPID_pWinPos "" VALUE 0x0000 /* @ECU_Address@cal_PsPtcDesValPID_pWinPos@ */ Scalar_FLOAT32_IEEE 0 ME11_CM_single_per_ -3.4E+38 3.4E+38 /end CHARACTERISTIC
/begin CHARACTERISTIC cal_TSACBatMinEntTempA "" VALUE 0x0000 /* @ECU_Address@cal_TSACBatMinEntTempA@ */ Scalar_FLOAT32_IEEE 0 ME11_CM_single_C -40.0 80.0 /end CHARACTERISTIC
/begin CHARACTERISTIC cal_TSACBatMinEntTempB "" VALUE 0x0000 /* @ECU_Address@cal_TSACBatMinEntTempB@ */ Scalar_FLOAT32_IEEE 0 ME11_CM_single_C -40.0 80.0 /end CHARACTERISTIC
/begin CHARACTERISTIC cal_TSACBatMinExitTempM "" VALUE 0x0000 /* @ECU_Address@cal_TSACBatMinExitTempM@ */ Scalar_FLOAT32_IEEE 0 ME11_CM_single_C -40.0 80.0 /end CHARACTERISTIC
/begin CHARACTERISTIC cal_TSACBatMinExitTempN "" VALUE 0x0000 /* @ECU_Address@cal_TSACBatMinExitTempN@ */ Scalar_FLOAT32_IEEE 0 ME11_CM_single_C -40.0 80.0 /end CHARACTERISTIC
/begin CHARACTERISTIC cal_TSBatInletTempOffsetP "" VALUE 0x0000 /* @ECU_Address@cal_TSBatInletTempOffsetP@ */ Scalar_FLOAT32_IEEE 0 ME11_CM_single_C -40.0 80.0 /end CHARACTERISTIC
/begin CHARACTERISTIC cal_TSBatMinExitTempJ "" VALUE 0x0000 /* @ECU_Address@cal_TSBatMinExitTempJ@ */ Scalar_FLOAT32_IEEE 0 ME11_CM_single_C -40.0 80.0 /end CHARACTERISTIC
/begin CHARACTERISTIC cal_TSBatMinTempOffsetD "" VALUE 0x0000 /* @ECU_Address@cal_TSBatMinTempOffsetD@ */ Scalar_FLOAT32_IEEE 0 ME11_CM_single_C -40.0 80.0 /end CHARACTERISTIC
/begin CHARACTERISTIC cal_TSBatMinTemplowValB "" VALUE 0x0000 /* @ECU_Address@cal_TSBatMinTemplowValB@ */ Scalar_FLOAT32_IEEE 0 ME11_CM_single_C -40.0 80.0 /end CHARACTERISTIC
/begin CHARACTERISTIC cal_TSDCBatMinEntTempC "" VALUE 0x0000 /* @ECU_Address@cal_TSDCBatMinEntTempC@ */ Scalar_FLOAT32_IEEE 0 ME11_CM_single_C -40.0 80.0 /end CHARACTERISTIC
/begin CHARACTERISTIC cal_TSDCBatMinExitTempK "" VALUE 0x0000 /* @ECU_Address@cal_TSDCBatMinExitTempK@ */ Scalar_FLOAT32_IEEE 0 ME11_CM_single_C -40.0 80.0 /end CHARACTERISTIC
/begin CHARACTERISTIC cal_TSIGBTMinTempEntC "" VALUE 0x0000 /* @ECU_Address@cal_TSIGBTMinTempEntC@ */ Scalar_FLOAT32_IEEE 0 ME11_CM_single_C -40.0 80.0 /end CHARACTERISTIC
/begin CHARACTERISTIC cal_TSIGBTMinTempExitG "" VALUE 0x0000 /* @ECU_Address@cal_TSIGBTMinTempExitG@ */ Scalar_FLOAT32_IEEE 0 ME11_CM_single_C -40.0 80.0 /end CHARACTERISTIC
/begin CHARACTERISTIC cal_TSIPUExitTempI "" VALUE 0x0000 /* @ECU_Address@cal_TSIPUExitTempI@ */ Scalar_FLOAT32_IEEE 0 ME11_CM_single_C -40.0 80.0 /end CHARACTERISTIC
/begin CHARACTERISTIC cal_TSMotorMinTempEntC "" VALUE 0x0000 /* @ECU_Address@cal_TSMotorMinTempEntC@ */ Scalar_FLOAT32_IEEE 0 ME11_CM_single_C -40.0 80.0 /end CHARACTERISTIC
/begin CHARACTERISTIC cal_TSMotorMinTempExitH "" VALUE 0x0000 /* @ECU_Address@cal_TSMotorMinTempExitH@ */ Scalar_FLOAT32_IEEE 0 ME11_CM_single_C -40.0 80.0 /end CHARACTERISTIC
/begin CHARACTERISTIC cal_tACBatCoolCellTempOn "" VALUE 0x0000 /* @ECU_Address@cal_tACBatCoolCellTempOn@ */ Scalar_FLOAT32_IEEE 0 ME11_CM_single_C 0.0 50.0 /end CHARACTERISTIC
/begin CHARACTERISTIC cal_tBatCoolACChrgCellTempOff "" VALUE 0x0000 /* @ECU_Address@cal_tBatCoolACChrgCellTempOff@ */ Scalar_FLOAT32_IEEE 0 ME11_CM_single_C -40.0 40.0 /end CHARACTERISTIC
/begin CHARACTERISTIC cal_tBatCoolCellTempOn "" VALUE 0x0000 /* @ECU_Address@cal_tBatCoolCellTempOn@ */ Scalar_FLOAT32_IEEE 0 ME11_CM_single_C 0.0 50.0 /end CHARACTERISTIC
/begin CHARACTERISTIC cal_tBatCoolDCChrgCellTempOff "" VALUE 0x0000 /* @ECU_Address@cal_tBatCoolDCChrgCellTempOff@ */ Scalar_FLOAT32_IEEE 0 ME11_CM_single_C -40.0 40.0 /end CHARACTERISTIC
/begin CHARACTERISTIC cal_tBatCoolVehReadyCellTempOff "" VALUE 0x0000 /* @ECU_Address@cal_tBatCoolVehReadyCellTempOff@ */ Scalar_FLOAT32_IEEE 0 ME11_CM_single_C -40.0 40.0 /end CHARACTERISTIC
/begin CHARACTERISTIC cal_tBatHeatACChrgCellTempOff "" VALUE 0x0000 /* @ECU_Address@cal_tBatHeatACChrgCellTempOff@ */ Scalar_FLOAT32_IEEE 0 ME11_CM_single_C -40.0 40.0 /end CHARACTERISTIC
/begin CHARACTERISTIC cal_tBatHeatACChrgCellTempOn "" VALUE 0x0000 /* @ECU_Address@cal_tBatHeatACChrgCellTempOn@ */ Scalar_FLOAT32_IEEE 0 ME11_CM_single_C -40.0 20.0 /end CHARACTERISTIC
/begin CHARACTERISTIC cal_tBatHeatACChrgSOCHighTempOff "" VALUE 0x0000 /* @ECU_Address@cal_tBatHeatACChrgSOCHighTempOff@ */ Scalar_FLOAT32_IEEE 0 ME11_CM_single_C 0.0 40.0 /end CHARACTERISTIC
/begin CHARACTERISTIC cal_tBatHeatACChrgSOCHighTempOn "" VALUE 0x0000 /* @ECU_Address@cal_tBatHeatACChrgSOCHighTempOn@ */ Scalar_FLOAT32_IEEE 0 ME11_CM_single_C 0.0 40.0 /end CHARACTERISTIC
/begin CHARACTERISTIC cal_tBatHeatDCChrgCellTempOff "" VALUE 0x0000 /* @ECU_Address@cal_tBatHeatDCChrgCellTempOff@ */ Scalar_FLOAT32_IEEE 0 ME11_CM_single_C -40.0 40.0 /end CHARACTERISTIC
/begin CHARACTERISTIC cal_tBatHeatDCChrgCellTempOn "" VALUE 0x0000 /* @ECU_Address@cal_tBatHeatDCChrgCellTempOn@ */ Scalar_FLOAT32_IEEE 0 ME11_CM_single_C 0.0 30.0 /end CHARACTERISTIC
/begin CHARACTERISTIC cal_tBatHeatVehReadyCellTempOff "" VALUE 0x0000 /* @ECU_Address@cal_tBatHeatVehReadyCellTempOff@ */ Scalar_FLOAT32_IEEE 0 ME11_CM_single_C -40.0 50.0 /end CHARACTERISTIC
/begin CHARACTERISTIC cal_tBatHeatVehReadyCellTempOn "" VALUE 0x0000 /* @ECU_Address@cal_tBatHeatVehReadyCellTempOn@ */ Scalar_FLOAT32_IEEE 0 ME11_CM_single_C -40.0 50.0 /end CHARACTERISTIC
/begin CHARACTERISTIC cal_tDCBatCoolCellTempOn "" VALUE 0x0000 /* @ECU_Address@cal_tDCBatCoolCellTempOn@ */ Scalar_FLOAT32_IEEE 0 ME11_CM_single_C 0.0 50.0 /end CHARACTERISTIC
/begin CHARACTERISTIC cal_tLTROffBatBal2ToMaxCellDiff "" VALUE 0x0000 /* @ECU_Address@cal_tLTROffBatBal2ToMaxCellDiff@ */ Scalar_FLOAT32_IEEE 0 ME11_CM_single_C -10.0 10.0 /end CHARACTERISTIC
/begin CHARACTERISTIC cal_tLTROnDCChrgMaxCellTemp "" VALUE 0x0000 /* @ECU_Address@cal_tLTROnDCChrgMaxCellTemp@ */ Scalar_FLOAT32_IEEE 0 ME11_CM_single_C -40.0 50.0 /end CHARACTERISTIC
/begin CHARACTERISTIC cal_tLTROnDCChrgMinCellTemp "" VALUE 0x0000 /* @ECU_Address@cal_tLTROnDCChrgMinCellTemp@ */ Scalar_FLOAT32_IEEE 0 ME11_CM_single_C -40.0 50.0 /end CHARACTERISTIC
/begin CHARACTERISTIC cal_tLTROnMaxCellToMotDiff "" VALUE 0x0000 /* @ECU_Address@cal_tLTROnMaxCellToMotDiff@ */ Scalar_FLOAT32_IEEE 0 ME11_CM_single_C -10.0 10.0 /end CHARACTERISTIC
/begin CHARACTERISTIC cal_FalseTime2Solar "" VALUE 0x0000 /* @ECU_Address@cal_FalseTime2Solar@ */ Scalar_UWORD 0 ME11_CM_uint16_per_ 0 65535 /end CHARACTERISTIC
/begin CHARACTERISTIC cal_RiseTime2Solar "" VALUE 0x0000 /* @ECU_Address@cal_RiseTime2Solar@ */ Scalar_UWORD 0 ME11_CM_uint16_per_ 0 65535 /end CHARACTERISTIC
/begin CHARACTERISTIC cal_SolarFalseStep "" VALUE 0x0000 /* @ECU_Address@cal_SolarFalseStep@ */ Scalar_UWORD 0 ME11_CM_uint16_w_per_m_2 0.0 100.0 /end CHARACTERISTIC
/begin CHARACTERISTIC cal_SolarRiseStep "" VALUE 0x0000 /* @ECU_Address@cal_SolarRiseStep@ */ Scalar_UWORD 0 ME11_CM_uint16_w_per_m_2 0.0 100.0 /end CHARACTERISTIC
/begin CHARACTERISTIC cal_UpAndDownStartTime "" VALUE 0x0000 /* @ECU_Address@cal_UpAndDownStartTime@ */ Scalar_UWORD 0 ME11_CM_uint16_s 0.0 100.0 /end CHARACTERISTIC
/begin CHARACTERISTIC cal_AutoDefogEnable "" VALUE 0x0000 /* @ECU_Address@cal_AutoDefogEnable@ */ Scalar_BOOLEAN 0 ME11_CM_boolean_per_ 0.0 1.0 /end CHARACTERISTIC
/begin CHARACTERISTIC cal_BEXVPosDataEnb "" VALUE 0x0000 /* @ECU_Address@cal_BEXVPosDataEnb@ */ Scalar_BOOLEAN 0 ME11_CM_boolean_flg 0.0 1.0 /end CHARACTERISTIC
/begin CHARACTERISTIC cal_HPEXVInitReqDataeEnb "" VALUE 0x0000 /* @ECU_Address@cal_HPEXVInitReqDataeEnb@ */ Scalar_BOOLEAN 0 ME11_CM_boolean_flg 0.0 1.0 /end CHARACTERISTIC
/begin CHARACTERISTIC BlowerACMode "" VALUE 0x0000 /* @ECU_Address@BlowerACMode@ */ Scalar_UBYTE 0 ME11_CM_uint8_flg 0.0 100.0 /end CHARACTERISTIC
/begin CHARACTERISTIC BlowerBILevelMode "" VALUE 0x0000 /* @ECU_Address@BlowerBILevelMode@ */ Scalar_UBYTE 0 ME11_CM_uint8_flg 0.0 100.0 /end CHARACTERISTIC
/begin CHARACTERISTIC BlowerDefrostMode "" VALUE 0x0000 /* @ECU_Address@BlowerDefrostMode@ */ Scalar_UBYTE 0 ME11_CM_uint8_flg 0.0 100.0 /end CHARACTERISTIC
/begin CHARACTERISTIC BlowerHeaterDefrostMode "" VALUE 0x0000 /* @ECU_Address@BlowerHeaterDefrostMode@ */ Scalar_UBYTE 0 ME11_CM_uint8_flg 0.0 100.0 /end CHARACTERISTIC
/begin CHARACTERISTIC BlowerHeaterMode "" VALUE 0x0000 /* @ECU_Address@BlowerHeaterMode@ */ Scalar_UBYTE 0 ME11_CM_uint8_flg 0.0 100.0 /end CHARACTERISTIC
/begin CHARACTERISTIC cal_ACRecirRatioLmt "" VALUE 0x0000 /* @ECU_Address@cal_ACRecirRatioLmt@ */ Scalar_UBYTE 0 ME11_CM_uint8_per_ 0.0 100.0 /end CHARACTERISTIC
/begin CHARACTERISTIC cal_FanLevelToPWM "" VAL_BLK 0x0000 /* @ECU_Address@cal_FanLevelToPWM@ */ Scalar_UBYTE 0 ME11_CM_uint8_percent_ 0.0 100.0 NUMBER 10 /end CHARACTERISTIC
/begin CHARACTERISTIC cal_HPEXVInitReqData "" VALUE 0x0000 /* @ECU_Address@cal_HPEXVInitReqData@ */ Scalar_UBYTE 0 ME11_CM_uint8_sts 0.0 4.0 /end CHARACTERISTIC
/begin CHARACTERISTIC cal_MixDoor2CabinCoolingEn_OFF "" VALUE 0x0000 /* @ECU_Address@cal_MixDoor2CabinCoolingEn_OFF@ */ Scalar_UBYTE 0 ME11_CM_uint8_per_ 0 255 /end CHARACTERISTIC
/begin CHARACTERISTIC cal_MixDoor2CabinCoolingEn_ON "" VALUE 0x0000 /* @ECU_Address@cal_MixDoor2CabinCoolingEn_ON@ */ Scalar_UBYTE 0 ME11_CM_uint8_per_ 0 255 /end CHARACTERISTIC
/begin MEASUREMENT ACCtl_tRightSetPointModeCor "" FLOAT32_IEEE ME11_CM_single_null 0 0 -3.4E+38 3.4E+38 ECU_ADDRESS 0x0000 /* @ECU_Address@ACCtl_tRightSetPointModeCor@ */ /end MEASUREMENT
/begin MEASUREMENT ACDVTPreSetSolarCor "" FLOAT32_IEEE ME11_CM_single_null 0 0 -3.4E+38 3.4E+38 ECU_ADDRESS 0x0000 /* @ECU_Address@ACDVTPreSetSolarCor@ */ /end MEASUREMENT
/begin MEASUREMENT ACDVTPreSetSolarCorByVx "" FLOAT32_IEEE ME11_CM_single_null 0 0 -3.4E+38 3.4E+38 ECU_ADDRESS 0x0000 /* @ECU_Address@ACDVTPreSetSolarCorByVx@ */ /end MEASUREMENT
/begin MEASUREMENT ACCCtl_sACCabinPreSetByEnv "" FLOAT32_IEEE ME11_CM_single_C 0 0 -3.4E+38 3.4E+38 ECU_ADDRESS 0x0000 /* @ECU_Address@ACCCtl_sACCabinPreSetByEnv@ */ /end MEASUREMENT
/begin MEASUREMENT CabinDesTempSolarCor "" FLOAT32_IEEE ME11_CM_single_null 0 0 -3.4E+38 3.4E+38 ECU_ADDRESS 0x0000 /* @ECU_Address@CabinDesTempSolarCor@ */ /end MEASUREMENT
/begin MEASUREMENT ACCCtl_sACCabinPreSetByEnvECO "" FLOAT32_IEEE ME11_CM_single_C 0 0 -3.4E+38 3.4E+38 ECU_ADDRESS 0x0000 /* @ECU_Address@ACCCtl_sACCabinPreSetByEnvECO@ */ /end MEASUREMENT
/begin MEASUREMENT CabinDesTempSolarCorECO "" FLOAT32_IEEE ME11_CM_single_null 0 0 -3.4E+38 3.4E+38 ECU_ADDRESS 0x0000 /* @ECU_Address@CabinDesTempSolarCorECO@ */ /end MEASUREMENT
/begin MEASUREMENT ACCtl_tDesFrontCabin "" FLOAT32_IEEE ME11_CM_single_null 0 0 -3.4E+38 3.4E+38 ECU_ADDRESS 0x0000 /* @ECU_Address@ACCtl_tDesFrontCabin@ */ /end MEASUREMENT
/begin MEASUREMENT AC_DVTPreSetByEnv "" FLOAT32_IEEE ME11_CM_single_null 0 0 -3.4E+38 3.4E+38 ECU_ADDRESS 0x0000 /* @ECU_Address@AC_DVTPreSetByEnv@ */ /end MEASUREMENT
/begin MEASUREMENT ACCtl_tDVTFeedfoward "" FLOAT32_IEEE ME11_CM_single_null 0 0 -3.4E+38 3.4E+38 ECU_ADDRESS 0x0000 /* @ECU_Address@ACCtl_tDVTFeedfoward@ */ /end MEASUREMENT
/begin MEASUREMENT EvapDesTempDrFanCor "" FLOAT32_IEEE ME11_CM_single_null 0 0 -3.4E+38 3.4E+38 ECU_ADDRESS 0x0000 /* @ECU_Address@EvapDesTempDrFanCor@ */ /end MEASUREMENT
/begin MEASUREMENT EvapDesTempDrEnvCor "" FLOAT32_IEEE ME11_CM_single_null 0 0 -3.4E+38 3.4E+38 ECU_ADDRESS 0x0000 /* @ECU_Address@EvapDesTempDrEnvCor@ */ /end MEASUREMENT
/begin MEASUREMENT EvapDesTempDrCabinCor "" FLOAT32_IEEE ME11_CM_single_null 0 0 -3.4E+38 3.4E+38 ECU_ADDRESS 0x0000 /* @ECU_Address@EvapDesTempDrCabinCor@ */ /end MEASUREMENT
/begin MEASUREMENT ACCtl_tDrSetBasicEvap "" FLOAT32_IEEE ME11_CM_single_null 0 0 -3.4E+38 3.4E+38 ECU_ADDRESS 0x0000 /* @ECU_Address@ACCtl_tDrSetBasicEvap@ */ /end MEASUREMENT
/begin MEASUREMENT EvapDesTempPsFanCor "" FLOAT32_IEEE ME11_CM_single_null 0 0 -3.4E+38 3.4E+38 ECU_ADDRESS 0x0000 /* @ECU_Address@EvapDesTempPsFanCor@ */ /end MEASUREMENT
/begin MEASUREMENT EvapDesTempPsEnvCor "" FLOAT32_IEEE ME11_CM_single_null 0 0 -3.4E+38 3.4E+38 ECU_ADDRESS 0x0000 /* @ECU_Address@EvapDesTempPsEnvCor@ */ /end MEASUREMENT
/begin MEASUREMENT EvapDesTempPsCabinCor "" FLOAT32_IEEE ME11_CM_single_null 0 0 -3.4E+38 3.4E+38 ECU_ADDRESS 0x0000 /* @ECU_Address@EvapDesTempPsCabinCor@ */ /end MEASUREMENT
/begin MEASUREMENT ACCtl_tPsSetBasicEvap "" FLOAT32_IEEE ME11_CM_single_null 0 0 -3.4E+38 3.4E+38 ECU_ADDRESS 0x0000 /* @ECU_Address@ACCtl_tPsSetBasicEvap@ */ /end MEASUREMENT
/begin MEASUREMENT ACPTCDrDesFanCor "" FLOAT32_IEEE ME11_CM_single_null 0 0 -3.4E+38 3.4E+38 ECU_ADDRESS 0x0000 /* @ECU_Address@ACPTCDrDesFanCor@ */ /end MEASUREMENT
/begin MEASUREMENT ACPTCDrDesEnvCor "" FLOAT32_IEEE ME11_CM_single_null 0 0 -3.4E+38 3.4E+38 ECU_ADDRESS 0x0000 /* @ECU_Address@ACPTCDrDesEnvCor@ */ /end MEASUREMENT
/begin MEASUREMENT ACPTCDrDesCabinCor "" FLOAT32_IEEE ME11_CM_single_null 0 0 -3.4E+38 3.4E+38 ECU_ADDRESS 0x0000 /* @ECU_Address@ACPTCDrDesCabinCor@ */ /end MEASUREMENT
/begin MEASUREMENT ACCtl_tDrSetBasicPTC "" FLOAT32_IEEE ME11_CM_single_null 0 0 -3.4E+38 3.4E+38 ECU_ADDRESS 0x0000 /* @ECU_Address@ACCtl_tDrSetBasicPTC@ */ /end MEASUREMENT
/begin MEASUREMENT ACPTCPsDesFanCor "" FLOAT32_IEEE ME11_CM_single_null 0 0 -3.4E+38 3.4E+38 ECU_ADDRESS 0x0000 /* @ECU_Address@ACPTCPsDesFanCor@ */ /end MEASUREMENT
/begin MEASUREMENT ACPTCPsDesEnvCor "" FLOAT32_IEEE ME11_CM_single_null 0 0 -3.4E+38 3.4E+38 ECU_ADDRESS 0x0000 /* @ECU_Address@ACPTCPsDesEnvCor@ */ /end MEASUREMENT
/begin MEASUREMENT ACPTCPsDesCabinCor "" FLOAT32_IEEE ME11_CM_single_null 0 0 -3.4E+38 3.4E+38 ECU_ADDRESS 0x0000 /* @ECU_Address@ACPTCPsDesCabinCor@ */ /end MEASUREMENT
/begin MEASUREMENT ACCtl_tPsSetBasicPTC "" FLOAT32_IEEE ME11_CM_single_null 0 0 -3.4E+38 3.4E+38 ECU_ADDRESS 0x0000 /* @ECU_Address@ACCtl_tPsSetBasicPTC@ */ /end MEASUREMENT
/begin MEASUREMENT SOMCtl_sBatHeatPTCTrgT "" FLOAT32_IEEE ME11_CM_single_C 0 0 -3.4E+38 3.4E+38 ECU_ADDRESS 0x0000 /* @ECU_Address@SOMCtl_sBatHeatPTCTrgT@ */ /end MEASUREMENT
/begin MEASUREMENT SOMCtl_sBatHeatTrgTempComp "" FLOAT32_IEEE ME11_CM_single_C 0 0 -3.4E+38 3.4E+38 ECU_ADDRESS 0x0000 /* @ECU_Address@SOMCtl_sBatHeatTrgTempComp@ */ /end MEASUREMENT
/begin MEASUREMENT ACTCtl_sCoolCondDepAvg1 "" FLOAT32_IEEE ME11_CM_single_C 0 0 -3.4E+38 3.4E+38 ECU_ADDRESS 0x0000 /* @ECU_Address@ACTCtl_sCoolCondDepAvg1@ */ /end MEASUREMENT
/begin MEASUREMENT ACTCtl_sEvapSuperHeatAvg1 "" FLOAT32_IEEE ME11_CM_single_C 0 0 -3.4E+38 3.4E+38 ECU_ADDRESS 0x0000 /* @ECU_Address@ACTCtl_sEvapSuperHeatAvg1@ */ /end MEASUREMENT
/begin MEASUREMENT ACTCtl_sAEXVI_Cor "" FLOAT32_IEEE ME11_CM_single_percent_ 0 0 -3.4E+38 3.4E+38 ECU_ADDRESS 0x0000 /* @ECU_Address@ACTCtl_sAEXVI_Cor@ */ /end MEASUREMENT
/begin MEASUREMENT ACTCtl_sChiSuperHeatAvg1 "" FLOAT32_IEEE ME11_CM_single_C 0 0 -3.4E+38 3.4E+38 ECU_ADDRESS 0x0000 /* @ECU_Address@ACTCtl_sChiSuperHeatAvg1@ */ /end MEASUREMENT
/begin MEASUREMENT ACTCtl_sBEXVI_Cor "" FLOAT32_IEEE ME11_CM_single_percent_ 0 0 -3.4E+38 3.4E+38 ECU_ADDRESS 0x0000 /* @ECU_Address@ACTCtl_sBEXVI_Cor@ */ /end MEASUREMENT
/begin MEASUREMENT ACTCtl_sCondDepAvg1 "" FLOAT32_IEEE ME11_CM_single_C 0 0 -3.4E+38 3.4E+38 ECU_ADDRESS 0x0000 /* @ECU_Address@ACTCtl_sCondDepAvg1@ */ /end MEASUREMENT
/begin MEASUREMENT ACTCtl_sHPEXVI_Cor "" FLOAT32_IEEE ME11_CM_single_percent_ 0 0 -3.4E+38 3.4E+38 ECU_ADDRESS 0x0000 /* @ECU_Address@ACTCtl_sHPEXVI_Cor@ */ /end MEASUREMENT
/begin MEASUREMENT ACTCtl_sExhSuperHeatAvg1 "" FLOAT32_IEEE ME11_CM_single_C 0 0 -3.4E+38 3.4E+38 ECU_ADDRESS 0x0000 /* @ECU_Address@ACTCtl_sExhSuperHeatAvg1@ */ /end MEASUREMENT
/begin MEASUREMENT ACTCtl_sSuperHeatAvg1 "" FLOAT32_IEEE ME11_CM_single_C 0 0 -3.4E+38 3.4E+38 ECU_ADDRESS 0x0000 /* @ECU_Address@ACTCtl_sSuperHeatAvg1@ */ /end MEASUREMENT
/begin MEASUREMENT ACCtl_PsfacPtc2NominalTemp "" FLOAT32_IEEE ME11_CM_single_null 0 0 -3.4E+38 3.4E+38 ECU_ADDRESS 0x0000 /* @ECU_Address@ACCtl_PsfacPtc2NominalTemp@ */ /end MEASUREMENT
/begin MEASUREMENT ACCtl_rPsSetMixDoorPCor "" FLOAT32_IEEE ME11_CM_single_null 0 0 -3.4E+38 3.4E+38 ECU_ADDRESS 0x0000 /* @ECU_Address@ACCtl_rPsSetMixDoorPCor@ */ /end MEASUREMENT
/begin MEASUREMENT ACCtl_rPsSetMixDoorICor "" FLOAT32_IEEE ME11_CM_single_null 0 0 -3.4E+38 3.4E+38 ECU_ADDRESS 0x0000 /* @ECU_Address@ACCtl_rPsSetMixDoorICor@ */ /end MEASUREMENT
/begin MEASUREMENT ACCtl_rPsSetMixDoorISum "" FLOAT32_IEEE ME11_CM_single_null 0 0 -3.4E+38 3.4E+38 ECU_ADDRESS 0x0000 /* @ECU_Address@ACCtl_rPsSetMixDoorISum@ */ /end MEASUREMENT
/begin MEASUREMENT ACCtl_DrfacPtc2NominalTemp "" FLOAT32_IEEE ME11_CM_single_null 0 0 -3.4E+38 3.4E+38 ECU_ADDRESS 0x0000 /* @ECU_Address@ACCtl_DrfacPtc2NominalTemp@ */ /end MEASUREMENT
/begin MEASUREMENT ACCtl_rDrSetMixDoorPCor "" FLOAT32_IEEE ME11_CM_single_null 0 0 -3.4E+38 3.4E+38 ECU_ADDRESS 0x0000 /* @ECU_Address@ACCtl_rDrSetMixDoorPCor@ */ /end MEASUREMENT
/begin MEASUREMENT ACCtl_rDrSetMixDoorICor "" FLOAT32_IEEE ME11_CM_single_null 0 0 -3.4E+38 3.4E+38 ECU_ADDRESS 0x0000 /* @ECU_Address@ACCtl_rDrSetMixDoorICor@ */ /end MEASUREMENT
/begin MEASUREMENT ACCtl_rDrSetMixDoorISum "" FLOAT32_IEEE ME11_CM_single_null 0 0 -3.4E+38 3.4E+38 ECU_ADDRESS 0x0000 /* @ECU_Address@ACCtl_rDrSetMixDoorISum@ */ /end MEASUREMENT
/begin MEASUREMENT ACCtl_tPsPTCICor "" FLOAT32_IEEE ME11_CM_single_null 0 0 -3.4E+38 3.4E+38 ECU_ADDRESS 0x0000 /* @ECU_Address@ACCtl_tPsPTCICor@ */ /end MEASUREMENT
/begin MEASUREMENT ACCtl_tPsPTCISum "" FLOAT32_IEEE ME11_CM_single_null 0 0 -3.4E+38 3.4E+38 ECU_ADDRESS 0x0000 /* @ECU_Address@ACCtl_tPsPTCISum@ */ /end MEASUREMENT
/begin MEASUREMENT ACCtl_tPsPTCPCor "" FLOAT32_IEEE ME11_CM_single_null 0 0 -3.4E+38 3.4E+38 ECU_ADDRESS 0x0000 /* @ECU_Address@ACCtl_tPsPTCPCor@ */ /end MEASUREMENT
/begin MEASUREMENT ACCtl_tDrPTCICor "" FLOAT32_IEEE ME11_CM_single_null 0 0 -3.4E+38 3.4E+38 ECU_ADDRESS 0x0000 /* @ECU_Address@ACCtl_tDrPTCICor@ */ /end MEASUREMENT
/begin MEASUREMENT ACCtl_tDrPTCISum "" FLOAT32_IEEE ME11_CM_single_null 0 0 -3.4E+38 3.4E+38 ECU_ADDRESS 0x0000 /* @ECU_Address@ACCtl_tDrPTCISum@ */ /end MEASUREMENT
/begin MEASUREMENT ACCtl_tDrPTCPCor "" FLOAT32_IEEE ME11_CM_single_null 0 0 -3.4E+38 3.4E+38 ECU_ADDRESS 0x0000 /* @ECU_Address@ACCtl_tDrPTCPCor@ */ /end MEASUREMENT
/begin MEASUREMENT ACCtl_tErrPsDVT2Duct "" FLOAT32_IEEE ME11_CM_single_null 0 0 -3.4E+38 3.4E+38 ECU_ADDRESS 0x0000 /* @ECU_Address@ACCtl_tErrPsDVT2Duct@ */ /end MEASUREMENT
/begin MEASUREMENT ACCtl_tPsEvapPCor "" FLOAT32_IEEE ME11_CM_single_null 0 0 -3.4E+38 3.4E+38 ECU_ADDRESS 0x0000 /* @ECU_Address@ACCtl_tPsEvapPCor@ */ /end MEASUREMENT
/begin MEASUREMENT ACCtl_tPsEvapICor "" FLOAT32_IEEE ME11_CM_single_null 0 0 -3.4E+38 3.4E+38 ECU_ADDRESS 0x0000 /* @ECU_Address@ACCtl_tPsEvapICor@ */ /end MEASUREMENT
/begin MEASUREMENT ACCtl_tPsEvapISum "" FLOAT32_IEEE ME11_CM_single_null 0 0 -3.4E+38 3.4E+38 ECU_ADDRESS 0x0000 /* @ECU_Address@ACCtl_tPsEvapISum@ */ /end MEASUREMENT
/begin MEASUREMENT ACCtl_tPsEvapDesPI "" FLOAT32_IEEE ME11_CM_single_null 0 0 -3.4E+38 3.4E+38 ECU_ADDRESS 0x0000 /* @ECU_Address@ACCtl_tPsEvapDesPI@ */ /end MEASUREMENT
/begin MEASUREMENT AC_PsEvapDesFilter "" FLOAT32_IEEE ME11_CM_single_null 0 0 -3.4E+38 3.4E+38 ECU_ADDRESS 0x0000 /* @ECU_Address@AC_PsEvapDesFilter@ */ /end MEASUREMENT
/begin MEASUREMENT ACCtl_tErrDrDVT2Duct "" FLOAT32_IEEE ME11_CM_single_null 0 0 -3.4E+38 3.4E+38 ECU_ADDRESS 0x0000 /* @ECU_Address@ACCtl_tErrDrDVT2Duct@ */ /end MEASUREMENT
/begin MEASUREMENT ACCtl_tDrEvapICor "" FLOAT32_IEEE ME11_CM_single_null 0 0 -3.4E+38 3.4E+38 ECU_ADDRESS 0x0000 /* @ECU_Address@ACCtl_tDrEvapICor@ */ /end MEASUREMENT
/begin MEASUREMENT ACCtl_tDrEvapISum "" FLOAT32_IEEE ME11_CM_single_null 0 0 -3.4E+38 3.4E+38 ECU_ADDRESS 0x0000 /* @ECU_Address@ACCtl_tDrEvapISum@ */ /end MEASUREMENT
/begin MEASUREMENT ACCtl_tDrEvapPCor "" FLOAT32_IEEE ME11_CM_single_null 0 0 -3.4E+38 3.4E+38 ECU_ADDRESS 0x0000 /* @ECU_Address@ACCtl_tDrEvapPCor@ */ /end MEASUREMENT
/begin MEASUREMENT ACCtl_tDrEvapDesPI "" FLOAT32_IEEE ME11_CM_single_null 0 0 -3.4E+38 3.4E+38 ECU_ADDRESS 0x0000 /* @ECU_Address@ACCtl_tDrEvapDesPI@ */ /end MEASUREMENT
/begin MEASUREMENT AC_DrEvapDesFilter "" FLOAT32_IEEE ME11_CM_single_null 0 0 -3.4E+38 3.4E+38 ECU_ADDRESS 0x0000 /* @ECU_Address@AC_DrEvapDesFilter@ */ /end MEASUREMENT
/begin MEASUREMENT AC_tEnvInvent "" FLOAT32_IEEE ME11_CM_single_null 0 0 -3.4E+38 3.4E+38 ECU_ADDRESS 0x0000 /* @ECU_Address@AC_tEnvInvent@ */ /end MEASUREMENT
/begin MEASUREMENT ACCtl_DVTIDeadBand "" FLOAT32_IEEE ME11_CM_single_null 0 0 -3.4E+38 3.4E+38 ECU_ADDRESS 0x0000 /* @ECU_Address@ACCtl_DVTIDeadBand@ */ /end MEASUREMENT
/begin MEASUREMENT ACCtl_tErrDVT "" FLOAT32_IEEE ME11_CM_single_null 0 0 -3.4E+38 3.4E+38 ECU_ADDRESS 0x0000 /* @ECU_Address@ACCtl_tErrDVT@ */ /end MEASUREMENT
/begin MEASUREMENT ACCtl_tDvtICor "" FLOAT32_IEEE ME11_CM_single_null 0 0 -3.4E+38 3.4E+38 ECU_ADDRESS 0x0000 /* @ECU_Address@ACCtl_tDvtICor@ */ /end MEASUREMENT
/begin MEASUREMENT PidCabinX_IsumMax "" FLOAT32_IEEE ME11_CM_single_null 0 0 -3.4E+38 3.4E+38 ECU_ADDRESS 0x0000 /* @ECU_Address@PidCabinX_IsumMax@ */ /end MEASUREMENT
/begin MEASUREMENT PidCabinX_IsumMin "" FLOAT32_IEEE ME11_CM_single_null 0 0 -3.4E+38 3.4E+38 ECU_ADDRESS 0x0000 /* @ECU_Address@PidCabinX_IsumMin@ */ /end MEASUREMENT
/begin MEASUREMENT ACCtl_tDvtISum "" FLOAT32_IEEE ME11_CM_single_null 0 0 -3.4E+38 3.4E+38 ECU_ADDRESS 0x0000 /* @ECU_Address@ACCtl_tDvtISum@ */ /end MEASUREMENT
/begin MEASUREMENT ACCtl_tDvtPCor "" FLOAT32_IEEE ME11_CM_single_null 0 0 -3.4E+38 3.4E+38 ECU_ADDRESS 0x0000 /* @ECU_Address@ACCtl_tDvtPCor@ */ /end MEASUREMENT
/begin MEASUREMENT AC_PidCabinT_UL "" FLOAT32_IEEE ME11_CM_single_null 0 0 -3.4E+38 3.4E+38 ECU_ADDRESS 0x0000 /* @ECU_Address@AC_PidCabinT_UL@ */ /end MEASUREMENT
/begin MEASUREMENT ACCtl_tDVTPIBas "" FLOAT32_IEEE ME11_CM_single_null 0 0 -3.4E+38 3.4E+38 ECU_ADDRESS 0x0000 /* @ECU_Address@ACCtl_tDVTPIBas@ */ /end MEASUREMENT
/begin MEASUREMENT ACCtl_RFaceFloor2Face "" FLOAT32_IEEE ME11_CM_single_null 0 0 -3.4E+38 3.4E+38 ECU_ADDRESS 0x0000 /* @ECU_Address@ACCtl_RFaceFloor2Face@ */ /end MEASUREMENT
/begin MEASUREMENT ACCtl_RFace2FaceFloor "" FLOAT32_IEEE ME11_CM_single_null 0 0 -3.4E+38 3.4E+38 ECU_ADDRESS 0x0000 /* @ECU_Address@ACCtl_RFace2FaceFloor@ */ /end MEASUREMENT
/begin MEASUREMENT ACCtl_RFaceFloor2Floor "" FLOAT32_IEEE ME11_CM_single_null 0 0 -3.4E+38 3.4E+38 ECU_ADDRESS 0x0000 /* @ECU_Address@ACCtl_RFaceFloor2Floor@ */ /end MEASUREMENT
/begin MEASUREMENT ACCtl_RFloor2FaceFloor "" FLOAT32_IEEE ME11_CM_single_null 0 0 -3.4E+38 3.4E+38 ECU_ADDRESS 0x0000 /* @ECU_Address@ACCtl_RFloor2FaceFloor@ */ /end MEASUREMENT
/begin MEASUREMENT ACCtl_tDVTFlt "" FLOAT32_IEEE ME11_CM_single_null 0 0 -3.4E+38 3.4E+38 ECU_ADDRESS 0x0000 /* @ECU_Address@ACCtl_tDVTFlt@ */ /end MEASUREMENT
/begin MEASUREMENT ACFanSpdSolarCor "" FLOAT32_IEEE ME11_CM_single_null 0 0 -3.4E+38 3.4E+38 ECU_ADDRESS 0x0000 /* @ECU_Address@ACFanSpdSolarCor@ */ /end MEASUREMENT
/begin MEASUREMENT ACFanSpdSolarCorByEnv "" FLOAT32_IEEE ME11_CM_single_null 0 0 -3.4E+38 3.4E+38 ECU_ADDRESS 0x0000 /* @ECU_Address@ACFanSpdSolarCorByEnv@ */ /end MEASUREMENT
/begin MEASUREMENT ACCCtl_sBlowerFanSpd "" FLOAT32_IEEE ME11_CM_single_percent_ 0 0 -3.4E+38 3.4E+38 ECU_ADDRESS 0x0000 /* @ECU_Address@ACCCtl_sBlowerFanSpd@ */ /end MEASUREMENT
/begin MEASUREMENT AC_rSunloadFlt "" UWORD ME11_CM_uint16_null 0 0 0 65535 ECU_ADDRESS 0x0000 /* @ECU_Address@AC_rSunloadFlt@ */ /end MEASUREMENT
/begin MEASUREMENT AC_tiAfterRun "" UWORD ME11_CM_uint16_ms 0 0 0 65535 ECU_ADDRESS 0x0000 /* @ECU_Address@AC_tiAfterRun@ */ /end MEASUREMENT
/begin MEASUREMENT GlbDa_LeftSolarAvr "" UWORD ME11_CM_uint16_null 0 0 0 65535 ECU_ADDRESS 0x0000 /* @ECU_Address@GlbDa_LeftSolarAvr@ */ /end MEASUREMENT
/begin MEASUREMENT SOMCtl_eBatCoolB2tB1 "" UBYTE ME11_CM_uint8_flg 0 0 0 255 ECU_ADDRESS 0x0000 /* @ECU_Address@SOMCtl_eBatCoolB2tB1@ */ /end MEASUREMENT
/begin MEASUREMENT SOMCtl_eBatCoolB1tB21 "" UBYTE ME11_CM_uint8_flg 0 0 0 255 ECU_ADDRESS 0x0000 /* @ECU_Address@SOMCtl_eBatCoolB1tB21@ */ /end MEASUREMENT
/begin MEASUREMENT SOMCtl_eBatCoolB1tB22 "" UBYTE ME11_CM_uint8_flg 0 0 0 255 ECU_ADDRESS 0x0000 /* @ECU_Address@SOMCtl_eBatCoolB1tB22@ */ /end MEASUREMENT
/begin MEASUREMENT SOMCtl_eBatHeatOffVal "" UBYTE ME11_CM_uint8_sts 0 0 0 255 ECU_ADDRESS 0x0000 /* @ECU_Address@SOMCtl_eBatHeatOffVal@ */ /end MEASUREMENT
/begin MEASUREMENT ACTCtl_bHPEXVInitReq "" UBYTE ME11_CM_uint8_sts 0 0 0 255 ECU_ADDRESS 0x0000 /* @ECU_Address@ACTCtl_bHPEXVInitReq@ */ /end MEASUREMENT
/begin MEASUREMENT ACTCtl_eLessThanT1Sts "" UBYTE ME11_CM_uint8_sts 0 0 0 255 ECU_ADDRESS 0x0000 /* @ECU_Address@ACTCtl_eLessThanT1Sts@ */ /end MEASUREMENT
/begin MEASUREMENT ACTCtl_bBatTempDiff "" UBYTE ME11_CM_uint8_flg 0 0 0 255 ECU_ADDRESS 0x0000 /* @ECU_Address@ACTCtl_bBatTempDiff@ */ /end MEASUREMENT
/begin MEASUREMENT ACCtl_stDvtPIDFreez "" UBYTE ME11_CM_uint8_null 0 0 0 255 ECU_ADDRESS 0x0000 /* @ECU_Address@ACCtl_stDvtPIDFreez@ */ /end MEASUREMENT
/begin MEASUREMENT AC_rRecircInc "" UBYTE ME11_CM_uint8_null 0 0 0 255 ECU_ADDRESS 0x0000 /* @ECU_Address@AC_rRecircInc@ */ /end MEASUREMENT
/begin MEASUREMENT SOMCtl_bBatHeatChrgFlgAB "" UBYTE ME11_CM_boolean_flg 0 0 0 1 ECU_ADDRESS 0x0000 /* @ECU_Address@SOMCtl_bBatHeatChrgFlgAB@ */ /end MEASUREMENT
/begin MEASUREMENT SOMCtl_bBatHeatChrgFlgCD "" UBYTE ME11_CM_boolean_flg 0 0 0 1 ECU_ADDRESS 0x0000 /* @ECU_Address@SOMCtl_bBatHeatChrgFlgCD@ */ /end MEASUREMENT
/begin MEASUREMENT SOMCtl_bBatHeatTempDiffE "" UBYTE ME11_CM_boolean_flg 0 0 0 1 ECU_ADDRESS 0x0000 /* @ECU_Address@SOMCtl_bBatHeatTempDiffE@ */ /end MEASUREMENT
/begin MEASUREMENT SOMCtl_bBatHeatPwrLmtF "" UBYTE ME11_CM_boolean_flg 0 0 0 1 ECU_ADDRESS 0x0000 /* @ECU_Address@SOMCtl_bBatHeatPwrLmtF@ */ /end MEASUREMENT
/begin MEASUREMENT SOMCtl_bBatB1TB41Flg "" UBYTE ME11_CM_boolean_flg 0 0 0 1 ECU_ADDRESS 0x0000 /* @ECU_Address@SOMCtl_bBatB1TB41Flg@ */ /end MEASUREMENT
/begin MEASUREMENT SOMCtl_bBatHeatOffFlg "" UBYTE ME11_CM_boolean_flg 0 0 0 1 ECU_ADDRESS 0x0000 /* @ECU_Address@SOMCtl_bBatHeatOffFlg@ */ /end MEASUREMENT
/begin MEASUREMENT SOMCtl_bBatB1TB42Flg "" UBYTE ME11_CM_boolean_flg 0 0 0 1 ECU_ADDRESS 0x0000 /* @ECU_Address@SOMCtl_bBatB1TB42Flg@ */ /end MEASUREMENT
/begin MEASUREMENT SOMCtl_bBatTSEntAFlg "" UBYTE ME11_CM_boolean_flg 0 0 0 1 ECU_ADDRESS 0x0000 /* @ECU_Address@SOMCtl_bBatTSEntAFlg@ */ /end MEASUREMENT
/begin MEASUREMENT SOMCtl_bBatTSEntBFlg "" UBYTE ME11_CM_boolean_flg 0 0 0 1 ECU_ADDRESS 0x0000 /* @ECU_Address@SOMCtl_bBatTSEntBFlg@ */ /end MEASUREMENT
/begin MEASUREMENT ACCtl_tErrDVTFlag "" UBYTE ME11_CM_boolean_null 0 0 0 1 ECU_ADDRESS 0x0000 /* @ECU_Address@ACCtl_tErrDVTFlag@ */ /end MEASUREMENT
/begin MEASUREMENT ACCtl_tErrACPTC "" FLOAT32_IEEE ME11_CM_single_null 0 0 -3.4E+38 3.4E+38 ECU_ADDRESS 0x0000 /* @ECU_Address@ACCtl_tErrACPTC@ */ /end MEASUREMENT
/begin MEASUREMENT ACCtl_pwrHeatingPCor "" FLOAT32_IEEE ME11_CM_single_null 0 0 -3.4E+38 3.4E+38 ECU_ADDRESS 0x0000 /* @ECU_Address@ACCtl_pwrHeatingPCor@ */ /end MEASUREMENT
/begin MEASUREMENT ACCtl_pwrHeatingICor "" FLOAT32_IEEE ME11_CM_single_null 0 0 -3.4E+38 3.4E+38 ECU_ADDRESS 0x0000 /* @ECU_Address@ACCtl_pwrHeatingICor@ */ /end MEASUREMENT
/begin MEASUREMENT ACCtl_pwrHeatingISum "" FLOAT32_IEEE ME11_CM_single_null 0 0 -3.4E+38 3.4E+38 ECU_ADDRESS 0x0000 /* @ECU_Address@ACCtl_pwrHeatingISum@ */ /end MEASUREMENT
/begin MEASUREMENT ACCtl_tErrACPTCPosFlag "" UBYTE ME11_CM_boolean_null 0 0 0 1 ECU_ADDRESS 0x0000 /* @ECU_Address@ACCtl_tErrACPTCPosFlag@ */ /end MEASUREMENT
/begin COMPU_METHOD ME11_CM_single_C "Q = V" RAT_FUNC "%8.6" "C" COEFFS 0 1 0 0 0 1 /end COMPU_METHOD
/begin COMPU_METHOD ME11_CM_single_v "Q = V" RAT_FUNC "%8.6" "v" COEFFS 0 1 0 0 0 1 /end COMPU_METHOD
/begin COMPU_METHOD ME11_CM_uint8_null "Q = V" RAT_FUNC "%3.0" "null" COEFFS 0 1 0 0 0 1 /end COMPU_METHOD
/begin COMPU_METHOD ME11_CM_single_Mpa "Q = V" RAT_FUNC "%8.6" "Mpa" COEFFS 0 1 0 0 0 1 /end COMPU_METHOD
/begin COMPU_METHOD ME11_CM_single_percent_ "Q = V" RAT_FUNC "%8.6" "%" COEFFS 0 1 0 0 0 1 /end COMPU_METHOD
/begin COMPU_METHOD ME11_CM_uint8_percent_ "Q = V" RAT_FUNC "%3.0" "%" COEFFS 0 1 0 0 0 1 /end COMPU_METHOD
/begin COMPU_METHOD ME11_CM_uint16_w_per_m_2 "Q = V" RAT_FUNC "%5.0" "w/m^2" COEFFS 0 1 0 0 0 1 /end COMPU_METHOD
/begin COMPU_METHOD ME11_CM_single_km_per_h "Q = V" RAT_FUNC "%8.6" "km/h" COEFFS 0 1 0 0 0 1 /end COMPU_METHOD
/begin COMPU_METHOD ME11_CM_single_kw "Q = V" RAT_FUNC "%8.6" "kw" COEFFS 0 1 0 0 0 1 /end COMPU_METHOD
/begin COMPU_METHOD ME11_CM_single_null "Q = V" RAT_FUNC "%8.6" "null" COEFFS 0 1 0 0 0 1 /end COMPU_METHOD
/begin COMPU_METHOD ME11_CM_single_rpm "Q = V" RAT_FUNC "%8.6" "rpm" COEFFS 0 1 0 0 0 1 /end COMPU_METHOD
/begin COMPU_METHOD ME11_CM_single_r "Q = V" RAT_FUNC "%8.6" "r" COEFFS 0 1 0 0 0 1 /end COMPU_METHOD
/begin COMPU_METHOD ME11_CM_single_s "Q = V" RAT_FUNC "%8.6" "s" COEFFS 0 1 0 0 0 1 /end COMPU_METHOD
/begin COMPU_METHOD ME11_CM_single_per_ "Q = V" RAT_FUNC "%8.6" "/" COEFFS 0 1 0 0 0 1 /end COMPU_METHOD
/begin COMPU_METHOD ME11_CM_uint16_s "Q = V" RAT_FUNC "%5.0" "s" COEFFS 0 1 0 0 0 1 /end COMPU_METHOD
/begin COMPU_METHOD ME11_CM_uint16_ms "Q = V" RAT_FUNC "%5.0" "ms" COEFFS 0 1 0 0 0 1 /end COMPU_METHOD
/begin COMPU_METHOD ME11_CM_uint16_per_ "Q = V" RAT_FUNC "%5.0" "/" COEFFS 0 1 0 0 0 1 /end COMPU_METHOD
/begin COMPU_METHOD ME11_CM_boolean_flg "Q = V" RAT_FUNC "%1.0" "flg" COEFFS 0 1 0 0 0 1 /end COMPU_METHOD
/begin COMPU_METHOD ME11_CM_boolean_per_ "Q = V" RAT_FUNC "%1.0" "/" COEFFS 0 1 0 0 0 1 /end COMPU_METHOD
/begin COMPU_METHOD ME11_CM_boolean_null "Q = V" RAT_FUNC "%1.0" "null" COEFFS 0 1 0 0 0 1 /end COMPU_METHOD
/begin COMPU_METHOD ME11_CM_uint8_flg "Q = V" RAT_FUNC "%3.0" "flg" COEFFS 0 1 0 0 0 1 /end COMPU_METHOD
/begin COMPU_METHOD ME11_CM_uint8_per_ "Q = V" RAT_FUNC "%3.0" "/" COEFFS 0 1 0 0 0 1 /end COMPU_METHOD
/begin COMPU_METHOD ME11_CM_uint8_sts "Q = V" RAT_FUNC "%3.0" "sts" COEFFS 0 1 0 0 0 1 /end COMPU_METHOD
/begin COMPU_METHOD ME11_CM_uint16_null "Q = V" RAT_FUNC "%5.0" "null" COEFFS 0 1 0 0 0 1 /end COMPU_METHOD
/begin GROUP S822_HPEXVCtrlC "ME11/ME11_TMS/Actuator/EXV/HPEXV/HPEXVParameterCal/HPEXVCtrlC"
 /begin REF_CHARACTERISTIC cal_HPEXVCtrlCDeadzone cal_HPEXVCtrlCDelayTime cal_HPEXVCtrlCFF_CUR cal_HPEXVCtrlCKi_CUR cal_HPEXVCtrlCKp_CUR cal_HPEXVCtrlCMax cal_HPEXVCtrlCMin cal_HPEXVCtrlCOpenVal /end REF_CHARACTERISTIC
/end GROUP
/begin GROUP S822_HPEXVCtrlD "ME11/ME11_TMS/Actuator/EXV/HPEXV/HPEXVParameterCal/HPEXVCtrlD"
 /begin REF_CHARACTERISTIC cal_HPEXVCtrlDDeadzone cal_HPEXVCtrlDDelayTime cal_HPEXVCtrlDFFLolmt cal_HPEXVCtrlDFFUplmt cal_HPEXVCtrlDFF_CUR cal_HPEXVCtrlDKi_CUR cal_HPEXVCtrlDKp_CUR cal_HPEXVCtrlDMax cal_HPEXVCtrlDMin cal_HPEXVCtrlDOpenVal cal_HPEXVCtrlDTrgtSubcool_CUR /end REF_CHARACTERISTIC
/end GROUP
/begin GROUP S822_HPEXVCtrlE "ME11/ME11_TMS/Actuator/EXV/HPEXV/HPEXVParameterCal/HPEXVCtrlE"
 /begin REF_CHARACTERISTIC cal_HPEXVCtrlEDeadzone cal_HPEXVCtrlEDelayTime cal_HPEXVCtrlEFFLolmt cal_HPEXVCtrlEFFUplmt cal_HPEXVCtrlEFF_CUR cal_HPEXVCtrlEKi_CUR cal_HPEXVCtrlEKp_CUR cal_HPEXVCtrlEMax cal_HPEXVCtrlEMin cal_HPEXVCtrlEOpenVal cal_HPEXVCtrlETrgtSubcool_CUR /end REF_CHARACTERISTIC
/end GROUP
/begin GROUP S822_PressLimit "ME11/ME11_TMS/Actuator/EXV/HPEXV/HPEXVParameterCal/PressLimit"
 /begin REF_CHARACTERISTIC cal_HPEXVHiPressLmtOff cal_HPEXVHiPressLmtOn cal_HPEXVLowPressLmtOff cal_HPEXVLowPressLmtOn /end REF_CHARACTERISTIC
/end GROUP
/begin GROUP S823_Override "ME11/ME11_TMS/Actuator/EXV/HPEXV/Init/Override" /begin REF_CHARACTERISTIC cal_HPEXVInitReqData cal_HPEXVInitReqDataeEnb /end REF_CHARACTERISTIC /begin REF_MEASUREMENT ACTCtl_bHPEXVInitReq /end REF_MEASUREMENT /end GROUP
/begin GROUP S895_Sensor_Filter "ME11/ME11_TMS/Actuator/EXV/SupercoolingOrSuperheat/AvgCondDep/Sensor_Filter" /begin REF_MEASUREMENT ACTCtl_sCondDepAvg1 /end REF_MEASUREMENT /end GROUP
/begin GROUP S896_Sensor_Filter "ME11/ME11_TMS/Actuator/EXV/SupercoolingOrSuperheat/AvgCondDep_Cool/Sensor_Filter" /begin REF_MEASUREMENT ACTCtl_sCoolCondDepAvg1 /end REF_MEASUREMENT /end GROUP
/begin GROUP S897_Sensor_Filter "ME11/ME11_TMS/Actuator/EXV/SupercoolingOrSuperheat/EvapSuperHeat/Sensor_Filter" /begin REF_MEASUREMENT ACTCtl_sEvapSuperHeatAvg1 /end REF_MEASUREMENT /end GROUP
/begin GROUP S898_Sensor_Filter "ME11/ME11_TMS/Actuator/EXV/SupercoolingOrSuperheat/EvapSuperHeat1/Sensor_Filter" /begin REF_MEASUREMENT ACTCtl_sChiSuperHeatAvg1 /end REF_MEASUREMENT /end GROUP
/begin GROUP S899_Sensor_Filter "ME11/ME11_TMS/Actuator/EXV/SupercoolingOrSuperheat/ExhSuperHeat/Sensor_Filter" /begin REF_MEASUREMENT ACTCtl_sExhSuperHeatAvg1 /end REF_MEASUREMENT /end GROUP
/begin GROUP S900_Sensor_Filter "ME11/ME11_TMS/Actuator/EXV/SupercoolingOrSuperheat/SuperHeat/Sensor_Filter" /begin REF_MEASUREMENT ACTCtl_sSuperHeatAvg1 /end REF_MEASUREMENT /end GROUP
/begin GROUP S1302_Subsystem "ME11/ME11_TMS/Power/RDCWorkMng/Stop_Manage/ACRunOffTimeCal/Subsystem" /begin REF_MEASUREMENT AC_tiAfterRun /end REF_MEASUREMENT /end GROUP
/begin GROUP S1337_A "ME11/ME11_TMS/SOM/BattaryMode/Balance/thermal_storage_enter/A"
 /begin REF_CHARACTERISTIC cal_TSBatMinTemplowValB cal_TSIGBTMinTempEntC cal_TSMotorMinTempEntC /end REF_CHARACTERISTIC
 /begin REF_MEASUREMENT SOMCtl_bBatTSEntAFlg /end REF_MEASUREMENT
/end GROUP
/begin GROUP S1337_B "ME11/ME11_TMS/SOM/BattaryMode/Balance/thermal_storage_enter/B" /begin SUB_GROUP S1359_A S1359_B S1359_C /end SUB_GROUP /begin REF_MEASUREMENT SOMCtl_bBatTSEntBFlg /end REF_MEASUREMENT /end GROUP
/begin GROUP S1338_C "ME11/ME11_TMS/SOM/BattaryMode/Balance/thermal_storage_exit/C" /begin REF_CHARACTERISTIC cal_TSBatMaxTempForEnvExitC_CUR /end REF_CHARACTERISTIC /end GROUP
/begin GROUP S1338_D "ME11/ME11_TMS/SOM/BattaryMode/Balance/thermal_storage_exit/D" /begin REF_CHARACTERISTIC cal_TSBatMinTempOffsetD /end REF_CHARACTERISTIC /end GROUP
/begin GROUP S1338_G "ME11/ME11_TMS/SOM/BattaryMode/Balance/thermal_storage_exit/G" /begin REF_CHARACTERISTIC cal_TSIGBTMinTempExitG /end REF_CHARACTERISTIC /end GROUP
/begin GROUP S1338_H "ME11/ME11_TMS/SOM/BattaryMode/Balance/thermal_storage_exit/H" /begin REF_CHARACTERISTIC cal_TSMotorMinTempExitH /end REF_CHARACTERISTIC /end GROUP
/begin GROUP S1338_I "ME11/ME11_TMS/SOM/BattaryMode/Balance/thermal_storage_exit/I" /begin REF_CHARACTERISTIC cal_TSIPUExitTempI /end REF_CHARACTERISTIC /end GROUP
/begin GROUP S1338_J "ME11/ME11_TMS/SOM/BattaryMode/Balance/thermal_storage_exit/J" /begin REF_CHARACTERISTIC cal_TSBatMinExitTempJ /end REF_CHARACTERISTIC /end GROUP
/begin GROUP S1338_K "ME11/ME11_TMS/SOM/BattaryMode/Balance/thermal_storage_exit/K" /begin REF_CHARACTERISTIC cal_TSDCBatMinExitTempK /end REF_CHARACTERISTIC /end GROUP
/begin GROUP S1338_M "ME11/ME11_TMS/SOM/BattaryMode/Balance/thermal_storage_exit/M" /begin REF_CHARACTERISTIC cal_ACChgBatHighSOCHeat cal_TSACBatMinExitTempM /end REF_CHARACTERISTIC /end GROUP
/begin GROUP S1338_N "ME11/ME11_TMS/SOM/BattaryMode/Balance/thermal_storage_exit/N" /begin REF_CHARACTERISTIC cal_ACChgBatLowSOCHeat cal_TSACBatMinExitTempN /end REF_CHARACTERISTIC /end GROUP
/begin GROUP S1338_P "ME11/ME11_TMS/SOM/BattaryMode/Balance/thermal_storage_exit/P" /begin REF_CHARACTERISTIC cal_TSBatInletTempOffsetP /end REF_CHARACTERISTIC /end GROUP
/begin GROUP S1390_ConditionABC "ME11/ME11_TMS/SOM/BattaryMode/Cool/B1_B21/ConditionABC" /begin REF_CHARACTERISTIC cal_tACBatCoolCellTempOn cal_tDCBatCoolCellTempOn /end REF_CHARACTERISTIC /end GROUP
/begin GROUP S1390_ConditionE "ME11/ME11_TMS/SOM/BattaryMode/Cool/B1_B21/ConditionE" /begin REF_CHARACTERISTIC cal_HeatPwrOn /end REF_CHARACTERISTIC /end GROUP
/begin GROUP S1390_Judge "ME11/ME11_TMS/SOM/BattaryMode/Cool/B1_B21/Judge" /begin REF_MEASUREMENT SOMCtl_eBatCoolB1tB21 /end REF_MEASUREMENT /end GROUP
/begin GROUP S1391_ConditionB "ME11/ME11_TMS/SOM/BattaryMode/Cool/B1_B22/ConditionB" /begin REF_CHARACTERISTIC cal_tBatCoolCellTempOn /end REF_CHARACTERISTIC /end GROUP
/begin GROUP S1391_ConditionD "ME11/ME11_TMS/SOM/BattaryMode/Cool/B1_B22/ConditionD" /begin REF_CHARACTERISTIC cal_HeatPwrOn /end REF_CHARACTERISTIC /end GROUP
/begin GROUP S1391_Judge "ME11/ME11_TMS/SOM/BattaryMode/Cool/B1_B22/Judge" /begin REF_MEASUREMENT SOMCtl_eBatCoolB1tB22 /end REF_MEASUREMENT /end GROUP
/begin GROUP S1392_ConditionD "ME11/ME11_TMS/SOM/BattaryMode/Cool/B2_B1/ConditionD" /begin REF_CHARACTERISTIC cal_BatHeatPwrLoLmt /end REF_CHARACTERISTIC /end GROUP
/begin GROUP S1392_ConditionGHI "ME11/ME11_TMS/SOM/BattaryMode/Cool/B2_B1/ConditionGHI"
 /begin REF_CHARACTERISTIC cal_tBatCoolACChrgCellTempOff cal_tBatCoolDCChrgCellTempOff cal_tBatCoolVehReadyCellTempOff /end REF_CHARACTERISTIC
/end GROUP
/begin GROUP S1392_Judge "ME11/ME11_TMS/SOM/BattaryMode/Cool/B2_B1/Judge" /begin REF_MEASUREMENT SOMCtl_eBatCoolB2tB1 /end REF_MEASUREMENT /end GROUP
/begin GROUP S1437_B "ME11/ME11_TMS/SOM/BattaryMode/DLTR/B1_B33/B" /begin REF_CHARACTERISTIC cal_tLTROnDCChrgMaxCellTemp /end REF_CHARACTERISTIC /end GROUP
/begin GROUP S1437_B1C1 "ME11/ME11_TMS/SOM/BattaryMode/DLTR/B1_B33/B1C1" /begin REF_CHARACTERISTIC cal_tLTROnDCChrgMaxCellTemp cal_tLTROnDCChrgMinCellTemp /end REF_CHARACTERISTIC /end GROUP
/begin GROUP S1437_C "ME11/ME11_TMS/SOM/BattaryMode/DLTR/B1_B33/C" /begin REF_CHARACTERISTIC cal_tLTROnMaxCellToMotDiff /end REF_CHARACTERISTIC /end GROUP
/begin GROUP S1438_A "ME11/ME11_TMS/SOM/BattaryMode/DLTR/B33_B1/A" /begin REF_CHARACTERISTIC cal_tLTROffBatBal2ToMaxCellDiff /end REF_CHARACTERISTIC /end GROUP
/begin GROUP S1438_B "ME11/ME11_TMS/SOM/BattaryMode/DLTR/B33_B1/B" /begin REF_CHARACTERISTIC cal_LTRExitBatMaxCellTemp /end REF_CHARACTERISTIC /end GROUP
/begin GROUP S1474_ConditionAorB "ME11/ME11_TMS/SOM/BattaryMode/Heat/B1_B41/ConditionAorB"
 /begin REF_CHARACTERISTIC cal_ACChgBatHighSOCHeat cal_ACChgBatLowSOCHeat cal_tBatHeatACChrgCellTempOn cal_tBatHeatACChrgSOCHighTempOn cal_tBatHeatDCChrgCellTempOn /end REF_CHARACTERISTIC
 /begin REF_MEASUREMENT SOMCtl_bBatHeatChrgFlgAB /end REF_MEASUREMENT
/end GROUP
/begin GROUP S1474_ConditionCorD "ME11/ME11_TMS/SOM/BattaryMode/Heat/B1_B41/ConditionCorD" /begin REF_MEASUREMENT SOMCtl_bBatHeatChrgFlgCD /end REF_MEASUREMENT /end GROUP
/begin GROUP S1474_ConditionE "ME11/ME11_TMS/SOM/BattaryMode/Heat/B1_B41/ConditionE" /begin REF_MEASUREMENT SOMCtl_bBatHeatTempDiffE /end REF_MEASUREMENT /end GROUP
/begin GROUP S1474_ConditionF "ME11/ME11_TMS/SOM/BattaryMode/Heat/B1_B41/ConditionF" /begin REF_CHARACTERISTIC cal_HeatPwrOn /end REF_CHARACTERISTIC /begin REF_MEASUREMENT SOMCtl_bBatHeatPwrLmtF /end REF_MEASUREMENT /end GROUP
/begin GROUP S1474_Judge "ME11/ME11_TMS/SOM/BattaryMode/Heat/B1_B41/Judge" /begin REF_MEASUREMENT SOMCtl_bBatB1TB41Flg /end REF_MEASUREMENT /end GROUP
/begin GROUP S1475_ConditionB "ME11/ME11_TMS/SOM/BattaryMode/Heat/B1_B42/ConditionB" /begin REF_CHARACTERISTIC cal_tBatHeatVehReadyCellTempOn /end REF_CHARACTERISTIC /end GROUP
/begin GROUP S1475_ConditionF "ME11/ME11_TMS/SOM/BattaryMode/Heat/B1_B42/ConditionF" /begin REF_CHARACTERISTIC cal_HeatPwrOn /end REF_CHARACTERISTIC /end GROUP
/begin GROUP S1475_Judge "ME11/ME11_TMS/SOM/BattaryMode/Heat/B1_B42/Judge" /begin REF_MEASUREMENT SOMCtl_bBatB1TB42Flg /end REF_MEASUREMENT /end GROUP
/begin GROUP S1476_ConditionB "ME11/ME11_TMS/SOM/BattaryMode/Heat/B41_B1/ConditionB" /begin REF_CHARACTERISTIC cal_BatHeatPwrLoLmt /end REF_CHARACTERISTIC /end GROUP
/begin GROUP S1476_ConditionHIJ "ME11/ME11_TMS/SOM/BattaryMode/Heat/B41_B1/ConditionHIJ"
 /begin REF_CHARACTERISTIC cal_ACChgBatHighSOCHeat cal_ACChgBatLowSOCHeat cal_tBatHeatACChrgCellTempOff cal_tBatHeatACChrgSOCHighTempOff cal_tBatHeatDCChrgCellTempOff cal_tBatHeatVehReadyCellTempOff /end REF_CHARACTERISTIC
/end GROUP
/begin GROUP S1476_Judge "ME11/ME11_TMS/SOM/BattaryMode/Heat/B41_B1/Judge" /begin REF_MEASUREMENT SOMCtl_bBatHeatOffFlg SOMCtl_eBatHeatOffVal /end REF_MEASUREMENT /end GROUP
/begin GROUP S1479_ACCharge "ME11/ME11_TMS/SOM/BattaryMode/Heat/calTemp/ACCharge"
 /begin REF_CHARACTERISTIC cal_ACBatHeatEnvTemp cal_ACBatHeatT1 cal_ACBatHeatT2 cal_ACBatHeatTave /end REF_CHARACTERISTIC
/end GROUP
/begin GROUP S1479_DCCharge "ME11/ME11_TMS/SOM/BattaryMode/Heat/calTemp/DCCharge"
 /begin REF_CHARACTERISTIC cal_DCBatHeatEnvTemp cal_DCBatHeatT1 cal_DCBatHeatT2 cal_DCBatHeatTave /end REF_CHARACTERISTIC
/end GROUP
/begin GROUP S1479_Discharge "ME11/ME11_TMS/SOM/BattaryMode/Heat/calTemp/Discharge"
 /begin REF_CHARACTERISTIC cal_NmlBatHeatEnvTemp cal_NmlBatHeatT1 cal_NmlBatHeatT2 cal_NmlBatHeatTave /end REF_CHARACTERISTIC
/end GROUP
/begin GROUP S1479_HeatTrgTemp "ME11/ME11_TMS/SOM/BattaryMode/Heat/calTemp/HeatTrgTemp"
 /begin REF_CHARACTERISTIC cal_ACChrgBatHeatTrgTemp_CUR cal_BatHeatTrgTempComp_CUR cal_DCChrgBatHeatTrgTemp_CUR cal_DisChrgBatHeatTrgTemp_CUR /end REF_CHARACTERISTIC
 /begin REF_MEASUREMENT SOMCtl_sBatHeatPTCTrgT SOMCtl_sBatHeatTrgTempComp /end REF_MEASUREMENT
/end GROUP
/begin GROUP S1539_A1 "ME11/ME11_TMS/SOM/BattaryMode/MotorAndBatLTR/Enter/A1" /begin REF_CHARACTERISTIC cal_DLTRDCBatMaxEntTempB_CUR /end REF_CHARACTERISTIC /end GROUP
/begin GROUP S1539_B "ME11/ME11_TMS/SOM/BattaryMode/MotorAndBatLTR/Enter/B" /begin REF_CHARACTERISTIC cal_DLTRBatMaxEntTempB_CUR /end REF_CHARACTERISTIC /end GROUP
/begin GROUP S1539_B1 "ME11/ME11_TMS/SOM/BattaryMode/MotorAndBatLTR/Enter/B1" /begin REF_CHARACTERISTIC cal_DLTRDCBatMaxEntTempB_CUR /end REF_CHARACTERISTIC /end GROUP
/begin GROUP S1539_B1C1 "ME11/ME11_TMS/SOM/BattaryMode/MotorAndBatLTR/Enter/B1C1" /begin REF_CHARACTERISTIC cal_tLTROnDCChrgMaxCellTemp cal_tLTROnDCChrgMinCellTemp /end REF_CHARACTERISTIC /end GROUP
/begin GROUP S1539_C "ME11/ME11_TMS/SOM/BattaryMode/MotorAndBatLTR/Enter/C" /begin REF_CHARACTERISTIC cal_tLTROnMaxCellToMotDiff /end REF_CHARACTERISTIC /end GROUP
/begin GROUP S1539_C1 "ME11/ME11_TMS/SOM/BattaryMode/MotorAndBatLTR/Enter/C1" /begin REF_CHARACTERISTIC cal_tLTROnMaxCellToMotDiff /end REF_CHARACTERISTIC /end GROUP
/begin GROUP S1540_A "ME11/ME11_TMS/SOM/BattaryMode/MotorAndBatLTR/Exit/A" /begin REF_CHARACTERISTIC cal_tLTROffBatBal2ToMaxCellDiff /end REF_CHARACTERISTIC /end GROUP
/begin GROUP S1540_BC "ME11/ME11_TMS/SOM/BattaryMode/MotorAndBatLTR/Exit/BC"
 /begin REF_CHARACTERISTIC cal_DLTRDCBatMaxExitTempB_CUR cal_DLTRNotDCBatMaxExitTempC_CUR /end REF_CHARACTERISTIC
/end GROUP
/begin GROUP S1540_D "ME11/ME11_TMS/SOM/BattaryMode/MotorAndBatLTR/Exit/D" /begin REF_CHARACTERISTIC cal_DLTRBatInlet2MaxTempDiff /end REF_CHARACTERISTIC /end GROUP
/begin GROUP S1632_C "ME11/ME11_TMS/SOM/BattaryMode/MotorLTRAndBatBalance/B33_B1/C" /begin REF_CHARACTERISTIC cal_TSDCBatMinExitTempK /end REF_CHARACTERISTIC /end GROUP
/begin GROUP S1632_D "ME11/ME11_TMS/SOM/BattaryMode/MotorLTRAndBatBalance/B33_B1/D" /begin REF_CHARACTERISTIC cal_ACChgBatHighSOCHeat cal_TSACBatMinExitTempM /end REF_CHARACTERISTIC /end GROUP
/begin GROUP S1632_E "ME11/ME11_TMS/SOM/BattaryMode/MotorLTRAndBatBalance/B33_B1/E" /begin REF_CHARACTERISTIC cal_ACChgBatLowSOCHeat cal_TSACBatMinExitTempN /end REF_CHARACTERISTIC /end GROUP
/begin GROUP S1632_I "ME11/ME11_TMS/SOM/BattaryMode/MotorLTRAndBatBalance/B33_B1/I" /begin REF_CHARACTERISTIC cal_TSIPUExitTempI /end REF_CHARACTERISTIC /end GROUP
/begin GROUP S1633_A "ME11/ME11_TMS/SOM/BattaryMode/MotorLTRAndBatBalance/Balance/A" /begin REF_CHARACTERISTIC cal_ACChgBatLowSOCHeat cal_TSACBatMinEntTempA /end REF_CHARACTERISTIC /end GROUP
/begin GROUP S1633_B "ME11/ME11_TMS/SOM/BattaryMode/MotorLTRAndBatBalance/Balance/B" /begin REF_CHARACTERISTIC cal_ACChgBatHighSOCHeat cal_TSACBatMinEntTempB /end REF_CHARACTERISTIC /end GROUP
/begin GROUP S1633_C "ME11/ME11_TMS/SOM/BattaryMode/MotorLTRAndBatBalance/Balance/C" /begin REF_CHARACTERISTIC cal_ACChgBatHighSOCHeat cal_TSDCBatMinEntTempC /end REF_CHARACTERISTIC /end GROUP
/begin GROUP S1633_D "ME11/ME11_TMS/SOM/BattaryMode/MotorLTRAndBatBalance/Balance/D" /begin REF_CHARACTERISTIC cal_ACChgBatHighSOCHeat /end REF_CHARACTERISTIC /end GROUP
/begin GROUP S49_ACFanLevelEnvCor "ME11/ME11_TMS/ACC/AutoAc/AutoACFun/BlowerFanSpeed/BlowerFanSpeedCalEnable/ACFanLevelEnvCor"
 /begin REF_CHARACTERISTIC cal_ACFanLevel0EnvCor_CUR cal_ACFanLevel1EnvCor_CUR cal_ACFanLevel2EnvCor_CUR cal_ACFanLevel3EnvCor_CUR cal_ACFanLevel4EnvCor_CUR cal_ACFanLevel5EnvCor_CUR cal_ACFanLevel6EnvCor_CUR cal_ACFanLevel7EnvCor_CUR cal_ACFanLevel8EnvCor_CUR /end REF_CHARACTERISTIC
/end GROUP
/begin GROUP S49_FanReqSpeedCal "ME11/ME11_TMS/ACC/AutoAc/AutoACFun/BlowerFanSpeed/BlowerFanSpeedCalEnable/FanReqSpeedCal" /begin SUB_GROUP S53_AutoMode S53_ManualMode /end SUB_GROUP /end GROUP
/begin GROUP S76_AutoMode "ME11/ME11_TMS/ACC/AutoAc/AutoACFun/BlowerMode/BlowerControlEnable/AutoMode" /begin SUB_GROUP S78_AutoBlowerMode /end SUB_GROUP /end GROUP
/begin GROUP S84_Compressor_ACWorkModeCheck "ME11/ME11_TMS/ACC/AutoAc/AutoACFun/Compressor_ACWorkModeCheck/CabinAccmReqEnable/Compressor_ACWorkModeCheck"
 /begin REF_CHARACTERISTIC cal_ErrOfEvaActTargInComf_OFF cal_ErrOfEvaActTargInComf_ON cal_ErrOfEvaActTargInEcon_OFF cal_ErrOfEvaActTargInEcon_ON cal_MixDoor2CabinCoolingEn_OFF cal_MixDoor2CabinCoolingEn_ON /end REF_CHARACTERISTIC
/end GROUP
/begin GROUP S84_Compressor_DefogWorkModeWithDefogCheck "ME11/ME11_TMS/ACC/AutoAc/AutoACFun/Compressor_ACWorkModeCheck/CabinAccmReqEnable/Compressor_DefogWorkModeWithDefogCheck"
 /begin REF_CHARACTERISTIC cal_ErrOfEvaActTargInDefog_OFF cal_ErrOfEvaActTargInDefog_ON /end REF_CHARACTERISTIC
/end GROUP
/begin GROUP S93_AC_PTCShutOffCond0 "ME11/ME11_TMS/ACC/AutoAc/AutoACFun/PTC_ACWorkModeCheck/AC_PTCCalEnableState/AC_PTCShutOffCond0"
 /begin REF_CHARACTERISTIC cal_ErrOfPTCActTargInComf_OFF cal_ErrOfPTCActTargInComf_ON cal_ErrOfPTCActTargInEcon_OFF cal_ErrOfPTCActTargInEcon_ON /end REF_CHARACTERISTIC
/end GROUP
/begin GROUP S94_IWin_Controller "ME11/ME11_TMS/ACC/AutoAc/AutoACFun/PTC_ACWorkModeCheck/PTC_PID/IWin_Controller" /begin SUB_GROUP S101_ISum /end SUB_GROUP /begin REF_MEASUREMENT ACCtl_pwrHeatingISum /end REF_MEASUREMENT /end GROUP
/begin GROUP S94_NegAndPosCheck "ME11/ME11_TMS/ACC/AutoAc/AutoACFun/PTC_ACWorkModeCheck/PTC_PID/NegAndPosCheck" /begin REF_MEASUREMENT ACCtl_tErrACPTC ACCtl_tErrACPTCPosFlag /end REF_MEASUREMENT /end GROUP
/begin GROUP S94_pWin_Controller "ME11/ME11_TMS/ACC/AutoAc/AutoACFun/PTC_ACWorkModeCheck/PTC_PID/pWin_Controller" /begin REF_MEASUREMENT ACCtl_pwrHeatingPCor /end REF_MEASUREMENT /end GROUP
/begin GROUP S122_DefogRiskLimIntakeRatio "ME11/ME11_TMS/ACC/AutoAc/AutoACFun/RecircModeEnaCalcu/ACCtlRecForSummerOrWinterOrNormalDefog1/DefogRiskLimIntakeRatio"
 /begin REF_CHARACTERISTIC cal_ACInletAutoDefogPrtEnvCor_CUR cal_ACInletDefogPrtEnvCor_CUR cal_ACInletDefogRiskCor_CUR cal_AutoDefogEnable /end REF_CHARACTERISTIC
/end GROUP
/begin GROUP S180_FrontCabinAimTempBasCal "ME11/ME11_TMS/ACC/AutoAc/EvaporatorAndPTCAimTempCal_FIX/DesiredVentTempCal_FIX/CalFrontVentDesireTemp/FrontCabinAimTempBasCal" /begin SUB_GROUP S184_PID_CalDVT_FIX /end SUB_GROUP /end GROUP
/begin GROUP S180_FrontCabinAimTempFeedfowardCorCal "ME11/ME11_TMS/ACC/AutoAc/EvaporatorAndPTCAimTempCal_FIX/DesiredVentTempCal_FIX/CalFrontVentDesireTemp/FrontCabinAimTempFeedfowardCorCal" /begin SUB_GROUP S185_SolarRamp /end SUB_GROUP
 /begin REF_CHARACTERISTIC cal_ACCabinPreSetByEnvECO_MAP cal_ACCabinPreSetByEnv_MAP cal_ACDVTPreSetByEnv_MAP cal_ACDVTPreSetEnvCor_CUR cal_ACDVTPreSetSolarCorByVx_MAP cal_ACDVTPreSetSolarCor_MAP cal_CabinDesTempSolarCorECO_MAP cal_CabinDesTempSolarCor_MAP cal_DefaultSetTemp cal_FalseTime2Solar cal_PsEnv4SetSelect cal_RiseTime2Solar /end REF_CHARACTERISTIC
 /begin REF_MEASUREMENT ACCCtl_sACCabinPreSetByEnv ACCCtl_sACCabinPreSetByEnvECO ACCtl_tDVTFeedfoward ACCtl_tDesFrontCabin ACCtl_tRightSetPointModeCor ACDVTPreSetSolarCor ACDVTPreSetSolarCorByVx AC_DVTPreSetByEnv CabinDesTempSolarCor CabinDesTempSolarCorECO /end REF_MEASUREMENT
/end GROUP
/begin GROUP S180_TempRamp "ME11/ME11_TMS/ACC/AutoAc/EvaporatorAndPTCAimTempCal_FIX/DesiredVentTempCal_FIX/CalFrontVentDesireTemp/TempRamp" /begin REF_MEASUREMENT AC_tEnvInvent /end REF_MEASUREMENT /end GROUP
/begin GROUP S275_CalAirCondEvapAimTemp_FIXPID "ME11/ME11_TMS/ACC/AutoAc/EvaporatorAndPTCAimTempCal_FIX/TargetEvaporatorTempGov/CalAirCondDrEvapAimTemp/CalAirCondEvapAimTemp_FIXPID"
 /begin SUB_GROUP S281_IWin_Controller S281_NegAndPosCheck S281_PI_Controller S281_pWin_Controller /end SUB_GROUP
 /begin REF_CHARACTERISTIC cal_DrEvaDesValPIDIntegDeadBandNeg cal_DrEvaDesValPIDIntegDeadBandPos cal_DrEvaDesValPIDKi cal_DrEvaDesValPIDKiNeg cal_DrEvaDesValPIDKiPos cal_DrEvaDesValPIDKp cal_DrEvaDesValPIDKpNeg cal_DrEvaDesValPIDKpPos cal_DrEvaDesValPIDLL cal_DrEvaDesValPIDUL cal_DrEvaDesValPID_IsumMax cal_DrEvaDesValPID_IsumMin cal_DrEvaDesValPID_pWinNeg cal_DrEvaDesValPID_pWinPos cal_DrEvapDesFilterByDvt_CUR /end REF_CHARACTERISTIC
 /begin REF_MEASUREMENT AC_DrEvapDesFilter /end REF_MEASUREMENT
/end GROUP
/begin GROUP S275_CalAirCondEvapDesTemp "ME11/ME11_TMS/ACC/AutoAc/EvaporatorAndPTCAimTempCal_FIX/TargetEvaporatorTempGov/CalAirCondDrEvapAimTemp/CalAirCondEvapDesTemp"
 /begin REF_CHARACTERISTIC cal_ACRecirRatioLmt cal_DrEvaDesValPIDLL cal_DrEvaDesValPIDUL cal_EvapBacTempDesACBi_CUR cal_EvapBacTempDesAC_CUR cal_EvapBacTempDesDefog_CUR cal_EvapBacTempDesFootDe_CUR cal_EvapBacTempDesFoot_CUR cal_EvapDesTempCabinCor_CUR cal_EvapDesTempEnvCor_MAP cal_EvapDesTempFanCor_CUR /end REF_CHARACTERISTIC
 /begin REF_MEASUREMENT ACCtl_tDrSetBasicEvap EvapDesTempDrCabinCor EvapDesTempDrEnvCor EvapDesTempDrFanCor /end REF_MEASUREMENT
/end GROUP
/begin GROUP S276_CalAirCondEvapAimTemp_RightDes "ME11/ME11_TMS/ACC/AutoAc/EvaporatorAndPTCAimTempCal_FIX/TargetEvaporatorTempGov/CalAirCondPsEvapAimTemp/CalAirCondEvapAimTemp_RightDes"
 /begin SUB_GROUP S306_IWin_Controller S306_NegAndPosCheck S306_PI_Controller S306_pWin_Controller /end SUB_GROUP
 /begin REF_CHARACTERISTIC cal_PsEvaDesValPIDIntegDeadBandNeg cal_PsEvaDesValPIDIntegDeadBandPos cal_PsEvaDesValPIDKi cal_PsEvaDesValPIDKiNeg cal_PsEvaDesValPIDKiPos cal_PsEvaDesValPIDKp cal_PsEvaDesValPIDKpNeg cal_PsEvaDesValPIDKpPos cal_PsEvaDesValPIDLL cal_PsEvaDesValPIDUL cal_PsEvaDesValPID_IsumMax cal_PsEvaDesValPID_IsumMin cal_PsEvaDesValPID_pWinNeg cal_PsEvaDesValPID_pWinPos cal_PsEvapDesFilterByDvt_CUR /end REF_CHARACTERISTIC
 /begin REF_MEASUREMENT AC_PsEvapDesFilter /end REF_MEASUREMENT
/end GROUP
/begin GROUP S276_CalAirCondMixVlvRightTrgBasicTemp "ME11/ME11_TMS/ACC/AutoAc/EvaporatorAndPTCAimTempCal_FIX/TargetEvaporatorTempGov/CalAirCondPsEvapAimTemp/CalAirCondMixVlvRightTrgBasicTemp"
 /begin REF_CHARACTERISTIC cal_ACRecirRatioLmt cal_DrEvaDesValPIDLL cal_DrEvaDesValPIDUL cal_EvapBacTempPsDesACBi_CUR cal_EvapBacTempPsDesAC_CUR cal_EvapBacTempPsDesDefog_CUR cal_EvapBacTempPsDesFootDe_CUR cal_EvapBacTempPsDesFoot_CUR cal_EvapDesTempPsCabinCor_CUR cal_EvapDesTempPsEnvCor_MAP cal_EvapDesTempPsFanCor_CUR /end REF_CHARACTERISTIC
 /begin REF_MEASUREMENT ACCtl_tPsSetBasicEvap EvapDesTempPsCabinCor EvapDesTempPsEnvCor EvapDesTempPsFanCor /end REF_MEASUREMENT
/end GROUP
/begin GROUP S335_CalAirCondMixVlvRightTrgBasicTemp "ME11/ME11_TMS/ACC/AutoAc/EvaporatorAndPTCAimTempCal_FIX/TargetPTCTempGov/CalPTCAimTemp_LeftDes/CalAirCondMixVlvRightTrgBasicTemp"
 /begin REF_CHARACTERISTIC cal_ACPTCDesBacAC_CUR cal_ACPTCDesBacBi_CUR cal_ACPTCDesBacDefog_CUR cal_ACPTCDesBacFootDe_CUR cal_ACPTCDesBacFoot_CUR cal_ACPTCDesCabinCor_CUR cal_ACPTCDesEnvCor_MAP cal_ACPTCDesFanCor_CUR cal_ACRecirRatioLmt /end REF_CHARACTERISTIC
 /begin REF_MEASUREMENT ACCtl_tDrSetBasicPTC ACPTCDrDesCabinCor ACPTCDrDesEnvCor ACPTCDrDesFanCor /end REF_MEASUREMENT
/end GROUP
/begin GROUP S335_CalAirCondPTCAimTemp_FIXPID "ME11/ME11_TMS/ACC/AutoAc/EvaporatorAndPTCAimTempCal_FIX/TargetPTCTempGov/CalPTCAimTemp_LeftDes/CalAirCondPTCAimTemp_FIXPID" /begin SUB_GROUP S342_IWin_Controller S342_pWin_Controller /end SUB_GROUP
 /begin REF_CHARACTERISTIC cal_DrPtcDesValPIDIntegDeadBand4InHeat cal_DrPtcDesValPIDIntegDeadBand4OutHeat cal_DrPtcDesValPIDKi cal_DrPtcDesValPIDKiNeg cal_DrPtcDesValPIDKiPos cal_DrPtcDesValPIDKp cal_DrPtcDesValPIDKpNeg cal_DrPtcDesValPIDKpPos cal_DrPtcDesValPIDLL cal_DrPtcDesValPIDUL cal_DrPtcDesValPID_IsumMax cal_DrPtcDesValPID_IsumMin cal_DrPtcDesValPID_pWinNeg cal_DrPtcDesValPID_pWinPos /end REF_CHARACTERISTIC
/end GROUP
/begin GROUP S336_CalAirCondMixVlvRightTrgBasicTemp "ME11/ME11_TMS/ACC/AutoAc/EvaporatorAndPTCAimTempCal_FIX/TargetPTCTempGov/CalPTCAimTemp_RightDes/CalAirCondMixVlvRightTrgBasicTemp"
 /begin REF_CHARACTERISTIC cal_ACPTCPsDesBacAC_CUR cal_ACPTCPsDesBacBi_CUR cal_ACPTCPsDesBacDefog_CUR cal_ACPTCPsDesBacFootDe_CUR cal_ACPTCPsDesBacFoot_CUR cal_ACPTCPsDesCabinCor_CUR cal_ACPTCPsDesEnvCor_MAP cal_ACPTCPsDesFanCor_CUR cal_ACRecirRatioLmt /end REF_CHARACTERISTIC
 /begin REF_MEASUREMENT ACCtl_tPsSetBasicPTC ACPTCPsDesCabinCor ACPTCPsDesEnvCor ACPTCPsDesFanCor /end REF_MEASUREMENT
/end GROUP
/begin GROUP S336_CalAirCondPTCAimTemp_LeftDes "ME11/ME11_TMS/ACC/AutoAc/EvaporatorAndPTCAimTempCal_FIX/TargetPTCTempGov/CalPTCAimTemp_RightDes/CalAirCondPTCAimTemp_LeftDes" /begin SUB_GROUP S364_IWin_Controller S364_pWin_Controller /end SUB_GROUP
 /begin REF_CHARACTERISTIC cal_PsPtcDesValPIDIntegDeadBand4InHeat cal_PsPtcDesValPIDIntegDeadBand4OutHeat cal_PsPtcDesValPIDKi cal_PsPtcDesValPIDKiNeg cal_PsPtcDesValPIDKiPos cal_PsPtcDesValPIDKp cal_PsPtcDesValPIDKpNeg cal_PsPtcDesValPIDKpPos cal_PsPtcDesValPIDLL cal_PsPtcDesValPIDUL cal_PsPtcDesValPID_IsumMax cal_PsPtcDesValPID_IsumMin cal_PsPtcDesValPID_pWinNeg cal_PsPtcDesValPID_pWinPos /end REF_CHARACTERISTIC
/end GROUP
/begin GROUP S389_CalFactorNominalTemp2ACPtcTemp "ME11/ME11_TMS/ACC/AutoAc/MixDoorOpenCloseDesCal/CalDrMixDoorDesRatio/CalAirCondMixVlvLeftTrgTemp/CalFactorNominalTemp2ACPtcTemp" /begin REF_CHARACTERISTIC cal_LAirmixNomOutWaterT /end REF_CHARACTERISTIC /begin REF_MEASUREMENT ACCtl_DrfacPtc2NominalTemp /end REF_MEASUREMENT /end GROUP
/begin GROUP S390_IWin_Controller "ME11/ME11_TMS/ACC/AutoAc/MixDoorOpenCloseDesCal/CalDrMixDoorDesRatio/CalDrMixDoorDesRatio_FIXPID/IWin_Controller" /begin SUB_GROUP S396_ISum /end SUB_GROUP /begin REF_MEASUREMENT ACCtl_rDrSetMixDoorISum /end REF_MEASUREMENT /end GROUP
/begin GROUP S390_pWin_Controller "ME11/ME11_TMS/ACC/AutoAc/MixDoorOpenCloseDesCal/CalDrMixDoorDesRatio/CalDrMixDoorDesRatio_FIXPID/pWin_Controller" /begin REF_MEASUREMENT ACCtl_rDrSetMixDoorPCor /end REF_MEASUREMENT /end GROUP
/begin GROUP S415_CalFactorNominalTemp2ACPtcTemp "ME11/ME11_TMS/ACC/AutoAc/MixDoorOpenCloseDesCal/CalPsMixDoorDesRatio/CalAirCondMixVlvRightTrgTemp/CalFactorNominalTemp2ACPtcTemp" /begin REF_CHARACTERISTIC cal_LAirmixNomOutWaterT /end REF_CHARACTERISTIC /begin REF_MEASUREMENT ACCtl_PsfacPtc2NominalTemp /end REF_MEASUREMENT /end GROUP
/begin GROUP S416_IWin_Controller "ME11/ME11_TMS/ACC/AutoAc/MixDoorOpenCloseDesCal/CalPsMixDoorDesRatio/CalPsMixDoorDesRatio/IWin_Controller" /begin SUB_GROUP S420_ISum /end SUB_GROUP /begin REF_MEASUREMENT ACCtl_rPsSetMixDoorISum /end REF_MEASUREMENT /end GROUP
/begin GROUP S416_pWin_Controller "ME11/ME11_TMS/ACC/AutoAc/MixDoorOpenCloseDesCal/CalPsMixDoorDesRatio/CalPsMixDoorDesRatio/pWin_Controller" /begin REF_MEASUREMENT ACCtl_rPsSetMixDoorPCor /end REF_MEASUREMENT /end GROUP
/begin GROUP S647_UpOrDown "ME11/ME11_TMS/Actuator/CWV/C3WV_MCV/MUL/FallInBetweenT1AndT2/UpOrDown" /begin REF_MEASUREMENT ACTCtl_bBatTempDiff /end REF_MEASUREMENT /end GROUP
/begin GROUP S649_UpOrDown "ME11/ME11_TMS/Actuator/CWV/C3WV_MCV/MUL/MinTempLessThanT1/UpOrDown" /begin SUB_GROUP S655_UpDown /end SUB_GROUP /end GROUP
/begin GROUP S697_ISum "ME11/ME11_TMS/Actuator/EXV/AEXV/AEXVPICtrl/IWin_Controller/ISum" /begin REF_MEASUREMENT ACTCtl_sAEXVI_Cor /end REF_MEASUREMENT /end GROUP
/begin GROUP S739_Filter "ME11/ME11_TMS/Actuator/EXV/AEXV/pressureprotection/OpenOrCloseAEXVPos/Filter" /begin REF_CHARACTERISTIC cal_AEXVDownSpdLmt cal_AEXVUpSpdLmt /end REF_CHARACTERISTIC /end GROUP
/begin GROUP S739_Filter1 "ME11/ME11_TMS/Actuator/EXV/AEXV/pressureprotection/OpenOrCloseAEXVPos/Filter1" /begin REF_CHARACTERISTIC cal_AEXVOpenCtrlDownSpdLmt cal_AEXVOpenCtrlUpSpdLmt /end REF_CHARACTERISTIC /end GROUP
/begin GROUP S765_ISum "ME11/ME11_TMS/Actuator/EXV/BEXV/BEXVPICtrl/IWin_Controller/ISum" /begin REF_MEASUREMENT ACTCtl_sBEXVI_Cor /end REF_MEASUREMENT /end GROUP
/begin GROUP S807_Override "ME11/ME11_TMS/Actuator/EXV/BEXV/pressure-protection/Choose/Override" /begin REF_CHARACTERISTIC cal_BEXVPosData cal_BEXVPosDataEnb /end REF_CHARACTERISTIC /end GROUP
/begin GROUP S807_StepLimit "ME11/ME11_TMS/Actuator/EXV/BEXV/pressure-protection/Choose/StepLimit" /begin REF_CHARACTERISTIC cal_BEXVFloorDiff1 cal_BEXVFloorDiff2 /end REF_CHARACTERISTIC /end GROUP
/begin GROUP S809_Filter "ME11/ME11_TMS/Actuator/EXV/BEXV/pressure-protection/OpenOrCloseControl/Filter" /begin REF_CHARACTERISTIC cal_BEXVDownSpdLmt cal_BEXVUpSpdLmt /end REF_CHARACTERISTIC /end GROUP
/begin GROUP S809_Filter1 "ME11/ME11_TMS/Actuator/EXV/BEXV/pressure-protection/OpenOrCloseControl/Filter1" /begin REF_CHARACTERISTIC cal_BEXVOpenCtrlDownSpdLmt cal_BEXVOpenCtrlUpSpdLmt /end REF_CHARACTERISTIC /end GROUP
/begin GROUP S825_Filter "ME11/ME11_TMS/Actuator/EXV/HPEXV/Arbitration/HPEXVLimit/Filter" /begin REF_CHARACTERISTIC cal_HPEXVDownSpdLmt cal_HPEXVUpSpdLmt /end REF_CHARACTERISTIC /end GROUP
/begin GROUP S825_Filter1 "ME11/ME11_TMS/Actuator/EXV/HPEXV/Arbitration/HPEXVLimit/Filter1" /begin REF_CHARACTERISTIC cal_HPEXVOpenCtrlDownSpdLmt cal_HPEXVOpenCtrlUpSpdLmt /end REF_CHARACTERISTIC /end GROUP
/begin GROUP S841_ISum "ME11/ME11_TMS/Actuator/EXV/HPEXV/HPEXVPICtrl/IWin_Controller/ISum" /begin REF_MEASUREMENT ACTCtl_sHPEXVI_Cor /end REF_MEASUREMENT /end GROUP
/begin GROUP S1359_A "ME11/ME11_TMS/SOM/BattaryMode/Balance/thermal_storage_enter/B/A" /begin REF_CHARACTERISTIC cal_ACChgBatLowSOCHeat cal_TSACBatMinEntTempA /end REF_CHARACTERISTIC /end GROUP
/begin GROUP S1359_B "ME11/ME11_TMS/SOM/BattaryMode/Balance/thermal_storage_enter/B/B" /begin REF_CHARACTERISTIC cal_ACChgBatHighSOCHeat cal_TSACBatMinEntTempB /end REF_CHARACTERISTIC /end GROUP
/begin GROUP S1359_C "ME11/ME11_TMS/SOM/BattaryMode/Balance/thermal_storage_enter/B/C" /begin REF_CHARACTERISTIC cal_TSDCBatMinEntTempC /end REF_CHARACTERISTIC /end GROUP
/begin GROUP S53_AutoMode "ME11/ME11_TMS/ACC/AutoAc/AutoACFun/BlowerFanSpeed/BlowerFanSpeedCalEnable/FanReqSpeedCal/AutoMode" /begin SUB_GROUP S54_AutoModeBloweFanSpeedCal S54_DefogBloweFanSpeedCal /end SUB_GROUP /end GROUP
/begin GROUP S53_ManualMode "ME11/ME11_TMS/ACC/AutoAc/AutoACFun/BlowerFanSpeed/BlowerFanSpeedCalEnable/FanReqSpeedCal/ManualMode" /begin REF_CHARACTERISTIC cal_FanLevelToPWM /end REF_CHARACTERISTIC /end GROUP
/begin GROUP S78_AutoBlowerMode "ME11/ME11_TMS/ACC/AutoAc/AutoACFun/BlowerMode/BlowerControlEnable/AutoMode/AutoBlowerMode"
 /begin REF_CHARACTERISTIC BlowerACMode BlowerBILevelMode BlowerDefrostMode BlowerHeaterDefrostMode BlowerHeaterMode cal_RFace2FaceFloorByEnv_CUR cal_RFaceFloor2FaceByEnv_CUR cal_RFaceFloor2FloorByEnv_CUR cal_RFloor2FaceFloorByEnv_CUR /end REF_CHARACTERISTIC
 /begin REF_MEASUREMENT ACCtl_RFace2FaceFloor ACCtl_RFaceFloor2Face ACCtl_RFaceFloor2Floor ACCtl_RFloor2FaceFloor /end REF_MEASUREMENT
/end GROUP
/begin GROUP S101_ISum "ME11/ME11_TMS/ACC/AutoAc/AutoACFun/PTC_ACWorkModeCheck/PTC_PID/IWin_Controller/ISum" /begin REF_MEASUREMENT ACCtl_pwrHeatingICor /end REF_MEASUREMENT /end GROUP
/begin GROUP S184_PID_CalDVT_FIX "ME11/ME11_TMS/ACC/AutoAc/EvaporatorAndPTCAimTempCal_FIX/DesiredVentTempCal_FIX/CalFrontVentDesireTemp/FrontCabinAimTempBasCal/PID_CalDVT_FIX"
 /begin SUB_GROUP S187_IWin_Controller S187_NegAndPosCheck S187_PI_Controller S187_pWin_Controller /end SUB_GROUP
 /begin REF_CHARACTERISTIC cal_DvtDesIsumMaxByCabinTDiff_CUR cal_DvtDesIsumMinByCabinTDiff_CUR cal_DvtDesLmtByCabinTDiff_MAP cal_DvtDesValPIDIntegDeadBand cal_DvtDesValPIDKi_CUR cal_DvtDesValPIDKp_CUR cal_DvtDesValPID_Ki cal_DvtDesValPID_Kp cal_DvtDesValPID_pWinNeg cal_DvtDesValPID_pWinPos /end REF_CHARACTERISTIC
 /begin REF_MEASUREMENT ACCtl_DVTIDeadBand AC_PidCabinT_UL PidCabinX_IsumMax PidCabinX_IsumMin /end REF_MEASUREMENT
/end GROUP
/begin GROUP S185_SolarRamp "ME11/ME11_TMS/ACC/AutoAc/EvaporatorAndPTCAimTempCal_FIX/DesiredVentTempCal_FIX/CalFrontVentDesireTemp/FrontCabinAimTempFeedfowardCorCal/SolarRamp"
 /begin REF_CHARACTERISTIC cal_SolarFalseStep cal_SolarRiseStep cal_UpAndDownStartTime /end REF_CHARACTERISTIC
 /begin REF_MEASUREMENT AC_rSunloadFlt /end REF_MEASUREMENT
/end GROUP
/begin GROUP S281_IWin_Controller "ME11/ME11_TMS/ACC/AutoAc/EvaporatorAndPTCAimTempCal_FIX/TargetEvaporatorTempGov/CalAirCondDrEvapAimTemp/CalAirCondEvapAimTemp_FIXPID/IWin_Controller" /begin SUB_GROUP S284_ISum /end SUB_GROUP /begin REF_MEASUREMENT ACCtl_tDrEvapISum /end REF_MEASUREMENT /end GROUP
/begin GROUP S281_NegAndPosCheck "ME11/ME11_TMS/ACC/AutoAc/EvaporatorAndPTCAimTempCal_FIX/TargetEvaporatorTempGov/CalAirCondDrEvapAimTemp/CalAirCondEvapAimTemp_FIXPID/NegAndPosCheck" /begin REF_MEASUREMENT ACCtl_tErrDrDVT2Duct /end REF_MEASUREMENT /end GROUP
/begin GROUP S281_PI_Controller "ME11/ME11_TMS/ACC/AutoAc/EvaporatorAndPTCAimTempCal_FIX/TargetEvaporatorTempGov/CalAirCondDrEvapAimTemp/CalAirCondEvapAimTemp_FIXPID/PI_Controller" /begin REF_MEASUREMENT ACCtl_tDrEvapDesPI /end REF_MEASUREMENT /end GROUP
/begin GROUP S281_pWin_Controller "ME11/ME11_TMS/ACC/AutoAc/EvaporatorAndPTCAimTempCal_FIX/TargetEvaporatorTempGov/CalAirCondDrEvapAimTemp/CalAirCondEvapAimTemp_FIXPID/pWin_Controller" /begin REF_MEASUREMENT ACCtl_tDrEvapPCor /end REF_MEASUREMENT /end GROUP
/begin GROUP S306_IWin_Controller "ME11/ME11_TMS/ACC/AutoAc/EvaporatorAndPTCAimTempCal_FIX/TargetEvaporatorTempGov/CalAirCondPsEvapAimTemp/CalAirCondEvapAimTemp_RightDes/IWin_Controller" /begin SUB_GROUP S310_ISum /end SUB_GROUP /begin REF_MEASUREMENT ACCtl_tPsEvapISum /end REF_MEASUREMENT /end GROUP
/begin GROUP S306_NegAndPosCheck "ME11/ME11_TMS/ACC/AutoAc/EvaporatorAndPTCAimTempCal_FIX/TargetEvaporatorTempGov/CalAirCondPsEvapAimTemp/CalAirCondEvapAimTemp_RightDes/NegAndPosCheck" /begin REF_MEASUREMENT ACCtl_tErrPsDVT2Duct /end REF_MEASUREMENT /end GROUP
/begin GROUP S306_PI_Controller "ME11/ME11_TMS/ACC/AutoAc/EvaporatorAndPTCAimTempCal_FIX/TargetEvaporatorTempGov/CalAirCondPsEvapAimTemp/CalAirCondEvapAimTemp_RightDes/PI_Controller" /begin REF_MEASUREMENT ACCtl_tPsEvapDesPI /end REF_MEASUREMENT /end GROUP
/begin GROUP S306_pWin_Controller "ME11/ME11_TMS/ACC/AutoAc/EvaporatorAndPTCAimTempCal_FIX/TargetEvaporatorTempGov/CalAirCondPsEvapAimTemp/CalAirCondEvapAimTemp_RightDes/pWin_Controller" /begin REF_MEASUREMENT ACCtl_tPsEvapPCor /end REF_MEASUREMENT /end GROUP
/begin GROUP S342_IWin_Controller "ME11/ME11_TMS/ACC/AutoAc/EvaporatorAndPTCAimTempCal_FIX/TargetPTCTempGov/CalPTCAimTemp_LeftDes/CalAirCondPTCAimTemp_FIXPID/IWin_Controller" /begin SUB_GROUP S344_ISum /end SUB_GROUP /begin REF_MEASUREMENT ACCtl_tDrPTCISum /end REF_MEASUREMENT /end GROUP
/begin GROUP S342_pWin_Controller "ME11/ME11_TMS/ACC/AutoAc/EvaporatorAndPTCAimTempCal_FIX/TargetPTCTempGov/CalPTCAimTemp_LeftDes/CalAirCondPTCAimTemp_FIXPID/pWin_Controller" /begin REF_MEASUREMENT ACCtl_tDrPTCPCor /end REF_MEASUREMENT /end GROUP
/begin GROUP S364_IWin_Controller "ME11/ME11_TMS/ACC/AutoAc/EvaporatorAndPTCAimTempCal_FIX/TargetPTCTempGov/CalPTCAimTemp_RightDes/CalAirCondPTCAimTemp_LeftDes/IWin_Controller" /begin SUB_GROUP S366_ISum /end SUB_GROUP /begin REF_MEASUREMENT ACCtl_tPsPTCISum /end REF_MEASUREMENT /end GROUP
/begin GROUP S364_pWin_Controller "ME11/ME11_TMS/ACC/AutoAc/EvaporatorAndPTCAimTempCal_FIX/TargetPTCTempGov/CalPTCAimTemp_RightDes/CalAirCondPTCAimTemp_LeftDes/pWin_Controller" /begin REF_MEASUREMENT ACCtl_tPsPTCPCor /end REF_MEASUREMENT /end GROUP
/begin GROUP S396_ISum "ME11/ME11_TMS/ACC/AutoAc/MixDoorOpenCloseDesCal/CalDrMixDoorDesRatio/CalDrMixDoorDesRatio_FIXPID/IWin_Controller/ISum" /begin REF_MEASUREMENT ACCtl_rDrSetMixDoorICor /end REF_MEASUREMENT /end GROUP
/begin GROUP S420_ISum "ME11/ME11_TMS/ACC/AutoAc/MixDoorOpenCloseDesCal/CalPsMixDoorDesRatio/CalPsMixDoorDesRatio/IWin_Controller/ISum" /begin REF_MEASUREMENT ACCtl_rPsSetMixDoorICor /end REF_MEASUREMENT /end GROUP
/begin GROUP S655_UpDown "ME11/ME11_TMS/Actuator/CWV/C3WV_MCV/MUL/MinTempLessThanT1/UpOrDown/UpDown" /begin REF_MEASUREMENT ACTCtl_eLessThanT1Sts /end REF_MEASUREMENT /end GROUP
/begin GROUP S54_AutoModeBloweFanSpeedCal "ME11/ME11_TMS/ACC/AutoAc/AutoACFun/BlowerFanSpeed/BlowerFanSpeedCalEnable/FanReqSpeedCal/AutoMode/AutoModeBloweFanSpeedCal" /begin SUB_GROUP S56_DVTWeightCal S56_FanSpeed2FanLevel /end SUB_GROUP
 /begin REF_CHARACTERISTIC cal_ACFanSpdBatCor_CUR cal_ACFanSpdDvtSet_CUR cal_ACFanSpdRecircCor_CUR cal_ACFanSpdSolarCorByEnv_MAP cal_ACFanSpdSolarCor_MAP cal_ACFanSpdVssCor_CUR cal_ACRecirRatioLmt cal_FanLevelToPWM /end REF_CHARACTERISTIC
 /begin REF_MEASUREMENT ACCCtl_sBlowerFanSpd ACFanSpdSolarCor ACFanSpdSolarCorByEnv AC_rRecircInc GlbDa_LeftSolarAvr /end REF_MEASUREMENT
/end GROUP
/begin GROUP S54_DefogBloweFanSpeedCal "ME11/ME11_TMS/ACC/AutoAc/AutoACFun/BlowerFanSpeed/BlowerFanSpeedCalEnable/FanReqSpeedCal/AutoMode/DefogBloweFanSpeedCal" /begin REF_CHARACTERISTIC cal_FanLevelToPWM /end REF_CHARACTERISTIC /end GROUP
/begin GROUP S187_IWin_Controller "ME11/ME11_TMS/ACC/AutoAc/EvaporatorAndPTCAimTempCal_FIX/DesiredVentTempCal_FIX/CalFrontVentDesireTemp/FrontCabinAimTempBasCal/PID_CalDVT_FIX/IWin_Controller" /begin SUB_GROUP S188_ISum /end SUB_GROUP /begin REF_MEASUREMENT ACCtl_tDvtISum /end REF_MEASUREMENT /end GROUP
/begin GROUP S187_NegAndPosCheck "ME11/ME11_TMS/ACC/AutoAc/EvaporatorAndPTCAimTempCal_FIX/DesiredVentTempCal_FIX/CalFrontVentDesireTemp/FrontCabinAimTempBasCal/PID_CalDVT_FIX/NegAndPosCheck" /begin REF_MEASUREMENT ACCtl_tErrDVT ACCtl_tErrDVTFlag /end REF_MEASUREMENT /end GROUP
/begin GROUP S187_PI_Controller "ME11/ME11_TMS/ACC/AutoAc/EvaporatorAndPTCAimTempCal_FIX/DesiredVentTempCal_FIX/CalFrontVentDesireTemp/FrontCabinAimTempBasCal/PID_CalDVT_FIX/PI_Controller" /begin REF_MEASUREMENT ACCtl_stDvtPIDFreez ACCtl_tDVTPIBas /end REF_MEASUREMENT /end GROUP
/begin GROUP S187_pWin_Controller "ME11/ME11_TMS/ACC/AutoAc/EvaporatorAndPTCAimTempCal_FIX/DesiredVentTempCal_FIX/CalFrontVentDesireTemp/FrontCabinAimTempBasCal/PID_CalDVT_FIX/pWin_Controller" /begin REF_MEASUREMENT ACCtl_tDvtPCor /end REF_MEASUREMENT /end GROUP
/begin GROUP S284_ISum "ME11/ME11_TMS/ACC/AutoAc/EvaporatorAndPTCAimTempCal_FIX/TargetEvaporatorTempGov/CalAirCondDrEvapAimTemp/CalAirCondEvapAimTemp_FIXPID/IWin_Controller/ISum" /begin REF_MEASUREMENT ACCtl_tDrEvapICor /end REF_MEASUREMENT /end GROUP
/begin GROUP S310_ISum "ME11/ME11_TMS/ACC/AutoAc/EvaporatorAndPTCAimTempCal_FIX/TargetEvaporatorTempGov/CalAirCondPsEvapAimTemp/CalAirCondEvapAimTemp_RightDes/IWin_Controller/ISum" /begin REF_MEASUREMENT ACCtl_tPsEvapICor /end REF_MEASUREMENT /end GROUP
/begin GROUP S344_ISum "ME11/ME11_TMS/ACC/AutoAc/EvaporatorAndPTCAimTempCal_FIX/TargetPTCTempGov/CalPTCAimTemp_LeftDes/CalAirCondPTCAimTemp_FIXPID/IWin_Controller/ISum" /begin REF_MEASUREMENT ACCtl_tDrPTCICor /end REF_MEASUREMENT /end GROUP
/begin GROUP S366_ISum "ME11/ME11_TMS/ACC/AutoAc/EvaporatorAndPTCAimTempCal_FIX/TargetPTCTempGov/CalPTCAimTemp_RightDes/CalAirCondPTCAimTemp_LeftDes/IWin_Controller/ISum" /begin REF_MEASUREMENT ACCtl_tPsPTCICor /end REF_MEASUREMENT /end GROUP
/begin GROUP S56_DVTWeightCal "ME11/ME11_TMS/ACC/AutoAc/AutoACFun/BlowerFanSpeed/BlowerFanSpeedCalEnable/FanReqSpeedCal/AutoMode/AutoModeBloweFanSpeedCal/DVTWeightCal" /begin REF_CHARACTERISTIC cal_PsDVTWeight /end REF_CHARACTERISTIC /begin REF_MEASUREMENT ACCtl_tDVTFlt /end REF_MEASUREMENT /end GROUP
/begin GROUP S56_FanSpeed2FanLevel "ME11/ME11_TMS/ACC/AutoAc/AutoACFun/BlowerFanSpeed/BlowerFanSpeedCalEnable/FanReqSpeedCal/AutoMode/AutoModeBloweFanSpeedCal/FanSpeed2FanLevel" /begin REF_CHARACTERISTIC cal_FanLevelToPWM /end REF_CHARACTERISTIC /end GROUP
/begin GROUP S188_ISum "ME11/ME11_TMS/ACC/AutoAc/EvaporatorAndPTCAimTempCal_FIX/DesiredVentTempCal_FIX/CalFrontVentDesireTemp/FrontCabinAimTempBasCal/PID_CalDVT_FIX/IWin_Controller/ISum" /begin REF_MEASUREMENT ACCtl_tDvtICor /end REF_MEASUREMENT /end GROUP
