/begin MOD_COMMON "Mod Common Comment Here" BYTE_ORDER MSB_LAST /end MOD_COMMON
/begin RECORD_LAYOUT Scalar_BOOLEAN FNC_VALUES 1 UBYTE COLUMN_DIR DIRECT /end RECORD_LAYOUT
/begin RECORD_LAYOUT Scalar_UBYTE FNC_VALUES 1 UBYTE COLUMN_DIR DIRECT /end RECORD_LAYOUT
/begin RECORD_LAYOUT Scalar_UWORD FNC_VALUES 1 UWORD COLUMN_DIR DIRECT /end RECORD_LAYOUT
/begin RECORD_LAYOUT Scalar_FLOAT32_IEEE FNC_VALUES 1 FLOAT32_IEEE COLUMN_DIR DIRECT /end RECORD_LAYOUT
/begin RECORD_LAYOUT Lookup1D_X_BYTE AXIS_PTS_X 1 SBYTE INDEX_INCR DIRECT /end RECORD_LAYOUT
/begin RECORD_LAYOUT Lookup1D_UBYTE FNC_VALUES 1 UBYTE COLUMN_DIR DIRECT /end RECORD_LAYOUT
/begin RECORD_LAYOUT Lookup1D_X_UBYTE AXIS_PTS_X 1 UBYTE INDEX_INCR DIRECT /end RECORD_LAYOUT
/begin RECORD_LAYOUT Lookup1D_X_WORD AXIS_PTS_X 1 SWORD INDEX_INCR DIRECT /end RECORD_LAYOUT
/begin RECORD_LAYOUT Lookup1D_ULONG FNC_VALUES 1 ULONG COLUMN_DIR DIRECT /end RECORD_LAYOUT
/begin RECORD_LAYOUT Lookup1D_X_ULONG AXIS_PTS_X 1 ULONG INDEX_INCR DIRECT /end RECORD_LAYOUT
/begin RECORD_LAYOUT Lookup1D_SLONG FNC_VALUES 1 SLONG COLUMN_DIR DIRECT /end RECORD_LAYOUT
/begin RECORD_LAYOUT Lookup1D_X_LONG AXIS_PTS_X 1 SLONG INDEX_INCR DIRECT /end RECORD_LAYOUT
/begin RECORD_LAYOUT Lookup1D_FLOAT32_IEEE FNC_VALUES 1 FLOAT32_IEEE COLUMN_DIR DIRECT /end RECORD_LAYOUT
/begin RECORD_LAYOUT Lookup1D_X_FLOAT32_IEEE AXIS_PTS_X 1 FLOAT32_IEEE INDEX_INCR DIRECT /end RECORD_LAYOUT
/begin RECORD_LAYOUT Lookup1D_FLOAT64_IEEE FNC_VALUES 1 FLOAT64_IEEE COLUMN_DIR DIRECT /end RECORD_LAYOUT
/begin RECORD_LAYOUT Lookup2D_X_UBYTE AXIS_PTS_X 1 UBYTE INDEX_INCR DIRECT /end RECORD_LAYOUT
/begin RECORD_LAYOUT Lookup2D_FLOAT32_IEEE FNC_VALUES 1 FLOAT32_IEEE COLUMN_DIR DIRECT /end RECORD_LAYOUT
/begin RECORD_LAYOUT Lookup2D_X_FLOAT32_IEEE AXIS_PTS_X 1 FLOAT32_IEEE INDEX_INCR DIRECT /end RECORD_LAYOUT
/begin CHARACTERISTIC cal_ColdStartPCUTempMinByEnv_CUR "" CURVE 0x0000 /* @ECU_Address@cal_ColdStartPCUTempMinByEnv_CUR@ */ Lookup1D_FLOAT32_IEEE 0 ME11_CM_single_C -40.0 100.0
 /begin AXIS_DESCR COM_AXIS EE_tEnv ME11_CM_single_C 7 -40.0 100.0 AXIS_PTS_REF cal_ColdStartPCUTempMinByEnv_1X /end AXIS_DESCR
/end CHARACTERISTIC
/begin AXIS_PTS cal_ColdStartPCUTempMinByEnv_1X "" 0x0000 /* @ECU_Address@cal_ColdStartPCUTempMinByEnv_1X@ */ EE_tEnv Lookup1D_X_FLOAT32_IEEE 0 ME11_CM_single_C 7 -40.0 100.0 /end AXIS_PTS
/begin CHARACTERISTIC cal_PCUtempOffset2ShutByEnv_CUR "" CURVE 0x0000 /* @ECU_Address@cal_PCUtempOffset2ShutByEnv_CUR@ */ Lookup1D_FLOAT32_IEEE 0 ME11_CM_single_C -40.0 100.0
 /begin AXIS_DESCR COM_AXIS EE_tEnv ME11_CM_single_C 7 -40.0 100.0 AXIS_PTS_REF cal_PCUtempOffset2ShutByEnv_1X /end AXIS_DESCR
/end CHARACTERISTIC
/begin AXIS_PTS cal_PCUtempOffset2ShutByEnv_1X "" 0x0000 /* @ECU_Address@cal_PCUtempOffset2ShutByEnv_1X@ */ EE_tEnv Lookup1D_X_FLOAT32_IEEE 0 ME11_CM_single_C 7 -40.0 100.0 /end AXIS_PTS
/begin CHARACTERISTIC cal_CabinTempDuctUpStepCor_CUR "" CURVE 0x0000 /* @ECU_Address@cal_CabinTempDuctUpStepCor_CUR@ */ Lookup1D_FLOAT32_IEEE 0 ME11_CM_single_C -40.0 80.0
 /begin AXIS_DESCR COM_AXIS NO_INPUT_QUANTITY ME11_CM_single_C 10 -40.0 80.0 AXIS_PTS_REF cal_CabinTempDuctUpStepCor_1X /end AXIS_DESCR
/end CHARACTERISTIC
/begin AXIS_PTS cal_CabinTempDuctUpStepCor_1X "" 0x0000 /* @ECU_Address@cal_CabinTempDuctUpStepCor_1X@ */ NO_INPUT_QUANTITY Lookup1D_X_FLOAT32_IEEE 0 ME11_CM_single_C 10 -40.0 80.0 /end AXIS_PTS
/begin CHARACTERISTIC cal_ECOEvaDesValLL_MAP "" MAP 0x0000 /* @ECU_Address@cal_ECOEvaDesValLL_MAP@ */ Lookup2D_FLOAT32_IEEE 0 ME11_CM_single_C -1.0 30.0
 /begin AXIS_DESCR COM_AXIS HMICtl_sLeftSetPoint ME11_CM_single_C 7 0.0 32.0 AXIS_PTS_REF cal_ECOEvaDesValLL_2Y /end AXIS_DESCR
 /begin AXIS_DESCR COM_AXIS ACSen_sEnvTempCor ME11_CM_single_null 6 -40.0 100.0 AXIS_PTS_REF cal_ECOEvaDesValLL_2X /end AXIS_DESCR
/end CHARACTERISTIC
/begin AXIS_PTS cal_ECOEvaDesValLL_2X "" 0x0000 /* @ECU_Address@cal_ECOEvaDesValLL_2X@ */ ACSen_sEnvTempCor Lookup2D_X_FLOAT32_IEEE 0 ME11_CM_single_null 6 -40.0 100.0 /end AXIS_PTS
/begin AXIS_PTS cal_ECOEvaDesValLL_2Y "" 0x0000 /* @ECU_Address@cal_ECOEvaDesValLL_2Y@ */ HMICtl_sLeftSetPoint Lookup2D_X_FLOAT32_IEEE 0 ME11_CM_single_C 7 0.0 32.0 /end AXIS_PTS
/begin CHARACTERISTIC cal_SetPtcDesTempMax_MAP "" MAP 0x0000 /* @ECU_Address@cal_SetPtcDesTempMax_MAP@ */ Lookup2D_FLOAT32_IEEE 0 ME11_CM_single_C 0.0 100.0
 /begin AXIS_DESCR COM_AXIS NO_INPUT_QUANTITY ME11_CM_uint8_percent_ 10 0.0 100.0 AXIS_PTS_REF cal_SetPtcDesTempMax_2Y /end AXIS_DESCR
 /begin AXIS_DESCR COM_AXIS ACSen_sEnvTempCor ME11_CM_single_C 10 -40.0 100.0 AXIS_PTS_REF cal_SetPtcDesTempMax_2X /end AXIS_DESCR
/end CHARACTERISTIC
/begin AXIS_PTS cal_SetPtcDesTempMax_2X "" 0x0000 /* @ECU_Address@cal_SetPtcDesTempMax_2X@ */ ACSen_sEnvTempCor Lookup2D_X_FLOAT32_IEEE 0 ME11_CM_single_C 10 -40.0 100.0 /end AXIS_PTS
/begin AXIS_PTS cal_SetPtcDesTempMax_2Y "" 0x0000 /* @ECU_Address@cal_SetPtcDesTempMax_2Y@ */ NO_INPUT_QUANTITY Lookup2D_X_UBYTE 0 ME11_CM_uint8_percent_ 10 0.0 100.0 /end AXIS_PTS
/begin CHARACTERISTIC cal_AccmSpdLimByHiPressDownSide_CUR "" CURVE 0x0000 /* @ECU_Address@cal_AccmSpdLimByHiPressDownSide_CUR@ */ Lookup1D_FLOAT32_IEEE 0 ME11_CM_single_rpm 0.0 8000.0
 /begin AXIS_DESCR COM_AXIS NO_INPUT_QUANTITY ME11_CM_uint8_L 12 0.0 20.0 AXIS_PTS_REF cal_AccmSpdLimByHiPressDownSide_1X /end AXIS_DESCR
/end CHARACTERISTIC
/begin AXIS_PTS cal_AccmSpdLimByHiPressDownSide_1X "" 0x0000 /* @ECU_Address@cal_AccmSpdLimByHiPressDownSide_1X@ */ NO_INPUT_QUANTITY Lookup1D_X_UBYTE 0 ME11_CM_uint8_L 12 0.0 20.0 /end AXIS_PTS
/begin CHARACTERISTIC cal_AccmSpdLimByHiPressLevelCalcu_CUR "" CURVE 0x0000 /* @ECU_Address@cal_AccmSpdLimByHiPressLevelCalcu_CUR@ */ Lookup1D_UBYTE 0 ME11_CM_uint8_L 0.0 20.0
 /begin AXIS_DESCR COM_AXIS ACSen_sHiPressFilter ME11_CM_single_mpa 12 0.0 10.0 AXIS_PTS_REF cal_AccmSpdLimByHiPressLevelCalcu_1X /end AXIS_DESCR
/end CHARACTERISTIC
/begin AXIS_PTS cal_AccmSpdLimByHiPressLevelCalcu_1X "" 0x0000 /* @ECU_Address@cal_AccmSpdLimByHiPressLevelCalcu_1X@ */ ACSen_sHiPressFilter Lookup1D_X_FLOAT32_IEEE 0 ME11_CM_single_mpa 12 0.0 10.0 /end AXIS_PTS
/begin CHARACTERISTIC cal_AccmSpdLimByHiPressUpSide_CUR "" CURVE 0x0000 /* @ECU_Address@cal_AccmSpdLimByHiPressUpSide_CUR@ */ Lookup1D_FLOAT32_IEEE 0 ME11_CM_single_rpm 0.0 8000.0
 /begin AXIS_DESCR COM_AXIS NO_INPUT_QUANTITY ME11_CM_uint8_L 12 0.0 20.0 AXIS_PTS_REF cal_AccmSpdLimByHiPressUpSide_1X /end AXIS_DESCR
/end CHARACTERISTIC
/begin AXIS_PTS cal_AccmSpdLimByHiPressUpSide_1X "" 0x0000 /* @ECU_Address@cal_AccmSpdLimByHiPressUpSide_1X@ */ NO_INPUT_QUANTITY Lookup1D_X_UBYTE 0 ME11_CM_uint8_L 12 0.0 20.0 /end AXIS_PTS
/begin CHARACTERISTIC cal_AccmSpdLimByLoPressDownSide_CUR "" CURVE 0x0000 /* @ECU_Address@cal_AccmSpdLimByLoPressDownSide_CUR@ */ Lookup1D_FLOAT32_IEEE 0 ME11_CM_single_rpm 0.0 8000.0
 /begin AXIS_DESCR COM_AXIS NO_INPUT_QUANTITY ME11_CM_uint8_L 12 0.0 20.0 AXIS_PTS_REF cal_AccmSpdLimByLoPressDownSide_1X /end AXIS_DESCR
/end CHARACTERISTIC
/begin AXIS_PTS cal_AccmSpdLimByLoPressDownSide_1X "" 0x0000 /* @ECU_Address@cal_AccmSpdLimByLoPressDownSide_1X@ */ NO_INPUT_QUANTITY Lookup1D_X_UBYTE 0 ME11_CM_uint8_L 12 0.0 20.0 /end AXIS_PTS
/begin CHARACTERISTIC cal_AccmSpdLimByLoPressLevelCalcu_CUR "" CURVE 0x0000 /* @ECU_Address@cal_AccmSpdLimByLoPressLevelCalcu_CUR@ */ Lookup1D_UBYTE 0 ME11_CM_uint8_L 0.0 20.0
 /begin AXIS_DESCR COM_AXIS ACSen_sLoPressFilter ME11_CM_single_mpa 12 0.0 10.0 AXIS_PTS_REF cal_AccmSpdLimByLoPressLevelCalcu_1X /end AXIS_DESCR
/end CHARACTERISTIC
/begin AXIS_PTS cal_AccmSpdLimByLoPressLevelCalcu_1X "" 0x0000 /* @ECU_Address@cal_AccmSpdLimByLoPressLevelCalcu_1X@ */ ACSen_sLoPressFilter Lookup1D_X_FLOAT32_IEEE 0 ME11_CM_single_mpa 12 0.0 10.0 /end AXIS_PTS
/begin CHARACTERISTIC cal_AccmSpdLimByLoPressUpSide_CUR "" CURVE 0x0000 /* @ECU_Address@cal_AccmSpdLimByLoPressUpSide_CUR@ */ Lookup1D_FLOAT32_IEEE 0 ME11_CM_single_rpm 0.0 8000.0
 /begin AXIS_DESCR COM_AXIS NO_INPUT_QUANTITY ME11_CM_uint8_L 12 0.0 20.0 AXIS_PTS_REF cal_AccmSpdLimByLoPressUpSide_1X /end AXIS_DESCR
/end CHARACTERISTIC
/begin AXIS_PTS cal_AccmSpdLimByLoPressUpSide_1X "" 0x0000 /* @ECU_Address@cal_AccmSpdLimByLoPressUpSide_1X@ */ NO_INPUT_QUANTITY Lookup1D_X_UBYTE 0 ME11_CM_uint8_L 12 0.0 20.0 /end AXIS_PTS
/begin CHARACTERISTIC cal_COMPATNoiseSpdLmtHVS_CUR "" CURVE 0x0000 /* @ECU_Address@cal_COMPATNoiseSpdLmtHVS_CUR@ */ Lookup1D_FLOAT32_IEEE 0 ME11_CM_single_rpm 0.0 8000.0
 /begin AXIS_DESCR COM_AXIS ACSen_sEnvTempCor ME11_CM_single_C 8 -40.0 150.0 AXIS_PTS_REF cal_COMPATNoiseSpdLmtHVS_1X /end AXIS_DESCR
/end CHARACTERISTIC
/begin AXIS_PTS cal_COMPATNoiseSpdLmtHVS_1X "" 0x0000 /* @ECU_Address@cal_COMPATNoiseSpdLmtHVS_1X@ */ ACSen_sEnvTempCor Lookup1D_X_FLOAT32_IEEE 0 ME11_CM_single_C 8 -40.0 150.0 /end AXIS_PTS
/begin CHARACTERISTIC cal_COMPATNoiseSpdLmt_MAP "" MAP 0x0000 /* @ECU_Address@cal_COMPATNoiseSpdLmt_MAP@ */ Lookup2D_FLOAT32_IEEE 0 ME11_CM_single_rpm 0.0 8000.0
 /begin AXIS_DESCR COM_AXIS NO_INPUT_QUANTITY ME11_CM_uint8_percent_ 10 0.0 100.0 AXIS_PTS_REF cal_COMPATNoiseSpdLmt_2Y /end AXIS_DESCR
 /begin AXIS_DESCR COM_AXIS ACTCtl_sACCMPIVal ME11_CM_single_rpm 10 0.0 8000.0 AXIS_PTS_REF cal_COMPATNoiseSpdLmt_2X /end AXIS_DESCR
/end CHARACTERISTIC
/begin AXIS_PTS cal_COMPATNoiseSpdLmt_2X "" 0x0000 /* @ECU_Address@cal_COMPATNoiseSpdLmt_2X@ */ ACTCtl_sACCMPIVal Lookup2D_X_FLOAT32_IEEE 0 ME11_CM_single_rpm 10 0.0 8000.0 /end AXIS_PTS
/begin AXIS_PTS cal_COMPATNoiseSpdLmt_2Y "" 0x0000 /* @ECU_Address@cal_COMPATNoiseSpdLmt_2Y@ */ NO_INPUT_QUANTITY Lookup2D_X_UBYTE 0 ME11_CM_uint8_percent_ 10 0.0 100.0 /end AXIS_PTS
/begin CHARACTERISTIC cal_PCULimBTMAccmSpdDes_CUR "" CURVE 0x0000 /* @ECU_Address@cal_PCULimBTMAccmSpdDes_CUR@ */ Lookup1D_FLOAT32_IEEE 0 ME11_CM_single_rpm 0.0 8000.0
 /begin AXIS_DESCR COM_AXIS ACSen_sMotTempFilter ME11_CM_single_C 8 -40.0 100.0 AXIS_PTS_REF cal_PCULimBTMAccmSpdDes_1X /end AXIS_DESCR
/end CHARACTERISTIC
/begin AXIS_PTS cal_PCULimBTMAccmSpdDes_1X "" 0x0000 /* @ECU_Address@cal_PCULimBTMAccmSpdDes_1X@ */ ACSen_sMotTempFilter Lookup1D_X_FLOAT32_IEEE 0 ME11_CM_single_C 8 -40.0 100.0 /end AXIS_PTS
/begin CHARACTERISTIC cal_PCULimBTMAndCabinAccmSpdDes_CUR "" CURVE 0x0000 /* @ECU_Address@cal_PCULimBTMAndCabinAccmSpdDes_CUR@ */ Lookup1D_FLOAT32_IEEE 0 ME11_CM_single_rpm 0.0 8000.0
 /begin AXIS_DESCR COM_AXIS ACSen_sMotTempFilter ME11_CM_single_C 8 -40.0 100.0 AXIS_PTS_REF cal_PCULimBTMAndCabinAccmSpdDes_1X /end AXIS_DESCR
/end CHARACTERISTIC
/begin AXIS_PTS cal_PCULimBTMAndCabinAccmSpdDes_1X "" 0x0000 /* @ECU_Address@cal_PCULimBTMAndCabinAccmSpdDes_1X@ */ ACSen_sMotTempFilter Lookup1D_X_FLOAT32_IEEE 0 ME11_CM_single_C 8 -40.0 100.0 /end AXIS_PTS
/begin CHARACTERISTIC cal_PCULimCabinAccmSpdDes_CUR "" CURVE 0x0000 /* @ECU_Address@cal_PCULimCabinAccmSpdDes_CUR@ */ Lookup1D_FLOAT32_IEEE 0 ME11_CM_single_rpm 0.0 8000.0
 /begin AXIS_DESCR COM_AXIS ACSen_sMotTempFilter ME11_CM_single_C 8 -40.0 100.0 AXIS_PTS_REF cal_PCULimCabinAccmSpdDes_1X /end AXIS_DESCR
/end CHARACTERISTIC
/begin AXIS_PTS cal_PCULimCabinAccmSpdDes_1X "" 0x0000 /* @ECU_Address@cal_PCULimCabinAccmSpdDes_1X@ */ ACSen_sMotTempFilter Lookup1D_X_FLOAT32_IEEE 0 ME11_CM_single_C 8 -40.0 100.0 /end AXIS_PTS
/begin CHARACTERISTIC cal_COMPEnvSpdLmt1_CUR "" CURVE 0x0000 /* @ECU_Address@cal_COMPEnvSpdLmt1_CUR@ */ Lookup1D_FLOAT32_IEEE 0 ME11_CM_single_rpm 0.0 8000.0
 /begin AXIS_DESCR COM_AXIS ACSen_sEnvTempCor ME11_CM_single_C 2 -40.0 150.0 AXIS_PTS_REF cal_COMPEnvSpdLmt1_1X /end AXIS_DESCR
/end CHARACTERISTIC
/begin AXIS_PTS cal_COMPEnvSpdLmt1_1X "" 0x0000 /* @ECU_Address@cal_COMPEnvSpdLmt1_1X@ */ ACSen_sEnvTempCor Lookup1D_X_FLOAT32_IEEE 0 ME11_CM_single_C 2 -40.0 150.0 /end AXIS_PTS
/begin CHARACTERISTIC cal_COMPEnvSpdLmt2_CUR "" CURVE 0x0000 /* @ECU_Address@cal_COMPEnvSpdLmt2_CUR@ */ Lookup1D_FLOAT32_IEEE 0 ME11_CM_single_rpm 0.0 8000.0
 /begin AXIS_DESCR COM_AXIS ACSen_sEnvTempCor ME11_CM_single_C 2 -40.0 150.0 AXIS_PTS_REF cal_COMPEnvSpdLmt2_1X /end AXIS_DESCR
/end CHARACTERISTIC
/begin AXIS_PTS cal_COMPEnvSpdLmt2_1X "" 0x0000 /* @ECU_Address@cal_COMPEnvSpdLmt2_1X@ */ ACSen_sEnvTempCor Lookup1D_X_FLOAT32_IEEE 0 ME11_CM_single_C 2 -40.0 150.0 /end AXIS_PTS
/begin CHARACTERISTIC cal_COMPEnvSpdLmt3_CUR "" CURVE 0x0000 /* @ECU_Address@cal_COMPEnvSpdLmt3_CUR@ */ Lookup1D_FLOAT32_IEEE 0 ME11_CM_single_rpm 0.0 8000.0
 /begin AXIS_DESCR COM_AXIS ACSen_sEnvTempCor ME11_CM_single_C 2 -40.0 150.0 AXIS_PTS_REF cal_COMPEnvSpdLmt3_1X /end AXIS_DESCR
/end CHARACTERISTIC
/begin AXIS_PTS cal_COMPEnvSpdLmt3_1X "" 0x0000 /* @ECU_Address@cal_COMPEnvSpdLmt3_1X@ */ ACSen_sEnvTempCor Lookup1D_X_FLOAT32_IEEE 0 ME11_CM_single_C 2 -40.0 150.0 /end AXIS_PTS
/begin CHARACTERISTIC cal_COMPFanLevelLmt_CUR "" CURVE 0x0000 /* @ECU_Address@cal_COMPFanLevelLmt_CUR@ */ Lookup1D_FLOAT32_IEEE 0 ME11_CM_single_rpm 0.0 8000.0
 /begin AXIS_DESCR COM_AXIS AC_FanLeVel ME11_CM_uint8_null 9 0.0 10.0 AXIS_PTS_REF cal_COMPFanLevelLmt_1X /end AXIS_DESCR
/end CHARACTERISTIC
/begin AXIS_PTS cal_COMPFanLevelLmt_1X "" 0x0000 /* @ECU_Address@cal_COMPFanLevelLmt_1X@ */ AC_FanLeVel Lookup1D_X_UBYTE 0 ME11_CM_uint8_null 9 0.0 10.0 /end AXIS_PTS
/begin CHARACTERISTIC cal_ACCMCtrlA1FF_CUR "" CURVE 0x0000 /* @ECU_Address@cal_ACCMCtrlA1FF_CUR@ */ Lookup1D_FLOAT32_IEEE 0 ME11_CM_single_rpm 0.0 8000.0
 /begin AXIS_DESCR COM_AXIS ACSen_sEnvTempCor ME11_CM_single_C 6 -40.0 100.0 AXIS_PTS_REF cal_ACCMCtrlA1FF_1X /end AXIS_DESCR
/end CHARACTERISTIC
/begin AXIS_PTS cal_ACCMCtrlA1FF_1X "" 0x0000 /* @ECU_Address@cal_ACCMCtrlA1FF_1X@ */ ACSen_sEnvTempCor Lookup1D_X_FLOAT32_IEEE 0 ME11_CM_single_C 6 -40.0 100.0 /end AXIS_PTS
/begin CHARACTERISTIC cal_ACCMCtrlA2FF_MAP "" MAP 0x0000 /* @ECU_Address@cal_ACCMCtrlA2FF_MAP@ */ Lookup2D_FLOAT32_IEEE 0 ME11_CM_single_rpm 0.0 8000.0
 /begin AXIS_DESCR COM_AXIS NO_INPUT_QUANTITY ME11_CM_single_C 5 -40.0 100.0 AXIS_PTS_REF cal_ACCMCtrlA2FF_2Y /end AXIS_DESCR
 /begin AXIS_DESCR COM_AXIS ACSen_sEnvTempCor ME11_CM_single_C 6 -40.0 100.0 AXIS_PTS_REF cal_ACCMCtrlA2FF_2X /end AXIS_DESCR
/end CHARACTERISTIC
/begin AXIS_PTS cal_ACCMCtrlA2FF_2X "" 0x0000 /* @ECU_Address@cal_ACCMCtrlA2FF_2X@ */ ACSen_sEnvTempCor Lookup2D_X_FLOAT32_IEEE 0 ME11_CM_single_C 6 -40.0 100.0 /end AXIS_PTS
/begin AXIS_PTS cal_ACCMCtrlA2FF_2Y "" 0x0000 /* @ECU_Address@cal_ACCMCtrlA2FF_2Y@ */ NO_INPUT_QUANTITY Lookup2D_X_FLOAT32_IEEE 0 ME11_CM_single_C 5 -40.0 100.0 /end AXIS_PTS
/begin CHARACTERISTIC cal_ACCMCtrlAKi_CUR "" CURVE 0x0000 /* @ECU_Address@cal_ACCMCtrlAKi_CUR@ */ Lookup1D_FLOAT32_IEEE 0 ME11_CM_single_null 0.0 100.0
 /begin AXIS_DESCR COM_AXIS ACTCtl_tCtrlADiff ME11_CM_single_C 8 -100.0 100.0 AXIS_PTS_REF cal_ACCMCtrlAKi_1X /end AXIS_DESCR
/end CHARACTERISTIC
/begin AXIS_PTS cal_ACCMCtrlAKi_1X "" 0x0000 /* @ECU_Address@cal_ACCMCtrlAKi_1X@ */ ACTCtl_tCtrlADiff Lookup1D_X_FLOAT32_IEEE 0 ME11_CM_single_C 8 -100.0 100.0 /end AXIS_PTS
/begin CHARACTERISTIC cal_ACCMCtrlAKp_CUR "" CURVE 0x0000 /* @ECU_Address@cal_ACCMCtrlAKp_CUR@ */ Lookup1D_FLOAT32_IEEE 0 ME11_CM_single_null 0.0 100.0
 /begin AXIS_DESCR COM_AXIS ACTCtl_tCtrlADiff ME11_CM_single_C 8 -100.0 100.0 AXIS_PTS_REF cal_ACCMCtrlAKp_1X /end AXIS_DESCR
/end CHARACTERISTIC
/begin AXIS_PTS cal_ACCMCtrlAKp_1X "" 0x0000 /* @ECU_Address@cal_ACCMCtrlAKp_1X@ */ ACTCtl_tCtrlADiff Lookup1D_X_FLOAT32_IEEE 0 ME11_CM_single_C 8 -100.0 100.0 /end AXIS_PTS
/begin CHARACTERISTIC cal_PTCAuxHeatPwrLmt_MAP "" MAP 0x0000 /* @ECU_Address@cal_PTCAuxHeatPwrLmt_MAP@ */ Lookup2D_FLOAT32_IEEE 0 ME11_CM_single_kw 0.0 10.0
 /begin AXIS_DESCR COM_AXIS HMICtl_sLeftSetPoint ME11_CM_single_C 6 -40.0 40.0 AXIS_PTS_REF cal_PTCAuxHeatPwrLmt_2X /end AXIS_DESCR
 /begin AXIS_DESCR COM_AXIS ACTCtl_tCtrlADiff ME11_CM_single_C 6 -40.0 30.0 AXIS_PTS_REF cal_PTCAuxHeatPwrLmt_2Y /end AXIS_DESCR
/end CHARACTERISTIC
/begin AXIS_PTS cal_PTCAuxHeatPwrLmt_2Y "" 0x0000 /* @ECU_Address@cal_PTCAuxHeatPwrLmt_2Y@ */ ACTCtl_tCtrlADiff Lookup2D_X_FLOAT32_IEEE 0 ME11_CM_single_C 6 -40.0 30.0 /end AXIS_PTS
/begin AXIS_PTS cal_PTCAuxHeatPwrLmt_2X "" 0x0000 /* @ECU_Address@cal_PTCAuxHeatPwrLmt_2X@ */ HMICtl_sLeftSetPoint Lookup2D_X_FLOAT32_IEEE 0 ME11_CM_single_C 6 -40.0 40.0 /end AXIS_PTS
/begin CHARACTERISTIC cal_PTCOnReqPower_CUR "" CURVE 0x0000 /* @ECU_Address@cal_PTCOnReqPower_CUR@ */ Lookup1D_FLOAT32_IEEE 0 ME11_CM_single_kw 0.0 10.0
 /begin AXIS_DESCR COM_AXIS ACCtl_tSetPointPTC ME11_CM_single_C 6 0.0 100.0 AXIS_PTS_REF cal_PTCOnReqPower_1X /end AXIS_DESCR
/end CHARACTERISTIC
/begin AXIS_PTS cal_PTCOnReqPower_1X "" 0x0000 /* @ECU_Address@cal_PTCOnReqPower_1X@ */ ACCtl_tSetPointPTC Lookup1D_X_FLOAT32_IEEE 0 ME11_CM_single_C 6 0.0 100.0 /end AXIS_PTS
/begin CHARACTERISTIC cal_ACCMCtrlBFF_CUR "" CURVE 0x0000 /* @ECU_Address@cal_ACCMCtrlBFF_CUR@ */ Lookup1D_FLOAT32_IEEE 0 ME11_CM_single_rpm 0.0 8000.0
 /begin AXIS_DESCR COM_AXIS BMS_HVBatCellTempMin ME11_CM_single_C 6 -40.0 100.0 AXIS_PTS_REF cal_ACCMCtrlBFF_1X /end AXIS_DESCR
/end CHARACTERISTIC
/begin AXIS_PTS cal_ACCMCtrlBFF_1X "" 0x0000 /* @ECU_Address@cal_ACCMCtrlBFF_1X@ */ BMS_HVBatCellTempMin Lookup1D_X_FLOAT32_IEEE 0 ME11_CM_single_C 6 -40.0 100.0 /end AXIS_PTS
/begin CHARACTERISTIC cal_ACCMCtrlBKi_CUR "" CURVE 0x0000 /* @ECU_Address@cal_ACCMCtrlBKi_CUR@ */ Lookup1D_FLOAT32_IEEE 0 ME11_CM_single_null 0.0 100.0
 /begin AXIS_DESCR COM_AXIS ACTCtl_tCtrlBDiff ME11_CM_single_C 8 -40.0 100.0 AXIS_PTS_REF cal_ACCMCtrlBKi_1X /end AXIS_DESCR
/end CHARACTERISTIC
/begin AXIS_PTS cal_ACCMCtrlBKi_1X "" 0x0000 /* @ECU_Address@cal_ACCMCtrlBKi_1X@ */ ACTCtl_tCtrlBDiff Lookup1D_X_FLOAT32_IEEE 0 ME11_CM_single_C 8 -40.0 100.0 /end AXIS_PTS
/begin CHARACTERISTIC cal_ACCMCtrlBKp_CUR "" CURVE 0x0000 /* @ECU_Address@cal_ACCMCtrlBKp_CUR@ */ Lookup1D_FLOAT32_IEEE 0 ME11_CM_single_null 0.0 100.0
 /begin AXIS_DESCR COM_AXIS ACTCtl_tCtrlBDiff ME11_CM_single_C 8 -40.0 100.0 AXIS_PTS_REF cal_ACCMCtrlBKp_1X /end AXIS_DESCR
/end CHARACTERISTIC
/begin AXIS_PTS cal_ACCMCtrlBKp_1X "" 0x0000 /* @ECU_Address@cal_ACCMCtrlBKp_1X@ */ ACTCtl_tCtrlBDiff Lookup1D_X_FLOAT32_IEEE 0 ME11_CM_single_C 8 -40.0 100.0 /end AXIS_PTS
/begin CHARACTERISTIC cal_ACCMCtrlC1FF_CUR "" CURVE 0x0000 /* @ECU_Address@cal_ACCMCtrlC1FF_CUR@ */ Lookup1D_FLOAT32_IEEE 0 ME11_CM_single_rpm 0.0 8000.0
 /begin AXIS_DESCR COM_AXIS ACSen_sEnvTempCor ME11_CM_single_C 5 -40.0 100.0 AXIS_PTS_REF cal_ACCMCtrlC1FF_1X /end AXIS_DESCR
/end CHARACTERISTIC
/begin AXIS_PTS cal_ACCMCtrlC1FF_1X "" 0x0000 /* @ECU_Address@cal_ACCMCtrlC1FF_1X@ */ ACSen_sEnvTempCor Lookup1D_X_FLOAT32_IEEE 0 ME11_CM_single_C 5 -40.0 100.0 /end AXIS_PTS
/begin CHARACTERISTIC cal_ACCMCtrlC2FF_CUR "" CURVE 0x0000 /* @ECU_Address@cal_ACCMCtrlC2FF_CUR@ */ Lookup1D_FLOAT32_IEEE 0 ME11_CM_single_rpm 0.0 8000.0
 /begin AXIS_DESCR COM_AXIS NO_INPUT_QUANTITY ME11_CM_single_C 4 -40.0 100.0 AXIS_PTS_REF cal_ACCMCtrlC2FF_1X /end AXIS_DESCR
/end CHARACTERISTIC
/begin AXIS_PTS cal_ACCMCtrlC2FF_1X "" 0x0000 /* @ECU_Address@cal_ACCMCtrlC2FF_1X@ */ NO_INPUT_QUANTITY Lookup1D_X_FLOAT32_IEEE 0 ME11_CM_single_C 4 -40.0 100.0 /end AXIS_PTS
/begin CHARACTERISTIC cal_ACCMCtrlCKi_CUR "" CURVE 0x0000 /* @ECU_Address@cal_ACCMCtrlCKi_CUR@ */ Lookup1D_FLOAT32_IEEE 0 ME11_CM_single_null 0.0 100.0
 /begin AXIS_DESCR COM_AXIS ACTCtl_tCtrlCDiff ME11_CM_single_C 8 -100.0 100.0 AXIS_PTS_REF cal_ACCMCtrlCKi_1X /end AXIS_DESCR
/end CHARACTERISTIC
/begin AXIS_PTS cal_ACCMCtrlCKi_1X "" 0x0000 /* @ECU_Address@cal_ACCMCtrlCKi_1X@ */ ACTCtl_tCtrlCDiff Lookup1D_X_FLOAT32_IEEE 0 ME11_CM_single_C 8 -100.0 100.0 /end AXIS_PTS
/begin CHARACTERISTIC cal_ACCMCtrlCKp_CUR "" CURVE 0x0000 /* @ECU_Address@cal_ACCMCtrlCKp_CUR@ */ Lookup1D_FLOAT32_IEEE 0 ME11_CM_single_null 0.0 100.0
 /begin AXIS_DESCR COM_AXIS ACTCtl_tCtrlCDiff ME11_CM_single_C 8 -100.0 100.0 AXIS_PTS_REF cal_ACCMCtrlCKp_1X /end AXIS_DESCR
/end CHARACTERISTIC
/begin AXIS_PTS cal_ACCMCtrlCKp_1X "" 0x0000 /* @ECU_Address@cal_ACCMCtrlCKp_1X@ */ ACTCtl_tCtrlCDiff Lookup1D_X_FLOAT32_IEEE 0 ME11_CM_single_C 8 -100.0 100.0 /end AXIS_PTS
/begin CHARACTERISTIC cal_ACCMCtrlD1FF_CUR "" CURVE 0x0000 /* @ECU_Address@cal_ACCMCtrlD1FF_CUR@ */ Lookup1D_FLOAT32_IEEE 0 ME11_CM_single_rpm 0.0 8000.0
 /begin AXIS_DESCR COM_AXIS ACSen_sEnvTempCor ME11_CM_single_C 3 -40.0 100.0 AXIS_PTS_REF cal_ACCMCtrlD1FF_1X /end AXIS_DESCR
/end CHARACTERISTIC
/begin AXIS_PTS cal_ACCMCtrlD1FF_1X "" 0x0000 /* @ECU_Address@cal_ACCMCtrlD1FF_1X@ */ ACSen_sEnvTempCor Lookup1D_X_FLOAT32_IEEE 0 ME11_CM_single_C 3 -40.0 100.0 /end AXIS_PTS
/begin CHARACTERISTIC cal_ACCMCtrlD2FF_CUR "" CURVE 0x0000 /* @ECU_Address@cal_ACCMCtrlD2FF_CUR@ */ Lookup1D_FLOAT32_IEEE 0 ME11_CM_single_rpm 0.0 8000.0
 /begin AXIS_DESCR COM_AXIS NO_INPUT_QUANTITY ME11_CM_single_C 4 -40.0 100.0 AXIS_PTS_REF cal_ACCMCtrlD2FF_1X /end AXIS_DESCR
/end CHARACTERISTIC
/begin AXIS_PTS cal_ACCMCtrlD2FF_1X "" 0x0000 /* @ECU_Address@cal_ACCMCtrlD2FF_1X@ */ NO_INPUT_QUANTITY Lookup1D_X_FLOAT32_IEEE 0 ME11_CM_single_C 4 -40.0 100.0 /end AXIS_PTS
/begin CHARACTERISTIC cal_ACCMCtrlDKi_CUR "" CURVE 0x0000 /* @ECU_Address@cal_ACCMCtrlDKi_CUR@ */ Lookup1D_FLOAT32_IEEE 0 ME11_CM_single_null 0.0 100.0
 /begin AXIS_DESCR COM_AXIS NO_INPUT_QUANTITY ME11_CM_single_C 8 -40.0 100.0 AXIS_PTS_REF cal_ACCMCtrlDKi_1X /end AXIS_DESCR
/end CHARACTERISTIC
/begin AXIS_PTS cal_ACCMCtrlDKi_1X "" 0x0000 /* @ECU_Address@cal_ACCMCtrlDKi_1X@ */ NO_INPUT_QUANTITY Lookup1D_X_FLOAT32_IEEE 0 ME11_CM_single_C 8 -40.0 100.0 /end AXIS_PTS
/begin CHARACTERISTIC cal_ACCMCtrlDKp_CUR "" CURVE 0x0000 /* @ECU_Address@cal_ACCMCtrlDKp_CUR@ */ Lookup1D_FLOAT32_IEEE 0 ME11_CM_single_null 0.0 100.0
 /begin AXIS_DESCR COM_AXIS NO_INPUT_QUANTITY ME11_CM_single_C 8 -40.0 100.0 AXIS_PTS_REF cal_ACCMCtrlDKp_1X /end AXIS_DESCR
/end CHARACTERISTIC
/begin AXIS_PTS cal_ACCMCtrlDKp_1X "" 0x0000 /* @ECU_Address@cal_ACCMCtrlDKp_1X@ */ NO_INPUT_QUANTITY Lookup1D_X_FLOAT32_IEEE 0 ME11_CM_single_C 8 -40.0 100.0 /end AXIS_PTS
/begin CHARACTERISTIC cal_ACCMCtrlDPIMax_CUR "" CURVE 0x0000 /* @ECU_Address@cal_ACCMCtrlDPIMax_CUR@ */ Lookup1D_FLOAT32_IEEE 0 ME11_CM_single_rpm 0.0 10000.0
 /begin AXIS_DESCR COM_AXIS ACSen_sEnvTempCor ME11_CM_single_C 5 -40.0 80.0 AXIS_PTS_REF cal_ACCMCtrlDPIMax_1X /end AXIS_DESCR
/end CHARACTERISTIC
/begin AXIS_PTS cal_ACCMCtrlDPIMax_1X "" 0x0000 /* @ECU_Address@cal_ACCMCtrlDPIMax_1X@ */ ACSen_sEnvTempCor Lookup1D_X_FLOAT32_IEEE 0 ME11_CM_single_C 5 -40.0 80.0 /end AXIS_PTS
/begin CHARACTERISTIC cal_ACCMCtrlDTrg_CUR "" CURVE 0x0000 /* @ECU_Address@cal_ACCMCtrlDTrg_CUR@ */ Lookup1D_FLOAT32_IEEE 0 ME11_CM_single_C -2.0 20.0
 /begin AXIS_DESCR COM_AXIS ACSen_sEnvTempCor ME11_CM_single_C 7 -30.0 100.0 AXIS_PTS_REF cal_ACCMCtrlDTrg_1X /end AXIS_DESCR
/end CHARACTERISTIC
/begin AXIS_PTS cal_ACCMCtrlDTrg_1X "" 0x0000 /* @ECU_Address@cal_ACCMCtrlDTrg_1X@ */ ACSen_sEnvTempCor Lookup1D_X_FLOAT32_IEEE 0 ME11_CM_single_C 7 -30.0 100.0 /end AXIS_PTS
/begin CHARACTERISTIC cal_ACCMCtrlE1FF_CUR "" CURVE 0x0000 /* @ECU_Address@cal_ACCMCtrlE1FF_CUR@ */ Lookup1D_FLOAT32_IEEE 0 ME11_CM_single_rpm 0.0 8000.0
 /begin AXIS_DESCR COM_AXIS ACSen_sEnvTempCor ME11_CM_single_C 7 -40.0 100.0 AXIS_PTS_REF cal_ACCMCtrlE1FF_1X /end AXIS_DESCR
/end CHARACTERISTIC
/begin AXIS_PTS cal_ACCMCtrlE1FF_1X "" 0x0000 /* @ECU_Address@cal_ACCMCtrlE1FF_1X@ */ ACSen_sEnvTempCor Lookup1D_X_FLOAT32_IEEE 0 ME11_CM_single_C 7 -40.0 100.0 /end AXIS_PTS
/begin CHARACTERISTIC cal_ACCMCtrlE2FF_CUR "" CURVE 0x0000 /* @ECU_Address@cal_ACCMCtrlE2FF_CUR@ */ Lookup1D_FLOAT32_IEEE 0 ME11_CM_single_rpm 0.0 8000.0
 /begin AXIS_DESCR COM_AXIS NO_INPUT_QUANTITY ME11_CM_single_C 4 -40.0 100.0 AXIS_PTS_REF cal_ACCMCtrlE2FF_1X /end AXIS_DESCR
/end CHARACTERISTIC
/begin AXIS_PTS cal_ACCMCtrlE2FF_1X "" 0x0000 /* @ECU_Address@cal_ACCMCtrlE2FF_1X@ */ NO_INPUT_QUANTITY Lookup1D_X_FLOAT32_IEEE 0 ME11_CM_single_C 4 -40.0 100.0 /end AXIS_PTS
/begin CHARACTERISTIC cal_ACCMCtrlEKi_CUR "" CURVE 0x0000 /* @ECU_Address@cal_ACCMCtrlEKi_CUR@ */ Lookup1D_FLOAT32_IEEE 0 ME11_CM_single_null 0.0 100.0
 /begin AXIS_DESCR COM_AXIS NO_INPUT_QUANTITY ME11_CM_single_C 8 -100.0 100.0 AXIS_PTS_REF cal_ACCMCtrlEKi_1X /end AXIS_DESCR
/end CHARACTERISTIC
/begin AXIS_PTS cal_ACCMCtrlEKi_1X "" 0x0000 /* @ECU_Address@cal_ACCMCtrlEKi_1X@ */ NO_INPUT_QUANTITY Lookup1D_X_FLOAT32_IEEE 0 ME11_CM_single_C 8 -100.0 100.0 /end AXIS_PTS
/begin CHARACTERISTIC cal_ACCMCtrlEKp_CUR "" CURVE 0x0000 /* @ECU_Address@cal_ACCMCtrlEKp_CUR@ */ Lookup1D_FLOAT32_IEEE 0 ME11_CM_single_null 0.0 100.0
 /begin AXIS_DESCR COM_AXIS NO_INPUT_QUANTITY ME11_CM_single_C 8 -100.0 100.0 AXIS_PTS_REF cal_ACCMCtrlEKp_1X /end AXIS_DESCR
/end CHARACTERISTIC
/begin AXIS_PTS cal_ACCMCtrlEKp_1X "" 0x0000 /* @ECU_Address@cal_ACCMCtrlEKp_1X@ */ NO_INPUT_QUANTITY Lookup1D_X_FLOAT32_IEEE 0 ME11_CM_single_C 8 -100.0 100.0 /end AXIS_PTS
/begin CHARACTERISTIC cal_ACCMCtrlF1FF_CUR "" CURVE 0x0000 /* @ECU_Address@cal_ACCMCtrlF1FF_CUR@ */ Lookup1D_FLOAT32_IEEE 0 ME11_CM_single_rpm 0.0 8000.0
 /begin AXIS_DESCR COM_AXIS ACSen_sEnvTempCor ME11_CM_single_C 5 -40.0 100.0 AXIS_PTS_REF cal_ACCMCtrlF1FF_1X /end AXIS_DESCR
/end CHARACTERISTIC
/begin AXIS_PTS cal_ACCMCtrlF1FF_1X "" 0x0000 /* @ECU_Address@cal_ACCMCtrlF1FF_1X@ */ ACSen_sEnvTempCor Lookup1D_X_FLOAT32_IEEE 0 ME11_CM_single_C 5 -40.0 100.0 /end AXIS_PTS
/begin CHARACTERISTIC cal_ACCMCtrlF2FF_CUR "" CURVE 0x0000 /* @ECU_Address@cal_ACCMCtrlF2FF_CUR@ */ Lookup1D_FLOAT32_IEEE 0 ME11_CM_single_rpm 0.0 8000.0
 /begin AXIS_DESCR COM_AXIS NO_INPUT_QUANTITY ME11_CM_single_C 5 -40.0 100.0 AXIS_PTS_REF cal_ACCMCtrlF2FF_1X /end AXIS_DESCR
/end CHARACTERISTIC
/begin AXIS_PTS cal_ACCMCtrlF2FF_1X "" 0x0000 /* @ECU_Address@cal_ACCMCtrlF2FF_1X@ */ NO_INPUT_QUANTITY Lookup1D_X_FLOAT32_IEEE 0 ME11_CM_single_C 5 -40.0 100.0 /end AXIS_PTS
/begin CHARACTERISTIC cal_ACCMCtrlFKi_CUR "" CURVE 0x0000 /* @ECU_Address@cal_ACCMCtrlFKi_CUR@ */ Lookup1D_FLOAT32_IEEE 0 ME11_CM_single_null 0.0 100.0
 /begin AXIS_DESCR COM_AXIS NO_INPUT_QUANTITY ME11_CM_single_C 8 -100.0 100.0 AXIS_PTS_REF cal_ACCMCtrlFKi_1X /end AXIS_DESCR
/end CHARACTERISTIC
/begin AXIS_PTS cal_ACCMCtrlFKi_1X "" 0x0000 /* @ECU_Address@cal_ACCMCtrlFKi_1X@ */ NO_INPUT_QUANTITY Lookup1D_X_FLOAT32_IEEE 0 ME11_CM_single_C 8 -100.0 100.0 /end AXIS_PTS
/begin CHARACTERISTIC cal_ACCMCtrlFKp_CUR "" CURVE 0x0000 /* @ECU_Address@cal_ACCMCtrlFKp_CUR@ */ Lookup1D_FLOAT32_IEEE 0 ME11_CM_single_null 0.0 100.0
 /begin AXIS_DESCR COM_AXIS NO_INPUT_QUANTITY ME11_CM_single_C 8 -100.0 100.0 AXIS_PTS_REF cal_ACCMCtrlFKp_1X /end AXIS_DESCR
/end CHARACTERISTIC
/begin AXIS_PTS cal_ACCMCtrlFKp_1X "" 0x0000 /* @ECU_Address@cal_ACCMCtrlFKp_1X@ */ NO_INPUT_QUANTITY Lookup1D_X_FLOAT32_IEEE 0 ME11_CM_single_C 8 -100.0 100.0 /end AXIS_PTS
/begin CHARACTERISTIC cal_ACCMCtrlFPIMax_CUR "" CURVE 0x0000 /* @ECU_Address@cal_ACCMCtrlFPIMax_CUR@ */ Lookup1D_FLOAT32_IEEE 0 ME11_CM_single_rpm 0.0 10000.0
 /begin AXIS_DESCR COM_AXIS ACSen_sEnvTempCor ME11_CM_single_C 5 -40.0 80.0 AXIS_PTS_REF cal_ACCMCtrlFPIMax_1X /end AXIS_DESCR
/end CHARACTERISTIC
/begin AXIS_PTS cal_ACCMCtrlFPIMax_1X "" 0x0000 /* @ECU_Address@cal_ACCMCtrlFPIMax_1X@ */ ACSen_sEnvTempCor Lookup1D_X_FLOAT32_IEEE 0 ME11_CM_single_C 5 -40.0 80.0 /end AXIS_PTS
/begin CHARACTERISTIC cal_CtrlFPTCAuxHeatPwrLmt_MAP "" MAP 0x0000 /* @ECU_Address@cal_CtrlFPTCAuxHeatPwrLmt_MAP@ */ Lookup2D_FLOAT32_IEEE 0 ME11_CM_single_kw 0.0 10.0
 /begin AXIS_DESCR COM_AXIS HMICtl_sLeftSetPoint ME11_CM_single_C 6 0.0 40.0 AXIS_PTS_REF cal_CtrlFPTCAuxHeatPwrLmt_2X /end AXIS_DESCR
 /begin AXIS_DESCR COM_AXIS NO_INPUT_QUANTITY ME11_CM_single_C 6 0.0 30.0 AXIS_PTS_REF cal_CtrlFPTCAuxHeatPwrLmt_2Y /end AXIS_DESCR
/end CHARACTERISTIC
/begin AXIS_PTS cal_CtrlFPTCAuxHeatPwrLmt_2Y "" 0x0000 /* @ECU_Address@cal_CtrlFPTCAuxHeatPwrLmt_2Y@ */ NO_INPUT_QUANTITY Lookup2D_X_FLOAT32_IEEE 0 ME11_CM_single_C 6 0.0 30.0 /end AXIS_PTS
/begin AXIS_PTS cal_CtrlFPTCAuxHeatPwrLmt_2X "" 0x0000 /* @ECU_Address@cal_CtrlFPTCAuxHeatPwrLmt_2X@ */ HMICtl_sLeftSetPoint Lookup2D_X_FLOAT32_IEEE 0 ME11_CM_single_C 6 0.0 40.0 /end AXIS_PTS
/begin CHARACTERISTIC cal_CtrlFPTCOnReqPower_CUR "" CURVE 0x0000 /* @ECU_Address@cal_CtrlFPTCOnReqPower_CUR@ */ Lookup1D_FLOAT32_IEEE 0 ME11_CM_single_kw 0.0 10.0
 /begin AXIS_DESCR COM_AXIS ACCtl_tSetPointPTC ME11_CM_single_C 6 0.0 100.0 AXIS_PTS_REF cal_CtrlFPTCOnReqPower_1X /end AXIS_DESCR
/end CHARACTERISTIC
/begin AXIS_PTS cal_CtrlFPTCOnReqPower_1X "" 0x0000 /* @ECU_Address@cal_CtrlFPTCOnReqPower_1X@ */ ACCtl_tSetPointPTC Lookup1D_X_FLOAT32_IEEE 0 ME11_CM_single_C 6 0.0 100.0 /end AXIS_PTS
/begin CHARACTERISTIC cal_ACCMCtrlH1FF_CUR "" CURVE 0x0000 /* @ECU_Address@cal_ACCMCtrlH1FF_CUR@ */ Lookup1D_FLOAT32_IEEE 0 ME11_CM_single_rpm 0.0 8000.0
 /begin AXIS_DESCR COM_AXIS ACSen_sEnvTempCor ME11_CM_single_C 5 -40.0 100.0 AXIS_PTS_REF cal_ACCMCtrlH1FF_1X /end AXIS_DESCR
/end CHARACTERISTIC
/begin AXIS_PTS cal_ACCMCtrlH1FF_1X "" 0x0000 /* @ECU_Address@cal_ACCMCtrlH1FF_1X@ */ ACSen_sEnvTempCor Lookup1D_X_FLOAT32_IEEE 0 ME11_CM_single_C 5 -40.0 100.0 /end AXIS_PTS
/begin CHARACTERISTIC cal_ACCMCtrlH2FF_CUR "" CURVE 0x0000 /* @ECU_Address@cal_ACCMCtrlH2FF_CUR@ */ Lookup1D_FLOAT32_IEEE 0 ME11_CM_single_rpm 0.0 8000.0
 /begin AXIS_DESCR COM_AXIS NO_INPUT_QUANTITY ME11_CM_single_C 4 -40.0 100.0 AXIS_PTS_REF cal_ACCMCtrlH2FF_1X /end AXIS_DESCR
/end CHARACTERISTIC
/begin AXIS_PTS cal_ACCMCtrlH2FF_1X "" 0x0000 /* @ECU_Address@cal_ACCMCtrlH2FF_1X@ */ NO_INPUT_QUANTITY Lookup1D_X_FLOAT32_IEEE 0 ME11_CM_single_C 4 -40.0 100.0 /end AXIS_PTS
/begin CHARACTERISTIC cal_ACCMCtrlHKi_CUR "" CURVE 0x0000 /* @ECU_Address@cal_ACCMCtrlHKi_CUR@ */ Lookup1D_FLOAT32_IEEE 0 ME11_CM_single_null 0.0 100.0
 /begin AXIS_DESCR COM_AXIS NO_INPUT_QUANTITY ME11_CM_single_C 8 -100.0 100.0 AXIS_PTS_REF cal_ACCMCtrlHKi_1X /end AXIS_DESCR
/end CHARACTERISTIC
/begin AXIS_PTS cal_ACCMCtrlHKi_1X "" 0x0000 /* @ECU_Address@cal_ACCMCtrlHKi_1X@ */ NO_INPUT_QUANTITY Lookup1D_X_FLOAT32_IEEE 0 ME11_CM_single_C 8 -100.0 100.0 /end AXIS_PTS
/begin CHARACTERISTIC cal_ACCMCtrlHKp_CUR "" CURVE 0x0000 /* @ECU_Address@cal_ACCMCtrlHKp_CUR@ */ Lookup1D_FLOAT32_IEEE 0 ME11_CM_single_null 0.0 100.0
 /begin AXIS_DESCR COM_AXIS NO_INPUT_QUANTITY ME11_CM_single_C 8 -100.0 100.0 AXIS_PTS_REF cal_ACCMCtrlHKp_1X /end AXIS_DESCR
/end CHARACTERISTIC
/begin AXIS_PTS cal_ACCMCtrlHKp_1X "" 0x0000 /* @ECU_Address@cal_ACCMCtrlHKp_1X@ */ NO_INPUT_QUANTITY Lookup1D_X_FLOAT32_IEEE 0 ME11_CM_single_C 8 -100.0 100.0 /end AXIS_PTS
/begin CHARACTERISTIC cal_ACCMCtlDownlmt "" VALUE 0x0000 /* @ECU_Address@cal_ACCMCtlDownlmt@ */ Scalar_FLOAT32_IEEE 0 ME11_CM_single_rpm 0.0 10000.0 /end CHARACTERISTIC
/begin CHARACTERISTIC cal_ACCMCtlUplmt "" VALUE 0x0000 /* @ECU_Address@cal_ACCMCtlUplmt@ */ Scalar_FLOAT32_IEEE 0 ME11_CM_single_rpm 0.0 10000.0 /end CHARACTERISTIC
/begin CHARACTERISTIC cal_ACCMCtrlACct "" VALUE 0x0000 /* @ECU_Address@cal_ACCMCtrlACct@ */ Scalar_FLOAT32_IEEE 0 ME11_CM_single_null 0.0 10.0 /end CHARACTERISTIC
/begin CHARACTERISTIC cal_ACCMCtrlADeadzone "" VALUE 0x0000 /* @ECU_Address@cal_ACCMCtrlADeadzone@ */ Scalar_FLOAT32_IEEE 0 ME11_CM_single_C 0.0 5.0 /end CHARACTERISTIC
/begin CHARACTERISTIC cal_ACCMCtrlADlyTime "" VALUE 0x0000 /* @ECU_Address@cal_ACCMCtrlADlyTime@ */ Scalar_FLOAT32_IEEE 0 ME11_CM_single_s 0.0 100.0 /end CHARACTERISTIC
/begin CHARACTERISTIC cal_ACCMCtrlAPIMax "" VALUE 0x0000 /* @ECU_Address@cal_ACCMCtrlAPIMax@ */ Scalar_FLOAT32_IEEE 0 ME11_CM_single_rpm 0.0 8000.0 /end CHARACTERISTIC
/begin CHARACTERISTIC cal_ACCMCtrlAPIMin "" VALUE 0x0000 /* @ECU_Address@cal_ACCMCtrlAPIMin@ */ Scalar_FLOAT32_IEEE 0 ME11_CM_single_rpm 0.0 8000.0 /end CHARACTERISTIC
/begin CHARACTERISTIC cal_ACCMCtrlARunTime "" VALUE 0x0000 /* @ECU_Address@cal_ACCMCtrlARunTime@ */ Scalar_FLOAT32_IEEE 0 ME11_CM_single_s 0.0 100.0 /end CHARACTERISTIC
/begin CHARACTERISTIC cal_ACCMCtrlBDeadzone "" VALUE 0x0000 /* @ECU_Address@cal_ACCMCtrlBDeadzone@ */ Scalar_FLOAT32_IEEE 0 ME11_CM_single_C 0.0 10.0 /end CHARACTERISTIC
/begin CHARACTERISTIC cal_ACCMCtrlBDlyTime "" VALUE 0x0000 /* @ECU_Address@cal_ACCMCtrlBDlyTime@ */ Scalar_FLOAT32_IEEE 0 ME11_CM_single_s 0.0 100.0 /end CHARACTERISTIC
/begin CHARACTERISTIC cal_ACCMCtrlBPIMax "" VALUE 0x0000 /* @ECU_Address@cal_ACCMCtrlBPIMax@ */ Scalar_FLOAT32_IEEE 0 ME11_CM_single_rpm 0.0 8000.0 /end CHARACTERISTIC
/begin CHARACTERISTIC cal_ACCMCtrlBPIMin "" VALUE 0x0000 /* @ECU_Address@cal_ACCMCtrlBPIMin@ */ Scalar_FLOAT32_IEEE 0 ME11_CM_single_rpm 0.0 8000.0 /end CHARACTERISTIC
/begin CHARACTERISTIC cal_ACCMCtrlBRunTime "" VALUE 0x0000 /* @ECU_Address@cal_ACCMCtrlBRunTime@ */ Scalar_FLOAT32_IEEE 0 ME11_CM_single_s 0.0 100.0 /end CHARACTERISTIC
/begin CHARACTERISTIC cal_ACCMCtrlCDeadzone "" VALUE 0x0000 /* @ECU_Address@cal_ACCMCtrlCDeadzone@ */ Scalar_FLOAT32_IEEE 0 ME11_CM_single_C 0.0 5.0 /end CHARACTERISTIC
/begin CHARACTERISTIC cal_ACCMCtrlCDlyTime "" VALUE 0x0000 /* @ECU_Address@cal_ACCMCtrlCDlyTime@ */ Scalar_FLOAT32_IEEE 0 ME11_CM_single_s 0.0 100.0 /end CHARACTERISTIC
/begin CHARACTERISTIC cal_ACCMCtrlCPIMax "" VALUE 0x0000 /* @ECU_Address@cal_ACCMCtrlCPIMax@ */ Scalar_FLOAT32_IEEE 0 ME11_CM_single_rpm 0.0 8000.0 /end CHARACTERISTIC
/begin CHARACTERISTIC cal_ACCMCtrlCPIMin "" VALUE 0x0000 /* @ECU_Address@cal_ACCMCtrlCPIMin@ */ Scalar_FLOAT32_IEEE 0 ME11_CM_single_rpm 0.0 8000.0 /end CHARACTERISTIC
/begin CHARACTERISTIC cal_ACCMCtrlCRunTime "" VALUE 0x0000 /* @ECU_Address@cal_ACCMCtrlCRunTime@ */ Scalar_FLOAT32_IEEE 0 ME11_CM_single_s 0.0 100.0 /end CHARACTERISTIC
/begin CHARACTERISTIC cal_ACCMCtrlDDeadzone "" VALUE 0x0000 /* @ECU_Address@cal_ACCMCtrlDDeadzone@ */ Scalar_FLOAT32_IEEE 0 ME11_CM_single_C 0.0 5.0 /end CHARACTERISTIC
/begin CHARACTERISTIC cal_ACCMCtrlDDlyTime "" VALUE 0x0000 /* @ECU_Address@cal_ACCMCtrlDDlyTime@ */ Scalar_FLOAT32_IEEE 0 ME11_CM_single_s 0.0 100.0 /end CHARACTERISTIC
/begin CHARACTERISTIC cal_ACCMCtrlDPIMin "" VALUE 0x0000 /* @ECU_Address@cal_ACCMCtrlDPIMin@ */ Scalar_FLOAT32_IEEE 0 ME11_CM_single_rpm 0.0 8000.0 /end CHARACTERISTIC
/begin CHARACTERISTIC cal_ACCMCtrlDRunTime "" VALUE 0x0000 /* @ECU_Address@cal_ACCMCtrlDRunTime@ */ Scalar_FLOAT32_IEEE 0 ME11_CM_single_s 0.0 100.0 /end CHARACTERISTIC
/begin CHARACTERISTIC cal_ACCMCtrlEDeadzone "" VALUE 0x0000 /* @ECU_Address@cal_ACCMCtrlEDeadzone@ */ Scalar_FLOAT32_IEEE 0 ME11_CM_single_C 0.0 5.0 /end CHARACTERISTIC
/begin CHARACTERISTIC cal_ACCMCtrlEDlyTime "" VALUE 0x0000 /* @ECU_Address@cal_ACCMCtrlEDlyTime@ */ Scalar_FLOAT32_IEEE 0 ME11_CM_single_s 0.0 100.0 /end CHARACTERISTIC
/begin CHARACTERISTIC cal_ACCMCtrlEPIMax "" VALUE 0x0000 /* @ECU_Address@cal_ACCMCtrlEPIMax@ */ Scalar_FLOAT32_IEEE 0 ME11_CM_single_rpm 0.0 8000.0 /end CHARACTERISTIC
/begin CHARACTERISTIC cal_ACCMCtrlEPIMin "" VALUE 0x0000 /* @ECU_Address@cal_ACCMCtrlEPIMin@ */ Scalar_FLOAT32_IEEE 0 ME11_CM_single_rpm 0.0 8000.0 /end CHARACTERISTIC
/begin CHARACTERISTIC cal_ACCMCtrlERunTime "" VALUE 0x0000 /* @ECU_Address@cal_ACCMCtrlERunTime@ */ Scalar_FLOAT32_IEEE 0 ME11_CM_single_s 0.0 100.0 /end CHARACTERISTIC
/begin CHARACTERISTIC cal_ACCMCtrlETrgTemp "" VALUE 0x0000 /* @ECU_Address@cal_ACCMCtrlETrgTemp@ */ Scalar_FLOAT32_IEEE 0 ME11_CM_single_C -5.0 20.0 /end CHARACTERISTIC
/begin CHARACTERISTIC cal_ACCMCtrlFDeadzone "" VALUE 0x0000 /* @ECU_Address@cal_ACCMCtrlFDeadzone@ */ Scalar_FLOAT32_IEEE 0 ME11_CM_single_C 0.0 5.0 /end CHARACTERISTIC
/begin CHARACTERISTIC cal_ACCMCtrlFDlyTime "" VALUE 0x0000 /* @ECU_Address@cal_ACCMCtrlFDlyTime@ */ Scalar_FLOAT32_IEEE 0 ME11_CM_single_s 0.0 100.0 /end CHARACTERISTIC
/begin CHARACTERISTIC cal_ACCMCtrlFPIMin "" VALUE 0x0000 /* @ECU_Address@cal_ACCMCtrlFPIMin@ */ Scalar_FLOAT32_IEEE 0 ME11_CM_single_rpm 0.0 8000.0 /end CHARACTERISTIC
/begin CHARACTERISTIC cal_ACCMCtrlFRunTime "" VALUE 0x0000 /* @ECU_Address@cal_ACCMCtrlFRunTime@ */ Scalar_FLOAT32_IEEE 0 ME11_CM_single_s 0.0 100.0 /end CHARACTERISTIC
/begin CHARACTERISTIC cal_ACCMCtrlHCct "" VALUE 0x0000 /* @ECU_Address@cal_ACCMCtrlHCct@ */ Scalar_FLOAT32_IEEE 0 ME11_CM_single_null 0.0 100.0 /end CHARACTERISTIC
/begin CHARACTERISTIC cal_ACCMCtrlHDeadzone "" VALUE 0x0000 /* @ECU_Address@cal_ACCMCtrlHDeadzone@ */ Scalar_FLOAT32_IEEE 0 ME11_CM_single_C 0.0 5.0 /end CHARACTERISTIC
/begin CHARACTERISTIC cal_ACCMCtrlHDlyTime "" VALUE 0x0000 /* @ECU_Address@cal_ACCMCtrlHDlyTime@ */ Scalar_FLOAT32_IEEE 0 ME11_CM_single_s 0.0 100.0 /end CHARACTERISTIC
/begin CHARACTERISTIC cal_ACCMCtrlHPIMax "" VALUE 0x0000 /* @ECU_Address@cal_ACCMCtrlHPIMax@ */ Scalar_FLOAT32_IEEE 0 ME11_CM_single_rpm 0.0 8000.0 /end CHARACTERISTIC
/begin CHARACTERISTIC cal_ACCMCtrlHPIMin "" VALUE 0x0000 /* @ECU_Address@cal_ACCMCtrlHPIMin@ */ Scalar_FLOAT32_IEEE 0 ME11_CM_single_rpm 0.0 8000.0 /end CHARACTERISTIC
/begin CHARACTERISTIC cal_ACCMCtrlHRunTime "" VALUE 0x0000 /* @ECU_Address@cal_ACCMCtrlHRunTime@ */ Scalar_FLOAT32_IEEE 0 ME11_CM_single_s 0.0 100.0 /end CHARACTERISTIC
/begin CHARACTERISTIC cal_ACCMCtrlSpdData "" VALUE 0x0000 /* @ECU_Address@cal_ACCMCtrlSpdData@ */ Scalar_FLOAT32_IEEE 0 ME11_CM_single_rpm 0.0 10000.0 /end CHARACTERISTIC
/begin CHARACTERISTIC cal_ACCMHiTempData "" VALUE 0x0000 /* @ECU_Address@cal_ACCMHiTempData@ */ Scalar_FLOAT32_IEEE 0 ME11_CM_single_C -50.0 150.0 /end CHARACTERISTIC
/begin CHARACTERISTIC cal_AEXVClsEvapPrtTemp "" VALUE 0x0000 /* @ECU_Address@cal_AEXVClsEvapPrtTemp@ */ Scalar_FLOAT32_IEEE 0 ME11_CM_single_C -20.0 20.0 /end CHARACTERISTIC
/begin CHARACTERISTIC cal_AEXVClsValEvapPrt "" VALUE 0x0000 /* @ECU_Address@cal_AEXVClsValEvapPrt@ */ Scalar_FLOAT32_IEEE 0 ME11_CM_single_percent_ 0.0 10.0 /end CHARACTERISTIC
/begin CHARACTERISTIC cal_AEXVClsValRunTimeEvapPrt "" VALUE 0x0000 /* @ECU_Address@cal_AEXVClsValRunTimeEvapPrt@ */ Scalar_FLOAT32_IEEE 0 ME11_CM_single_s 0.0 100.0 /end CHARACTERISTIC
/begin CHARACTERISTIC cal_AEXVCtlKi "" VALUE 0x0000 /* @ECU_Address@cal_AEXVCtlKi@ */ Scalar_FLOAT32_IEEE 0 ME11_CM_single_null 0.0 10.0 /end CHARACTERISTIC
/begin CHARACTERISTIC cal_AEXVCtlKisumMax "" VALUE 0x0000 /* @ECU_Address@cal_AEXVCtlKisumMax@ */ Scalar_FLOAT32_IEEE 0 ME11_CM_single_percent_ 0.0 100.0 /end CHARACTERISTIC
/begin CHARACTERISTIC cal_AEXVCtlKisumMin "" VALUE 0x0000 /* @ECU_Address@cal_AEXVCtlKisumMin@ */ Scalar_FLOAT32_IEEE 0 ME11_CM_single_percent_ -100.0 100.0 /end CHARACTERISTIC
/begin CHARACTERISTIC cal_AEXVCtlKp "" VALUE 0x0000 /* @ECU_Address@cal_AEXVCtlKp@ */ Scalar_FLOAT32_IEEE 0 ME11_CM_single_null 0.0 10.0 /end CHARACTERISTIC
/begin CHARACTERISTIC cal_AEXVFltClsSpd "" VALUE 0x0000 /* @ECU_Address@cal_AEXVFltClsSpd@ */ Scalar_FLOAT32_IEEE 0 ME11_CM_single_percent_ 0.0 10.0 /end CHARACTERISTIC
/begin CHARACTERISTIC cal_AEXVHighPressProhOn "" VALUE 0x0000 /* @ECU_Address@cal_AEXVHighPressProhOn@ */ Scalar_FLOAT32_IEEE 0 ME11_CM_single_Mpa 0.0 10.0 /end CHARACTERISTIC
/begin CHARACTERISTIC cal_AEXVLowPressProhOn "" VALUE 0x0000 /* @ECU_Address@cal_AEXVLowPressProhOn@ */ Scalar_FLOAT32_IEEE 0 ME11_CM_single_Mpa 0.0 5.0 /end CHARACTERISTIC
/begin CHARACTERISTIC cal_AEXVOpenDelayTimeEvapNOPrt "" VALUE 0x0000 /* @ECU_Address@cal_AEXVOpenDelayTimeEvapNOPrt@ */ Scalar_FLOAT32_IEEE 0 ME11_CM_single_s 0.0 100.0 /end CHARACTERISTIC
/begin CHARACTERISTIC cal_AEXVOpenEvapNOPrtTemp "" VALUE 0x0000 /* @ECU_Address@cal_AEXVOpenEvapNOPrtTemp@ */ Scalar_FLOAT32_IEEE 0 ME11_CM_single_C 0.0 20.0 /end CHARACTERISTIC
/begin CHARACTERISTIC cal_AEXVOpenRunTimeEvapNOPrt "" VALUE 0x0000 /* @ECU_Address@cal_AEXVOpenRunTimeEvapNOPrt@ */ Scalar_FLOAT32_IEEE 0 ME11_CM_single_s 0.0 100.0 /end CHARACTERISTIC
/begin CHARACTERISTIC cal_AEXVOpenValEvapNOPrt "" VALUE 0x0000 /* @ECU_Address@cal_AEXVOpenValEvapNOPrt@ */ Scalar_FLOAT32_IEEE 0 ME11_CM_single_percent_ 0.0 10.0 /end CHARACTERISTIC
/begin CHARACTERISTIC cal_AEXVOpenValveSpd "" VALUE 0x0000 /* @ECU_Address@cal_AEXVOpenValveSpd@ */ Scalar_FLOAT32_IEEE 0 ME11_CM_single_percent_ 0.0 5.0 /end CHARACTERISTIC
/begin CHARACTERISTIC cal_BCVPosDiffDelayTime "" VALUE 0x0000 /* @ECU_Address@cal_BCVPosDiffDelayTime@ */ Scalar_FLOAT32_IEEE 0 ME11_CM_single_min 0.0 300.0 /end CHARACTERISTIC
/begin CHARACTERISTIC cal_BEXVCtlKi "" VALUE 0x0000 /* @ECU_Address@cal_BEXVCtlKi@ */ Scalar_FLOAT32_IEEE 0 ME11_CM_single_null 0.0 10.0 /end CHARACTERISTIC
/begin CHARACTERISTIC cal_BEXVCtlKisumMax "" VALUE 0x0000 /* @ECU_Address@cal_BEXVCtlKisumMax@ */ Scalar_FLOAT32_IEEE 0 ME11_CM_single_percent_ 0.0 100.0 /end CHARACTERISTIC
/begin CHARACTERISTIC cal_BEXVCtlKisumMin "" VALUE 0x0000 /* @ECU_Address@cal_BEXVCtlKisumMin@ */ Scalar_FLOAT32_IEEE 0 ME11_CM_single_percent_ -100.0 100.0 /end CHARACTERISTIC
/begin CHARACTERISTIC cal_BEXVCtlKp "" VALUE 0x0000 /* @ECU_Address@cal_BEXVCtlKp@ */ Scalar_FLOAT32_IEEE 0 ME11_CM_single_null 0.0 10.0 /end CHARACTERISTIC
/begin CHARACTERISTIC cal_BEXVHighPressProhOn "" VALUE 0x0000 /* @ECU_Address@cal_BEXVHighPressProhOn@ */ Scalar_FLOAT32_IEEE 0 ME11_CM_single_Mpa 0.0 10.0 /end CHARACTERISTIC
/begin CHARACTERISTIC cal_BEXVLowPressProhOn "" VALUE 0x0000 /* @ECU_Address@cal_BEXVLowPressProhOn@ */ Scalar_FLOAT32_IEEE 0 ME11_CM_single_Mpa 0.0 5.0 /end CHARACTERISTIC
/begin CHARACTERISTIC cal_BEXVOpenValveSpd "" VALUE 0x0000 /* @ECU_Address@cal_BEXVOpenValveSpd@ */ Scalar_FLOAT32_IEEE 0 ME11_CM_single_percent_ 0.0 5.0 /end CHARACTERISTIC
/begin CHARACTERISTIC cal_BMSInletTempHighOffMCV "" VALUE 0x0000 /* @ECU_Address@cal_BMSInletTempHighOffMCV@ */ Scalar_FLOAT32_IEEE 0 ME11_CM_single_C -40.0 100.0 /end CHARACTERISTIC
/begin CHARACTERISTIC cal_BMSInletTempLowOnMCV "" VALUE 0x0000 /* @ECU_Address@cal_BMSInletTempLowOnMCV@ */ Scalar_FLOAT32_IEEE 0 ME11_CM_single_C -40.0 100.0 /end CHARACTERISTIC
/begin CHARACTERISTIC cal_BatCoolInletTrgTemp "" VALUE 0x0000 /* @ECU_Address@cal_BatCoolInletTrgTemp@ */ Scalar_FLOAT32_IEEE 0 ME11_CM_single_C 10.0 30.0 /end CHARACTERISTIC
/begin CHARACTERISTIC cal_BatCoolTrgFilter "" VALUE 0x0000 /* @ECU_Address@cal_BatCoolTrgFilter@ */ Scalar_FLOAT32_IEEE 0 ME11_CM_single_C_per_0_1s 0.0 100.0 /end CHARACTERISTIC
/begin CHARACTERISTIC cal_BatTrgTempData "" VALUE 0x0000 /* @ECU_Address@cal_BatTrgTempData@ */ Scalar_FLOAT32_IEEE 0 ME11_CM_single_C 0.0 80.0 /end CHARACTERISTIC
/begin CHARACTERISTIC cal_COMPBatMaxSpdLmt "" VALUE 0x0000 /* @ECU_Address@cal_COMPBatMaxSpdLmt@ */ Scalar_FLOAT32_IEEE 0 ME11_CM_single_rpm 0.0 8000.0 /end CHARACTERISTIC
/begin CHARACTERISTIC cal_COMPCabinCoolMaxSpdLmt "" VALUE 0x0000 /* @ECU_Address@cal_COMPCabinCoolMaxSpdLmt@ */ Scalar_FLOAT32_IEEE 0 ME11_CM_single_rpm 0.0 8000.0 /end CHARACTERISTIC
/begin CHARACTERISTIC cal_COMPCoolLowSpd "" VALUE 0x0000 /* @ECU_Address@cal_COMPCoolLowSpd@ */ Scalar_FLOAT32_IEEE 0 ME11_CM_single_km_per_h 0.0 100.0 /end CHARACTERISTIC
/begin CHARACTERISTIC cal_COMPExhTDownSpd "" VALUE 0x0000 /* @ECU_Address@cal_COMPExhTDownSpd@ */ Scalar_FLOAT32_IEEE 0 ME11_CM_single_rpm 0.0 2000.0 /end CHARACTERISTIC
/begin CHARACTERISTIC cal_CabinCondToCoolHPEXVPos1 "" VALUE 0x0000 /* @ECU_Address@cal_CabinCondToCoolHPEXVPos1@ */ Scalar_FLOAT32_IEEE 0 ME11_CM_single_percent_ 0.0 100.0 /end CHARACTERISTIC
/begin CHARACTERISTIC cal_CabinCondToCoolHPEXVPos2 "" VALUE 0x0000 /* @ECU_Address@cal_CabinCondToCoolHPEXVPos2@ */ Scalar_FLOAT32_IEEE 0 ME11_CM_single_percent_ 0.0 100.0 /end CHARACTERISTIC
/begin CHARACTERISTIC cal_CabinCondToEvpHPEXVPos "" VALUE 0x0000 /* @ECU_Address@cal_CabinCondToEvpHPEXVPos@ */ Scalar_FLOAT32_IEEE 0 ME11_CM_single_percent_ 0.0 100.0 /end CHARACTERISTIC
/begin CHARACTERISTIC cal_CabinEvpToHPEnvTemp "" VALUE 0x0000 /* @ECU_Address@cal_CabinEvpToHPEnvTemp@ */ Scalar_FLOAT32_IEEE 0 ME11_CM_single_C -5.0 20.0 /end CHARACTERISTIC
/begin CHARACTERISTIC cal_CabinHys1TempOffset "" VALUE 0x0000 /* @ECU_Address@cal_CabinHys1TempOffset@ */ Scalar_FLOAT32_IEEE 0 ME11_CM_single_C -5.0 5.0 /end CHARACTERISTIC
/begin CHARACTERISTIC cal_CabinHys2TempOffset "" VALUE 0x0000 /* @ECU_Address@cal_CabinHys2TempOffset@ */ Scalar_FLOAT32_IEEE 0 ME11_CM_single_C -5.0 5.0 /end CHARACTERISTIC
/begin CHARACTERISTIC cal_CabinModeKeepStandbyTime "" VALUE 0x0000 /* @ECU_Address@cal_CabinModeKeepStandbyTime@ */ Scalar_FLOAT32_IEEE 0 ME11_CM_single_min 0.0 100.0 /end CHARACTERISTIC
/begin CHARACTERISTIC cal_CabinModeTransF1Constant "" VALUE 0x0000 /* @ECU_Address@cal_CabinModeTransF1Constant@ */ Scalar_FLOAT32_IEEE 0 ME11_CM_single_C -20.0 20.0 /end CHARACTERISTIC
/begin CHARACTERISTIC cal_CabinModeTransF1Slope "" VALUE 0x0000 /* @ECU_Address@cal_CabinModeTransF1Slope@ */ Scalar_FLOAT32_IEEE 0 ME11_CM_single_null 0.0 5.0 /end CHARACTERISTIC
/begin CHARACTERISTIC cal_CabinModeTransF2Constant "" VALUE 0x0000 /* @ECU_Address@cal_CabinModeTransF2Constant@ */ Scalar_FLOAT32_IEEE 0 ME11_CM_single_C -20.0 20.0 /end CHARACTERISTIC
/begin CHARACTERISTIC cal_CabinModeTransF2Slope "" VALUE 0x0000 /* @ECU_Address@cal_CabinModeTransF2Slope@ */ Scalar_FLOAT32_IEEE 0 ME11_CM_single_null 0.0 5.0 /end CHARACTERISTIC
/begin CHARACTERISTIC cal_CabinTempData "" VALUE 0x0000 /* @ECU_Address@cal_CabinTempData@ */ Scalar_FLOAT32_IEEE 0 ME11_CM_single_C -40.0 100.0 /end CHARACTERISTIC
/begin CHARACTERISTIC cal_ChiTempData "" VALUE 0x0000 /* @ECU_Address@cal_ChiTempData@ */ Scalar_FLOAT32_IEEE 0 ME11_CM_single_C -50.0 150.0 /end CHARACTERISTIC
/begin CHARACTERISTIC cal_ClsCoolInletTemp "" VALUE 0x0000 /* @ECU_Address@cal_ClsCoolInletTemp@ */ Scalar_FLOAT32_IEEE 0 ME11_CM_single_C 0.0 100.0 /end CHARACTERISTIC
/begin CHARACTERISTIC cal_ClsCoolInletTempTime "" VALUE 0x0000 /* @ECU_Address@cal_ClsCoolInletTempTime@ */ Scalar_FLOAT32_IEEE 0 ME11_CM_single_s 0.0 1000.0 /end CHARACTERISTIC
/begin CHARACTERISTIC cal_CondDepFilter "" VALUE 0x0000 /* @ECU_Address@cal_CondDepFilter@ */ Scalar_FLOAT32_IEEE 0 ME11_CM_single_per_ 0.0 1.0 /end CHARACTERISTIC
/begin CHARACTERISTIC cal_CtrlFPTCOffPowerVal "" VALUE 0x0000 /* @ECU_Address@cal_CtrlFPTCOffPowerVal@ */ Scalar_FLOAT32_IEEE 0 ME11_CM_single_kw 0.0 10.0 /end CHARACTERISTIC
/begin CHARACTERISTIC cal_DrDuctSenFailDeflt "" VALUE 0x0000 /* @ECU_Address@cal_DrDuctSenFailDeflt@ */ Scalar_FLOAT32_IEEE 0 ME11_CM_single_per_ -3.4E+38 3.4E+38 /end CHARACTERISTIC
/begin CHARACTERISTIC cal_EntExtDefTime "" VALUE 0x0000 /* @ECU_Address@cal_EntExtDefTime@ */ Scalar_FLOAT32_IEEE 0 ME11_CM_single_min 0.0 100.0 /end CHARACTERISTIC
/begin CHARACTERISTIC cal_ErrAmbTDvtForEvaLL "" VALUE 0x0000 /* @ECU_Address@cal_ErrAmbTDvtForEvaLL@ */ Scalar_FLOAT32_IEEE 0 ME11_CM_single_per_ -3.4E+38 3.4E+38 /end CHARACTERISTIC
/begin CHARACTERISTIC cal_ErrAmbTDvtForEvaUL "" VALUE 0x0000 /* @ECU_Address@cal_ErrAmbTDvtForEvaUL@ */ Scalar_FLOAT32_IEEE 0 ME11_CM_single_per_ -3.4E+38 3.4E+38 /end CHARACTERISTIC
/begin CHARACTERISTIC cal_ErrAmbTDvtForPtcLL "" VALUE 0x0000 /* @ECU_Address@cal_ErrAmbTDvtForPtcLL@ */ Scalar_FLOAT32_IEEE 0 ME11_CM_single_per_ -3.4E+38 3.4E+38 /end CHARACTERISTIC
/begin CHARACTERISTIC cal_ErrAmbTDvtForPtcUL "" VALUE 0x0000 /* @ECU_Address@cal_ErrAmbTDvtForPtcUL@ */ Scalar_FLOAT32_IEEE 0 ME11_CM_single_per_ -3.4E+38 3.4E+38 /end CHARACTERISTIC
/begin CHARACTERISTIC cal_EvaDesLLMax "" VALUE 0x0000 /* @ECU_Address@cal_EvaDesLLMax@ */ Scalar_FLOAT32_IEEE 0 ME11_CM_single_per_ -3.4E+38 3.4E+38 /end CHARACTERISTIC
/begin CHARACTERISTIC cal_EvapSurTempData "" VALUE 0x0000 /* @ECU_Address@cal_EvapSurTempData@ */ Scalar_FLOAT32_IEEE 0 ME11_CM_single_C -50.0 150.0 /end CHARACTERISTIC
/begin CHARACTERISTIC cal_EvapTempData "" VALUE 0x0000 /* @ECU_Address@cal_EvapTempData@ */ Scalar_FLOAT32_IEEE 0 ME11_CM_single_C -50.0 150.0 /end CHARACTERISTIC
/begin CHARACTERISTIC cal_ExhSuperHeatFilter "" VALUE 0x0000 /* @ECU_Address@cal_ExhSuperHeatFilter@ */ Scalar_FLOAT32_IEEE 0 ME11_CM_single_per_ 0.0 1.0 /end CHARACTERISTIC
/begin CHARACTERISTIC cal_ExitExtDefTime "" VALUE 0x0000 /* @ECU_Address@cal_ExitExtDefTime@ */ Scalar_FLOAT32_IEEE 0 ME11_CM_single_min 0.0 30.0 /end CHARACTERISTIC
/begin CHARACTERISTIC cal_ExtDefEnvMaxTemp "" VALUE 0x0000 /* @ECU_Address@cal_ExtDefEnvMaxTemp@ */ Scalar_FLOAT32_IEEE 0 ME11_CM_single_C -40.0 40.0 /end CHARACTERISTIC
/begin CHARACTERISTIC cal_ExtDefEnvMinTemp "" VALUE 0x0000 /* @ECU_Address@cal_ExtDefEnvMinTemp@ */ Scalar_FLOAT32_IEEE 0 ME11_CM_single_C -40.0 40.0 /end CHARACTERISTIC
/begin CHARACTERISTIC cal_ExtDefOHXOffTemp "" VALUE 0x0000 /* @ECU_Address@cal_ExtDefOHXOffTemp@ */ Scalar_FLOAT32_IEEE 0 ME11_CM_single_C 0.0 20.0 /end CHARACTERISTIC
/begin CHARACTERISTIC cal_ExtDefOHXOnTemp "" VALUE 0x0000 /* @ECU_Address@cal_ExtDefOHXOnTemp@ */ Scalar_FLOAT32_IEEE 0 ME11_CM_single_C -20.0 10.0 /end CHARACTERISTIC
/begin CHARACTERISTIC cal_ExtDefTempDiff "" VALUE 0x0000 /* @ECU_Address@cal_ExtDefTempDiff@ */ Scalar_FLOAT32_IEEE 0 ME11_CM_single_C -40.0 40.0 /end CHARACTERISTIC
/begin CHARACTERISTIC cal_FaceDuctTempData "" VALUE 0x0000 /* @ECU_Address@cal_FaceDuctTempData@ */ Scalar_FLOAT32_IEEE 0 ME11_CM_single_C -40.0 100.0 /end CHARACTERISTIC
/begin CHARACTERISTIC cal_FootDuctTempData "" VALUE 0x0000 /* @ECU_Address@cal_FootDuctTempData@ */ Scalar_FLOAT32_IEEE 0 ME11_CM_single_C -40.0 100.0 /end CHARACTERISTIC
/begin CHARACTERISTIC cal_HPAndLPDiffMaxVal "" VALUE 0x0000 /* @ECU_Address@cal_HPAndLPDiffMaxVal@ */ Scalar_FLOAT32_IEEE 0 ME11_CM_single_Mpa 0.0 1.0 /end CHARACTERISTIC
/begin CHARACTERISTIC cal_HPEXVCtlKi "" VALUE 0x0000 /* @ECU_Address@cal_HPEXVCtlKi@ */ Scalar_FLOAT32_IEEE 0 ME11_CM_single_null 0.0 10.0 /end CHARACTERISTIC
/begin CHARACTERISTIC cal_HPEXVCtlKiDeadzoneNeg "" VALUE 0x0000 /* @ECU_Address@cal_HPEXVCtlKiDeadzoneNeg@ */ Scalar_FLOAT32_IEEE 0 ME11_CM_single_C 0.0 10.0 /end CHARACTERISTIC
/begin CHARACTERISTIC cal_HPEXVCtlKiDeadzonePos "" VALUE 0x0000 /* @ECU_Address@cal_HPEXVCtlKiDeadzonePos@ */ Scalar_FLOAT32_IEEE 0 ME11_CM_single_C 0.0 10.0 /end CHARACTERISTIC
/begin CHARACTERISTIC cal_HPEXVCtlKisumMax "" VALUE 0x0000 /* @ECU_Address@cal_HPEXVCtlKisumMax@ */ Scalar_FLOAT32_IEEE 0 ME11_CM_single_percent_ 0.0 100.0 /end CHARACTERISTIC
/begin CHARACTERISTIC cal_HPEXVCtlKisumMin "" VALUE 0x0000 /* @ECU_Address@cal_HPEXVCtlKisumMin@ */ Scalar_FLOAT32_IEEE 0 ME11_CM_single_percent_ -100.0 100.0 /end CHARACTERISTIC
/begin CHARACTERISTIC cal_HPEXVCtlKp "" VALUE 0x0000 /* @ECU_Address@cal_HPEXVCtlKp@ */ Scalar_FLOAT32_IEEE 0 ME11_CM_single_null 0.0 10.0 /end CHARACTERISTIC
/begin CHARACTERISTIC cal_HPEXVCtlKpDeadzoneNeg "" VALUE 0x0000 /* @ECU_Address@cal_HPEXVCtlKpDeadzoneNeg@ */ Scalar_FLOAT32_IEEE 0 ME11_CM_single_C 0.0 10.0 /end CHARACTERISTIC
/begin CHARACTERISTIC cal_HPEXVCtlKpDeadzonePos "" VALUE 0x0000 /* @ECU_Address@cal_HPEXVCtlKpDeadzonePos@ */ Scalar_FLOAT32_IEEE 0 ME11_CM_single_C 0.0 10.0 /end CHARACTERISTIC
/begin CHARACTERISTIC cal_HPEXVlowPressLmtTrg "" VALUE 0x0000 /* @ECU_Address@cal_HPEXVlowPressLmtTrg@ */ Scalar_FLOAT32_IEEE 0 ME11_CM_single_C -40.0 100.0 /end CHARACTERISTIC
/begin CHARACTERISTIC cal_HeatCOMPEnvTempLmtOff "" VALUE 0x0000 /* @ECU_Address@cal_HeatCOMPEnvTempLmtOff@ */ Scalar_FLOAT32_IEEE 0 ME11_CM_single_C -40.0 100.0 /end CHARACTERISTIC
/begin CHARACTERISTIC cal_HeatCOMPEnvTempLmtOn "" VALUE 0x0000 /* @ECU_Address@cal_HeatCOMPEnvTempLmtOn@ */ Scalar_FLOAT32_IEEE 0 ME11_CM_single_C -40.0 100.0 /end CHARACTERISTIC
/begin CHARACTERISTIC cal_HiPressData "" VALUE 0x0000 /* @ECU_Address@cal_HiPressData@ */ Scalar_FLOAT32_IEEE 0 ME11_CM_single_Mpa 0.0 10.0 /end CHARACTERISTIC
/begin CHARACTERISTIC cal_LTRFanCtrl_1X "" VAL_BLK 0x0000 /* @ECU_Address@cal_LTRFanCtrl_1X@ */ Scalar_FLOAT32_IEEE 0 ME11_CM_single_C 0.0 100.0 NUMBER 2 /end CHARACTERISTIC
/begin CHARACTERISTIC cal_LTRIGBTTempMotPMPCtrl_1X "" VAL_BLK 0x0000 /* @ECU_Address@cal_LTRIGBTTempMotPMPCtrl_1X@ */ Scalar_FLOAT32_IEEE 0 ME11_CM_single_C 0.0 100.0 NUMBER 2 /end CHARACTERISTIC
/begin CHARACTERISTIC cal_LTRIPUTempFanCtrl_1X "" VAL_BLK 0x0000 /* @ECU_Address@cal_LTRIPUTempFanCtrl_1X@ */ Scalar_FLOAT32_IEEE 0 ME11_CM_single_C 0.0 100.0 NUMBER 2 /end CHARACTERISTIC
/begin CHARACTERISTIC cal_LTRIPUTempMotPMPCtrl_1X "" VAL_BLK 0x0000 /* @ECU_Address@cal_LTRIPUTempMotPMPCtrl_1X@ */ Scalar_FLOAT32_IEEE 0 ME11_CM_single_C 0.0 100.0 NUMBER 2 /end CHARACTERISTIC
/begin CHARACTERISTIC cal_LTRMotorTempMotPMPCtrl_1X "" VAL_BLK 0x0000 /* @ECU_Address@cal_LTRMotorTempMotPMPCtrl_1X@ */ Scalar_FLOAT32_IEEE 0 ME11_CM_single_C 0.0 100.0 NUMBER 2 /end CHARACTERISTIC
/begin CHARACTERISTIC cal_LoPressData "" VALUE 0x0000 /* @ECU_Address@cal_LoPressData@ */ Scalar_FLOAT32_IEEE 0 ME11_CM_single_Mpa 0.0 10.0 /end CHARACTERISTIC
/begin CHARACTERISTIC cal_MCVPosDiffDelayTime "" VALUE 0x0000 /* @ECU_Address@cal_MCVPosDiffDelayTime@ */ Scalar_FLOAT32_IEEE 0 ME11_CM_single_min 0.0 300.0 /end CHARACTERISTIC
/begin CHARACTERISTIC cal_MixDoorPercData "" VALUE 0x0000 /* @ECU_Address@cal_MixDoorPercData@ */ Scalar_FLOAT32_IEEE 0 ME11_CM_single_percent_ 0.0 100.0 /end CHARACTERISTIC
/begin CHARACTERISTIC cal_MotorModeData "" VALUE 0x0000 /* @ECU_Address@cal_MotorModeData@ */ Scalar_FLOAT32_IEEE 0 ME11_CM_single_null 0.0 5.0 /end CHARACTERISTIC
/begin CHARACTERISTIC cal_NmCOMPEnvTempLmtOff "" VALUE 0x0000 /* @ECU_Address@cal_NmCOMPEnvTempLmtOff@ */ Scalar_FLOAT32_IEEE 0 ME11_CM_single_C -40.0 100.0 /end CHARACTERISTIC
/begin CHARACTERISTIC cal_NmCOMPEnvTempLmtOn "" VALUE 0x0000 /* @ECU_Address@cal_NmCOMPEnvTempLmtOn@ */ Scalar_FLOAT32_IEEE 0 ME11_CM_single_C -40.0 100.0 /end CHARACTERISTIC
/begin CHARACTERISTIC cal_OHXTempData "" VALUE 0x0000 /* @ECU_Address@cal_OHXTempData@ */ Scalar_FLOAT32_IEEE 0 ME11_CM_single_C -50.0 150.0 /end CHARACTERISTIC
/begin CHARACTERISTIC cal_OpenCoolInletTemp "" VALUE 0x0000 /* @ECU_Address@cal_OpenCoolInletTemp@ */ Scalar_FLOAT32_IEEE 0 ME11_CM_single_C 0.0 100.0 /end CHARACTERISTIC
/begin CHARACTERISTIC cal_OpenCtrlCOMPDownlmt "" VALUE 0x0000 /* @ECU_Address@cal_OpenCtrlCOMPDownlmt@ */ Scalar_FLOAT32_IEEE 0 ME11_CM_single_rpm 0.0 3000.0 /end CHARACTERISTIC
/begin CHARACTERISTIC cal_OpenCtrlCOMPUplmt "" VALUE 0x0000 /* @ECU_Address@cal_OpenCtrlCOMPUplmt@ */ Scalar_FLOAT32_IEEE 0 ME11_CM_single_rpm 0.0 3000.0 /end CHARACTERISTIC
/begin CHARACTERISTIC cal_PTCOffPowerVal "" VALUE 0x0000 /* @ECU_Address@cal_PTCOffPowerVal@ */ Scalar_FLOAT32_IEEE 0 ME11_CM_single_kw 0.0 10.0 /end CHARACTERISTIC
/begin CHARACTERISTIC cal_PTCReqtPowerData "" VALUE 0x0000 /* @ECU_Address@cal_PTCReqtPowerData@ */ Scalar_FLOAT32_IEEE 0 ME11_CM_single_kw 0.0 10.0 /end CHARACTERISTIC
/begin CHARACTERISTIC cal_PsDuctSensorFailDeflt "" VALUE 0x0000 /* @ECU_Address@cal_PsDuctSensorFailDeflt@ */ Scalar_FLOAT32_IEEE 0 ME11_CM_single_per_ -3.4E+38 3.4E+38 /end CHARACTERISTIC
/begin CHARACTERISTIC cal_SensorVolDownFlg "" VALUE 0x0000 /* @ECU_Address@cal_SensorVolDownFlg@ */ Scalar_FLOAT32_IEEE 0 ME11_CM_single_mv 0.0 5000.0 /end CHARACTERISTIC
/begin CHARACTERISTIC cal_SensorVolUpFlg "" VALUE 0x0000 /* @ECU_Address@cal_SensorVolUpFlg@ */ Scalar_FLOAT32_IEEE 0 ME11_CM_single_mv 0.0 5000.0 /end CHARACTERISTIC
/begin CHARACTERISTIC cal_SetPtcDesCoff "" VALUE 0x0000 /* @ECU_Address@cal_SetPtcDesCoff@ */ Scalar_FLOAT32_IEEE 0 ME11_CM_single_C 0.0 1.0 /end CHARACTERISTIC
/begin CHARACTERISTIC cal_SetPtcDesTempMin "" VALUE 0x0000 /* @ECU_Address@cal_SetPtcDesTempMin@ */ Scalar_FLOAT32_IEEE 0 ME11_CM_single_C 0.0 100.0 /end CHARACTERISTIC
/begin CHARACTERISTIC cal_SuperHeatFilter "" VALUE 0x0000 /* @ECU_Address@cal_SuperHeatFilter@ */ Scalar_FLOAT32_IEEE 0 ME11_CM_single_per_ 0.0 1.0 /end CHARACTERISTIC
/begin CHARACTERISTIC cal_TevapLoStepMin "" VALUE 0x0000 /* @ECU_Address@cal_TevapLoStepMin@ */ Scalar_FLOAT32_IEEE 0 ME11_CM_single_per_ -3.4E+38 3.4E+38 /end CHARACTERISTIC
/begin CHARACTERISTIC cal_TevapUpStepMin "" VALUE 0x0000 /* @ECU_Address@cal_TevapUpStepMin@ */ Scalar_FLOAT32_IEEE 0 ME11_CM_single_per_ -3.4E+38 3.4E+38 /end CHARACTERISTIC
/begin CHARACTERISTIC cal_WCCTempData "" VALUE 0x0000 /* @ECU_Address@cal_WCCTempData@ */ Scalar_FLOAT32_IEEE 0 ME11_CM_single_C -50.0 150.0 /end CHARACTERISTIC
/begin CHARACTERISTIC cal_rCabinCoolToCondMixDoor "" VALUE 0x0000 /* @ECU_Address@cal_rCabinCoolToCondMixDoor@ */ Scalar_FLOAT32_IEEE 0 ME11_CM_single_percent_ 0.0 100.0 /end CHARACTERISTIC
/begin CHARACTERISTIC cal_tCabinCondToCoolDvtDiff "" VALUE 0x0000 /* @ECU_Address@cal_tCabinCondToCoolDvtDiff@ */ Scalar_FLOAT32_IEEE 0 ME11_CM_single_C -10.0 10.0 /end CHARACTERISTIC
/begin CHARACTERISTIC cal_tCabinCondToCoolEvapTemp "" VALUE 0x0000 /* @ECU_Address@cal_tCabinCondToCoolEvapTemp@ */ Scalar_FLOAT32_IEEE 0 ME11_CM_single_C -5.0 20.0 /end CHARACTERISTIC
/begin CHARACTERISTIC cal_tCabinCondToEvpEvapTemp "" VALUE 0x0000 /* @ECU_Address@cal_tCabinCondToEvpEvapTemp@ */ Scalar_FLOAT32_IEEE 0 ME11_CM_single_C -5.0 20.0 /end CHARACTERISTIC
/begin CHARACTERISTIC cal_tCabinCoolEnvTempHigh "" VALUE 0x0000 /* @ECU_Address@cal_tCabinCoolEnvTempHigh@ */ Scalar_FLOAT32_IEEE 0 ME11_CM_single_C 0.0 40.0 /end CHARACTERISTIC
/begin CHARACTERISTIC cal_tCabinCoolEnvTempLow "" VALUE 0x0000 /* @ECU_Address@cal_tCabinCoolEnvTempLow@ */ Scalar_FLOAT32_IEEE 0 ME11_CM_single_C 0.0 20.0 /end CHARACTERISTIC
/begin CHARACTERISTIC cal_tCabinCoolToCondDvtDiff "" VALUE 0x0000 /* @ECU_Address@cal_tCabinCoolToCondDvtDiff@ */ Scalar_FLOAT32_IEEE 0 ME11_CM_single_C -10.0 10.0 /end CHARACTERISTIC
/begin CHARACTERISTIC cal_tCabinEvpToCondDvtDiff "" VALUE 0x0000 /* @ECU_Address@cal_tCabinEvpToCondDvtDiff@ */ Scalar_FLOAT32_IEEE 0 ME11_CM_single_C -10.0 10.0 /end CHARACTERISTIC
/begin CHARACTERISTIC cal_tCabinHPToEvpEnvTemp "" VALUE 0x0000 /* @ECU_Address@cal_tCabinHPToEvpEnvTemp@ */ Scalar_FLOAT32_IEEE 0 ME11_CM_single_C -5.0 20.0 /end CHARACTERISTIC
/begin CHARACTERISTIC cal_CabinEvpToCondCompLmt "" VALUE 0x0000 /* @ECU_Address@cal_CabinEvpToCondCompLmt@ */ Scalar_UWORD 0 ME11_CM_uint16_rpm 0.0 8000.0 /end CHARACTERISTIC
/begin CHARACTERISTIC cal_SolarData "" VALUE 0x0000 /* @ECU_Address@cal_SolarData@ */ Scalar_UWORD 0 ME11_CM_uint16_w_per_m_2 0.0 1200.0 /end CHARACTERISTIC
/begin CHARACTERISTIC cal_TevapLoTime "" VALUE 0x0000 /* @ECU_Address@cal_TevapLoTime@ */ Scalar_UWORD 0 ME11_CM_uint16_per_ 0 65535 /end CHARACTERISTIC
/begin CHARACTERISTIC cal_TevapUpTime "" VALUE 0x0000 /* @ECU_Address@cal_TevapUpTime@ */ Scalar_UWORD 0 ME11_CM_uint16_s 0.0 100.0 /end CHARACTERISTIC
/begin CHARACTERISTIC cal_RefModeData "" VALUE 0x0000 /* @ECU_Address@cal_RefModeData@ */ Scalar_UBYTE 0 ME11_CM_RefModes_null 0 14 /end CHARACTERISTIC
/begin CHARACTERISTIC cal_WaterModeData "" VALUE 0x0000 /* @ECU_Address@cal_WaterModeData@ */ Scalar_UBYTE 0 ME11_CM_WaterModes_flg 0 6 /end CHARACTERISTIC
/begin CHARACTERISTIC cal_ACCMCtrlSpdDataEnb "" VALUE 0x0000 /* @ECU_Address@cal_ACCMCtrlSpdDataEnb@ */ Scalar_BOOLEAN 0 ME11_CM_boolean_flg 0.0 1.0 /end CHARACTERISTIC
/begin CHARACTERISTIC cal_ACCMEnbData "" VALUE 0x0000 /* @ECU_Address@cal_ACCMEnbData@ */ Scalar_BOOLEAN 0 ME11_CM_boolean_rpm 0.0 1.0 /end CHARACTERISTIC
/begin CHARACTERISTIC cal_ACCMEnbDataEnb "" VALUE 0x0000 /* @ECU_Address@cal_ACCMEnbDataEnb@ */ Scalar_BOOLEAN 0 ME11_CM_boolean_flg 0.0 1.0 /end CHARACTERISTIC
/begin CHARACTERISTIC cal_ACCMHiTempDataEnb "" VALUE 0x0000 /* @ECU_Address@cal_ACCMHiTempDataEnb@ */ Scalar_BOOLEAN 0 ME11_CM_boolean_flg 0.0 1.0 /end CHARACTERISTIC
/begin CHARACTERISTIC cal_AcPMPFaultFlgData "" VALUE 0x0000 /* @ECU_Address@cal_AcPMPFaultFlgData@ */ Scalar_BOOLEAN 0 ME11_CM_boolean_flg 0.0 1.0 /end CHARACTERISTIC
/begin CHARACTERISTIC cal_AcPMPFaultFlgDataEnb "" VALUE 0x0000 /* @ECU_Address@cal_AcPMPFaultFlgDataEnb@ */ Scalar_BOOLEAN 0 ME11_CM_boolean_flg 0.0 1.0 /end CHARACTERISTIC
/begin CHARACTERISTIC cal_AcPMPSpdSetDataEnb "" VALUE 0x0000 /* @ECU_Address@cal_AcPMPSpdSetDataEnb@ */ Scalar_BOOLEAN 0 ME11_CM_boolean_flg 0.0 1.0 /end CHARACTERISTIC
/begin CHARACTERISTIC cal_AirInletPerEnb "" VALUE 0x0000 /* @ECU_Address@cal_AirInletPerEnb@ */ Scalar_BOOLEAN 0 ME11_CM_boolean_flg 0.0 1.0 /end CHARACTERISTIC
/begin CHARACTERISTIC cal_BatModeTestCtrl "" VALUE 0x0000 /* @ECU_Address@cal_BatModeTestCtrl@ */ Scalar_BOOLEAN 0 ME11_CM_boolean_flg 0.0 1.0 /end CHARACTERISTIC
/begin CHARACTERISTIC cal_BatPMPFaultFlgData "" VALUE 0x0000 /* @ECU_Address@cal_BatPMPFaultFlgData@ */ Scalar_BOOLEAN 0 ME11_CM_boolean_flg 0.0 1.0 /end CHARACTERISTIC
/begin CHARACTERISTIC cal_BatPMPFaultFlgDataEnb "" VALUE 0x0000 /* @ECU_Address@cal_BatPMPFaultFlgDataEnb@ */ Scalar_BOOLEAN 0 ME11_CM_boolean_flg 0.0 1.0 /end CHARACTERISTIC
/begin CHARACTERISTIC cal_BatPMPSpdSetDataEnb "" VALUE 0x0000 /* @ECU_Address@cal_BatPMPSpdSetDataEnb@ */ Scalar_BOOLEAN 0 ME11_CM_boolean_flg 0.0 1.0 /end CHARACTERISTIC
/begin CHARACTERISTIC cal_BatTrgTempEnb "" VALUE 0x0000 /* @ECU_Address@cal_BatTrgTempEnb@ */ Scalar_BOOLEAN 0 ME11_CM_boolean_flg 0.0 1.0 /end CHARACTERISTIC
/begin CHARACTERISTIC cal_CabinSetPTCSwitch "" VALUE 0x0000 /* @ECU_Address@cal_CabinSetPTCSwitch@ */ Scalar_BOOLEAN 0 ME11_CM_boolean_per_ 0.0 1.0 /end CHARACTERISTIC
/begin CHARACTERISTIC cal_CabinTempEnb "" VALUE 0x0000 /* @ECU_Address@cal_CabinTempEnb@ */ Scalar_BOOLEAN 0 ME11_CM_boolean_flg 0.0 1.0 /end CHARACTERISTIC
/begin CHARACTERISTIC cal_ChiTempDataEnb "" VALUE 0x0000 /* @ECU_Address@cal_ChiTempDataEnb@ */ Scalar_BOOLEAN 0 ME11_CM_boolean_flg 0.0 1.0 /end CHARACTERISTIC
/begin CHARACTERISTIC cal_EvaEnable "" VALUE 0x0000 /* @ECU_Address@cal_EvaEnable@ */ Scalar_BOOLEAN 0 ME11_CM_boolean_per_ 0 1 /end CHARACTERISTIC
/begin CHARACTERISTIC cal_EvapSurTempDataEnb "" VALUE 0x0000 /* @ECU_Address@cal_EvapSurTempDataEnb@ */ Scalar_BOOLEAN 0 ME11_CM_boolean_flg 0.0 1.0 /end CHARACTERISTIC
/begin CHARACTERISTIC cal_EvapTempDataEnb "" VALUE 0x0000 /* @ECU_Address@cal_EvapTempDataEnb@ */ Scalar_BOOLEAN 0 ME11_CM_boolean_flg 0.0 1.0 /end CHARACTERISTIC
/begin CHARACTERISTIC cal_ExtDefFlgData "" VALUE 0x0000 /* @ECU_Address@cal_ExtDefFlgData@ */ Scalar_BOOLEAN 0 ME11_CM_boolean_flg 0.0 1.0 /end CHARACTERISTIC
/begin CHARACTERISTIC cal_ExtDefFlgDataEnb "" VALUE 0x0000 /* @ECU_Address@cal_ExtDefFlgDataEnb@ */ Scalar_BOOLEAN 0 ME11_CM_boolean_flg 0.0 1.0 /end CHARACTERISTIC
/begin CHARACTERISTIC cal_FaceDuctTempEnb "" VALUE 0x0000 /* @ECU_Address@cal_FaceDuctTempEnb@ */ Scalar_BOOLEAN 0 ME11_CM_boolean_flg 0.0 1.0 /end CHARACTERISTIC
/begin CHARACTERISTIC cal_FixPIDSecletFlag "" VALUE 0x0000 /* @ECU_Address@cal_FixPIDSecletFlag@ */ Scalar_BOOLEAN 0 ME11_CM_boolean_per_ 0 1 /end CHARACTERISTIC
/begin CHARACTERISTIC cal_FootDuctTempEnb "" VALUE 0x0000 /* @ECU_Address@cal_FootDuctTempEnb@ */ Scalar_BOOLEAN 0 ME11_CM_boolean_flg 0.0 1.0 /end CHARACTERISTIC
/begin CHARACTERISTIC cal_HPEXVStepLmtSw "" VALUE 0x0000 /* @ECU_Address@cal_HPEXVStepLmtSw@ */ Scalar_BOOLEAN 0 ME11_CM_boolean_flg 0.0 1.0 /end CHARACTERISTIC
/begin CHARACTERISTIC cal_HVPartModeEnb "" VALUE 0x0000 /* @ECU_Address@cal_HVPartModeEnb@ */ Scalar_BOOLEAN 0 ME11_CM_boolean_flg 0.0 1.0 /end CHARACTERISTIC
/begin CHARACTERISTIC cal_HiPressDataEnb "" VALUE 0x0000 /* @ECU_Address@cal_HiPressDataEnb@ */ Scalar_BOOLEAN 0 ME11_CM_boolean_flg 0.0 1.0 /end CHARACTERISTIC
/begin CHARACTERISTIC cal_LoPressDataEnb "" VALUE 0x0000 /* @ECU_Address@cal_LoPressDataEnb@ */ Scalar_BOOLEAN 0 ME11_CM_boolean_flg 0.0 1.0 /end CHARACTERISTIC
/begin CHARACTERISTIC cal_MixDoorPercDataEnb "" VALUE 0x0000 /* @ECU_Address@cal_MixDoorPercDataEnb@ */ Scalar_BOOLEAN 0 ME11_CM_boolean_flg 0.0 1.0 /end CHARACTERISTIC
/begin CHARACTERISTIC cal_MotPMPFaultFlgData "" VALUE 0x0000 /* @ECU_Address@cal_MotPMPFaultFlgData@ */ Scalar_BOOLEAN 0 ME11_CM_boolean_flg 0.0 1.0 /end CHARACTERISTIC
/begin CHARACTERISTIC cal_MotPMPFaultFlgDataEnb "" VALUE 0x0000 /* @ECU_Address@cal_MotPMPFaultFlgDataEnb@ */ Scalar_BOOLEAN 0 ME11_CM_boolean_flg 0.0 1.0 /end CHARACTERISTIC
/begin CHARACTERISTIC cal_MotPMPSpdSetDataEnb "" VALUE 0x0000 /* @ECU_Address@cal_MotPMPSpdSetDataEnb@ */ Scalar_BOOLEAN 0 ME11_CM_boolean_flg 0.0 1.0 /end CHARACTERISTIC
/begin CHARACTERISTIC cal_MotorModeEnb "" VALUE 0x0000 /* @ECU_Address@cal_MotorModeEnb@ */ Scalar_BOOLEAN 0 ME11_CM_boolean_flg 0.0 1.0 /end CHARACTERISTIC
/begin CHARACTERISTIC cal_OHXTempDataEnb "" VALUE 0x0000 /* @ECU_Address@cal_OHXTempDataEnb@ */ Scalar_BOOLEAN 0 ME11_CM_boolean_flg 0.0 1.0 /end CHARACTERISTIC
/begin CHARACTERISTIC cal_PTCEnableDataEnb "" VALUE 0x0000 /* @ECU_Address@cal_PTCEnableDataEnb@ */ Scalar_BOOLEAN 0 ME11_CM_boolean_flg 0.0 1.0 /end CHARACTERISTIC
/begin CHARACTERISTIC cal_PTCReqtPowerDataEnb "" VALUE 0x0000 /* @ECU_Address@cal_PTCReqtPowerDataEnb@ */ Scalar_BOOLEAN 0 ME11_CM_boolean_flg 0.0 1.0 /end CHARACTERISTIC
/begin CHARACTERISTIC cal_PtcEnable "" VALUE 0x0000 /* @ECU_Address@cal_PtcEnable@ */ Scalar_BOOLEAN 0 ME11_CM_boolean_per_ 0 1 /end CHARACTERISTIC
/begin CHARACTERISTIC cal_RefModeEnb "" VALUE 0x0000 /* @ECU_Address@cal_RefModeEnb@ */ Scalar_BOOLEAN 0 ME11_CM_boolean_flg 0.0 1.0 /end CHARACTERISTIC
/begin CHARACTERISTIC cal_SolarEnb "" VALUE 0x0000 /* @ECU_Address@cal_SolarEnb@ */ Scalar_BOOLEAN 0 ME11_CM_boolean_flg 0.0 1.0 /end CHARACTERISTIC
/begin CHARACTERISTIC cal_WCCTempDataEnb "" VALUE 0x0000 /* @ECU_Address@cal_WCCTempDataEnb@ */ Scalar_BOOLEAN 0 ME11_CM_boolean_flg 0.0 1.0 /end CHARACTERISTIC
/begin CHARACTERISTIC cal_WaterModeEnb "" VALUE 0x0000 /* @ECU_Address@cal_WaterModeEnb@ */ Scalar_BOOLEAN 0 ME11_CM_boolean_null 0.0 1.0 /end CHARACTERISTIC
/begin CHARACTERISTIC ACDefog "" VALUE 0x0000 /* @ECU_Address@ACDefog@ */ Scalar_UBYTE 0 ME11_CM_uint8_flg 0.0 64.0 /end CHARACTERISTIC
/begin CHARACTERISTIC cal_ACCtlRecLevelForACHotStart "" VALUE 0x0000 /* @ECU_Address@cal_ACCtlRecLevelForACHotStart@ */ Scalar_UBYTE 0 ME11_CM_uint8_per_ 0.0 15.0 /end CHARACTERISTIC
/begin CHARACTERISTIC cal_ACCtlRecLevelForAQS "" VALUE 0x0000 /* @ECU_Address@cal_ACCtlRecLevelForAQS@ */ Scalar_UBYTE 0 ME11_CM_uint8_per_ 0.0 15.0 /end CHARACTERISTIC
/begin CHARACTERISTIC cal_ACCtlRecLevelForForceChange "" VALUE 0x0000 /* @ECU_Address@cal_ACCtlRecLevelForForceChange@ */ Scalar_UBYTE 0 ME11_CM_uint8_per_ 0.0 15.0 /end CHARACTERISTIC
/begin CHARACTERISTIC cal_ACCtlRecLevelForForceDefog "" VALUE 0x0000 /* @ECU_Address@cal_ACCtlRecLevelForForceDefog@ */ Scalar_UBYTE 0 ME11_CM_uint8_per_ 0.0 15.0 /end CHARACTERISTIC
/begin CHARACTERISTIC cal_ACCtlRecLevelForManual "" VALUE 0x0000 /* @ECU_Address@cal_ACCtlRecLevelForManual@ */ Scalar_UBYTE 0 ME11_CM_uint8_per_ 0.0 15.0 /end CHARACTERISTIC
/begin CHARACTERISTIC cal_ACCtlRecLevelForNormalDefog "" VALUE 0x0000 /* @ECU_Address@cal_ACCtlRecLevelForNormalDefog@ */ Scalar_UBYTE 0 ME11_CM_uint8_per_ 0.0 15.0 /end CHARACTERISTIC
/begin CHARACTERISTIC cal_ACCtlRecLevelForPCUTemp "" VALUE 0x0000 /* @ECU_Address@cal_ACCtlRecLevelForPCUTemp@ */ Scalar_UBYTE 0 ME11_CM_uint8_per_ 0.0 15.0 /end CHARACTERISTIC
/begin CHARACTERISTIC cal_ACCtlRecLevelForPTCDvt "" VALUE 0x0000 /* @ECU_Address@cal_ACCtlRecLevelForPTCDvt@ */ Scalar_UBYTE 0 ME11_CM_uint8_per_ 0.0 15.0 /end CHARACTERISTIC
/begin CHARACTERISTIC cal_ACCtlRecLevelForQkChargeCooling "" VALUE 0x0000 /* @ECU_Address@cal_ACCtlRecLevelForQkChargeCooling@ */ Scalar_UBYTE 0 ME11_CM_uint8_per_ 0.0 15.0 /end CHARACTERISTIC
/begin CHARACTERISTIC cal_ACCtlRecLevelForRemoteAC "" VALUE 0x0000 /* @ECU_Address@cal_ACCtlRecLevelForRemoteAC@ */ Scalar_UBYTE 0 ME11_CM_uint8_per_ 0.0 15.0 /end CHARACTERISTIC
/begin CHARACTERISTIC cal_ACCtlRecLevelForSummer "" VALUE 0x0000 /* @ECU_Address@cal_ACCtlRecLevelForSummer@ */ Scalar_UBYTE 0 ME11_CM_uint8_per_ 0.0 15.0 /end CHARACTERISTIC
/begin CHARACTERISTIC cal_ACCtlRecLevelForTargetOutTemp "" VALUE 0x0000 /* @ECU_Address@cal_ACCtlRecLevelForTargetOutTemp@ */ Scalar_UBYTE 0 ME11_CM_uint8_per_ 0.0 15.0 /end CHARACTERISTIC
/begin CHARACTERISTIC cal_ACCtlRecLevelForTempLow "" VALUE 0x0000 /* @ECU_Address@cal_ACCtlRecLevelForTempLow@ */ Scalar_UBYTE 0 ME11_CM_uint8_per_ 0.0 15.0 /end CHARACTERISTIC
/begin CHARACTERISTIC cal_ACCtlRecLevelForVent "" VALUE 0x0000 /* @ECU_Address@cal_ACCtlRecLevelForVent@ */ Scalar_UBYTE 0 ME11_CM_uint8_per_ 0.0 15.0 /end CHARACTERISTIC
/begin CHARACTERISTIC cal_ACCtlRecLevelForWinter "" VALUE 0x0000 /* @ECU_Address@cal_ACCtlRecLevelForWinter@ */ Scalar_UBYTE 0 ME11_CM_uint8_per_ 0.0 15.0 /end CHARACTERISTIC
/begin CHARACTERISTIC cal_AcPMPSpdSetData "" VALUE 0x0000 /* @ECU_Address@cal_AcPMPSpdSetData@ */ Scalar_UBYTE 0 ME11_CM_uint8_percent_ 0.0 255.0 /end CHARACTERISTIC
/begin CHARACTERISTIC cal_AirInletPerData "" VALUE 0x0000 /* @ECU_Address@cal_AirInletPerData@ */ Scalar_UBYTE 0 ME11_CM_uint8_percent_ 0.0 100.0 /end CHARACTERISTIC
/begin CHARACTERISTIC cal_BCVFltStsDelayTime "" VALUE 0x0000 /* @ECU_Address@cal_BCVFltStsDelayTime@ */ Scalar_UBYTE 0 ME11_CM_uint8_s 0.0 100.0 /end CHARACTERISTIC
/begin CHARACTERISTIC cal_BatPMPSpdSetData "" VALUE 0x0000 /* @ECU_Address@cal_BatPMPSpdSetData@ */ Scalar_UBYTE 0 ME11_CM_uint8_percent_ 0.0 255.0 /end CHARACTERISTIC
/begin CHARACTERISTIC cal_C3WVExhPosVal "" VALUE 0x0000 /* @ECU_Address@cal_C3WVExhPosVal@ */ Scalar_UBYTE 0 ME11_CM_uint8_percent_ 0.0 100.0 /end CHARACTERISTIC
/begin CHARACTERISTIC cal_C5WVExhPosVal "" VALUE 0x0000 /* @ECU_Address@cal_C5WVExhPosVal@ */ Scalar_UBYTE 0 ME11_CM_uint8_percent_ 0.0 100.0 /end CHARACTERISTIC
/begin CHARACTERISTIC cal_CO2RecircRatio "" VALUE 0x0000 /* @ECU_Address@cal_CO2RecircRatio@ */ Scalar_UBYTE 0 ME11_CM_uint8_per_ 0 255 /end CHARACTERISTIC
/begin CHARACTERISTIC cal_CabinTCorSelect "" VALUE 0x0000 /* @ECU_Address@cal_CabinTCorSelect@ */ Scalar_UBYTE 0 ME11_CM_uint8_per_ 0 255 /end CHARACTERISTIC
/begin CHARACTERISTIC cal_HVPartModeData "" VALUE 0x0000 /* @ECU_Address@cal_HVPartModeData@ */ Scalar_UBYTE 0 ME11_CM_uint8_null 0.0 8.0 /end CHARACTERISTIC
/begin CHARACTERISTIC cal_LTRFanCtrl_1Y "" VAL_BLK 0x0000 /* @ECU_Address@cal_LTRFanCtrl_1Y@ */ Scalar_UBYTE 0 ME11_CM_uint8_rpm 0.0 100.0 NUMBER 3 /end CHARACTERISTIC
/begin CHARACTERISTIC cal_LTRIGBTTempMotPMPCtrl_1Y "" VAL_BLK 0x0000 /* @ECU_Address@cal_LTRIGBTTempMotPMPCtrl_1Y@ */ Scalar_UBYTE 0 ME11_CM_uint8_percent_ 0.0 100.0 NUMBER 3 /end CHARACTERISTIC
/begin CHARACTERISTIC cal_LTRIPUTempFanCtrl_1Y "" VAL_BLK 0x0000 /* @ECU_Address@cal_LTRIPUTempFanCtrl_1Y@ */ Scalar_UBYTE 0 ME11_CM_uint8_rpm 0.0 100.0 NUMBER 3 /end CHARACTERISTIC
/begin CHARACTERISTIC cal_LTRIPUTempMotPMPCtrl_1Y "" VAL_BLK 0x0000 /* @ECU_Address@cal_LTRIPUTempMotPMPCtrl_1Y@ */ Scalar_UBYTE 0 ME11_CM_uint8_percent_ 0.0 100.0 NUMBER 3 /end CHARACTERISTIC
/begin CHARACTERISTIC cal_LTRMotorTempMotPMPCtrl_1Y "" VAL_BLK 0x0000 /* @ECU_Address@cal_LTRMotorTempMotPMPCtrl_1Y@ */ Scalar_UBYTE 0 ME11_CM_uint8_percent_ 0.0 100.0 NUMBER 3 /end CHARACTERISTIC
/begin CHARACTERISTIC cal_MCVFltStsDelayTime "" VALUE 0x0000 /* @ECU_Address@cal_MCVFltStsDelayTime@ */ Scalar_UBYTE 0 ME11_CM_uint8_s 0.0 100.0 /end CHARACTERISTIC
/begin CHARACTERISTIC cal_MotPMPSpdSetData "" VALUE 0x0000 /* @ECU_Address@cal_MotPMPSpdSetData@ */ Scalar_UBYTE 0 ME11_CM_uint8_percent_ 0.0 255.0 /end CHARACTERISTIC
/begin CHARACTERISTIC cal_PTCEnableData "" VALUE 0x0000 /* @ECU_Address@cal_PTCEnableData@ */ Scalar_UBYTE 0 ME11_CM_uint8_flg 0.0 3.0 /end CHARACTERISTIC
/begin CHARACTERISTIC cal_rCabinEvpToHPInnRatio "" VALUE 0x0000 /* @ECU_Address@cal_rCabinEvpToHPInnRatio@ */ Scalar_UBYTE 0 ME11_CM_uint8_percent_ 0.0 100.0 /end CHARACTERISTIC
/begin CHARACTERISTIC cal_rCabinHPToEvpInnRatio "" VALUE 0x0000 /* @ECU_Address@cal_rCabinHPToEvpInnRatio@ */ Scalar_UBYTE 0 ME11_CM_uint8_percent_ 0.0 100.0 /end CHARACTERISTIC
/begin MEASUREMENT ACCtl_tLeftDuct "" FLOAT32_IEEE ME11_CM_single_null 0 0 -3.4E+38 3.4E+38 ECU_ADDRESS 0x0000 /* @ECU_Address@ACCtl_tLeftDuct@ */ /end MEASUREMENT
/begin MEASUREMENT GlbDa_tCabinInvent "" FLOAT32_IEEE ME11_CM_single_null 0 0 -3.4E+38 3.4E+38 ECU_ADDRESS 0x0000 /* @ECU_Address@GlbDa_tCabinInvent@ */ /end MEASUREMENT
/begin MEASUREMENT ACCtl_tRightDuct "" FLOAT32_IEEE ME11_CM_single_null 0 0 -3.4E+38 3.4E+38 ECU_ADDRESS 0x0000 /* @ECU_Address@ACCtl_tRightDuct@ */ /end MEASUREMENT
/begin MEASUREMENT Eva_CoolingCond1 "" FLOAT32_IEEE ME11_CM_single_null 0 0 -3.4E+38 3.4E+38 ECU_ADDRESS 0x0000 /* @ECU_Address@Eva_CoolingCond1@ */ /end MEASUREMENT
/begin MEASUREMENT Eva_CoolingCond2 "" FLOAT32_IEEE ME11_CM_single_null 0 0 -3.4E+38 3.4E+38 ECU_ADDRESS 0x0000 /* @ECU_Address@Eva_CoolingCond2@ */ /end MEASUREMENT
/begin MEASUREMENT Eva_CloseCond1 "" FLOAT32_IEEE ME11_CM_single_null 0 0 -3.4E+38 3.4E+38 ECU_ADDRESS 0x0000 /* @ECU_Address@Eva_CloseCond1@ */ /end MEASUREMENT
/begin MEASUREMENT Eva_CooledCond1 "" FLOAT32_IEEE ME11_CM_single_null 0 0 -3.4E+38 3.4E+38 ECU_ADDRESS 0x0000 /* @ECU_Address@Eva_CooledCond1@ */ /end MEASUREMENT
/begin MEASUREMENT ACCtl_sECOEvaDesValLL "" FLOAT32_IEEE ME11_CM_single_C 0 0 -3.4E+38 3.4E+38 ECU_ADDRESS 0x0000 /* @ECU_Address@ACCtl_sECOEvaDesValLL@ */ /end MEASUREMENT
/begin MEASUREMENT ACCtl_tSetPointEvap "" FLOAT32_IEEE ME11_CM_single_null 0 0 -3.4E+38 3.4E+38 ECU_ADDRESS 0x0000 /* @ECU_Address@ACCtl_tSetPointEvap@ */ /end MEASUREMENT
/begin MEASUREMENT ACPTC_HeatingCond1 "" FLOAT32_IEEE ME11_CM_single_null 0 0 -3.4E+38 3.4E+38 ECU_ADDRESS 0x0000 /* @ECU_Address@ACPTC_HeatingCond1@ */ /end MEASUREMENT
/begin MEASUREMENT ACPTC_HeatingCond2 "" FLOAT32_IEEE ME11_CM_single_null 0 0 -3.4E+38 3.4E+38 ECU_ADDRESS 0x0000 /* @ECU_Address@ACPTC_HeatingCond2@ */ /end MEASUREMENT
/begin MEASUREMENT ACPtc_CloseCond1 "" FLOAT32_IEEE ME11_CM_single_null 0 0 -3.4E+38 3.4E+38 ECU_ADDRESS 0x0000 /* @ECU_Address@ACPtc_CloseCond1@ */ /end MEASUREMENT
/begin MEASUREMENT ACPTC_HeatedCond1 "" FLOAT32_IEEE ME11_CM_single_null 0 0 -3.4E+38 3.4E+38 ECU_ADDRESS 0x0000 /* @ECU_Address@ACPTC_HeatedCond1@ */ /end MEASUREMENT
/begin MEASUREMENT ACCCtl_sSetPtcDesTempMax "" FLOAT32_IEEE ME11_CM_single_C 0 0 -3.4E+38 3.4E+38 ECU_ADDRESS 0x0000 /* @ECU_Address@ACCCtl_sSetPtcDesTempMax@ */ /end MEASUREMENT
/begin MEASUREMENT ACCtl_tSetPointPTC "" FLOAT32_IEEE ME11_CM_single_null 0 0 -3.4E+38 3.4E+38 ECU_ADDRESS 0x0000 /* @ECU_Address@ACCtl_tSetPointPTC@ */ /end MEASUREMENT
/begin MEASUREMENT SOMCtl_sF1Value "" FLOAT32_IEEE ME11_CM_single_C 0 0 -3.4E+38 3.4E+38 ECU_ADDRESS 0x0000 /* @ECU_Address@SOMCtl_sF1Value@ */ /end MEASUREMENT
/begin MEASUREMENT SOMCtl_sF2Value "" FLOAT32_IEEE ME11_CM_single_C 0 0 -3.4E+38 3.4E+38 ECU_ADDRESS 0x0000 /* @ECU_Address@SOMCtl_sF2Value@ */ /end MEASUREMENT
/begin MEASUREMENT ACSen_sPressRateVal "" FLOAT32_IEEE ME11_CM_single_percent_ 0 0 -3.4E+38 3.4E+38 ECU_ADDRESS 0x0000 /* @ECU_Address@ACSen_sPressRateVal@ */ /end MEASUREMENT
/begin MEASUREMENT SOMCtl_sBatTrgTemp "" FLOAT32_IEEE ME11_CM_single_C 0 0 -3.4E+38 3.4E+38 ECU_ADDRESS 0x0000 /* @ECU_Address@SOMCtl_sBatTrgTemp@ */ /end MEASUREMENT
/begin MEASUREMENT ThCo_rSetLeftMixDoor "" FLOAT32_IEEE ME11_CM_single_null 0 0 -3.4E+38 3.4E+38 ECU_ADDRESS 0x0000 /* @ECU_Address@ThCo_rSetLeftMixDoor@ */ /end MEASUREMENT
/begin MEASUREMENT ThCo_rSetRightMixDoor "" FLOAT32_IEEE ME11_CM_single_null 0 0 -3.4E+38 3.4E+38 ECU_ADDRESS 0x0000 /* @ECU_Address@ThCo_rSetRightMixDoor@ */ /end MEASUREMENT
/begin MEASUREMENT ACTCtl_sCOMPCtrlAClsFF "" FLOAT32_IEEE ME11_CM_single_rpm 0 0 -3.4E+38 3.4E+38 ECU_ADDRESS 0x0000 /* @ECU_Address@ACTCtl_sCOMPCtrlAClsFF@ */ /end MEASUREMENT
/begin MEASUREMENT ACTCtl_tCtrlADiff "" FLOAT32_IEEE ME11_CM_single_C 0 0 -3.4E+38 3.4E+38 ECU_ADDRESS 0x0000 /* @ECU_Address@ACTCtl_tCtrlADiff@ */ /end MEASUREMENT
/begin MEASUREMENT ACTCtl_tCtrlBDiff "" FLOAT32_IEEE ME11_CM_single_C 0 0 -3.4E+38 3.4E+38 ECU_ADDRESS 0x0000 /* @ECU_Address@ACTCtl_tCtrlBDiff@ */ /end MEASUREMENT
/begin MEASUREMENT ACTCtl_tCtrlCDiff "" FLOAT32_IEEE ME11_CM_single_C 0 0 -3.4E+38 3.4E+38 ECU_ADDRESS 0x0000 /* @ECU_Address@ACTCtl_tCtrlCDiff@ */ /end MEASUREMENT
/begin MEASUREMENT ACTCtl_sDCoolBatTempDiff "" FLOAT32_IEEE ME11_CM_single_C 0 0 -3.4E+38 3.4E+38 ECU_ADDRESS 0x0000 /* @ECU_Address@ACTCtl_sDCoolBatTempDiff@ */ /end MEASUREMENT
/begin MEASUREMENT ACTCtl_sDCoolCabinTempDiff "" FLOAT32_IEEE ME11_CM_single_C 0 0 -3.4E+38 3.4E+38 ECU_ADDRESS 0x0000 /* @ECU_Address@ACTCtl_sDCoolCabinTempDiff@ */ /end MEASUREMENT
/begin MEASUREMENT ACTCtl_sACCMI_Sum "" FLOAT32_IEEE ME11_CM_single_rpm 0 0 -3.4E+38 3.4E+38 ECU_ADDRESS 0x0000 /* @ECU_Address@ACTCtl_sACCMI_Sum@ */ /end MEASUREMENT
/begin MEASUREMENT ACTCtl_sACCMP_Cor "" FLOAT32_IEEE ME11_CM_single_rpm 0 0 -3.4E+38 3.4E+38 ECU_ADDRESS 0x0000 /* @ECU_Address@ACTCtl_sACCMP_Cor@ */ /end MEASUREMENT
/begin MEASUREMENT ACTCtl_sACCMPIVal "" FLOAT32_IEEE ME11_CM_single_rpm 0 0 -3.4E+38 3.4E+38 ECU_ADDRESS 0x0000 /* @ECU_Address@ACTCtl_sACCMPIVal@ */ /end MEASUREMENT
/begin MEASUREMENT ACTCtl_sCOMPATNoiseLmtHVSSpd "" FLOAT32_IEEE ME11_CM_single_rpm 0 0 -3.4E+38 3.4E+38 ECU_ADDRESS 0x0000 /* @ECU_Address@ACTCtl_sCOMPATNoiseLmtHVSSpd@ */ /end MEASUREMENT
/begin MEASUREMENT ACTCtl_sCOMPATNoiseBlwAndAccmSpd "" FLOAT32_IEEE ME11_CM_single_rpm 0 0 -3.4E+38 3.4E+38 ECU_ADDRESS 0x0000 /* @ECU_Address@ACTCtl_sCOMPATNoiseBlwAndAccmSpd@ */ /end MEASUREMENT
/begin MEASUREMENT ACTCtl_sCOMPCoolLmtSpd "" FLOAT32_IEEE ME11_CM_single_rpm 0 0 -3.4E+38 3.4E+38 ECU_ADDRESS 0x0000 /* @ECU_Address@ACTCtl_sCOMPCoolLmtSpd@ */ /end MEASUREMENT
/begin MEASUREMENT ACTCtl_sCOMPHPLmtSpd "" FLOAT32_IEEE ME11_CM_single_rpm 0 0 -3.4E+38 3.4E+38 ECU_ADDRESS 0x0000 /* @ECU_Address@ACTCtl_sCOMPHPLmtSpd@ */ /end MEASUREMENT
/begin MEASUREMENT ACTCtl_sCOMPLPLmtSpd "" FLOAT32_IEEE ME11_CM_single_rpm 0 0 -3.4E+38 3.4E+38 ECU_ADDRESS 0x0000 /* @ECU_Address@ACTCtl_sCOMPLPLmtSpd@ */ /end MEASUREMENT
/begin MEASUREMENT ACTCtl_sCOMPPCULimSpd "" FLOAT32_IEEE ME11_CM_single_rpm 0 0 -3.4E+38 3.4E+38 ECU_ADDRESS 0x0000 /* @ECU_Address@ACTCtl_sCOMPPCULimSpd@ */ /end MEASUREMENT
/begin MEASUREMENT ACTCtl_sCOMPATNoiseLmtSpd "" FLOAT32_IEEE ME11_CM_single_rpm 0 0 -3.4E+38 3.4E+38 ECU_ADDRESS 0x0000 /* @ECU_Address@ACTCtl_sCOMPATNoiseLmtSpd@ */ /end MEASUREMENT
/begin MEASUREMENT ACTCtl_sCOMPEnvLmtSpd "" FLOAT32_IEEE ME11_CM_single_rpm 0 0 -3.4E+38 3.4E+38 ECU_ADDRESS 0x0000 /* @ECU_Address@ACTCtl_sCOMPEnvLmtSpd@ */ /end MEASUREMENT
/begin MEASUREMENT ACTCtl_sCOMPFanlevelLmtSpd "" FLOAT32_IEEE ME11_CM_single_rpm 0 0 -3.4E+38 3.4E+38 ECU_ADDRESS 0x0000 /* @ECU_Address@ACTCtl_sCOMPFanlevelLmtSpd@ */ /end MEASUREMENT
/begin MEASUREMENT ACTCtl_sCOMPDownSpd "" FLOAT32_IEEE ME11_CM_single_null 0 0 -3.4E+38 3.4E+38 ECU_ADDRESS 0x0000 /* @ECU_Address@ACTCtl_sCOMPDownSpd@ */ /end MEASUREMENT
/begin MEASUREMENT ACTCtl_sPTCAuxHeatPwr "" FLOAT32_IEEE ME11_CM_single_kw 0 0 -3.4E+38 3.4E+38 ECU_ADDRESS 0x0000 /* @ECU_Address@ACTCtl_sPTCAuxHeatPwr@ */ /end MEASUREMENT
/begin MEASUREMENT ACTCtl_sCtrlFPTCAuxHeatPwr "" FLOAT32_IEEE ME11_CM_single_kw 0 0 -3.4E+38 3.4E+38 ECU_ADDRESS 0x0000 /* @ECU_Address@ACTCtl_sCtrlFPTCAuxHeatPwr@ */ /end MEASUREMENT
/begin MEASUREMENT ACTCtl_sCoolCondDepAvg "" FLOAT32_IEEE ME11_CM_single_C 0 0 -3.4E+38 3.4E+38 ECU_ADDRESS 0x0000 /* @ECU_Address@ACTCtl_sCoolCondDepAvg@ */ /end MEASUREMENT
/begin MEASUREMENT ACTCtl_sEvapSuperHeatAvg "" FLOAT32_IEEE ME11_CM_single_C 0 0 -3.4E+38 3.4E+38 ECU_ADDRESS 0x0000 /* @ECU_Address@ACTCtl_sEvapSuperHeatAvg@ */ /end MEASUREMENT
/begin MEASUREMENT ACTCtl_sAEXVDvt "" FLOAT32_IEEE ME11_CM_single_C 0 0 -3.4E+38 3.4E+38 ECU_ADDRESS 0x0000 /* @ECU_Address@ACTCtl_sAEXVDvt@ */ /end MEASUREMENT
/begin MEASUREMENT ACTCtl_sAEXVPos "" FLOAT32_IEEE ME11_CM_single_percent_ 0 0 -3.4E+38 3.4E+38 ECU_ADDRESS 0x0000 /* @ECU_Address@ACTCtl_sAEXVPos@ */ /end MEASUREMENT
/begin MEASUREMENT ACTCtl_sChiSuperHeatAvg "" FLOAT32_IEEE ME11_CM_single_C 0 0 -3.4E+38 3.4E+38 ECU_ADDRESS 0x0000 /* @ECU_Address@ACTCtl_sChiSuperHeatAvg@ */ /end MEASUREMENT
/begin MEASUREMENT ACTCtl_sBEXVDvt "" FLOAT32_IEEE ME11_CM_single_C 0 0 -3.4E+38 3.4E+38 ECU_ADDRESS 0x0000 /* @ECU_Address@ACTCtl_sBEXVDvt@ */ /end MEASUREMENT
/begin MEASUREMENT ACTCtl_sCondDepAvg "" FLOAT32_IEEE ME11_CM_single_C 0 0 -3.4E+38 3.4E+38 ECU_ADDRESS 0x0000 /* @ECU_Address@ACTCtl_sCondDepAvg@ */ /end MEASUREMENT
/begin MEASUREMENT ACTCtl_sHPEXVSetPoint "" FLOAT32_IEEE ME11_CM_single_null 0 0 -3.4E+38 3.4E+38 ECU_ADDRESS 0x0000 /* @ECU_Address@ACTCtl_sHPEXVSetPoint@ */ /end MEASUREMENT
/begin MEASUREMENT ACTCtl_sHPEXVDvt "" FLOAT32_IEEE ME11_CM_single_C 0 0 -3.4E+38 3.4E+38 ECU_ADDRESS 0x0000 /* @ECU_Address@ACTCtl_sHPEXVDvt@ */ /end MEASUREMENT
/begin MEASUREMENT ACTCtl_sHPEXVPos "" FLOAT32_IEEE ME11_CM_single_percent_ 0 0 -3.4E+38 3.4E+38 ECU_ADDRESS 0x0000 /* @ECU_Address@ACTCtl_sHPEXVPos@ */ /end MEASUREMENT
/begin MEASUREMENT ACTCtl_sExhSuperHeatAvg "" FLOAT32_IEEE ME11_CM_single_C 0 0 -3.4E+38 3.4E+38 ECU_ADDRESS 0x0000 /* @ECU_Address@ACTCtl_sExhSuperHeatAvg@ */ /end MEASUREMENT
/begin MEASUREMENT ACTCtl_sSuperHeatAvg "" FLOAT32_IEEE ME11_CM_single_C 0 0 -3.4E+38 3.4E+38 ECU_ADDRESS 0x0000 /* @ECU_Address@ACTCtl_sSuperHeatAvg@ */ /end MEASUREMENT
/begin MEASUREMENT ACTCtl_sPTCReqPower "" FLOAT32_IEEE ME11_CM_single_kw 0 0 -3.4E+38 3.4E+38 ECU_ADDRESS 0x0000 /* @ECU_Address@ACTCtl_sPTCReqPower@ */ /end MEASUREMENT
/begin MEASUREMENT EE_tEnv "" FLOAT32_IEEE ME11_CM_single_C 0 0 -3.4E+38 3.4E+38 ECU_ADDRESS 0x0000 /* @ECU_Address@EE_tEnv@ */ /end MEASUREMENT
/begin MEASUREMENT EE_PCUInletTemp "" FLOAT32_IEEE ME11_CM_single_C 0 0 -3.4E+38 3.4E+38 ECU_ADDRESS 0x0000 /* @ECU_Address@EE_PCUInletTemp@ */ /end MEASUREMENT
/begin MEASUREMENT PCU_StartClntTemp "" FLOAT32_IEEE ME11_CM_single_C 0 0 -3.4E+38 3.4E+38 ECU_ADDRESS 0x0000 /* @ECU_Address@PCU_StartClntTemp@ */ /end MEASUREMENT
/begin MEASUREMENT ColdStartPCUTempMinByEnv "" FLOAT32_IEEE ME11_CM_single_C 0 0 -3.4E+38 3.4E+38 ECU_ADDRESS 0x0000 /* @ECU_Address@ColdStartPCUTempMinByEnv@ */ /end MEASUREMENT
/begin MEASUREMENT PCUtempOffset2ShutByEnv "" FLOAT32_IEEE ME11_CM_single_C 0 0 -3.4E+38 3.4E+38 ECU_ADDRESS 0x0000 /* @ECU_Address@PCUtempOffset2ShutByEnv@ */ /end MEASUREMENT
/begin MEASUREMENT ACTCtl_sHPEXVCtrlFF "" FLOAT32_IEEE ME11_CM_single_percent_ 0 0 -3.4E+38 3.4E+38 ECU_ADDRESS 0x0000 /* @ECU_Address@ACTCtl_sHPEXVCtrlFF@ */ /end MEASUREMENT
/begin MEASUREMENT ACTCtl_sBEXVCtrlFF "" FLOAT32_IEEE ME11_CM_single_C 0 0 -3.4E+38 3.4E+38 ECU_ADDRESS 0x0000 /* @ECU_Address@ACTCtl_sBEXVCtrlFF@ */ /end MEASUREMENT
/begin MEASUREMENT ACTCtl_sAEXVCtrlFF "" FLOAT32_IEEE ME11_CM_single_C 0 0 -3.4E+38 3.4E+38 ECU_ADDRESS 0x0000 /* @ECU_Address@ACTCtl_sAEXVCtrlFF@ */ /end MEASUREMENT
/begin MEASUREMENT ACCtl_IntakeRatio "" UBYTE ME11_CM_uint8_null 0 0 0 255 ECU_ADDRESS 0x0000 /* @ECU_Address@ACCtl_IntakeRatio@ */ /end MEASUREMENT
/begin MEASUREMENT ACCtl_BloweFanSpeed "" UBYTE ME11_CM_uint8_null 0 0 0 255 ECU_ADDRESS 0x0000 /* @ECU_Address@ACCtl_BloweFanSpeed@ */ /end MEASUREMENT
/begin MEASUREMENT SOMCtl_eHVPartMode "" UBYTE ME11_CM_uint8_null 0 0 0 255 ECU_ADDRESS 0x0000 /* @ECU_Address@SOMCtl_eHVPartMode@ */ /end MEASUREMENT
/begin MEASUREMENT ACTCtl_eAcPMPSpdPerc "" UBYTE ME11_CM_uint8_percent_ 0 0 0 255 ECU_ADDRESS 0x0000 /* @ECU_Address@ACTCtl_eAcPMPSpdPerc@ */ /end MEASUREMENT
/begin MEASUREMENT AC_FanLevelAct "" UBYTE ME11_CM_uint8_null 0 0 0 255 ECU_ADDRESS 0x0000 /* @ECU_Address@AC_FanLevelAct@ */ /end MEASUREMENT
/begin MEASUREMENT AC_FanLeVel "" UBYTE ME11_CM_uint8_null 0 0 0 255 ECU_ADDRESS 0x0000 /* @ECU_Address@AC_FanLeVel@ */ /end MEASUREMENT
/begin MEASUREMENT ACTCtl_bCOMPIFreeFlag "" UBYTE ME11_CM_uint8_flg 0 0 0 255 ECU_ADDRESS 0x0000 /* @ECU_Address@ACTCtl_bCOMPIFreeFlag@ */ /end MEASUREMENT
/begin MEASUREMENT ACTCtl_sPTCEnable "" UBYTE ME11_CM_uint8_flg 0 0 0 255 ECU_ADDRESS 0x0000 /* @ECU_Address@ACTCtl_sPTCEnable@ */ /end MEASUREMENT
/begin MEASUREMENT EE_TimeHour "" UBYTE ME11_CM_uint8_h 0 0 0 255 ECU_ADDRESS 0x0000 /* @ECU_Address@EE_TimeHour@ */ /end MEASUREMENT
/begin MEASUREMENT EE_TimeMin "" UBYTE ME11_CM_uint8_min 0 0 0 255 ECU_ADDRESS 0x0000 /* @ECU_Address@EE_TimeMin@ */ /end MEASUREMENT
/begin MEASUREMENT EE_TimeDay "" UBYTE ME11_CM_uint8_day 0 0 0 255 ECU_ADDRESS 0x0000 /* @ECU_Address@EE_TimeDay@ */ /end MEASUREMENT
/begin MEASUREMENT ACTCtl_eEvapProSts "" UBYTE ME11_CM_uint8_null 0 0 0 255 ECU_ADDRESS 0x0000 /* @ECU_Address@ACTCtl_eEvapProSts@ */ /end MEASUREMENT
/begin MEASUREMENT ACTCtl_bAEXVFaultFlg "" UBYTE ME11_CM_boolean_flg 0 0 0 1 ECU_ADDRESS 0x0000 /* @ECU_Address@ACTCtl_bAEXVFaultFlg@ */ /end MEASUREMENT
/begin MEASUREMENT ACTCtl_bBEXVFaultFlg "" UBYTE ME11_CM_boolean_flg 0 0 0 1 ECU_ADDRESS 0x0000 /* @ECU_Address@ACTCtl_bBEXVFaultFlg@ */ /end MEASUREMENT
/begin MEASUREMENT ACTCtl_bHPEXVFaultFlg "" UBYTE ME11_CM_boolean_flg 0 0 0 1 ECU_ADDRESS 0x0000 /* @ECU_Address@ACTCtl_bHPEXVFaultFlg@ */ /end MEASUREMENT
/begin MEASUREMENT ACTCtl_bBatPMPFaultFlg "" UBYTE ME11_CM_boolean_flg 0 0 0 1 ECU_ADDRESS 0x0000 /* @ECU_Address@ACTCtl_bBatPMPFaultFlg@ */ /end MEASUREMENT
/begin MEASUREMENT ACTCtl_bMotPMPFaultFlg "" UBYTE ME11_CM_boolean_flg 0 0 0 1 ECU_ADDRESS 0x0000 /* @ECU_Address@ACTCtl_bMotPMPFaultFlg@ */ /end MEASUREMENT
/begin MEASUREMENT SOMCtl_bMotorLTRAndBatBalFlg "" UBYTE ME11_CM_boolean_flg 0 0 0 1 ECU_ADDRESS 0x0000 /* @ECU_Address@SOMCtl_bMotorLTRAndBatBalFlg@ */ /end MEASUREMENT
/begin MEASUREMENT SOMCtl_bMotAndBatLTRFlg "" UBYTE ME11_CM_boolean_flg 0 0 0 1 ECU_ADDRESS 0x0000 /* @ECU_Address@SOMCtl_bMotAndBatLTRFlg@ */ /end MEASUREMENT
/begin MEASUREMENT ACTCtl_bAcPMPFaultFlg "" UBYTE ME11_CM_boolean_flg 0 0 0 1 ECU_ADDRESS 0x0000 /* @ECU_Address@ACTCtl_bAcPMPFaultFlg@ */ /end MEASUREMENT
/begin MEASUREMENT SOMCtl_bMotorHeatBatOnFlg "" UBYTE ME11_CM_boolean_flg 0 0 0 1 ECU_ADDRESS 0x0000 /* @ECU_Address@SOMCtl_bMotorHeatBatOnFlg@ */ /end MEASUREMENT
/begin MEASUREMENT SOMCtl_bMotHeatBatFlg "" UBYTE ME11_CM_boolean_flg 0 0 0 1 ECU_ADDRESS 0x0000 /* @ECU_Address@SOMCtl_bMotHeatBatFlg@ */ /end MEASUREMENT
/begin MEASUREMENT SOMCtl_bBatLTRFlg "" UBYTE ME11_CM_boolean_flg 0 0 0 1 ECU_ADDRESS 0x0000 /* @ECU_Address@SOMCtl_bBatLTRFlg@ */ /end MEASUREMENT
/begin MEASUREMENT SOMCtl_bB1toB31 "" UBYTE ME11_CM_boolean_flg 0 0 0 1 ECU_ADDRESS 0x0000 /* @ECU_Address@SOMCtl_bB1toB31@ */ /end MEASUREMENT
/begin MEASUREMENT SOMCtl_bBatHeatB3tB1Flg "" UBYTE ME11_CM_boolean_flg 0 0 0 1 ECU_ADDRESS 0x0000 /* @ECU_Address@SOMCtl_bBatHeatB3tB1Flg@ */ /end MEASUREMENT
/begin MEASUREMENT SOMCtl_bMD2ToMD1Flg "" UBYTE ME11_CM_boolean_flg 0 0 0 1 ECU_ADDRESS 0x0000 /* @ECU_Address@SOMCtl_bMD2ToMD1Flg@ */ /end MEASUREMENT
/begin MEASUREMENT SOMCtl_bEntExtDefFlg "" UBYTE ME11_CM_boolean_flg 0 0 0 1 ECU_ADDRESS 0x0000 /* @ECU_Address@SOMCtl_bEntExtDefFlg@ */ /end MEASUREMENT
/begin MEASUREMENT SOMCtl_bExitExtDefTempFlg "" UBYTE ME11_CM_boolean_flg 0 0 0 1 ECU_ADDRESS 0x0000 /* @ECU_Address@SOMCtl_bExitExtDefTempFlg@ */ /end MEASUREMENT
/begin MEASUREMENT SOMCtl_bExtDefFlg "" UBYTE ME11_CM_boolean_flg 0 0 0 1 ECU_ADDRESS 0x0000 /* @ECU_Address@SOMCtl_bExtDefFlg@ */ /end MEASUREMENT
/begin MEASUREMENT ACTCrl_bEnvCOMPLmt "" UBYTE ME11_CM_boolean_flg 0 0 0 1 ECU_ADDRESS 0x0000 /* @ECU_Address@ACTCrl_bEnvCOMPLmt@ */ /end MEASUREMENT
/begin MEASUREMENT ACTCtl_bOCOLmtFlg "" UBYTE ME11_CM_boolean_flg 0 0 0 1 ECU_ADDRESS 0x0000 /* @ECU_Address@ACTCtl_bOCOLmtFlg@ */ /end MEASUREMENT
/begin MEASUREMENT ACTCtl_bPressProtectFlg "" UBYTE ME11_CM_boolean_flg 0 0 0 1 ECU_ADDRESS 0x0000 /* @ECU_Address@ACTCtl_bPressProtectFlg@ */ /end MEASUREMENT
/begin MEASUREMENT ACTCtl_bPressRateFlg "" UBYTE ME11_CM_boolean_flg 0 0 0 1 ECU_ADDRESS 0x0000 /* @ECU_Address@ACTCtl_bPressRateFlg@ */ /end MEASUREMENT
/begin MEASUREMENT ACTCtl_bCOMPRealFault "" UBYTE ME11_CM_boolean_flg 0 0 0 1 ECU_ADDRESS 0x0000 /* @ECU_Address@ACTCtl_bCOMPRealFault@ */ /end MEASUREMENT
/begin MEASUREMENT ACTCtl_bACCMCtlEnb "" UBYTE ME11_CM_boolean_flg 0 0 0 1 ECU_ADDRESS 0x0000 /* @ECU_Address@ACTCtl_bACCMCtlEnb@ */ /end MEASUREMENT
/begin MEASUREMENT ACCtl_stCabinCoolingEn "" UBYTE ME11_CM_boolean_null 0 0 0 1 ECU_ADDRESS 0x0000 /* @ECU_Address@ACCtl_stCabinCoolingEn@ */ /end MEASUREMENT
/begin MEASUREMENT ACCtl_stRecOut "" UBYTE ME11_CM_boolean_null 0 0 0 1 ECU_ADDRESS 0x0000 /* @ECU_Address@ACCtl_stRecOut@ */ /end MEASUREMENT
/begin MEASUREMENT ACTCtl_bCOMPFaultClc "" UBYTE ME11_CM_boolean_flg 0 0 0 1 ECU_ADDRESS 0x0000 /* @ECU_Address@ACTCtl_bCOMPFaultClc@ */ /end MEASUREMENT
/begin MEASUREMENT ACTCtl_bMCVlearnFlg "" UBYTE ME11_CM_boolean_flg 0 0 0 1 ECU_ADDRESS 0x0000 /* @ECU_Address@ACTCtl_bMCVlearnFlg@ */ /end MEASUREMENT
/begin MEASUREMENT ACTCtl_bBCVlearnFlg "" UBYTE ME11_CM_boolean_flg 0 0 0 1 ECU_ADDRESS 0x0000 /* @ECU_Address@ACTCtl_bBCVlearnFlg@ */ /end MEASUREMENT
/begin MEASUREMENT ACTCtl_bAEXVInitFinishFlg "" UBYTE ME11_CM_boolean_flg 0 0 0 1 ECU_ADDRESS 0x0000 /* @ECU_Address@ACTCtl_bAEXVInitFinishFlg@ */ /end MEASUREMENT
/begin MEASUREMENT ACTCtl_bAEXVDvtFlg "" UBYTE ME11_CM_boolean_flg 0 0 0 1 ECU_ADDRESS 0x0000 /* @ECU_Address@ACTCtl_bAEXVDvtFlg@ */ /end MEASUREMENT
/begin MEASUREMENT ACTCtl_bBEXVInitFinishFlg "" UBYTE ME11_CM_boolean_flg 0 0 0 1 ECU_ADDRESS 0x0000 /* @ECU_Address@ACTCtl_bBEXVInitFinishFlg@ */ /end MEASUREMENT
/begin MEASUREMENT ACTCtl_bBEXVDvtFlg "" UBYTE ME11_CM_boolean_flg 0 0 0 1 ECU_ADDRESS 0x0000 /* @ECU_Address@ACTCtl_bBEXVDvtFlg@ */ /end MEASUREMENT
/begin MEASUREMENT ACTCtl_bHPEXVDvtFlg "" UBYTE ME11_CM_boolean_flg 0 0 0 1 ECU_ADDRESS 0x0000 /* @ECU_Address@ACTCtl_bHPEXVDvtFlg@ */ /end MEASUREMENT
/begin MEASUREMENT ACTCtl_bHPEXVInitFinishFlg "" UBYTE ME11_CM_boolean_flg 0 0 0 1 ECU_ADDRESS 0x0000 /* @ECU_Address@ACTCtl_bHPEXVInitFinishFlg@ */ /end MEASUREMENT
/begin MEASUREMENT SOMCtl_bMD3ToMD4Flg "" UBYTE ME11_CM_boolean_flg 0 0 0 1 ECU_ADDRESS 0x0000 /* @ECU_Address@SOMCtl_bMD3ToMD4Flg@ */ /end MEASUREMENT
/begin MEASUREMENT SOMCtl_bMD4ToMD3Flg "" UBYTE ME11_CM_boolean_flg 0 0 0 1 ECU_ADDRESS 0x0000 /* @ECU_Address@SOMCtl_bMD4ToMD3Flg@ */ /end MEASUREMENT
/begin MEASUREMENT SOMCtl_bMD3DHMD2Flg "" UBYTE ME11_CM_boolean_flg 0 0 0 1 ECU_ADDRESS 0x0000 /* @ECU_Address@SOMCtl_bMD3DHMD2Flg@ */ /end MEASUREMENT
/begin MEASUREMENT SOMCtl_bMD2ToMD3Flg "" UBYTE ME11_CM_boolean_flg 0 0 0 1 ECU_ADDRESS 0x0000 /* @ECU_Address@SOMCtl_bMD2ToMD3Flg@ */ /end MEASUREMENT
/begin MEASUREMENT SOMCtl_bMD3ToMD2Flg "" UBYTE ME11_CM_boolean_flg 0 0 0 1 ECU_ADDRESS 0x0000 /* @ECU_Address@SOMCtl_bMD3ToMD2Flg@ */ /end MEASUREMENT
/begin MEASUREMENT SOMCtl_bMD2DHMD1Flg "" UBYTE ME11_CM_boolean_flg 0 0 0 1 ECU_ADDRESS 0x0000 /* @ECU_Address@SOMCtl_bMD2DHMD1Flg@ */ /end MEASUREMENT
/begin MEASUREMENT SOMCtl_bMD1CLMSts "" UBYTE ME11_CM_boolean_flg 0 0 0 1 ECU_ADDRESS 0x0000 /* @ECU_Address@SOMCtl_bMD1CLMSts@ */ /end MEASUREMENT
/begin MEASUREMENT SOMCtl_bMD1ToMD2Flg "" UBYTE ME11_CM_boolean_flg 0 0 0 1 ECU_ADDRESS 0x0000 /* @ECU_Address@SOMCtl_bMD1ToMD2Flg@ */ /end MEASUREMENT
/begin MEASUREMENT SOMCtl_bBatBalFlg "" UBYTE ME11_CM_boolean_flg 0 0 0 1 ECU_ADDRESS 0x0000 /* @ECU_Address@SOMCtl_bBatBalFlg@ */ /end MEASUREMENT
/begin MEASUREMENT ACTCtl_bCOMPEnbDelay "" UBYTE ME11_CM_boolean_flg 0 0 0 1 ECU_ADDRESS 0x0000 /* @ECU_Address@ACTCtl_bCOMPEnbDelay@ */ /end MEASUREMENT
/begin MEASUREMENT ACCtl_stACPTCHeated "" UBYTE ME11_CM_boolean_null 0 0 0 1 ECU_ADDRESS 0x0000 /* @ECU_Address@ACCtl_stACPTCHeated@ */ /end MEASUREMENT
/begin MEASUREMENT ACCtl_stEvaCooledFlag "" UBYTE ME11_CM_boolean_null 0 0 0 1 ECU_ADDRESS 0x0000 /* @ECU_Address@ACCtl_stEvaCooledFlag@ */ /end MEASUREMENT
/begin MEASUREMENT SOMCtl_eWaterMode "" UBYTE ME11_CM_WaterModes_null 0 0 0 6 ECU_ADDRESS 0x0000 /* @ECU_Address@SOMCtl_eWaterMode@ */ /end MEASUREMENT
/begin MEASUREMENT SOMCtl_eRefModes "" UBYTE ME11_CM_RefModes_null 0 0 0 14 ECU_ADDRESS 0x0000 /* @ECU_Address@SOMCtl_eRefModes@ */ /end MEASUREMENT
/begin MEASUREMENT SOMCtl_eCabinModePre "" UBYTE ME11_CM_CabinMode_null 0 0 0 7 ECU_ADDRESS 0x0000 /* @ECU_Address@SOMCtl_eCabinModePre@ */ /end MEASUREMENT
/begin MEASUREMENT ACCtl_BlowerMode "" UBYTE ME11_CM_BlowerModes_null 0 0 0 8 ECU_ADDRESS 0x0000 /* @ECU_Address@ACCtl_BlowerMode@ */ /end MEASUREMENT
/begin MEASUREMENT ACSen_sFaceDuctTempFilter "" FLOAT32_IEEE ME11_CM_single_C 0 0 -3.4E+38 3.4E+38 ECU_ADDRESS 0x0000 /* @ECU_Address@ACSen_sFaceDuctTempFilter@ */ /end MEASUREMENT
/begin MEASUREMENT ACSen_sFootDuctTempFilter "" FLOAT32_IEEE ME11_CM_single_C 0 0 -3.4E+38 3.4E+38 ECU_ADDRESS 0x0000 /* @ECU_Address@ACSen_sFootDuctTempFilter@ */ /end MEASUREMENT
/begin MEASUREMENT ACSen_sMixDoorPerc "" FLOAT32_IEEE ME11_CM_single_percent_ 0 0 -3.4E+38 3.4E+38 ECU_ADDRESS 0x0000 /* @ECU_Address@ACSen_sMixDoorPerc@ */ /end MEASUREMENT
/begin MEASUREMENT ACSen_sModeMotorVol "" FLOAT32_IEEE ME11_CM_single_null 0 0 -3.4E+38 3.4E+38 ECU_ADDRESS 0x0000 /* @ECU_Address@ACSen_sModeMotorVol@ */ /end MEASUREMENT
/begin MEASUREMENT ACSen_sEvapTempFilter "" FLOAT32_IEEE ME11_CM_single_C 0 0 -3.4E+38 3.4E+38 ECU_ADDRESS 0x0000 /* @ECU_Address@ACSen_sEvapTempFilter@ */ /end MEASUREMENT
/begin MEASUREMENT ACSen_sWCCHiTempFilter "" FLOAT32_IEEE ME11_CM_single_C 0 0 -3.4E+38 3.4E+38 ECU_ADDRESS 0x0000 /* @ECU_Address@ACSen_sWCCHiTempFilter@ */ /end MEASUREMENT
/begin MEASUREMENT ACSen_sHiPressFilter "" FLOAT32_IEEE ME11_CM_single_Mpa 0 0 -3.4E+38 3.4E+38 ECU_ADDRESS 0x0000 /* @ECU_Address@ACSen_sHiPressFilter@ */ /end MEASUREMENT
/begin MEASUREMENT ACSen_sLoPressFilter "" FLOAT32_IEEE ME11_CM_single_Mpa 0 0 -3.4E+38 3.4E+38 ECU_ADDRESS 0x0000 /* @ECU_Address@ACSen_sLoPressFilter@ */ /end MEASUREMENT
/begin MEASUREMENT ACSen_sCabinTempFilter "" FLOAT32_IEEE ME11_CM_single_C 0 0 -3.4E+38 3.4E+38 ECU_ADDRESS 0x0000 /* @ECU_Address@ACSen_sCabinTempFilter@ */ /end MEASUREMENT
/begin MEASUREMENT ACSen_sACCMHiTempFilter "" FLOAT32_IEEE ME11_CM_single_C 0 0 -3.4E+38 3.4E+38 ECU_ADDRESS 0x0000 /* @ECU_Address@ACSen_sACCMHiTempFilter@ */ /end MEASUREMENT
/begin MEASUREMENT ACSen_sOHXTempFilter "" FLOAT32_IEEE ME11_CM_single_C 0 0 -3.4E+38 3.4E+38 ECU_ADDRESS 0x0000 /* @ECU_Address@ACSen_sOHXTempFilter@ */ /end MEASUREMENT
/begin MEASUREMENT ACSen_sChiTempFilter "" FLOAT32_IEEE ME11_CM_single_C 0 0 -3.4E+38 3.4E+38 ECU_ADDRESS 0x0000 /* @ECU_Address@ACSen_sChiTempFilter@ */ /end MEASUREMENT
/begin MEASUREMENT ACSen_sEvapSurTemp "" FLOAT32_IEEE ME11_CM_single_C 0 0 -3.4E+38 3.4E+38 ECU_ADDRESS 0x0000 /* @ECU_Address@ACSen_sEvapSurTemp@ */ /end MEASUREMENT
/begin MEASUREMENT AC_rSolarRight "" UWORD ME11_CM_uint16_null 0 0 0 65535 ECU_ADDRESS 0x0000 /* @ECU_Address@AC_rSolarRight@ */ /end MEASUREMENT
/begin MEASUREMENT ACSen_eAirInletPer "" UBYTE ME11_CM_uint8_percent_ 0 0 0 255 ECU_ADDRESS 0x0000 /* @ECU_Address@ACSen_eAirInletPer@ */ /end MEASUREMENT
/begin MEASUREMENT ACSen_eACCMHTSenSts "" UBYTE ME11_CM_FaultStatus_flg 0 0 0 2 ECU_ADDRESS 0x0000 /* @ECU_Address@ACSen_eACCMHTSenSts@ */ /end MEASUREMENT
/begin MEASUREMENT ACSen_eWCCHTSenSts "" UBYTE ME11_CM_FaultStatus_flg 0 0 0 2 ECU_ADDRESS 0x0000 /* @ECU_Address@ACSen_eWCCHTSenSts@ */ /end MEASUREMENT
/begin MEASUREMENT ACSen_eOHXTSenSts "" UBYTE ME11_CM_FaultStatus_flg 0 0 0 2 ECU_ADDRESS 0x0000 /* @ECU_Address@ACSen_eOHXTSenSts@ */ /end MEASUREMENT
/begin MEASUREMENT ACSen_eEVAPSurfTSenSts "" UBYTE ME11_CM_FaultStatus_flg 0 0 0 2 ECU_ADDRESS 0x0000 /* @ECU_Address@ACSen_eEVAPSurfTSenSts@ */ /end MEASUREMENT
/begin MEASUREMENT ACSen_eEVAPTSenSts "" UBYTE ME11_CM_FaultStatus_flg 0 0 0 2 ECU_ADDRESS 0x0000 /* @ECU_Address@ACSen_eEVAPTSenSts@ */ /end MEASUREMENT
/begin MEASUREMENT ACSen_eChillerTSenSts "" UBYTE ME11_CM_FaultStatus_flg 0 0 0 2 ECU_ADDRESS 0x0000 /* @ECU_Address@ACSen_eChillerTSenSts@ */ /end MEASUREMENT
/begin MEASUREMENT ACSen_eFootDuctSenSts "" UBYTE ME11_CM_FaultStatus_flg 0 0 0 2 ECU_ADDRESS 0x0000 /* @ECU_Address@ACSen_eFootDuctSenSts@ */ /end MEASUREMENT
/begin MEASUREMENT ACSen_eFaceDuctSenSts "" UBYTE ME11_CM_FaultStatus_flg 0 0 0 2 ECU_ADDRESS 0x0000 /* @ECU_Address@ACSen_eFaceDuctSenSts@ */ /end MEASUREMENT
/begin MEASUREMENT ACSen_eCabinSenSts "" UBYTE ME11_CM_FaultStatus_flg 0 0 0 2 ECU_ADDRESS 0x0000 /* @ECU_Address@ACSen_eCabinSenSts@ */ /end MEASUREMENT
/begin COMPU_METHOD ME11_CM_single_C "Q = V" RAT_FUNC "%8.6" "C" COEFFS 0 1 0 0 0 1 /end COMPU_METHOD
/begin COMPU_METHOD ME11_CM_uint8_null "Q = V" RAT_FUNC "%3.0" "null" COEFFS 0 1 0 0 0 1 /end COMPU_METHOD
/begin COMPU_METHOD ME11_CM_single_Mpa "Q = V" RAT_FUNC "%8.6" "Mpa" COEFFS 0 1 0 0 0 1 /end COMPU_METHOD
/begin COMPU_METHOD ME11_CM_single_mv "Q = V" RAT_FUNC "%8.6" "mv" COEFFS 0 1 0 0 0 1 /end COMPU_METHOD
/begin COMPU_METHOD ME11_CM_single_percent_ "Q = V" RAT_FUNC "%8.6" "%" COEFFS 0 1 0 0 0 1 /end COMPU_METHOD
/begin COMPU_METHOD ME11_CM_uint8_percent_ "Q = V" RAT_FUNC "%3.0" "%" COEFFS 0 1 0 0 0 1 /end COMPU_METHOD
/begin COMPU_METHOD ME11_CM_uint16_w_per_m_2 "Q = V" RAT_FUNC "%5.0" "w/m^2" COEFFS 0 1 0 0 0 1 /end COMPU_METHOD
/begin COMPU_METHOD ME11_CM_single_km_per_h "Q = V" RAT_FUNC "%8.6" "km/h" COEFFS 0 1 0 0 0 1 /end COMPU_METHOD
/begin COMPU_METHOD ME11_CM_single_kw "Q = V" RAT_FUNC "%8.6" "kw" COEFFS 0 1 0 0 0 1 /end COMPU_METHOD
/begin COMPU_METHOD ME11_CM_single_null "Q = V" RAT_FUNC "%8.6" "null" COEFFS 0 1 0 0 0 1 /end COMPU_METHOD
/begin COMPU_METHOD ME11_CM_single_rpm "Q = V" RAT_FUNC "%8.6" "rpm" COEFFS 0 1 0 0 0 1 /end COMPU_METHOD
/begin COMPU_METHOD ME11_CM_uint8_L "Q = V" RAT_FUNC "%3.0" "L" COEFFS 0 1 0 0 0 1 /end COMPU_METHOD
/begin COMPU_METHOD ME11_CM_single_mpa "Q = V" RAT_FUNC "%8.6" "mpa" COEFFS 0 1 0 0 0 1 /end COMPU_METHOD
/begin COMPU_METHOD ME11_CM_single_s "Q = V" RAT_FUNC "%8.6" "s" COEFFS 0 1 0 0 0 1 /end COMPU_METHOD
/begin COMPU_METHOD ME11_CM_single_min "Q = V" RAT_FUNC "%8.6" "min" COEFFS 0 1 0 0 0 1 /end COMPU_METHOD
/begin COMPU_METHOD ME11_CM_single_C_per_0_1s "Q = V" RAT_FUNC "%8.6" "C/0.1s" COEFFS 0 1 0 0 0 1 /end COMPU_METHOD
/begin COMPU_METHOD ME11_CM_single_per_ "Q = V" RAT_FUNC "%8.6" "/" COEFFS 0 1 0 0 0 1 /end COMPU_METHOD
/begin COMPU_METHOD ME11_CM_uint16_rpm "Q = V" RAT_FUNC "%5.0" "rpm" COEFFS 0 1 0 0 0 1 /end COMPU_METHOD
/begin COMPU_METHOD ME11_CM_uint16_s "Q = V" RAT_FUNC "%5.0" "s" COEFFS 0 1 0 0 0 1 /end COMPU_METHOD
/begin COMPU_METHOD ME11_CM_uint16_per_ "Q = V" RAT_FUNC "%5.0" "/" COEFFS 0 1 0 0 0 1 /end COMPU_METHOD
/begin COMPU_METHOD ME11_CM_CabinMode_null "Enumerated data type: CabinMode" TAB_VERB "%0.6" "null" COMPU_TAB_REF VTAB_FOR_ME11_CM_CabinMode_null /end COMPU_METHOD
/begin COMPU_VTAB VTAB_FOR_ME11_CM_CabinMode_null "Enumerated data type: CabinMode" TAB_VERB 7 0 "CabinMode_MD_Off" 1 "CabinMode_MD1_CLM" 2 "CabinMode_MD2_DHMD1" 3 "CabinMode_MD3_DHMD2" 4 "CabinMode_MD4_HP" 6 "CabinMode_VENT" 7 "CabinMode_STANDBY" /end COMPU_VTAB
/begin COMPU_METHOD ME11_CM_RefModes_null "Enumerated data type: RefModes" TAB_VERB "%0.6" "null" COMPU_TAB_REF VTAB_FOR_ME11_CM_RefModes_null /end COMPU_METHOD
/begin COMPU_VTAB VTAB_FOR_ME11_CM_RefModes_null "Enumerated data type: RefModes" TAB_VERB 15 0 "RefModes_Ref_Off" 1 "RefModes_CoolCabin" 2 "RefModes_CoolBat" 3 "RefModes_CoolDouble" 4 "RefModes_HeatCabin" 5 "RefModes_HeatBat" 6 "RefModes_HeatDouble" 7 "RefModes_SerDeh_LCC" 8 "RefModes_SerDeh_EVAP" 9 "RefModes_ParDeh" 10 "RefModes_Def" 11 "RefModes_Defrosting" 12 "RefModes_CoolCabinAHeatBat" 13 "RefModes_CoolBatAHeatCabin" 14 "RefModes_DehAndBatCool" /end COMPU_VTAB
/begin COMPU_METHOD ME11_CM_WaterModes_flg "Enumerated data type: WaterModes" TAB_VERB "%0.6" "flg" COMPU_TAB_REF VTAB_FOR_ME11_CM_WaterModes_flg /end COMPU_METHOD
/begin COMPU_VTAB VTAB_FOR_ME11_CM_WaterModes_flg "Enumerated data type: WaterModes" TAB_VERB 7 0 "WaterOff" 1 "WaterLTR" 2 "LTRAndCoolOrHeat" 3 "RecAndBal" 4 "LTRAndBal" 5 "Water_MotorHeatBat" 6 "WasteHeatRec" /end COMPU_VTAB
/begin COMPU_METHOD ME11_CM_boolean_flg "Q = V" RAT_FUNC "%1.0" "flg" COEFFS 0 1 0 0 0 1 /end COMPU_METHOD
/begin COMPU_METHOD ME11_CM_boolean_rpm "Q = V" RAT_FUNC "%1.0" "rpm" COEFFS 0 1 0 0 0 1 /end COMPU_METHOD
/begin COMPU_METHOD ME11_CM_boolean_per_ "Q = V" RAT_FUNC "%1.0" "/" COEFFS 0 1 0 0 0 1 /end COMPU_METHOD
/begin COMPU_METHOD ME11_CM_boolean_null "Q = V" RAT_FUNC "%1.0" "null" COEFFS 0 1 0 0 0 1 /end COMPU_METHOD
/begin COMPU_METHOD ME11_CM_uint8_flg "Q = V" RAT_FUNC "%3.0" "flg" COEFFS 0 1 0 0 0 1 /end COMPU_METHOD
/begin COMPU_METHOD ME11_CM_uint8_per_ "Q = V" RAT_FUNC "%3.0" "/" COEFFS 0 1 0 0 0 1 /end COMPU_METHOD
/begin COMPU_METHOD ME11_CM_uint8_s "Q = V" RAT_FUNC "%3.0" "s" COEFFS 0 1 0 0 0 1 /end COMPU_METHOD
/begin COMPU_METHOD ME11_CM_uint8_rpm "Q = V" RAT_FUNC "%3.0" "rpm" COEFFS 0 1 0 0 0 1 /end COMPU_METHOD
/begin COMPU_METHOD ME11_CM_uint16_null "Q = V" RAT_FUNC "%5.0" "null" COEFFS 0 1 0 0 0 1 /end COMPU_METHOD
/begin COMPU_METHOD ME11_CM_uint8_h "Q = V" RAT_FUNC "%3.0" "h" COEFFS 0 1 0 0 0 1 /end COMPU_METHOD
/begin COMPU_METHOD ME11_CM_uint8_min "Q = V" RAT_FUNC "%3.0" "min" COEFFS 0 1 0 0 0 1 /end COMPU_METHOD
/begin COMPU_METHOD ME11_CM_uint8_day "Q = V" RAT_FUNC "%3.0" "day" COEFFS 0 1 0 0 0 1 /end COMPU_METHOD
/begin COMPU_METHOD ME11_CM_WaterModes_null "Enumerated data type: WaterModes" TAB_VERB "%0.6" "null" COMPU_TAB_REF VTAB_FOR_ME11_CM_WaterModes_null /end COMPU_METHOD
/begin COMPU_VTAB VTAB_FOR_ME11_CM_WaterModes_null "Enumerated data type: WaterModes" TAB_VERB 7 0 "WaterOff" 1 "WaterLTR" 2 "LTRAndCoolOrHeat" 3 "RecAndBal" 4 "LTRAndBal" 5 "Water_MotorHeatBat" 6 "WasteHeatRec" /end COMPU_VTAB
/begin COMPU_METHOD ME11_CM_FaultStatus_flg "Enumerated data type: FaultStatus" TAB_VERB "%0.6" "flg" COMPU_TAB_REF VTAB_FOR_ME11_CM_FaultStatus_flg /end COMPU_METHOD
/begin COMPU_VTAB VTAB_FOR_ME11_CM_FaultStatus_flg "Enumerated data type: FaultStatus" TAB_VERB 3 0 "Normal" 1 "Ground" 2 "Power" /end COMPU_VTAB
/begin COMPU_METHOD ME11_CM_BlowerModes_null "Enumerated data type: BlowerModes" TAB_VERB "%0.6" "null" COMPU_TAB_REF VTAB_FOR_ME11_CM_BlowerModes_null /end COMPU_METHOD
/begin COMPU_VTAB VTAB_FOR_ME11_CM_BlowerModes_null "Enumerated data type: BlowerModes" TAB_VERB 9 5 "BlowerModes_FaceMode" 4 "BlowerModes_FaceHeaterMode" 2 "BlowerModes_HeaterMode" 3 "BlowerModes_HeaterDeforstMode" 1 "BlowerModes_DeforstMode" 0 "BlowerModes_OffMode" 8 "BlowerModes_AutoMode" 6 "BlowerModes_FaceDeforstMode" 7 "BlowerModes_FaceHeaterDeforstMode" /end COMPU_VTAB
/begin GROUP S1292_Start_Manage "ME11/ME11_TMS/Power/RDCWorkMng/Start_Manage"
 /begin REF_CHARACTERISTIC cal_ColdStartPCUTempMinByEnv_CUR cal_PCUtempOffset2ShutByEnv_CUR /end REF_CHARACTERISTIC
 /begin REF_MEASUREMENT ColdStartPCUTempMinByEnv EE_PCUInletTemp EE_tEnv PCU_StartClntTemp PCUtempOffset2ShutByEnv /end REF_MEASUREMENT
/end GROUP
/begin GROUP S1292_Stop_Manage "ME11/ME11_TMS/Power/RDCWorkMng/Stop_Manage" /begin SUB_GROUP S1300_ACRunOffTimeCal /end SUB_GROUP /begin REF_MEASUREMENT EE_TimeDay EE_TimeHour EE_TimeMin /end REF_MEASUREMENT /end GROUP
/begin GROUP S1311_Balance "ME11/ME11_TMS/SOM/BattaryMode/Balance"
 /begin SUB_GROUP S1318_ACCharge S1318_Exit S1318_Ready S1318_thermal_storage_enter S1318_thermal_storage_exit /end SUB_GROUP
 /begin REF_MEASUREMENT SOMCtl_bBatBalFlg /end REF_MEASUREMENT
/end GROUP
/begin GROUP S1311_Cool "ME11/ME11_TMS/SOM/BattaryMode/Cool"
 /begin SUB_GROUP S1319_B1_B21 S1319_B1_B22 S1319_B2_B1 S1319_Override_BatTrgTemp /end SUB_GROUP
 /begin REF_CHARACTERISTIC cal_ClsCoolInletTemp cal_ClsCoolInletTempTime cal_OpenCoolInletTemp /end REF_CHARACTERISTIC
/end GROUP
/begin GROUP S1311_DLTR "ME11/ME11_TMS/SOM/BattaryMode/DLTR" /begin SUB_GROUP S1320_B1_B33 S1320_B33_B1 /end SUB_GROUP /begin REF_MEASUREMENT SOMCtl_bBatLTRFlg /end REF_MEASUREMENT /end GROUP
/begin GROUP S1311_DisplaySet "ME11/ME11_TMS/SOM/BattaryMode/DisplaySet" /begin SUB_GROUP S1321_Override_BatModed /end SUB_GROUP /end GROUP
/begin GROUP S1311_Heat "ME11/ME11_TMS/SOM/BattaryMode/Heat"
 /begin SUB_GROUP S1322_B1_B41 S1322_B1_B42 S1322_B41_B1 S1322_Override_BatTrgTemp S1322_calTemp /end SUB_GROUP
/end GROUP
/begin GROUP S1311_MotorAndBatLTR "ME11/ME11_TMS/SOM/BattaryMode/MotorAndBatLTR" /begin SUB_GROUP S1324_Enter S1324_Exit /end SUB_GROUP /begin REF_MEASUREMENT SOMCtl_bMotAndBatLTRFlg /end REF_MEASUREMENT /end GROUP
/begin GROUP S1311_MotorHeatBat "ME11/ME11_TMS/SOM/BattaryMode/MotorHeatBat" /begin SUB_GROUP S1325_B1_B30 S1325_B1_B31_AC S1325_B1_B31_PT S1325_B31_B1 /end SUB_GROUP /begin REF_MEASUREMENT SOMCtl_bB1toB31 SOMCtl_bBatHeatB3tB1Flg /end REF_MEASUREMENT /end GROUP
/begin GROUP S1311_MotorHeatBat_OTS "ME11/ME11_TMS/SOM/BattaryMode/MotorHeatBat_OTS" /begin SUB_GROUP S1326_Enter_AC S1326_Enter_PT S1326_Exit /end SUB_GROUP /begin REF_MEASUREMENT SOMCtl_bMotHeatBatFlg SOMCtl_bMotorHeatBatOnFlg /end REF_MEASUREMENT /end GROUP
/begin GROUP S1311_MotorLTRAndBatBalance "ME11/ME11_TMS/SOM/BattaryMode/MotorLTRAndBatBalance" /begin SUB_GROUP S1327_B33_B1 S1327_Balance S1327_LTR /end SUB_GROUP /begin REF_MEASUREMENT SOMCtl_bMotorLTRAndBatBalFlg /end REF_MEASUREMENT /end GROUP
/begin GROUP S1311_Override_BatTrgTemp "ME11/ME11_TMS/SOM/BattaryMode/Override_BatTrgTemp" /begin REF_CHARACTERISTIC cal_BatTrgTempData cal_BatTrgTempEnb /end REF_CHARACTERISTIC /begin REF_MEASUREMENT SOMCtl_sBatTrgTemp /end REF_MEASUREMENT /end GROUP
/begin GROUP S1312_Cal_F2AndF1 "ME11/ME11_TMS/SOM/Cabin/Cal_F2AndF1"
 /begin REF_CHARACTERISTIC cal_CabinModeTransF1Constant cal_CabinModeTransF1Slope cal_CabinModeTransF2Constant cal_CabinModeTransF2Slope /end REF_CHARACTERISTIC
 /begin REF_MEASUREMENT SOMCtl_sF1Value SOMCtl_sF2Value /end REF_MEASUREMENT
/end GROUP
/begin GROUP S1312_MD1ShiftMD2 "ME11/ME11_TMS/SOM/Cabin/MD1ShiftMD2"
 /begin REF_CHARACTERISTIC cal_CabinCondToCoolHPEXVPos1 cal_CabinCondToCoolHPEXVPos2 cal_rCabinCoolToCondMixDoor cal_tCabinCondToCoolDvtDiff cal_tCabinCondToCoolEvapTemp cal_tCabinCoolToCondDvtDiff /end REF_CHARACTERISTIC
 /begin REF_MEASUREMENT SOMCtl_bMD1ToMD2Flg SOMCtl_bMD2ToMD1Flg /end REF_MEASUREMENT
/end GROUP
/begin GROUP S1312_MD1_CLM "ME11/ME11_TMS/SOM/Cabin/MD1_CLM"
 /begin REF_CHARACTERISTIC cal_CabinHys1TempOffset cal_CabinHys2TempOffset cal_tCabinCoolEnvTempHigh cal_tCabinCoolEnvTempLow /end REF_CHARACTERISTIC
 /begin REF_MEASUREMENT SOMCtl_bMD1CLMSts /end REF_MEASUREMENT
/end GROUP
/begin GROUP S1312_MD2_DHMD1 "ME11/ME11_TMS/SOM/Cabin/MD2_DHMD1" /begin SUB_GROUP S1679_Enter S1679_Exit /end SUB_GROUP /begin REF_MEASUREMENT SOMCtl_bMD2DHMD1Flg /end REF_MEASUREMENT /end GROUP
/begin GROUP S1312_MD3ShiftMD2 "ME11/ME11_TMS/SOM/Cabin/MD3ShiftMD2"
 /begin REF_CHARACTERISTIC cal_CabinCondToEvpHPEXVPos cal_CabinEvpToCondCompLmt cal_tCabinCondToEvpEvapTemp cal_tCabinEvpToCondDvtDiff /end REF_CHARACTERISTIC
 /begin REF_MEASUREMENT SOMCtl_bMD2ToMD3Flg SOMCtl_bMD3ToMD2Flg /end REF_MEASUREMENT
/end GROUP
/begin GROUP S1312_MD3_DHMD2 "ME11/ME11_TMS/SOM/Cabin/MD3_DHMD2" /begin SUB_GROUP S1681_Enter S1681_Exit /end SUB_GROUP /begin REF_MEASUREMENT SOMCtl_bMD3DHMD2Flg /end REF_MEASUREMENT /end GROUP
/begin GROUP S1312_MD4ShiftMD3 "ME11/ME11_TMS/SOM/Cabin/MD4ShiftMD3"
 /begin REF_CHARACTERISTIC cal_CabinEvpToHPEnvTemp cal_rCabinEvpToHPInnRatio cal_rCabinHPToEvpInnRatio cal_tCabinHPToEvpEnvTemp /end REF_CHARACTERISTIC
 /begin REF_MEASUREMENT SOMCtl_bMD3ToMD4Flg SOMCtl_bMD4ToMD3Flg /end REF_MEASUREMENT
/end GROUP
/begin GROUP S1312_MD4_HP "ME11/ME11_TMS/SOM/Cabin/MD4_HP" /begin REF_CHARACTERISTIC cal_CabinHys1TempOffset cal_tCabinCoolEnvTempLow /end REF_CHARACTERISTIC /end GROUP
/begin GROUP S1312_ModeDisplay "ME11/ME11_TMS/SOM/Cabin/ModeDisplay" /begin SUB_GROUP S1684_Override_CabinModed /end SUB_GROUP /begin REF_CHARACTERISTIC cal_CabinModeKeepStandbyTime /end REF_CHARACTERISTIC /begin REF_MEASUREMENT SOMCtl_eCabinModePre /end REF_MEASUREMENT /end GROUP
/begin GROUP S1313_Override_WaterModed "ME11/ME11_TMS/SOM/DisplaySet/Override_WaterModed" /begin REF_CHARACTERISTIC cal_WaterModeData cal_WaterModeEnb /end REF_CHARACTERISTIC /begin REF_MEASUREMENT SOMCtl_eWaterMode /end REF_MEASUREMENT /end GROUP
/begin GROUP S1314_EnterCondition "ME11/ME11_TMS/SOM/ExternalizingDef/EnterCondition"
 /begin REF_CHARACTERISTIC cal_EntExtDefTime cal_ExtDefEnvMaxTemp cal_ExtDefEnvMinTemp cal_ExtDefOHXOnTemp cal_ExtDefTempDiff /end REF_CHARACTERISTIC
 /begin REF_MEASUREMENT SOMCtl_bEntExtDefFlg /end REF_MEASUREMENT
/end GROUP
/begin GROUP S1314_ExitCondition "ME11/ME11_TMS/SOM/ExternalizingDef/ExitCondition" /begin REF_CHARACTERISTIC cal_ExitExtDefTime cal_ExtDefOHXOffTemp /end REF_CHARACTERISTIC /begin REF_MEASUREMENT SOMCtl_bExitExtDefTempFlg /end REF_MEASUREMENT /end GROUP
/begin GROUP S1314_Override_RefModed "ME11/ME11_TMS/SOM/ExternalizingDef/Override_RefModed" /begin REF_CHARACTERISTIC cal_ExtDefFlgData cal_ExtDefFlgDataEnb /end REF_CHARACTERISTIC /begin REF_MEASUREMENT SOMCtl_bExtDefFlg /end REF_MEASUREMENT /end GROUP
/begin GROUP S1315_Override_HvPartModed "ME11/ME11_TMS/SOM/HVPart/Override_HvPartModed" /begin REF_CHARACTERISTIC cal_HVPartModeData cal_HVPartModeEnb /end REF_CHARACTERISTIC /begin REF_MEASUREMENT SOMCtl_eHVPartMode /end REF_MEASUREMENT /end GROUP
/begin GROUP S1316_Override_RefModed "ME11/ME11_TMS/SOM/REF/Override_RefModed" /begin REF_CHARACTERISTIC cal_RefModeData cal_RefModeEnb /end REF_CHARACTERISTIC /begin REF_MEASUREMENT SOMCtl_eRefModes /end REF_MEASUREMENT /end GROUP
/begin GROUP S1740_Cabin "ME11/ME11_TMS/Sensor/Cabin/Cabin" /begin SUB_GROUP S1756_SenDiagnostic /end SUB_GROUP /begin REF_MEASUREMENT ACSen_eCabinSenSts /end REF_MEASUREMENT /end GROUP
/begin GROUP S1740_Override_HvPartModed "ME11/ME11_TMS/Sensor/Cabin/Override_HvPartModed" /begin REF_CHARACTERISTIC cal_CabinTempData cal_CabinTempEnb /end REF_CHARACTERISTIC /begin REF_MEASUREMENT ACSen_sCabinTempFilter /end REF_MEASUREMENT /end GROUP
/begin GROUP S1742_Face "ME11/ME11_TMS/Sensor/FaceDuct/Face" /begin SUB_GROUP S1769_SenDiagnostic /end SUB_GROUP /begin REF_MEASUREMENT ACSen_eFaceDuctSenSts /end REF_MEASUREMENT /end GROUP
/begin GROUP S1742_Override_DuctTemp "ME11/ME11_TMS/Sensor/FaceDuct/Override_DuctTemp" /begin REF_CHARACTERISTIC cal_FaceDuctTempData cal_FaceDuctTempEnb /end REF_CHARACTERISTIC /begin REF_MEASUREMENT ACSen_sFaceDuctTempFilter /end REF_MEASUREMENT /end GROUP
/begin GROUP S1743_Foot "ME11/ME11_TMS/Sensor/FootDuct/Foot" /begin SUB_GROUP S1779_SenDiagnostic /end SUB_GROUP /begin REF_MEASUREMENT ACSen_eFootDuctSenSts /end REF_MEASUREMENT /end GROUP
/begin GROUP S1743_Override_DuctTemp "ME11/ME11_TMS/Sensor/FootDuct/Override_DuctTemp" /begin REF_CHARACTERISTIC cal_FootDuctTempData cal_FootDuctTempEnb /end REF_CHARACTERISTIC /begin REF_MEASUREMENT ACSen_sFootDuctTempFilter /end REF_MEASUREMENT /end GROUP
/begin GROUP S1744_Override_HvPartModed "ME11/ME11_TMS/Sensor/LoPress/Override_HvPartModed" /begin REF_CHARACTERISTIC cal_LoPressData cal_LoPressDataEnb /end REF_CHARACTERISTIC /begin REF_MEASUREMENT ACSen_sLoPressFilter /end REF_MEASUREMENT /end GROUP
/begin GROUP S1744_SenDiagnostic "ME11/ME11_TMS/Sensor/LoPress/SenDiagnostic" /begin REF_CHARACTERISTIC cal_SensorVolDownFlg cal_SensorVolUpFlg /end REF_CHARACTERISTIC /end GROUP
/begin GROUP S1745_Override_HvPartModed "ME11/ME11_TMS/Sensor/MixDoor/Override_HvPartModed" /begin REF_CHARACTERISTIC cal_MixDoorPercData cal_MixDoorPercDataEnb /end REF_CHARACTERISTIC /begin REF_MEASUREMENT ACSen_sMixDoorPerc /end REF_MEASUREMENT /end GROUP
/begin GROUP S1745_SenDiagnostic "ME11/ME11_TMS/Sensor/MixDoor/SenDiagnostic" /begin REF_CHARACTERISTIC cal_SensorVolDownFlg cal_SensorVolUpFlg /end REF_CHARACTERISTIC /end GROUP
/begin GROUP S1746_Override_HvPartModed "ME11/ME11_TMS/Sensor/ModeMotor/Override_HvPartModed" /begin REF_CHARACTERISTIC cal_MotorModeData cal_MotorModeEnb /end REF_CHARACTERISTIC /begin REF_MEASUREMENT ACSen_sModeMotorVol /end REF_MEASUREMENT /end GROUP
/begin GROUP S1746_SenDiagnostic "ME11/ME11_TMS/Sensor/ModeMotor/SenDiagnostic" /begin REF_CHARACTERISTIC cal_SensorVolDownFlg cal_SensorVolUpFlg /end REF_CHARACTERISTIC /end GROUP
/begin GROUP S1747_Override_HvPartModed "ME11/ME11_TMS/Sensor/Recirc/Override_HvPartModed" /begin REF_CHARACTERISTIC cal_AirInletPerData cal_AirInletPerEnb /end REF_CHARACTERISTIC /begin REF_MEASUREMENT ACSen_eAirInletPer /end REF_MEASUREMENT /end GROUP
/begin GROUP S1747_SenDiagnostic "ME11/ME11_TMS/Sensor/Recirc/SenDiagnostic" /begin REF_CHARACTERISTIC cal_SensorVolDownFlg cal_SensorVolUpFlg /end REF_CHARACTERISTIC /end GROUP
/begin GROUP S1748_Override_HvPartModed "ME11/ME11_TMS/Sensor/Solar/Override_HvPartModed" /begin REF_CHARACTERISTIC cal_SolarData cal_SolarEnb /end REF_CHARACTERISTIC /begin REF_MEASUREMENT AC_rSolarRight /end REF_MEASUREMENT /end GROUP
/begin GROUP S1748_SenDiagnostic "ME11/ME11_TMS/Sensor/Solar/SenDiagnostic" /begin REF_CHARACTERISTIC cal_SensorVolDownFlg cal_SensorVolUpFlg /end REF_CHARACTERISTIC /end GROUP
/begin GROUP S1749_ChiTemp "ME11/ME11_TMS/Sensor/TempChiller/ChiTemp" /begin REF_CHARACTERISTIC cal_ChiTempData cal_ChiTempDataEnb /end REF_CHARACTERISTIC /begin REF_MEASUREMENT ACSen_sChiTempFilter /end REF_MEASUREMENT /end GROUP
/begin GROUP S1749_Chiller "ME11/ME11_TMS/Sensor/TempChiller/Chiller" /begin SUB_GROUP S1819_SenDiagnostic /end SUB_GROUP /begin REF_MEASUREMENT ACSen_eChillerTSenSts /end REF_MEASUREMENT /end GROUP
/begin GROUP S1750_EVAP "ME11/ME11_TMS/Sensor/TempEvap/EVAP" /begin SUB_GROUP S1827_SenDiagnostic /end SUB_GROUP /begin REF_MEASUREMENT ACSen_eEVAPTSenSts /end REF_MEASUREMENT /end GROUP
/begin GROUP S1750_EvapTemp "ME11/ME11_TMS/Sensor/TempEvap/EvapTemp" /begin REF_CHARACTERISTIC cal_EvapTempData cal_EvapTempDataEnb /end REF_CHARACTERISTIC /begin REF_MEASUREMENT ACSen_sEvapTempFilter /end REF_MEASUREMENT /end GROUP
/begin GROUP S1751_EvapSurface "ME11/ME11_TMS/Sensor/TempEvapSurface/EvapSurface" /begin SUB_GROUP S1837_SenDiagnostic /end SUB_GROUP /begin REF_MEASUREMENT ACSen_eEVAPSurfTSenSts /end REF_MEASUREMENT /end GROUP
/begin GROUP S1751_Override_HvPartModed "ME11/ME11_TMS/Sensor/TempEvapSurface/Override_HvPartModed" /begin REF_CHARACTERISTIC cal_EvapSurTempData cal_EvapSurTempDataEnb /end REF_CHARACTERISTIC /begin REF_MEASUREMENT ACSen_sEvapSurTemp /end REF_MEASUREMENT /end GROUP
/begin GROUP S1752_Env "ME11/ME11_TMS/Sensor/TempOHX/Env" /begin SUB_GROUP S1846_SenDiagnostic /end SUB_GROUP /begin REF_MEASUREMENT ACSen_eOHXTSenSts /end REF_MEASUREMENT /end GROUP
/begin GROUP S1752_OHXTemp "ME11/ME11_TMS/Sensor/TempOHX/OHXTemp" /begin REF_CHARACTERISTIC cal_OHXTempData cal_OHXTempDataEnb /end REF_CHARACTERISTIC /begin REF_MEASUREMENT ACSen_sOHXTempFilter /end REF_MEASUREMENT /end GROUP
/begin GROUP S1753_Env "ME11/ME11_TMS/Sensor/WCCHiTemp/Env" /begin SUB_GROUP S1855_SenDiagnostic /end SUB_GROUP /begin REF_MEASUREMENT ACSen_eWCCHTSenSts /end REF_MEASUREMENT /end GROUP
/begin GROUP S1753_WCCTemp "ME11/ME11_TMS/Sensor/WCCHiTemp/WCCTemp" /begin REF_CHARACTERISTIC cal_WCCTempData cal_WCCTempDataEnb /end REF_CHARACTERISTIC /begin REF_MEASUREMENT ACSen_sWCCHiTempFilter /end REF_MEASUREMENT /end GROUP
/begin GROUP S1754_Override_HvPartModed "ME11/ME11_TMS/Sensor/pressWCCHi/Override_HvPartModed" /begin REF_CHARACTERISTIC cal_HiPressData cal_HiPressDataEnb /end REF_CHARACTERISTIC /begin REF_MEASUREMENT ACSen_sHiPressFilter /end REF_MEASUREMENT /end GROUP
/begin GROUP S1754_SenDiagnostic "ME11/ME11_TMS/Sensor/pressWCCHi/SenDiagnostic" /begin REF_CHARACTERISTIC cal_SensorVolDownFlg cal_SensorVolUpFlg /end REF_CHARACTERISTIC /end GROUP
/begin GROUP S1755_ACCMHi "ME11/ME11_TMS/Sensor/tempACCMHi/ACCMHi" /begin SUB_GROUP S1871_SenDiagnostic /end SUB_GROUP /begin REF_MEASUREMENT ACSen_eACCMHTSenSts /end REF_MEASUREMENT /end GROUP
/begin GROUP S1755_ACCMHiTemp "ME11/ME11_TMS/Sensor/tempACCMHi/ACCMHiTemp" /begin REF_CHARACTERISTIC cal_ACCMHiTempData cal_ACCMHiTempDataEnb /end REF_CHARACTERISTIC /begin REF_MEASUREMENT ACSen_sACCMHiTempFilter /end REF_MEASUREMENT /end GROUP
/begin GROUP S38_BlowerFanSpeed "ME11/ME11_TMS/ACC/AutoAc/AutoACFun/BlowerFanSpeed"
 /begin SUB_GROUP S42_BlowerFanSpeedCalEnable S42_FanMaxSpeedLimCal S42_FanMinSpeedLimCal /end SUB_GROUP
 /begin REF_MEASUREMENT ACCtl_BloweFanSpeed AC_FanLeVel AC_FanLevelAct /end REF_MEASUREMENT
/end GROUP
/begin GROUP S38_BlowerMode "ME11/ME11_TMS/ACC/AutoAc/AutoACFun/BlowerMode" /begin SUB_GROUP S43_BlowerControlEnable /end SUB_GROUP /begin REF_MEASUREMENT ACCtl_BlowerMode /end REF_MEASUREMENT /end GROUP
/begin GROUP S38_Compressor_ACWorkModeCheck "ME11/ME11_TMS/ACC/AutoAc/AutoACFun/Compressor_ACWorkModeCheck" /begin SUB_GROUP S44_CabinAccmReqEnable /end SUB_GROUP /begin REF_MEASUREMENT ACCtl_stCabinCoolingEn /end REF_MEASUREMENT /end GROUP
/begin GROUP S38_PTC_ACWorkModeCheck "ME11/ME11_TMS/ACC/AutoAc/AutoACFun/PTC_ACWorkModeCheck" /begin SUB_GROUP S45_AC_PTCCalEnableState S45_PTC_PID /end SUB_GROUP /end GROUP
/begin GROUP S38_RecircModeEnaCalcu "ME11/ME11_TMS/ACC/AutoAc/AutoACFun/RecircModeEnaCalcu"
 /begin SUB_GROUP S46_ACCtlRecForForceDefog1 S46_ACCtlRecForSummerOrWinterOrNormalDefog1 S46_ACCtlRecForVent1 S46_Mannual S46_RecACHotStart S46_RecAQS S46_RecForceChange S46_RecForceDefog S46_RecNormalDefog S46_RecPCUTemp S46_RecPTCDvt S46_RecQkChargeCooling S46_RecRemoteForce S46_RecSummerCond S46_RecTargetOutTemp S46_RecVent S46_RecWinterCond /end SUB_GROUP
 /begin REF_CHARACTERISTIC cal_ACCtlRecLevelForACHotStart cal_ACCtlRecLevelForAQS cal_ACCtlRecLevelForForceChange cal_ACCtlRecLevelForForceDefog cal_ACCtlRecLevelForManual cal_ACCtlRecLevelForNormalDefog cal_ACCtlRecLevelForPCUTemp cal_ACCtlRecLevelForPTCDvt cal_ACCtlRecLevelForQkChargeCooling cal_ACCtlRecLevelForRemoteAC cal_ACCtlRecLevelForSummer cal_ACCtlRecLevelForTargetOutTemp cal_ACCtlRecLevelForTempLow cal_ACCtlRecLevelForVent cal_ACCtlRecLevelForWinter cal_CO2RecircRatio /end REF_CHARACTERISTIC
/end GROUP
/begin GROUP S38_RecircModeOut "ME11/ME11_TMS/ACC/AutoAc/AutoACFun/RecircModeOut" /begin SUB_GROUP S47_ACCtlRecForForceDefog S47_Subsystem13 /end SUB_GROUP /begin REF_MEASUREMENT ACCtl_IntakeRatio ACCtl_stRecOut /end REF_MEASUREMENT /end GROUP
/begin GROUP S40_DesiredVentTempCal_FIX "ME11/ME11_TMS/ACC/AutoAc/EvaporatorAndPTCAimTempCal_FIX/DesiredVentTempCal_FIX"
 /begin SUB_GROUP S174_CalFrontVentDesireTemp S174_CalLeftVentDesireTemp S174_CalRightVentDesireTemp S174_DVTWeightCal /end SUB_GROUP
/end GROUP
/begin GROUP S40_DuctActualTemperature "ME11/ME11_TMS/ACC/AutoAc/EvaporatorAndPTCAimTempCal_FIX/DuctActualTemperature"
 /begin SUB_GROUP S175_CalDrDuctActualTemperature S175_CalPsDuctActualTemperature S175_LeftMixDoorPI S175_PIDEnabLeCheck_ S175_RightMixDoorPI /end SUB_GROUP
 /begin REF_CHARACTERISTIC cal_DrDuctSenFailDeflt cal_PsDuctSensorFailDeflt /end REF_CHARACTERISTIC
 /begin REF_MEASUREMENT ACCtl_tLeftDuct ACCtl_tRightDuct /end REF_MEASUREMENT
/end GROUP
/begin GROUP S40_InventedCabin "ME11/ME11_TMS/ACC/AutoAc/EvaporatorAndPTCAimTempCal_FIX/InventedCabin" /begin REF_CHARACTERISTIC cal_CabinTCorSelect cal_CabinTempDuctUpStepCor_CUR /end REF_CHARACTERISTIC /begin REF_MEASUREMENT GlbDa_tCabinInvent /end REF_MEASUREMENT /end GROUP
/begin GROUP S40_TargetEvaporatorTempGov "ME11/ME11_TMS/ACC/AutoAc/EvaporatorAndPTCAimTempCal_FIX/TargetEvaporatorTempGov"
 /begin SUB_GROUP S178_CalAirCondDrEvapAimTemp S178_CalAirCondPsEvapAimTemp S178_EvapTargetLowest /end SUB_GROUP
 /begin REF_CHARACTERISTIC cal_ECOEvaDesValLL_MAP cal_ErrAmbTDvtForEvaLL cal_ErrAmbTDvtForEvaUL cal_EvaDesLLMax cal_TevapLoStepMin cal_TevapLoTime /end REF_CHARACTERISTIC
 /begin REF_MEASUREMENT ACCtl_sECOEvaDesValLL ACCtl_stEvaCooledFlag ACCtl_tSetPointEvap Eva_CloseCond1 Eva_CooledCond1 Eva_CoolingCond1 Eva_CoolingCond2 /end REF_MEASUREMENT
/end GROUP
/begin GROUP S40_TargetPTCTempGov "ME11/ME11_TMS/ACC/AutoAc/EvaporatorAndPTCAimTempCal_FIX/TargetPTCTempGov" /begin SUB_GROUP S179_CalPTCAimTemp_LeftDes S179_CalPTCAimTemp_RightDes /end SUB_GROUP
 /begin REF_CHARACTERISTIC cal_CabinSetPTCSwitch cal_ErrAmbTDvtForPtcLL cal_ErrAmbTDvtForPtcUL cal_SetPtcDesCoff cal_SetPtcDesTempMax_MAP cal_SetPtcDesTempMin cal_TevapUpStepMin cal_TevapUpTime /end REF_CHARACTERISTIC
 /begin REF_MEASUREMENT ACCCtl_sSetPtcDesTempMax ACCtl_stACPTCHeated ACCtl_tSetPointPTC ACPTC_HeatedCond1 ACPTC_HeatingCond1 ACPTC_HeatingCond2 ACPtc_CloseCond1 /end REF_MEASUREMENT
/end GROUP
/begin GROUP S41_CalDrMixDoorDesRatio "ME11/ME11_TMS/ACC/AutoAc/MixDoorOpenCloseDesCal/CalDrMixDoorDesRatio"
 /begin SUB_GROUP S386_CalAirCondMixVlvLeftTrgTemp S386_CalDrMixDoorDesRatio_FIXPID /end SUB_GROUP
 /begin REF_CHARACTERISTIC cal_EvaEnable cal_FixPIDSecletFlag cal_PtcEnable /end REF_CHARACTERISTIC
/end GROUP
/begin GROUP S41_CalPsMixDoorDesRatio "ME11/ME11_TMS/ACC/AutoAc/MixDoorOpenCloseDesCal/CalPsMixDoorDesRatio"
 /begin SUB_GROUP S387_CalAirCondMixVlvRightTrgTemp S387_CalPsMixDoorDesRatio /end SUB_GROUP
 /begin REF_CHARACTERISTIC cal_EvaEnable cal_FixPIDSecletFlag cal_PtcEnable /end REF_CHARACTERISTIC
/end GROUP
/begin GROUP S41_CoTS_rSetMixDoor "ME11/ME11_TMS/ACC/AutoAc/MixDoorOpenCloseDesCal/CoTS_rSetMixDoor" /begin REF_CHARACTERISTIC ACDefog /end REF_CHARACTERISTIC /begin REF_MEASUREMENT ThCo_rSetLeftMixDoor ThCo_rSetRightMixDoor /end REF_MEASUREMENT /end GROUP
/begin GROUP S447_ModeOnOrOff "ME11/ME11_TMS/Actuator/COMP/ACCMEnble/ModeOnOrOff" /begin SUB_GROUP S459_ModeJudge /end SUB_GROUP /end GROUP
/begin GROUP S447_Override "ME11/ME11_TMS/Actuator/COMP/ACCMEnble/Override" /begin REF_CHARACTERISTIC cal_ACCMEnbData cal_ACCMEnbDataEnb /end REF_CHARACTERISTIC /begin REF_MEASUREMENT ACTCtl_bACCMCtlEnb /end REF_MEASUREMENT /end GROUP
/begin GROUP S448_IWin_Controller "ME11/ME11_TMS/Actuator/COMP/ACCMPICtrl/IWin_Controller" /begin SUB_GROUP S480_ISum /end SUB_GROUP /begin REF_MEASUREMENT ACTCtl_sACCMI_Sum /end REF_MEASUREMENT /end GROUP
/begin GROUP S448_PI_Controller "ME11/ME11_TMS/Actuator/COMP/ACCMPICtrl/PI_Controller" /begin REF_MEASUREMENT ACTCtl_bCOMPIFreeFlag ACTCtl_sACCMPIVal /end REF_MEASUREMENT /end GROUP
/begin GROUP S448_pWin_Controller "ME11/ME11_TMS/Actuator/COMP/ACCMPICtrl/pWin_Controller" /begin REF_MEASUREMENT ACTCtl_sACCMP_Cor /end REF_MEASUREMENT /end GROUP
/begin GROUP S449_ACCMFault "ME11/ME11_TMS/Actuator/COMP/COMPFaultHandling/ACCMFault" /begin REF_MEASUREMENT ACTCtl_bCOMPFaultClc ACTCtl_bCOMPRealFault /end REF_MEASUREMENT /end GROUP
/begin GROUP S449_EnvLmt "ME11/ME11_TMS/Actuator/COMP/COMPFaultHandling/EnvLmt"
 /begin REF_CHARACTERISTIC cal_HeatCOMPEnvTempLmtOff cal_HeatCOMPEnvTempLmtOn cal_NmCOMPEnvTempLmtOff cal_NmCOMPEnvTempLmtOn /end REF_CHARACTERISTIC
 /begin REF_MEASUREMENT ACTCrl_bEnvCOMPLmt /end REF_MEASUREMENT
/end GROUP
/begin GROUP S449_OCOLmt "ME11/ME11_TMS/Actuator/COMP/COMPFaultHandling/OCOLmt" /begin REF_CHARACTERISTIC cal_HPAndLPDiffMaxVal /end REF_CHARACTERISTIC /begin REF_MEASUREMENT ACTCtl_bCOMPEnbDelay ACTCtl_bOCOLmtFlg /end REF_MEASUREMENT /end GROUP
/begin GROUP S449_PressRateProtect "ME11/ME11_TMS/Actuator/COMP/COMPFaultHandling/PressRateProtect"
 /begin SUB_GROUP S504_Flg1Cal S504_Flg1Cal1 S504_Flg1Cal2 S504_Flg2Cal S504_Flg2Cal1 S504_Flg3Cal S504_Flg3Cal1 S504_FlgCal S504_Other /end SUB_GROUP
 /begin REF_MEASUREMENT ACSen_sPressRateVal ACTCtl_bPressProtectFlg ACTCtl_bPressRateFlg /end REF_MEASUREMENT
/end GROUP
/begin GROUP S450_COMP_AT_Noise_Lmt "ME11/ME11_TMS/Actuator/COMP/COMPLimitSpeed/COMP_AT_Noise_Lmt"
 /begin REF_CHARACTERISTIC cal_AccmSpdLimByHiPressDownSide_CUR cal_AccmSpdLimByHiPressLevelCalcu_CUR cal_AccmSpdLimByHiPressUpSide_CUR cal_AccmSpdLimByLoPressDownSide_CUR cal_AccmSpdLimByLoPressLevelCalcu_CUR cal_AccmSpdLimByLoPressUpSide_CUR cal_COMPATNoiseSpdLmtHVS_CUR cal_COMPATNoiseSpdLmt_MAP cal_COMPCoolLowSpd cal_PCULimBTMAccmSpdDes_CUR cal_PCULimBTMAndCabinAccmSpdDes_CUR cal_PCULimCabinAccmSpdDes_CUR /end REF_CHARACTERISTIC
 /begin REF_MEASUREMENT ACTCtl_sCOMPATNoiseBlwAndAccmSpd ACTCtl_sCOMPATNoiseLmtHVSSpd ACTCtl_sCOMPATNoiseLmtSpd ACTCtl_sCOMPCoolLmtSpd ACTCtl_sCOMPHPLmtSpd ACTCtl_sCOMPLPLmtSpd ACTCtl_sCOMPPCULimSpd /end REF_MEASUREMENT
/end GROUP
/begin GROUP S450_COMP_Cool_Speed_Lmt "ME11/ME11_TMS/Actuator/COMP/COMPLimitSpeed/COMP_Cool_Speed_Lmt"
 /begin REF_CHARACTERISTIC cal_COMPBatMaxSpdLmt cal_COMPCabinCoolMaxSpdLmt cal_COMPEnvSpdLmt1_CUR cal_COMPEnvSpdLmt2_CUR cal_COMPEnvSpdLmt3_CUR cal_COMPFanLevelLmt_CUR /end REF_CHARACTERISTIC
 /begin REF_MEASUREMENT ACTCtl_sCOMPEnvLmtSpd ACTCtl_sCOMPFanlevelLmtSpd /end REF_MEASUREMENT
/end GROUP
/begin GROUP S451_OpenOrCloseFilter "ME11/ME11_TMS/Actuator/COMP/COMPSpeedLmt/OpenOrCloseFilter" /begin SUB_GROUP S567_Deal /end SUB_GROUP
 /begin REF_CHARACTERISTIC cal_ACCMCtlDownlmt cal_ACCMCtlUplmt cal_OpenCtrlCOMPDownlmt cal_OpenCtrlCOMPUplmt /end REF_CHARACTERISTIC
/end GROUP
/begin GROUP S451_Override "ME11/ME11_TMS/Actuator/COMP/COMPSpeedLmt/Override" /begin REF_CHARACTERISTIC cal_ACCMCtrlSpdData cal_ACCMCtrlSpdDataEnb /end REF_CHARACTERISTIC /end GROUP
/begin GROUP S451_Spd "ME11/ME11_TMS/Actuator/COMP/COMPSpeedLmt/Spd" /begin REF_CHARACTERISTIC cal_COMPExhTDownSpd /end REF_CHARACTERISTIC /begin REF_MEASUREMENT ACTCtl_sCOMPDownSpd /end REF_MEASUREMENT /end GROUP
/begin GROUP S454_ACCMCtrlA "ME11/ME11_TMS/Actuator/COMP/ParameterCal/ACCMCtrlA" /begin SUB_GROUP S582_Target_computation S582_relay /end SUB_GROUP
 /begin REF_CHARACTERISTIC cal_ACCMCtrlA1FF_CUR cal_ACCMCtrlA2FF_MAP cal_ACCMCtrlACct cal_ACCMCtrlADeadzone cal_ACCMCtrlADlyTime cal_ACCMCtrlAKi_CUR cal_ACCMCtrlAKp_CUR cal_ACCMCtrlAPIMax cal_ACCMCtrlAPIMin cal_ACCMCtrlARunTime cal_PTCAuxHeatPwrLmt_MAP cal_PTCOffPowerVal cal_PTCOnReqPower_CUR /end REF_CHARACTERISTIC
 /begin REF_MEASUREMENT ACTCtl_sCOMPCtrlAClsFF ACTCtl_sPTCAuxHeatPwr ACTCtl_tCtrlADiff /end REF_MEASUREMENT
/end GROUP
/begin GROUP S454_ACCMCtrlB "ME11/ME11_TMS/Actuator/COMP/ParameterCal/ACCMCtrlB"
 /begin REF_CHARACTERISTIC cal_ACCMCtrlBDeadzone cal_ACCMCtrlBDlyTime cal_ACCMCtrlBFF_CUR cal_ACCMCtrlBKi_CUR cal_ACCMCtrlBKp_CUR cal_ACCMCtrlBPIMax cal_ACCMCtrlBPIMin cal_ACCMCtrlBRunTime cal_BatCoolInletTrgTemp cal_BatCoolTrgFilter /end REF_CHARACTERISTIC
 /begin REF_MEASUREMENT ACTCtl_tCtrlBDiff /end REF_MEASUREMENT
/end GROUP
/begin GROUP S454_ACCMCtrlC "ME11/ME11_TMS/Actuator/COMP/ParameterCal/ACCMCtrlC"
 /begin REF_CHARACTERISTIC cal_ACCMCtrlACct cal_ACCMCtrlC1FF_CUR cal_ACCMCtrlC2FF_CUR cal_ACCMCtrlCDeadzone cal_ACCMCtrlCDlyTime cal_ACCMCtrlCKi_CUR cal_ACCMCtrlCKp_CUR cal_ACCMCtrlCPIMax cal_ACCMCtrlCPIMin cal_ACCMCtrlCRunTime /end REF_CHARACTERISTIC
 /begin REF_MEASUREMENT ACTCtl_tCtrlCDiff /end REF_MEASUREMENT
/end GROUP
/begin GROUP S454_ACCMCtrlD "ME11/ME11_TMS/Actuator/COMP/ParameterCal/ACCMCtrlD"
 /begin REF_CHARACTERISTIC cal_ACCMCtrlACct cal_ACCMCtrlD1FF_CUR cal_ACCMCtrlD2FF_CUR cal_ACCMCtrlDDeadzone cal_ACCMCtrlDDlyTime cal_ACCMCtrlDKi_CUR cal_ACCMCtrlDKp_CUR cal_ACCMCtrlDPIMax_CUR cal_ACCMCtrlDPIMin cal_ACCMCtrlDRunTime cal_ACCMCtrlDTrg_CUR /end REF_CHARACTERISTIC
/end GROUP
/begin GROUP S454_ACCMCtrlE "ME11/ME11_TMS/Actuator/COMP/ParameterCal/ACCMCtrlE"
 /begin REF_CHARACTERISTIC cal_ACCMCtrlACct cal_ACCMCtrlE1FF_CUR cal_ACCMCtrlE2FF_CUR cal_ACCMCtrlEDeadzone cal_ACCMCtrlEDlyTime cal_ACCMCtrlEKi_CUR cal_ACCMCtrlEKp_CUR cal_ACCMCtrlEPIMax cal_ACCMCtrlEPIMin cal_ACCMCtrlERunTime cal_ACCMCtrlETrgTemp cal_BatCoolTrgFilter /end REF_CHARACTERISTIC
/end GROUP
/begin GROUP S454_ACCMCtrlF "ME11/ME11_TMS/Actuator/COMP/ParameterCal/ACCMCtrlF" /begin SUB_GROUP S587_relay /end SUB_GROUP
 /begin REF_CHARACTERISTIC cal_ACCMCtrlACct cal_ACCMCtrlF1FF_CUR cal_ACCMCtrlF2FF_CUR cal_ACCMCtrlFDeadzone cal_ACCMCtrlFDlyTime cal_ACCMCtrlFKi_CUR cal_ACCMCtrlFKp_CUR cal_ACCMCtrlFPIMax_CUR cal_ACCMCtrlFPIMin cal_ACCMCtrlFRunTime cal_CtrlFPTCAuxHeatPwrLmt_MAP cal_CtrlFPTCOffPowerVal cal_CtrlFPTCOnReqPower_CUR /end REF_CHARACTERISTIC
 /begin REF_MEASUREMENT ACTCtl_sCtrlFPTCAuxHeatPwr /end REF_MEASUREMENT
/end GROUP
/begin GROUP S454_ACCMCtrlH "ME11/ME11_TMS/Actuator/COMP/ParameterCal/ACCMCtrlH"
 /begin REF_CHARACTERISTIC cal_ACCMCtrlH1FF_CUR cal_ACCMCtrlH2FF_CUR cal_ACCMCtrlHCct cal_ACCMCtrlHDeadzone cal_ACCMCtrlHDlyTime cal_ACCMCtrlHKi_CUR cal_ACCMCtrlHKp_CUR cal_ACCMCtrlHPIMax cal_ACCMCtrlHPIMin cal_ACCMCtrlHRunTime cal_BatCoolInletTrgTemp /end REF_CHARACTERISTIC
 /begin REF_MEASUREMENT ACTCtl_sDCoolBatTempDiff ACTCtl_sDCoolCabinTempDiff /end REF_MEASUREMENT
/end GROUP
/begin GROUP S637_MUL "ME11/ME11_TMS/Actuator/CWV/C3WV_MCV/MUL"
 /begin SUB_GROUP S641_FallInBetweenT1AndT2 S641_HeatTemp S641_MinTempLessThanT1 /end SUB_GROUP
 /begin REF_CHARACTERISTIC cal_BMSInletTempHighOffMCV cal_BMSInletTempLowOnMCV cal_C3WVExhPosVal /end REF_CHARACTERISTIC
/end GROUP
/begin GROUP S637_selflearning "ME11/ME11_TMS/Actuator/CWV/C3WV_MCV/selflearning" /begin SUB_GROUP S642_Override_C5WV /end SUB_GROUP /begin REF_CHARACTERISTIC cal_MCVFltStsDelayTime cal_MCVPosDiffDelayTime /end REF_CHARACTERISTIC /begin REF_MEASUREMENT ACTCtl_bMCVlearnFlg /end REF_MEASUREMENT /end GROUP
/begin GROUP S638_Position "ME11/ME11_TMS/Actuator/CWV/C5WV_BCV/Position" /begin REF_CHARACTERISTIC cal_BatModeTestCtrl cal_C5WVExhPosVal /end REF_CHARACTERISTIC /end GROUP
/begin GROUP S638_selflearning "ME11/ME11_TMS/Actuator/CWV/C5WV_BCV/selflearning" /begin SUB_GROUP S664_Override_C5WV /end SUB_GROUP /begin REF_CHARACTERISTIC cal_BCVFltStsDelayTime cal_BCVPosDiffDelayTime /end REF_CHARACTERISTIC /begin REF_MEASUREMENT ACTCtl_bBCVlearnFlg /end REF_MEASUREMENT /end GROUP
/begin GROUP S673_AEXVEnble "ME11/ME11_TMS/Actuator/EXV/AEXV/AEXVEnble" /begin SUB_GROUP S677_Override /end SUB_GROUP /begin REF_MEASUREMENT ACTCtl_sAEXVCtrlFF /end REF_MEASUREMENT /end GROUP
/begin GROUP S673_AEXVFault "ME11/ME11_TMS/Actuator/EXV/AEXV/AEXVFault" /begin REF_MEASUREMENT ACTCtl_bAEXVFaultFlg /end REF_MEASUREMENT /end GROUP
/begin GROUP S673_AEXVInit "ME11/ME11_TMS/Actuator/EXV/AEXV/AEXVInit" /begin SUB_GROUP S679_Override /end SUB_GROUP /begin REF_MEASUREMENT ACTCtl_bAEXVInitFinishFlg /end REF_MEASUREMENT /end GROUP
/begin GROUP S673_AEXVPICtrl "ME11/ME11_TMS/Actuator/EXV/AEXV/AEXVPICtrl"
 /begin SUB_GROUP S680_IWin_Controller S680_PI_Controller S680_pWin_Controller /end SUB_GROUP
 /begin REF_CHARACTERISTIC cal_AEXVCtlKi cal_AEXVCtlKisumMax cal_AEXVCtlKisumMin cal_AEXVCtlKp /end REF_CHARACTERISTIC
/end GROUP
/begin GROUP S673_AEXVPIParameter "ME11/ME11_TMS/Actuator/EXV/AEXV/AEXVPIParameter"
 /begin SUB_GROUP S681_AEXVCtrlB S681_AEXVCtrlC S681_AEXVCtrlD S681_AEXVCtrlDefault /end SUB_GROUP
/end GROUP
/begin GROUP S673_NegAndPosCheck_EXV "ME11/ME11_TMS/Actuator/EXV/AEXV/NegAndPosCheck_EXV" /begin REF_MEASUREMENT ACTCtl_bAEXVDvtFlg ACTCtl_sAEXVDvt /end REF_MEASUREMENT /end GROUP
/begin GROUP S673_pressureprotection "ME11/ME11_TMS/Actuator/EXV/AEXV/pressureprotection" /begin SUB_GROUP S683_OpenOrCloseAEXVPos S683_Override S683_StepLimit /end SUB_GROUP
 /begin REF_CHARACTERISTIC cal_AEXVClsEvapPrtTemp cal_AEXVClsValEvapPrt cal_AEXVClsValRunTimeEvapPrt cal_AEXVFltClsSpd cal_AEXVHighPressProhOn cal_AEXVLowPressProhOn cal_AEXVOpenDelayTimeEvapNOPrt cal_AEXVOpenEvapNOPrtTemp cal_AEXVOpenRunTimeEvapNOPrt cal_AEXVOpenValEvapNOPrt cal_AEXVOpenValveSpd /end REF_CHARACTERISTIC
 /begin REF_MEASUREMENT ACTCtl_eEvapProSts ACTCtl_sAEXVPos /end REF_MEASUREMENT
/end GROUP
/begin GROUP S674_BEXVFault "ME11/ME11_TMS/Actuator/EXV/BEXV/BEXVFault" /begin REF_MEASUREMENT ACTCtl_bBEXVFaultFlg /end REF_MEASUREMENT /end GROUP
/begin GROUP S674_BEXVInit "ME11/ME11_TMS/Actuator/EXV/BEXV/BEXVInit" /begin SUB_GROUP S749_Override /end SUB_GROUP /begin REF_MEASUREMENT ACTCtl_bBEXVInitFinishFlg /end REF_MEASUREMENT /end GROUP
/begin GROUP S674_BEXVPICtrl "ME11/ME11_TMS/Actuator/EXV/BEXV/BEXVPICtrl"
 /begin SUB_GROUP S750_IWin_Controller S750_PI_Controller S750_pWin_Controller /end SUB_GROUP
 /begin REF_CHARACTERISTIC cal_BEXVCtlKi cal_BEXVCtlKisumMax cal_BEXVCtlKisumMin cal_BEXVCtlKp /end REF_CHARACTERISTIC
/end GROUP
/begin GROUP S674_BEXVPIParameter "ME11/ME11_TMS/Actuator/EXV/BEXV/BEXVPIParameter" /begin SUB_GROUP S751_BEXVCtrlB S751_BEXVCtrlC /end SUB_GROUP /end GROUP
/begin GROUP S674_EXVEnble "ME11/ME11_TMS/Actuator/EXV/BEXV/EXVEnble" /begin SUB_GROUP S752_Override /end SUB_GROUP /begin REF_MEASUREMENT ACTCtl_sBEXVCtrlFF /end REF_MEASUREMENT /end GROUP
/begin GROUP S674_NegAndPosCheck_EXV "ME11/ME11_TMS/Actuator/EXV/BEXV/NegAndPosCheck_EXV" /begin REF_MEASUREMENT ACTCtl_bBEXVDvtFlg ACTCtl_sBEXVDvt /end REF_MEASUREMENT /end GROUP
/begin GROUP S674_pressure_protection "ME11/ME11_TMS/Actuator/EXV/BEXV/pressure-protection" /begin SUB_GROUP S754_Choose S754_OpenOrCloseControl /end SUB_GROUP
 /begin REF_CHARACTERISTIC cal_BEXVHighPressProhOn cal_BEXVLowPressProhOn cal_BEXVOpenValveSpd /end REF_CHARACTERISTIC
/end GROUP
/begin GROUP S675_Arbitration "ME11/ME11_TMS/Actuator/EXV/HPEXV/Arbitration" /begin SUB_GROUP S818_HPEXVLimit S818_Override S818_StepLimit /end SUB_GROUP /begin REF_CHARACTERISTIC cal_HPEXVStepLmtSw /end REF_CHARACTERISTIC /begin REF_MEASUREMENT ACTCtl_sHPEXVPos /end REF_MEASUREMENT /end GROUP
/begin GROUP S675_FFCal "ME11/ME11_TMS/Actuator/EXV/HPEXV/FFCal" /begin SUB_GROUP S819_Override /end SUB_GROUP /begin REF_MEASUREMENT ACTCtl_sHPEXVCtrlFF /end REF_MEASUREMENT /end GROUP
/begin GROUP S675_HPEXVFault "ME11/ME11_TMS/Actuator/EXV/HPEXV/HPEXVFault" /begin REF_MEASUREMENT ACTCtl_bHPEXVFaultFlg /end REF_MEASUREMENT /end GROUP
/begin GROUP S675_HPEXVPICtrl "ME11/ME11_TMS/Actuator/EXV/HPEXV/HPEXVPICtrl"
 /begin SUB_GROUP S821_IWin_Controller S821_PI_Controller S821_pWin_Controller /end SUB_GROUP
 /begin REF_CHARACTERISTIC cal_HPEXVCtlKi cal_HPEXVCtlKiDeadzoneNeg cal_HPEXVCtlKiDeadzonePos cal_HPEXVCtlKisumMax cal_HPEXVCtlKisumMin cal_HPEXVCtlKp cal_HPEXVCtlKpDeadzoneNeg cal_HPEXVCtlKpDeadzonePos /end REF_CHARACTERISTIC
/end GROUP
/begin GROUP S675_HPEXVParameterCal "ME11/ME11_TMS/Actuator/EXV/HPEXV/HPEXVParameterCal"
 /begin SUB_GROUP S822_HPEXVCtrlA S822_HPEXVCtrlC S822_HPEXVCtrlD S822_HPEXVCtrlE S822_PressLimit /end SUB_GROUP
 /begin REF_CHARACTERISTIC cal_HPEXVlowPressLmtTrg /end REF_CHARACTERISTIC
 /begin REF_MEASUREMENT ACTCtl_sHPEXVSetPoint /end REF_MEASUREMENT
/end GROUP
/begin GROUP S675_Init "ME11/ME11_TMS/Actuator/EXV/HPEXV/Init" /begin SUB_GROUP S823_Override /end SUB_GROUP /begin REF_MEASUREMENT ACTCtl_bHPEXVInitFinishFlg /end REF_MEASUREMENT /end GROUP
/begin GROUP S675_NegAndPosCheck_EXV "ME11/ME11_TMS/Actuator/EXV/HPEXV/NegAndPosCheck_EXV" /begin REF_MEASUREMENT ACTCtl_bHPEXVDvtFlg ACTCtl_sHPEXVDvt /end REF_MEASUREMENT /end GROUP
/begin GROUP S676_AvgCondDep "ME11/ME11_TMS/Actuator/EXV/SupercoolingOrSuperheat/AvgCondDep" /begin SUB_GROUP S895_Sensor_Filter /end SUB_GROUP /begin REF_CHARACTERISTIC cal_CondDepFilter /end REF_CHARACTERISTIC /begin REF_MEASUREMENT ACTCtl_sCondDepAvg /end REF_MEASUREMENT /end GROUP
/begin GROUP S676_AvgCondDep_Cool "ME11/ME11_TMS/Actuator/EXV/SupercoolingOrSuperheat/AvgCondDep_Cool" /begin SUB_GROUP S896_Sensor_Filter /end SUB_GROUP /begin REF_CHARACTERISTIC cal_SuperHeatFilter /end REF_CHARACTERISTIC /begin REF_MEASUREMENT ACTCtl_sCoolCondDepAvg /end REF_MEASUREMENT /end GROUP
/begin GROUP S676_EvapSuperHeat "ME11/ME11_TMS/Actuator/EXV/SupercoolingOrSuperheat/EvapSuperHeat" /begin SUB_GROUP S897_Sensor_Filter /end SUB_GROUP /begin REF_CHARACTERISTIC cal_SuperHeatFilter /end REF_CHARACTERISTIC /begin REF_MEASUREMENT ACTCtl_sEvapSuperHeatAvg /end REF_MEASUREMENT /end GROUP
/begin GROUP S676_EvapSuperHeat1 "ME11/ME11_TMS/Actuator/EXV/SupercoolingOrSuperheat/EvapSuperHeat1" /begin SUB_GROUP S898_Sensor_Filter /end SUB_GROUP /begin REF_CHARACTERISTIC cal_SuperHeatFilter /end REF_CHARACTERISTIC /begin REF_MEASUREMENT ACTCtl_sChiSuperHeatAvg /end REF_MEASUREMENT /end GROUP
/begin GROUP S676_ExhSuperHeat "ME11/ME11_TMS/Actuator/EXV/SupercoolingOrSuperheat/ExhSuperHeat" /begin SUB_GROUP S899_Sensor_Filter /end SUB_GROUP /begin REF_CHARACTERISTIC cal_ExhSuperHeatFilter /end REF_CHARACTERISTIC /begin REF_MEASUREMENT ACTCtl_sExhSuperHeatAvg /end REF_MEASUREMENT /end GROUP
/begin GROUP S676_SuperHeat "ME11/ME11_TMS/Actuator/EXV/SupercoolingOrSuperheat/SuperHeat" /begin SUB_GROUP S900_Sensor_Filter /end SUB_GROUP /begin REF_CHARACTERISTIC cal_SuperHeatFilter /end REF_CHARACTERISTIC /begin REF_MEASUREMENT ACTCtl_sSuperHeatAvg /end REF_MEASUREMENT /end GROUP
/begin GROUP S913_IPUTempJudge "ME11/ME11_TMS/Actuator/Fan/BatBalOrLTR/IPUTempJudge" /begin REF_CHARACTERISTIC cal_LTRIPUTempFanCtrl_1X cal_LTRIPUTempFanCtrl_1Y /end REF_CHARACTERISTIC /end GROUP
/begin GROUP S913_MotorTempJudge "ME11/ME11_TMS/Actuator/Fan/BatBalOrLTR/MotorTempJudge" /begin REF_CHARACTERISTIC cal_LTRFanCtrl_1X cal_LTRFanCtrl_1Y /end REF_CHARACTERISTIC /end GROUP
/begin GROUP S945_Override1 "ME11/ME11_TMS/Actuator/PTC/PTCEnable/Override1" /begin REF_CHARACTERISTIC cal_PTCEnableData cal_PTCEnableDataEnb /end REF_CHARACTERISTIC /begin REF_MEASUREMENT ACTCtl_sPTCEnable /end REF_MEASUREMENT /end GROUP
/begin GROUP S947_Override2 "ME11/ME11_TMS/Actuator/PTC/PTCRequestPwr/Override2" /begin REF_CHARACTERISTIC cal_PTCReqtPowerData cal_PTCReqtPowerDataEnb /end REF_CHARACTERISTIC /begin REF_MEASUREMENT ACTCtl_sPTCReqPower /end REF_MEASUREMENT /end GROUP
/begin GROUP S1022_Override_AcPmp "ME11/ME11_TMS/Actuator/PUMP/AcPMP/Override_AcPmp" /begin REF_CHARACTERISTIC cal_AcPMPSpdSetData cal_AcPMPSpdSetDataEnb /end REF_CHARACTERISTIC /begin REF_MEASUREMENT ACTCtl_eAcPMPSpdPerc /end REF_MEASUREMENT /end GROUP
/begin GROUP S1022_Override_AcPmpFault "ME11/ME11_TMS/Actuator/PUMP/AcPMP/Override_AcPmpFault" /begin REF_CHARACTERISTIC cal_AcPMPFaultFlgData cal_AcPMPFaultFlgDataEnb /end REF_CHARACTERISTIC /begin REF_MEASUREMENT ACTCtl_bAcPMPFaultFlg /end REF_MEASUREMENT /end GROUP
/begin GROUP S1023_Override_BatPmp "ME11/ME11_TMS/Actuator/PUMP/BatPMP/Override_BatPmp" /begin REF_CHARACTERISTIC cal_BatPMPSpdSetData cal_BatPMPSpdSetDataEnb /end REF_CHARACTERISTIC /end GROUP
/begin GROUP S1023_Override_BatPmp1 "ME11/ME11_TMS/Actuator/PUMP/BatPMP/Override_BatPmp1" /begin REF_CHARACTERISTIC cal_BatPMPFaultFlgData cal_BatPMPFaultFlgDataEnb /end REF_CHARACTERISTIC /begin REF_MEASUREMENT ACTCtl_bBatPMPFaultFlg /end REF_MEASUREMENT /end GROUP
/begin GROUP S1024_IGBTTempJudge "ME11/ME11_TMS/Actuator/PUMP/MotPMP/IGBTTempJudge" /begin REF_CHARACTERISTIC cal_LTRIGBTTempMotPMPCtrl_1X cal_LTRIGBTTempMotPMPCtrl_1Y /end REF_CHARACTERISTIC /end GROUP
/begin GROUP S1024_MotorTempJudge "ME11/ME11_TMS/Actuator/PUMP/MotPMP/MotorTempJudge"
 /begin REF_CHARACTERISTIC cal_LTRMotorTempMotPMPCtrl_1X cal_LTRMotorTempMotPMPCtrl_1Y /end REF_CHARACTERISTIC
/end GROUP
/begin GROUP S1024_Override_MotPmp "ME11/ME11_TMS/Actuator/PUMP/MotPMP/Override_MotPmp" /begin REF_CHARACTERISTIC cal_MotPMPSpdSetData cal_MotPMPSpdSetDataEnb /end REF_CHARACTERISTIC /end GROUP
/begin GROUP S1024_Override_Motmp1 "ME11/ME11_TMS/Actuator/PUMP/MotPMP/Override_Motmp1" /begin REF_CHARACTERISTIC cal_MotPMPFaultFlgData cal_MotPMPFaultFlgDataEnb /end REF_CHARACTERISTIC /begin REF_MEASUREMENT ACTCtl_bMotPMPFaultFlg /end REF_MEASUREMENT /end GROUP
/begin GROUP S1024_PCUTempJudge "ME11/ME11_TMS/Actuator/PUMP/MotPMP/PCUTempJudge" /begin REF_CHARACTERISTIC cal_LTRIPUTempMotPMPCtrl_1X cal_LTRIPUTempMotPMPCtrl_1Y /end REF_CHARACTERISTIC /end GROUP
/begin GROUP S1681_Enter "ME11/ME11_TMS/SOM/Cabin/MD3_DHMD2/Enter" /begin REF_CHARACTERISTIC cal_tCabinCoolEnvTempLow /end REF_CHARACTERISTIC /end GROUP
/begin GROUP S46_RecForceChange "ME11/ME11_TMS/ACC/AutoAc/AutoACFun/RecircModeEnaCalcu/RecForceChange" /begin REF_CHARACTERISTIC cal_ACCtlRecLevelForForceChange /end REF_CHARACTERISTIC /end GROUP
/begin GROUP S178_CalAirCondDrEvapAimTemp "ME11/ME11_TMS/ACC/AutoAc/EvaporatorAndPTCAimTempCal_FIX/TargetEvaporatorTempGov/CalAirCondDrEvapAimTemp" /begin REF_CHARACTERISTIC cal_EvaDesLLMax cal_FixPIDSecletFlag /end REF_CHARACTERISTIC /end GROUP
/begin GROUP S178_CalAirCondPsEvapAimTemp "ME11/ME11_TMS/ACC/AutoAc/EvaporatorAndPTCAimTempCal_FIX/TargetEvaporatorTempGov/CalAirCondPsEvapAimTemp" /begin REF_CHARACTERISTIC cal_EvaDesLLMax cal_FixPIDSecletFlag /end REF_CHARACTERISTIC /end GROUP
/begin GROUP S178_EvapTargetLowest "ME11/ME11_TMS/ACC/AutoAc/EvaporatorAndPTCAimTempCal_FIX/TargetEvaporatorTempGov/EvapTargetLowest" /begin REF_CHARACTERISTIC cal_EvaDesLLMax /end REF_CHARACTERISTIC /end GROUP
/begin GROUP S179_CalPTCAimTemp_LeftDes "ME11/ME11_TMS/ACC/AutoAc/EvaporatorAndPTCAimTempCal_FIX/TargetPTCTempGov/CalPTCAimTemp_LeftDes" /begin REF_CHARACTERISTIC cal_FixPIDSecletFlag /end REF_CHARACTERISTIC /end GROUP
/begin GROUP S179_CalPTCAimTemp_RightDes "ME11/ME11_TMS/ACC/AutoAc/EvaporatorAndPTCAimTempCal_FIX/TargetPTCTempGov/CalPTCAimTemp_RightDes" /begin REF_CHARACTERISTIC cal_FixPIDSecletFlag /end REF_CHARACTERISTIC /end GROUP
/begin GROUP S751_BEXVCtrlB "ME11/ME11_TMS/Actuator/EXV/BEXV/BEXVPIParameter/BEXVCtrlB" /begin REF_CHARACTERISTIC cal_BatCoolInletTrgTemp /end REF_CHARACTERISTIC /end GROUP
/begin GROUP S1695_EnterCondition1 "ME11/ME11_TMS/SOM/Cabin/MD2_DHMD1/Enter/EnterCondition1" /begin REF_CHARACTERISTIC cal_tCabinCoolEnvTempLow /end REF_CHARACTERISTIC /end GROUP
/begin GROUP S1695_EnterCondition2 "ME11/ME11_TMS/SOM/Cabin/MD2_DHMD1/Enter/EnterCondition2" /begin REF_CHARACTERISTIC cal_tCabinCoolEnvTempHigh /end REF_CHARACTERISTIC /end GROUP
/begin GROUP S1696_Condition1And2 "ME11/ME11_TMS/SOM/Cabin/MD2_DHMD1/Exit/Condition1And2"
 /begin REF_CHARACTERISTIC cal_CabinHys1TempOffset cal_CabinHys2TempOffset cal_tCabinCoolEnvTempHigh cal_tCabinCoolEnvTempLow /end REF_CHARACTERISTIC
/end GROUP
/begin GROUP S1696_Condition3 "ME11/ME11_TMS/SOM/Cabin/MD2_DHMD1/Exit/Condition3"
 /begin REF_CHARACTERISTIC cal_CabinHys1TempOffset cal_CabinHys2TempOffset cal_tCabinCoolEnvTempLow /end REF_CHARACTERISTIC
/end GROUP
/begin GROUP S1696_Contidion4 "ME11/ME11_TMS/SOM/Cabin/MD2_DHMD1/Exit/Contidion4" /begin REF_CHARACTERISTIC cal_CabinHys1TempOffset cal_tCabinCoolEnvTempLow /end REF_CHARACTERISTIC /end GROUP
/begin GROUP S1711_Condition1 "ME11/ME11_TMS/SOM/Cabin/MD3_DHMD2/Exit/Condition1" /begin REF_CHARACTERISTIC cal_CabinHys1TempOffset cal_tCabinCoolEnvTempLow /end REF_CHARACTERISTIC /end GROUP
/begin GROUP S1711_Condition2 "ME11/ME11_TMS/SOM/Cabin/MD3_DHMD2/Exit/Condition2"
 /begin REF_CHARACTERISTIC cal_CabinHys1TempOffset cal_CabinHys2TempOffset cal_tCabinCoolEnvTempLow /end REF_CHARACTERISTIC
/end GROUP
/begin GROUP S1711_Contidion3 "ME11/ME11_TMS/SOM/Cabin/MD3_DHMD2/Exit/Contidion3" /begin REF_CHARACTERISTIC cal_CabinHys1TempOffset /end REF_CHARACTERISTIC /end GROUP
/begin GROUP S157_Subsystem "ME11/ME11_TMS/ACC/AutoAc/AutoACFun/RecircModeOut/Subsystem13/Subsystem"
 /begin REF_CHARACTERISTIC cal_ACCtlRecLevelForNormalDefog cal_ACCtlRecLevelForSummer cal_ACCtlRecLevelForWinter /end REF_CHARACTERISTIC
/end GROUP
/begin GROUP S157_Subsystem1 "ME11/ME11_TMS/ACC/AutoAc/AutoACFun/RecircModeOut/Subsystem13/Subsystem1" /begin REF_CHARACTERISTIC cal_ACCtlRecLevelForPTCDvt /end REF_CHARACTERISTIC /end GROUP
/begin GROUP S157_Subsystem10 "ME11/ME11_TMS/ACC/AutoAc/AutoACFun/RecircModeOut/Subsystem13/Subsystem10" /begin REF_CHARACTERISTIC cal_ACCtlRecLevelForQkChargeCooling /end REF_CHARACTERISTIC /end GROUP
/begin GROUP S157_Subsystem11 "ME11/ME11_TMS/ACC/AutoAc/AutoACFun/RecircModeOut/Subsystem13/Subsystem11" /begin REF_CHARACTERISTIC cal_ACCtlRecLevelForForceChange /end REF_CHARACTERISTIC /end GROUP
/begin GROUP S157_Subsystem12 "ME11/ME11_TMS/ACC/AutoAc/AutoACFun/RecircModeOut/Subsystem13/Subsystem12" /begin REF_CHARACTERISTIC cal_ACCtlRecLevelForRemoteAC /end REF_CHARACTERISTIC /end GROUP
/begin GROUP S157_Subsystem2 "ME11/ME11_TMS/ACC/AutoAc/AutoACFun/RecircModeOut/Subsystem13/Subsystem2" /begin REF_CHARACTERISTIC cal_ACCtlRecLevelForACHotStart /end REF_CHARACTERISTIC /end GROUP
/begin GROUP S157_Subsystem3 "ME11/ME11_TMS/ACC/AutoAc/AutoACFun/RecircModeOut/Subsystem13/Subsystem3" /begin REF_CHARACTERISTIC cal_ACCtlRecLevelForTargetOutTemp /end REF_CHARACTERISTIC /end GROUP
/begin GROUP S157_Subsystem4 "ME11/ME11_TMS/ACC/AutoAc/AutoACFun/RecircModeOut/Subsystem13/Subsystem4" /begin REF_CHARACTERISTIC cal_ACCtlRecLevelForVent /end REF_CHARACTERISTIC /end GROUP
/begin GROUP S157_Subsystem5 "ME11/ME11_TMS/ACC/AutoAc/AutoACFun/RecircModeOut/Subsystem13/Subsystem5" /begin REF_CHARACTERISTIC cal_ACCtlRecLevelForTempLow /end REF_CHARACTERISTIC /end GROUP
/begin GROUP S157_Subsystem6 "ME11/ME11_TMS/ACC/AutoAc/AutoACFun/RecircModeOut/Subsystem13/Subsystem6" /begin REF_CHARACTERISTIC cal_ACCtlRecLevelForAQS /end REF_CHARACTERISTIC /end GROUP
/begin GROUP S157_Subsystem7 "ME11/ME11_TMS/ACC/AutoAc/AutoACFun/RecircModeOut/Subsystem13/Subsystem7" /begin REF_CHARACTERISTIC cal_ACCtlRecLevelForPCUTemp /end REF_CHARACTERISTIC /end GROUP
/begin GROUP S157_Subsystem8 "ME11/ME11_TMS/ACC/AutoAc/AutoACFun/RecircModeOut/Subsystem13/Subsystem8" /begin REF_CHARACTERISTIC cal_ACCtlRecLevelForForceDefog /end REF_CHARACTERISTIC /end GROUP
/begin GROUP S157_Subsystem9 "ME11/ME11_TMS/ACC/AutoAc/AutoACFun/RecircModeOut/Subsystem13/Subsystem9" /begin REF_CHARACTERISTIC cal_ACCtlRecLevelForManual /end REF_CHARACTERISTIC /end GROUP
/begin GROUP S180_FrontCabinAimTempBasCal "ME11/ME11_TMS/ACC/AutoAc/EvaporatorAndPTCAimTempCal_FIX/DesiredVentTempCal_FIX/CalFrontVentDesireTemp/FrontCabinAimTempBasCal" /begin REF_CHARACTERISTIC cal_FixPIDSecletFlag /end REF_CHARACTERISTIC /end GROUP
