/begin MOD_COMMON "Mod Common Comment Here" BYTE_ORDER MSB_LAST /end MOD_COMMON
/begin RECORD_LAYOUT Scalar_BOOLEAN FNC_VALUES 1 UBYTE COLUMN_DIR DIRECT /end RECORD_LAYOUT
/begin RECORD_LAYOUT Scalar_UBYTE FNC_VALUES 1 UBYTE COLUMN_DIR DIRECT /end RECORD_LAYOUT
/begin RECORD_LAYOUT Scalar_UWORD FNC_VALUES 1 UWORD COLUMN_DIR DIRECT /end RECORD_LAYOUT
/begin RECORD_LAYOUT Scalar_FLOAT32_IEEE FNC_VALUES 1 FLOAT32_IEEE COLUMN_DIR DIRECT /end RECORD_LAYOUT
/begin RECORD_LAYOUT Lookup1D_UBYTE FNC_VALUES 1 UBYTE COLUMN_DIR DIRECT /end RECORD_LAYOUT
/begin RECORD_LAYOUT Lookup1D_X_UWORD AXIS_PTS_X 1 UWORD INDEX_INCR DIRECT /end RECORD_LAYOUT
/begin RECORD_LAYOUT Lookup1D_FLOAT32_IEEE FNC_VALUES 1 FLOAT32_IEEE COLUMN_DIR DIRECT /end RECORD_LAYOUT
/begin RECORD_LAYOUT Lookup1D_X_FLOAT32_IEEE AXIS_PTS_X 1 FLOAT32_IEEE INDEX_INCR DIRECT /end RECORD_LAYOUT
/begin RECORD_LAYOUT Lookup1D_X_FLOAT64_IEEE AXIS_PTS_X 1 FLOAT64_IEEE INDEX_INCR DIRECT /end RECORD_LAYOUT
/begin RECORD_LAYOUT Lookup2D_BOOLEAN FNC_VALUES 1 UBYTE COLUMN_DIR DIRECT /end RECORD_LAYOUT
/begin RECORD_LAYOUT Lookup2D_X_BOOLEAN AXIS_PTS_X 1 UBYTE INDEX_INCR DIRECT /end RECORD_LAYOUT
/begin RECORD_LAYOUT Lookup2D_X_UBYTE AXIS_PTS_X 1 UBYTE INDEX_INCR DIRECT /end RECORD_LAYOUT
/begin RECORD_LAYOUT Lookup2D_BYTE FNC_VALUES 1 SBYTE COLUMN_DIR DIRECT /end RECORD_LAYOUT
/begin RECORD_LAYOUT Lookup2D_X_BYTE AXIS_PTS_X 1 SBYTE INDEX_INCR DIRECT /end RECORD_LAYOUT
/begin RECORD_LAYOUT Lookup2D_UWORD FNC_VALUES 1 UWORD COLUMN_DIR DIRECT /end RECORD_LAYOUT
/begin RECORD_LAYOUT Lookup2D_X_UWORD AXIS_PTS_X 1 UWORD INDEX_INCR DIRECT /end RECORD_LAYOUT
/begin RECORD_LAYOUT Lookup2D_WORD FNC_VALUES 1 SWORD COLUMN_DIR DIRECT /end RECORD_LAYOUT
/begin RECORD_LAYOUT Lookup2D_FLOAT32_IEEE FNC_VALUES 1 FLOAT32_IEEE COLUMN_DIR DIRECT /end RECORD_LAYOUT
/begin RECORD_LAYOUT Lookup2D_X_FLOAT32_IEEE AXIS_PTS_X 1 FLOAT32_IEEE INDEX_INCR DIRECT /end RECORD_LAYOUT
/begin CHARACTERISTIC cal_ACFanMaxSpdCellTempLim_CUR "" CURVE 0x0000 /* @ECU_Address@cal_ACFanMaxSpdCellTempLim_CUR@ */ Lookup1D_UBYTE 0 ME11_CM_uint8_percent_ 0.0 100.0
 /begin AXIS_DESCR COM_AXIS BMS_HVBatCellTempMax ME11_CM_single_C 5 -40.0 100.0 AXIS_PTS_REF cal_ACFanMaxSpdCellTempLim_1X /end AXIS_DESCR
/end CHARACTERISTIC
/begin AXIS_PTS cal_ACFanMaxSpdCellTempLim_1X "" 0x0000 /* @ECU_Address@cal_ACFanMaxSpdCellTempLim_1X@ */ BMS_HVBatCellTempMax Lookup1D_X_FLOAT32_IEEE 0 ME11_CM_single_C 5 -40.0 100.0 /end AXIS_PTS
/begin CHARACTERISTIC cal_ACFanMaxSpdDvtLim_CUR "" CURVE 0x0000 /* @ECU_Address@cal_ACFanMaxSpdDvtLim_CUR@ */ Lookup1D_UBYTE 0 ME11_CM_uint8_percent_ 0.0 100.0
 /begin AXIS_DESCR COM_AXIS AC_DVT2PTCErr ME11_CM_single_C 5 -40.0 80.0 AXIS_PTS_REF cal_ACFanMaxSpdDvtLim_1X /end AXIS_DESCR
/end CHARACTERISTIC
/begin AXIS_PTS cal_ACFanMaxSpdDvtLim_1X "" 0x0000 /* @ECU_Address@cal_ACFanMaxSpdDvtLim_1X@ */ AC_DVT2PTCErr Lookup1D_X_FLOAT32_IEEE 0 ME11_CM_single_C 5 -40.0 80.0 /end AXIS_PTS
/begin CHARACTERISTIC cal_ACPTCPwrPreSetByEnv_MAP "" MAP 0x0000 /* @ECU_Address@cal_ACPTCPwrPreSetByEnv_MAP@ */ Lookup2D_UWORD 0 ME11_CM_uint16_w 0.0 10000.0
 /begin AXIS_DESCR COM_AXIS ACSen_sEnvTempCor ME11_CM_single_C 10 -40.0 80.0 AXIS_PTS_REF cal_ACPTCPwrPreSetByEnv_2Y /end AXIS_DESCR
 /begin AXIS_DESCR COM_AXIS ACCtl_tSetPointPTC ME11_CM_single_C 10 -40.0 80.0 AXIS_PTS_REF cal_ACPTCPwrPreSetByEnv_2X /end AXIS_DESCR
/end CHARACTERISTIC
/begin AXIS_PTS cal_ACPTCPwrPreSetByEnv_2X "" 0x0000 /* @ECU_Address@cal_ACPTCPwrPreSetByEnv_2X@ */ ACCtl_tSetPointPTC Lookup2D_X_FLOAT32_IEEE 0 ME11_CM_single_C 10 -40.0 80.0 /end AXIS_PTS
/begin AXIS_PTS cal_ACPTCPwrPreSetByEnv_2Y "" 0x0000 /* @ECU_Address@cal_ACPTCPwrPreSetByEnv_2Y@ */ ACSen_sEnvTempCor Lookup2D_X_FLOAT32_IEEE 0 ME11_CM_single_C 10 -40.0 80.0 /end AXIS_PTS
/begin CHARACTERISTIC cal_ACInletEnvPrtSetCool_CUR "" CURVE 0x0000 /* @ECU_Address@cal_ACInletEnvPrtSetCool_CUR@ */ Lookup1D_UBYTE 0 ME11_CM_uint8_percent_ 0.0 100.0
 /begin AXIS_DESCR COM_AXIS ACSen_sEnvTempCor ME11_CM_single_C 5 -40.0 100.0 AXIS_PTS_REF cal_ACInletEnvPrtSetCool_1X /end AXIS_DESCR
/end CHARACTERISTIC
/begin AXIS_PTS cal_ACInletEnvPrtSetCool_1X "" 0x0000 /* @ECU_Address@cal_ACInletEnvPrtSetCool_1X@ */ ACSen_sEnvTempCor Lookup1D_X_FLOAT32_IEEE 0 ME11_CM_single_C 5 -40.0 100.0 /end AXIS_PTS
/begin CHARACTERISTIC cal_ACInletEnvPrtSetHeat_CUR "" CURVE 0x0000 /* @ECU_Address@cal_ACInletEnvPrtSetHeat_CUR@ */ Lookup1D_UBYTE 0 ME11_CM_uint8_percent_ 0.0 100.0
 /begin AXIS_DESCR COM_AXIS ACSen_sEnvTempCor ME11_CM_single_C 5 -40.0 100.0 AXIS_PTS_REF cal_ACInletEnvPrtSetHeat_1X /end AXIS_DESCR
/end CHARACTERISTIC
/begin AXIS_PTS cal_ACInletEnvPrtSetHeat_1X "" 0x0000 /* @ECU_Address@cal_ACInletEnvPrtSetHeat_1X@ */ ACSen_sEnvTempCor Lookup1D_X_FLOAT32_IEEE 0 ME11_CM_single_C 5 -40.0 100.0 /end AXIS_PTS
/begin CHARACTERISTIC cal_ACDrDVTSolarCor_MAP "" MAP 0x0000 /* @ECU_Address@cal_ACDrDVTSolarCor_MAP@ */ Lookup2D_FLOAT32_IEEE 0 ME11_CM_single_C -40.0 80.0
 /begin AXIS_DESCR COM_AXIS ACSen_sEnvTempCor ME11_CM_single_C 15 -40.0 80.0 AXIS_PTS_REF cal_ACDrDVTSolarCor_2Y /end AXIS_DESCR
 /begin AXIS_DESCR COM_AXIS GlbDa_LeftSolar ME11_CM_uint16_w_per_m_2 15 0.0 1300.0 AXIS_PTS_REF cal_ACDrDVTSolarCor_2X /end AXIS_DESCR
/end CHARACTERISTIC
/begin AXIS_PTS cal_ACDrDVTSolarCor_2X "" 0x0000 /* @ECU_Address@cal_ACDrDVTSolarCor_2X@ */ GlbDa_LeftSolar Lookup2D_X_UWORD 0 ME11_CM_uint16_w_per_m_2 15 0.0 1300.0 /end AXIS_PTS
/begin AXIS_PTS cal_ACDrDVTSolarCor_2Y "" 0x0000 /* @ECU_Address@cal_ACDrDVTSolarCor_2Y@ */ ACSen_sEnvTempCor Lookup2D_X_FLOAT32_IEEE 0 ME11_CM_single_C 15 -40.0 80.0 /end AXIS_PTS
/begin CHARACTERISTIC cal_ACPsDVTSetCorByEnv_MAP "" MAP 0x0000 /* @ECU_Address@cal_ACPsDVTSetCorByEnv_MAP@ */ Lookup2D_FLOAT32_IEEE 0 ME11_CM_single_C -40.0 100.0
 /begin AXIS_DESCR COM_AXIS ACSen_sEnvTempCor ME11_CM_single_C 14 -40.0 80.0 AXIS_PTS_REF cal_ACPsDVTSetCorByEnv_2Y /end AXIS_DESCR
 /begin AXIS_DESCR COM_AXIS AC_Ps2DrSetTempDvt ME11_CM_single_C 14 -40.0 100.0 AXIS_PTS_REF cal_ACPsDVTSetCorByEnv_2X /end AXIS_DESCR
/end CHARACTERISTIC
/begin AXIS_PTS cal_ACPsDVTSetCorByEnv_2X "" 0x0000 /* @ECU_Address@cal_ACPsDVTSetCorByEnv_2X@ */ AC_Ps2DrSetTempDvt Lookup2D_X_FLOAT32_IEEE 0 ME11_CM_single_C 14 -40.0 100.0 /end AXIS_PTS
/begin AXIS_PTS cal_ACPsDVTSetCorByEnv_2Y "" 0x0000 /* @ECU_Address@cal_ACPsDVTSetCorByEnv_2Y@ */ ACSen_sEnvTempCor Lookup2D_X_FLOAT32_IEEE 0 ME11_CM_single_C 14 -40.0 80.0 /end AXIS_PTS
/begin CHARACTERISTIC cal_ACPsDVTSolarCor_MAP "" MAP 0x0000 /* @ECU_Address@cal_ACPsDVTSolarCor_MAP@ */ Lookup2D_FLOAT32_IEEE 0 ME11_CM_single_C -40.0 100.0
 /begin AXIS_DESCR COM_AXIS ACSen_sEnvTempCor ME11_CM_single_C 15 -40.0 80.0 AXIS_PTS_REF cal_ACPsDVTSolarCor_2Y /end AXIS_DESCR
 /begin AXIS_DESCR COM_AXIS GlbDa_RightSolar ME11_CM_uint16_w_per_m_2 15 0.0 1300.0 AXIS_PTS_REF cal_ACPsDVTSolarCor_2X /end AXIS_DESCR
/end CHARACTERISTIC
/begin AXIS_PTS cal_ACPsDVTSolarCor_2X "" 0x0000 /* @ECU_Address@cal_ACPsDVTSolarCor_2X@ */ GlbDa_RightSolar Lookup2D_X_UWORD 0 ME11_CM_uint16_w_per_m_2 15 0.0 1300.0 /end AXIS_PTS
/begin AXIS_PTS cal_ACPsDVTSolarCor_2Y "" 0x0000 /* @ECU_Address@cal_ACPsDVTSolarCor_2Y@ */ ACSen_sEnvTempCor Lookup2D_X_FLOAT32_IEEE 0 ME11_CM_single_C 15 -40.0 80.0 /end AXIS_PTS
/begin CHARACTERISTIC cal_DrEvaDesValPIDLL_MAP "" MAP 0x0000 /* @ECU_Address@cal_DrEvaDesValPIDLL_MAP@ */ Lookup2D_FLOAT32_IEEE 0 ME11_CM_single_C -1.0 30.0
 /begin AXIS_DESCR COM_AXIS HMICtl_sLeftSetPoint ME11_CM_single_C 7 0.0 32.0 AXIS_PTS_REF cal_DrEvaDesValPIDLL_2Y /end AXIS_DESCR
 /begin AXIS_DESCR COM_AXIS NO_INPUT_QUANTITY ME11_CM_uint8_null 4 0.0 10.0 AXIS_PTS_REF cal_DrEvaDesValPIDLL_2X /end AXIS_DESCR
/end CHARACTERISTIC
/begin AXIS_PTS cal_DrEvaDesValPIDLL_2X "" 0x0000 /* @ECU_Address@cal_DrEvaDesValPIDLL_2X@ */ NO_INPUT_QUANTITY Lookup2D_X_UBYTE 0 ME11_CM_uint8_null 4 0.0 10.0 /end AXIS_PTS
/begin AXIS_PTS cal_DrEvaDesValPIDLL_2Y "" 0x0000 /* @ECU_Address@cal_DrEvaDesValPIDLL_2Y@ */ HMICtl_sLeftSetPoint Lookup2D_X_FLOAT32_IEEE 0 ME11_CM_single_C 7 0.0 32.0 /end AXIS_PTS
/begin CHARACTERISTIC cal_PsEvaDesValPIDLL_MAP "" MAP 0x0000 /* @ECU_Address@cal_PsEvaDesValPIDLL_MAP@ */ Lookup2D_FLOAT32_IEEE 0 ME11_CM_single_C -1.0 30.0
 /begin AXIS_DESCR COM_AXIS HMICtl_sLeftSetPoint ME11_CM_single_C 7 0.0 32.0 AXIS_PTS_REF cal_PsEvaDesValPIDLL_2Y /end AXIS_DESCR
 /begin AXIS_DESCR COM_AXIS NO_INPUT_QUANTITY ME11_CM_uint8_null 4 0.0 10.0 AXIS_PTS_REF cal_PsEvaDesValPIDLL_2X /end AXIS_DESCR
/end CHARACTERISTIC
/begin AXIS_PTS cal_PsEvaDesValPIDLL_2X "" 0x0000 /* @ECU_Address@cal_PsEvaDesValPIDLL_2X@ */ NO_INPUT_QUANTITY Lookup2D_X_UBYTE 0 ME11_CM_uint8_null 4 0.0 10.0 /end AXIS_PTS
/begin AXIS_PTS cal_PsEvaDesValPIDLL_2Y "" 0x0000 /* @ECU_Address@cal_PsEvaDesValPIDLL_2Y@ */ HMICtl_sLeftSetPoint Lookup2D_X_FLOAT32_IEEE 0 ME11_CM_single_C 7 0.0 32.0 /end AXIS_PTS
/begin CHARACTERISTIC cal_EvapDesLoLimByEnv_CUR "" CURVE 0x0000 /* @ECU_Address@cal_EvapDesLoLimByEnv_CUR@ */ Lookup1D_FLOAT32_IEEE 0 ME11_CM_single_C -40.0 80.0
 /begin AXIS_DESCR COM_AXIS ACSen_sEnvTempCor ME11_CM_single_C 8 -40.0 80.0 AXIS_PTS_REF cal_EvapDesLoLimByEnv_1X /end AXIS_DESCR
/end CHARACTERISTIC
/begin AXIS_PTS cal_EvapDesLoLimByEnv_1X "" 0x0000 /* @ECU_Address@cal_EvapDesLoLimByEnv_1X@ */ ACSen_sEnvTempCor Lookup1D_X_FLOAT32_IEEE 0 ME11_CM_single_C 8 -40.0 80.0 /end AXIS_PTS
/begin CHARACTERISTIC cal_EvapDesLoLimBySolarCor_CUR "" CURVE 0x0000 /* @ECU_Address@cal_EvapDesLoLimBySolarCor_CUR@ */ Lookup1D_FLOAT32_IEEE 0 ME11_CM_single_C -40.0 80.0
 /begin AXIS_DESCR COM_AXIS GlbDa_Solar ME11_CM_uint16_w_per_m_2 2 0.0 1300.0 AXIS_PTS_REF cal_EvapDesLoLimBySolarCor_1X /end AXIS_DESCR
/end CHARACTERISTIC
/begin AXIS_PTS cal_EvapDesLoLimBySolarCor_1X "" 0x0000 /* @ECU_Address@cal_EvapDesLoLimBySolarCor_1X@ */ GlbDa_Solar Lookup1D_X_UWORD 0 ME11_CM_uint16_w_per_m_2 2 0.0 1300.0 /end AXIS_PTS
/begin CHARACTERISTIC cal_DrMixBacSetDefog_CUR "" CURVE 0x0000 /* @ECU_Address@cal_DrMixBacSetDefog_CUR@ */ Lookup1D_FLOAT32_IEEE 0 ME11_CM_single_percent_ -100.0 100.0
 /begin AXIS_DESCR COM_AXIS ACCtl_tDrDVT ME11_CM_single_C 8 -40.0 80.0 AXIS_PTS_REF cal_DrMixBacSetDefog_1X /end AXIS_DESCR
/end CHARACTERISTIC
/begin AXIS_PTS cal_DrMixBacSetDefog_1X "" 0x0000 /* @ECU_Address@cal_DrMixBacSetDefog_1X@ */ ACCtl_tDrDVT Lookup1D_X_FLOAT32_IEEE 0 ME11_CM_single_C 8 -40.0 80.0 /end AXIS_PTS
/begin CHARACTERISTIC cal_DrMixBacSetFaceHeater_CUR "" CURVE 0x0000 /* @ECU_Address@cal_DrMixBacSetFaceHeater_CUR@ */ Lookup1D_FLOAT32_IEEE 0 ME11_CM_single_percent_ -100.0 100.0
 /begin AXIS_DESCR COM_AXIS ACCtl_tDrDVT ME11_CM_single_C 8 -40.0 80.0 AXIS_PTS_REF cal_DrMixBacSetFaceHeater_1X /end AXIS_DESCR
/end CHARACTERISTIC
/begin AXIS_PTS cal_DrMixBacSetFaceHeater_1X "" 0x0000 /* @ECU_Address@cal_DrMixBacSetFaceHeater_1X@ */ ACCtl_tDrDVT Lookup1D_X_FLOAT32_IEEE 0 ME11_CM_single_C 8 -40.0 80.0 /end AXIS_PTS
/begin CHARACTERISTIC cal_DrMixBacSetFace_CUR "" CURVE 0x0000 /* @ECU_Address@cal_DrMixBacSetFace_CUR@ */ Lookup1D_FLOAT32_IEEE 0 ME11_CM_single_percent_ -100.0 100.0
 /begin AXIS_DESCR COM_AXIS ACCtl_tDrDVT ME11_CM_single_C 8 -40.0 80.0 AXIS_PTS_REF cal_DrMixBacSetFace_1X /end AXIS_DESCR
/end CHARACTERISTIC
/begin AXIS_PTS cal_DrMixBacSetFace_1X "" 0x0000 /* @ECU_Address@cal_DrMixBacSetFace_1X@ */ ACCtl_tDrDVT Lookup1D_X_FLOAT32_IEEE 0 ME11_CM_single_C 8 -40.0 80.0 /end AXIS_PTS
/begin CHARACTERISTIC cal_DrMixBacSetHeaterDeforst_CUR "" CURVE 0x0000 /* @ECU_Address@cal_DrMixBacSetHeaterDeforst_CUR@ */ Lookup1D_FLOAT32_IEEE 0 ME11_CM_single_percent_ -100.0 100.0
 /begin AXIS_DESCR COM_AXIS ACCtl_tDrDVT ME11_CM_single_C 8 -40.0 80.0 AXIS_PTS_REF cal_DrMixBacSetHeaterDeforst_1X /end AXIS_DESCR
/end CHARACTERISTIC
/begin AXIS_PTS cal_DrMixBacSetHeaterDeforst_1X "" 0x0000 /* @ECU_Address@cal_DrMixBacSetHeaterDeforst_1X@ */ ACCtl_tDrDVT Lookup1D_X_FLOAT32_IEEE 0 ME11_CM_single_C 8 -40.0 80.0 /end AXIS_PTS
/begin CHARACTERISTIC cal_DrMixBacSetHeater_CUR "" CURVE 0x0000 /* @ECU_Address@cal_DrMixBacSetHeater_CUR@ */ Lookup1D_FLOAT32_IEEE 0 ME11_CM_single_percent_ -100.0 100.0
 /begin AXIS_DESCR COM_AXIS ACCtl_tDrDVT ME11_CM_single_C 8 -40.0 80.0 AXIS_PTS_REF cal_DrMixBacSetHeater_1X /end AXIS_DESCR
/end CHARACTERISTIC
/begin AXIS_PTS cal_DrMixBacSetHeater_1X "" 0x0000 /* @ECU_Address@cal_DrMixBacSetHeater_1X@ */ ACCtl_tDrDVT Lookup1D_X_FLOAT32_IEEE 0 ME11_CM_single_C 8 -40.0 80.0 /end AXIS_PTS
/begin CHARACTERISTIC cal_MixDoorClsFF_CUR "" CURVE 0x0000 /* @ECU_Address@cal_MixDoorClsFF_CUR@ */ Lookup1D_FLOAT32_IEEE 0 ME11_CM_single_percent_ 0.0 100.0
 /begin AXIS_DESCR COM_AXIS NO_INPUT_QUANTITY ME11_CM_single_C 8 -40.0 100.0 AXIS_PTS_REF cal_MixDoorClsFF_1X /end AXIS_DESCR
/end CHARACTERISTIC
/begin AXIS_PTS cal_MixDoorClsFF_1X "" 0x0000 /* @ECU_Address@cal_MixDoorClsFF_1X@ */ NO_INPUT_QUANTITY Lookup1D_X_FLOAT32_IEEE 0 ME11_CM_single_C 8 -40.0 100.0 /end AXIS_PTS
/begin CHARACTERISTIC cal_MixDoorKi_CUR "" CURVE 0x0000 /* @ECU_Address@cal_MixDoorKi_CUR@ */ Lookup1D_FLOAT32_IEEE 0 ME11_CM_single_percent_ 0.0 100.0
 /begin AXIS_DESCR COM_AXIS NO_INPUT_QUANTITY ME11_CM_single_C 8 -40.0 100.0 AXIS_PTS_REF cal_MixDoorKi_1X /end AXIS_DESCR
/end CHARACTERISTIC
/begin AXIS_PTS cal_MixDoorKi_1X "" 0x0000 /* @ECU_Address@cal_MixDoorKi_1X@ */ NO_INPUT_QUANTITY Lookup1D_X_FLOAT32_IEEE 0 ME11_CM_single_C 8 -40.0 100.0 /end AXIS_PTS
/begin CHARACTERISTIC cal_MixDoorKp_CUR "" CURVE 0x0000 /* @ECU_Address@cal_MixDoorKp_CUR@ */ Lookup1D_FLOAT32_IEEE 0 ME11_CM_single_percent_ 0.0 100.0
 /begin AXIS_DESCR COM_AXIS NO_INPUT_QUANTITY ME11_CM_single_C 8 -40.0 100.0 AXIS_PTS_REF cal_MixDoorKp_1X /end AXIS_DESCR
/end CHARACTERISTIC
/begin AXIS_PTS cal_MixDoorKp_1X "" 0x0000 /* @ECU_Address@cal_MixDoorKp_1X@ */ NO_INPUT_QUANTITY Lookup1D_X_FLOAT32_IEEE 0 ME11_CM_single_C 8 -40.0 100.0 /end AXIS_PTS
/begin CHARACTERISTIC cal_PsMixBacSetAC_CUR "" CURVE 0x0000 /* @ECU_Address@cal_PsMixBacSetAC_CUR@ */ Lookup1D_FLOAT32_IEEE 0 ME11_CM_single_percent_ -100.0 100.0
 /begin AXIS_DESCR COM_AXIS ACCtl_tPsDVT ME11_CM_single_C 8 -40.0 80.0 AXIS_PTS_REF cal_PsMixBacSetAC_1X /end AXIS_DESCR
/end CHARACTERISTIC
/begin AXIS_PTS cal_PsMixBacSetAC_1X "" 0x0000 /* @ECU_Address@cal_PsMixBacSetAC_1X@ */ ACCtl_tPsDVT Lookup1D_X_FLOAT32_IEEE 0 ME11_CM_single_C 8 -40.0 80.0 /end AXIS_PTS
/begin CHARACTERISTIC cal_PsMixBacSetBi_CUR "" CURVE 0x0000 /* @ECU_Address@cal_PsMixBacSetBi_CUR@ */ Lookup1D_FLOAT32_IEEE 0 ME11_CM_single_percent_ -100.0 100.0
 /begin AXIS_DESCR COM_AXIS ACCtl_tPsDVT ME11_CM_single_C 8 -40.0 80.0 AXIS_PTS_REF cal_PsMixBacSetBi_1X /end AXIS_DESCR
/end CHARACTERISTIC
/begin AXIS_PTS cal_PsMixBacSetBi_1X "" 0x0000 /* @ECU_Address@cal_PsMixBacSetBi_1X@ */ ACCtl_tPsDVT Lookup1D_X_FLOAT32_IEEE 0 ME11_CM_single_C 8 -40.0 80.0 /end AXIS_PTS
/begin CHARACTERISTIC cal_PsMixBacSetDefog_CUR "" CURVE 0x0000 /* @ECU_Address@cal_PsMixBacSetDefog_CUR@ */ Lookup1D_FLOAT32_IEEE 0 ME11_CM_single_percent_ -100.0 100.0
 /begin AXIS_DESCR COM_AXIS ACCtl_tPsDVT ME11_CM_single_C 8 -40.0 80.0 AXIS_PTS_REF cal_PsMixBacSetDefog_1X /end AXIS_DESCR
/end CHARACTERISTIC
/begin AXIS_PTS cal_PsMixBacSetDefog_1X "" 0x0000 /* @ECU_Address@cal_PsMixBacSetDefog_1X@ */ ACCtl_tPsDVT Lookup1D_X_FLOAT32_IEEE 0 ME11_CM_single_C 8 -40.0 80.0 /end AXIS_PTS
/begin CHARACTERISTIC cal_PsMixBacSetFootDe_CUR "" CURVE 0x0000 /* @ECU_Address@cal_PsMixBacSetFootDe_CUR@ */ Lookup1D_FLOAT32_IEEE 0 ME11_CM_single_percent_ -100.0 100.0
 /begin AXIS_DESCR COM_AXIS ACCtl_tPsDVT ME11_CM_single_C 8 -40.0 80.0 AXIS_PTS_REF cal_PsMixBacSetFootDe_1X /end AXIS_DESCR
/end CHARACTERISTIC
/begin AXIS_PTS cal_PsMixBacSetFootDe_1X "" 0x0000 /* @ECU_Address@cal_PsMixBacSetFootDe_1X@ */ ACCtl_tPsDVT Lookup1D_X_FLOAT32_IEEE 0 ME11_CM_single_C 8 -40.0 80.0 /end AXIS_PTS
/begin CHARACTERISTIC cal_PsMixBacSetFoot_CUR "" CURVE 0x0000 /* @ECU_Address@cal_PsMixBacSetFoot_CUR@ */ Lookup1D_FLOAT32_IEEE 0 ME11_CM_single_percent_ -100.0 100.0
 /begin AXIS_DESCR COM_AXIS ACCtl_tPsDVT ME11_CM_single_C 8 -40.0 80.0 AXIS_PTS_REF cal_PsMixBacSetFoot_1X /end AXIS_DESCR
/end CHARACTERISTIC
/begin AXIS_PTS cal_PsMixBacSetFoot_1X "" 0x0000 /* @ECU_Address@cal_PsMixBacSetFoot_1X@ */ ACCtl_tPsDVT Lookup1D_X_FLOAT32_IEEE 0 ME11_CM_single_C 8 -40.0 80.0 /end AXIS_PTS
/begin CHARACTERISTIC cal_BetwT1AndT2DownMCV_CUR "" CURVE 0x0000 /* @ECU_Address@cal_BetwT1AndT2DownMCV_CUR@ */ Lookup1D_UBYTE 0 ME11_CM_uint8_percent_ 0.0 40.0
 /begin AXIS_DESCR COM_AXIS NO_INPUT_QUANTITY ME11_CM_single_C 6 -10.0 50.0 AXIS_PTS_REF cal_BetwT1AndT2DownMCV_1X /end AXIS_DESCR
/end CHARACTERISTIC
/begin AXIS_PTS cal_BetwT1AndT2DownMCV_1X "" 0x0000 /* @ECU_Address@cal_BetwT1AndT2DownMCV_1X@ */ NO_INPUT_QUANTITY Lookup1D_X_FLOAT32_IEEE 0 ME11_CM_single_C 6 -10.0 50.0 /end AXIS_PTS
/begin CHARACTERISTIC cal_BetwT1AndT2StbyMCV_CUR "" CURVE 0x0000 /* @ECU_Address@cal_BetwT1AndT2StbyMCV_CUR@ */ Lookup1D_UBYTE 0 ME11_CM_uint8_percent_ 0.0 40.0
 /begin AXIS_DESCR COM_AXIS NO_INPUT_QUANTITY ME11_CM_single_C 6 -10.0 50.0 AXIS_PTS_REF cal_BetwT1AndT2StbyMCV_1X /end AXIS_DESCR
/end CHARACTERISTIC
/begin AXIS_PTS cal_BetwT1AndT2StbyMCV_1X "" 0x0000 /* @ECU_Address@cal_BetwT1AndT2StbyMCV_1X@ */ NO_INPUT_QUANTITY Lookup1D_X_FLOAT32_IEEE 0 ME11_CM_single_C 6 -10.0 50.0 /end AXIS_PTS
/begin CHARACTERISTIC cal_BetwT1AndT2UpMCV_CUR "" CURVE 0x0000 /* @ECU_Address@cal_BetwT1AndT2UpMCV_CUR@ */ Lookup1D_UBYTE 0 ME11_CM_uint8_percent_ 0.0 40.0
 /begin AXIS_DESCR COM_AXIS NO_INPUT_QUANTITY ME11_CM_single_C 6 -10.0 50.0 AXIS_PTS_REF cal_BetwT1AndT2UpMCV_1X /end AXIS_DESCR
/end CHARACTERISTIC
/begin AXIS_PTS cal_BetwT1AndT2UpMCV_1X "" 0x0000 /* @ECU_Address@cal_BetwT1AndT2UpMCV_1X@ */ NO_INPUT_QUANTITY Lookup1D_X_FLOAT32_IEEE 0 ME11_CM_single_C 6 -10.0 50.0 /end AXIS_PTS
/begin CHARACTERISTIC cal_LTT1DownMCV_CUR "" CURVE 0x0000 /* @ECU_Address@cal_LTT1DownMCV_CUR@ */ Lookup1D_UBYTE 0 ME11_CM_uint8_percent_ 0.0 40.0
 /begin AXIS_DESCR COM_AXIS BMS_InletCooltActlTemp ME11_CM_single_C 5 0.0 50.0 AXIS_PTS_REF cal_LTT1DownMCV_1X /end AXIS_DESCR
/end CHARACTERISTIC
/begin AXIS_PTS cal_LTT1DownMCV_1X "" 0x0000 /* @ECU_Address@cal_LTT1DownMCV_1X@ */ BMS_InletCooltActlTemp Lookup1D_X_FLOAT32_IEEE 0 ME11_CM_single_C 5 0.0 50.0 /end AXIS_PTS
/begin CHARACTERISTIC cal_LTT1StbyMCV_CUR "" CURVE 0x0000 /* @ECU_Address@cal_LTT1StbyMCV_CUR@ */ Lookup1D_UBYTE 0 ME11_CM_uint8_percent_ 0.0 40.0
 /begin AXIS_DESCR COM_AXIS BMS_InletCooltActlTemp ME11_CM_single_C 6 0.0 50.0 AXIS_PTS_REF cal_LTT1StbyMCV_1X /end AXIS_DESCR
/end CHARACTERISTIC
/begin AXIS_PTS cal_LTT1StbyMCV_1X "" 0x0000 /* @ECU_Address@cal_LTT1StbyMCV_1X@ */ BMS_InletCooltActlTemp Lookup1D_X_FLOAT32_IEEE 0 ME11_CM_single_C 6 0.0 50.0 /end AXIS_PTS
/begin CHARACTERISTIC cal_LTT1UpMCV_CUR "" CURVE 0x0000 /* @ECU_Address@cal_LTT1UpMCV_CUR@ */ Lookup1D_UBYTE 0 ME11_CM_uint8_percent_ 0.0 40.0
 /begin AXIS_DESCR COM_AXIS BMS_InletCooltActlTemp ME11_CM_single_C 5 0.0 50.0 AXIS_PTS_REF cal_LTT1UpMCV_1X /end AXIS_DESCR
/end CHARACTERISTIC
/begin AXIS_PTS cal_LTT1UpMCV_1X "" 0x0000 /* @ECU_Address@cal_LTT1UpMCV_1X@ */ BMS_InletCooltActlTemp Lookup1D_X_FLOAT32_IEEE 0 ME11_CM_single_C 5 0.0 50.0 /end AXIS_PTS
/begin CHARACTERISTIC cal_AEXVCtrlBCabinCoolPIMin_CUR "" CURVE 0x0000 /* @ECU_Address@cal_AEXVCtrlBCabinCoolPIMin_CUR@ */ Lookup1D_FLOAT32_IEEE 0 ME11_CM_single_percent_ 0.0 100.0
 /begin AXIS_DESCR COM_AXIS COMP_EcompActSpd ME11_CM_single_rpm 6 0.0 8000.0 AXIS_PTS_REF cal_AEXVCtrlBCabinCoolPIMin_1X /end AXIS_DESCR
/end CHARACTERISTIC
/begin AXIS_PTS cal_AEXVCtrlBCabinCoolPIMin_1X "" 0x0000 /* @ECU_Address@cal_AEXVCtrlBCabinCoolPIMin_1X@ */ COMP_EcompActSpd Lookup1D_X_FLOAT32_IEEE 0 ME11_CM_single_rpm 6 0.0 8000.0 /end AXIS_PTS
/begin CHARACTERISTIC cal_AEXVCtrlBDCoolPIMin_CUR "" CURVE 0x0000 /* @ECU_Address@cal_AEXVCtrlBDCoolPIMin_CUR@ */ Lookup1D_FLOAT32_IEEE 0 ME11_CM_single_percent_ 0.0 100.0
 /begin AXIS_DESCR COM_AXIS COMP_EcompActSpd ME11_CM_single_rpm 6 0.0 8000.0 AXIS_PTS_REF cal_AEXVCtrlBDCoolPIMin_1X /end AXIS_DESCR
/end CHARACTERISTIC
/begin AXIS_PTS cal_AEXVCtrlBDCoolPIMin_1X "" 0x0000 /* @ECU_Address@cal_AEXVCtrlBDCoolPIMin_1X@ */ COMP_EcompActSpd Lookup1D_X_FLOAT32_IEEE 0 ME11_CM_single_rpm 6 0.0 8000.0 /end AXIS_PTS
/begin CHARACTERISTIC cal_AEXVCtrlBFF_CUR "" CURVE 0x0000 /* @ECU_Address@cal_AEXVCtrlBFF_CUR@ */ Lookup1D_FLOAT32_IEEE 0 ME11_CM_single_percent_ 0.0 100.0
 /begin AXIS_DESCR COM_AXIS ACTCtl_sACCMCtlSpd ME11_CM_single_rpm 5 0.0 10000.0 AXIS_PTS_REF cal_AEXVCtrlBFF_1X /end AXIS_DESCR
/end CHARACTERISTIC
/begin AXIS_PTS cal_AEXVCtrlBFF_1X "" 0x0000 /* @ECU_Address@cal_AEXVCtrlBFF_1X@ */ ACTCtl_sACCMCtlSpd Lookup1D_X_FLOAT32_IEEE 0 ME11_CM_single_rpm 5 0.0 10000.0 /end AXIS_PTS
/begin CHARACTERISTIC cal_AEXVCtrlBKi_CUR "" CURVE 0x0000 /* @ECU_Address@cal_AEXVCtrlBKi_CUR@ */ Lookup1D_FLOAT32_IEEE 0 ME11_CM_single_null 0.0 10.0
 /begin AXIS_DESCR COM_AXIS ACTCtl_sCondDepDiff ME11_CM_single_C 8 -100.0 100.0 AXIS_PTS_REF cal_AEXVCtrlBKi_1X /end AXIS_DESCR
/end CHARACTERISTIC
/begin AXIS_PTS cal_AEXVCtrlBKi_1X "" 0x0000 /* @ECU_Address@cal_AEXVCtrlBKi_1X@ */ ACTCtl_sCondDepDiff Lookup1D_X_FLOAT32_IEEE 0 ME11_CM_single_C 8 -100.0 100.0 /end AXIS_PTS
/begin CHARACTERISTIC cal_AEXVCtrlBKp_CUR "" CURVE 0x0000 /* @ECU_Address@cal_AEXVCtrlBKp_CUR@ */ Lookup1D_FLOAT32_IEEE 0 ME11_CM_single_null 0.0 100.0
 /begin AXIS_DESCR COM_AXIS ACTCtl_sCondDepDiff ME11_CM_single_C 8 -100.0 100.0 AXIS_PTS_REF cal_AEXVCtrlBKp_1X /end AXIS_DESCR
/end CHARACTERISTIC
/begin AXIS_PTS cal_AEXVCtrlBKp_1X "" 0x0000 /* @ECU_Address@cal_AEXVCtrlBKp_1X@ */ ACTCtl_sCondDepDiff Lookup1D_X_FLOAT32_IEEE 0 ME11_CM_single_C 8 -100.0 100.0 /end AXIS_PTS
/begin CHARACTERISTIC cal_AEXVCtrlBTrgSubCoolCOMPSpd_CUR "" CURVE 0x0000 /* @ECU_Address@cal_AEXVCtrlBTrgSubCoolCOMPSpd_CUR@ */ Lookup1D_FLOAT32_IEEE 0 ME11_CM_single_C 0.0 20.0
 /begin AXIS_DESCR COM_AXIS COMP_EcompActSpd ME11_CM_single_rpm 9 0.0 100000.0 AXIS_PTS_REF cal_AEXVCtrlBTrgSubCoolCOMPSpd_1X /end AXIS_DESCR
/end CHARACTERISTIC
/begin AXIS_PTS cal_AEXVCtrlBTrgSubCoolCOMPSpd_1X "" 0x0000 /* @ECU_Address@cal_AEXVCtrlBTrgSubCoolCOMPSpd_1X@ */ COMP_EcompActSpd Lookup1D_X_FLOAT32_IEEE 0 ME11_CM_single_rpm 9 0.0 100000.0 /end AXIS_PTS
/begin CHARACTERISTIC cal_AEXVCtrlBTrgSubCool_CUR "" CURVE 0x0000 /* @ECU_Address@cal_AEXVCtrlBTrgSubCool_CUR@ */ Lookup1D_FLOAT32_IEEE 0 ME11_CM_single_C 0.0 20.0
 /begin AXIS_DESCR COM_AXIS ACSen_sEnvTempCor ME11_CM_single_C 9 0.0 70.0 AXIS_PTS_REF cal_AEXVCtrlBTrgSubCool_1X /end AXIS_DESCR
/end CHARACTERISTIC
/begin AXIS_PTS cal_AEXVCtrlBTrgSubCool_1X "" 0x0000 /* @ECU_Address@cal_AEXVCtrlBTrgSubCool_1X@ */ ACSen_sEnvTempCor Lookup1D_X_FLOAT32_IEEE 0 ME11_CM_single_C 9 0.0 70.0 /end AXIS_PTS
/begin CHARACTERISTIC cal_AEXVCtrlCFF_CUR "" CURVE 0x0000 /* @ECU_Address@cal_AEXVCtrlCFF_CUR@ */ Lookup1D_FLOAT32_IEEE 0 ME11_CM_single_percent_ 0.0 100.0
 /begin AXIS_DESCR COM_AXIS ACTCtl_sACCMCtlSpd ME11_CM_single_rpm 5 0.0 10000.0 AXIS_PTS_REF cal_AEXVCtrlCFF_1X /end AXIS_DESCR
/end CHARACTERISTIC
/begin AXIS_PTS cal_AEXVCtrlCFF_1X "" 0x0000 /* @ECU_Address@cal_AEXVCtrlCFF_1X@ */ ACTCtl_sACCMCtlSpd Lookup1D_X_FLOAT32_IEEE 0 ME11_CM_single_rpm 5 0.0 10000.0 /end AXIS_PTS
/begin CHARACTERISTIC cal_AEXVCtrlCKi_CUR "" CURVE 0x0000 /* @ECU_Address@cal_AEXVCtrlCKi_CUR@ */ Lookup1D_FLOAT32_IEEE 0 ME11_CM_single_null 0.0 10.0
 /begin AXIS_DESCR COM_AXIS NO_INPUT_QUANTITY ME11_CM_single_C 7 -40.0 100.0 AXIS_PTS_REF cal_AEXVCtrlCKi_1X /end AXIS_DESCR
/end CHARACTERISTIC
/begin AXIS_PTS cal_AEXVCtrlCKi_1X "" 0x0000 /* @ECU_Address@cal_AEXVCtrlCKi_1X@ */ NO_INPUT_QUANTITY Lookup1D_X_FLOAT32_IEEE 0 ME11_CM_single_C 7 -40.0 100.0 /end AXIS_PTS
/begin CHARACTERISTIC cal_AEXVCtrlCKp_CUR "" CURVE 0x0000 /* @ECU_Address@cal_AEXVCtrlCKp_CUR@ */ Lookup1D_FLOAT32_IEEE 0 ME11_CM_single_null 0.0 100.0
 /begin AXIS_DESCR COM_AXIS NO_INPUT_QUANTITY ME11_CM_single_C 7 -40.0 100.0 AXIS_PTS_REF cal_AEXVCtrlCKp_1X /end AXIS_DESCR
/end CHARACTERISTIC
/begin AXIS_PTS cal_AEXVCtrlCKp_1X "" 0x0000 /* @ECU_Address@cal_AEXVCtrlCKp_1X@ */ NO_INPUT_QUANTITY Lookup1D_X_FLOAT32_IEEE 0 ME11_CM_single_C 7 -40.0 100.0 /end AXIS_PTS
/begin CHARACTERISTIC cal_AEXVCtrlCTrgtSuperHeat_CUR "" CURVE 0x0000 /* @ECU_Address@cal_AEXVCtrlCTrgtSuperHeat_CUR@ */ Lookup1D_FLOAT32_IEEE 0 ME11_CM_single_C 0.0 100.0
 /begin AXIS_DESCR COM_AXIS ACSen_sEnvTempCor ME11_CM_single_C 7 -40.0 100.0 AXIS_PTS_REF cal_AEXVCtrlCTrgtSuperHeat_1X /end AXIS_DESCR
/end CHARACTERISTIC
/begin AXIS_PTS cal_AEXVCtrlCTrgtSuperHeat_1X "" 0x0000 /* @ECU_Address@cal_AEXVCtrlCTrgtSuperHeat_1X@ */ ACSen_sEnvTempCor Lookup1D_X_FLOAT32_IEEE 0 ME11_CM_single_C 7 -40.0 100.0 /end AXIS_PTS
/begin CHARACTERISTIC cal_AEXVCtrlDFF_CUR "" CURVE 0x0000 /* @ECU_Address@cal_AEXVCtrlDFF_CUR@ */ Lookup1D_FLOAT32_IEEE 0 ME11_CM_single_percent_ 0.0 100.0
 /begin AXIS_DESCR COM_AXIS ACTCtl_sACCMCtlSpd ME11_CM_single_rpm 5 0.0 10000.0 AXIS_PTS_REF cal_AEXVCtrlDFF_1X /end AXIS_DESCR
/end CHARACTERISTIC
/begin AXIS_PTS cal_AEXVCtrlDFF_1X "" 0x0000 /* @ECU_Address@cal_AEXVCtrlDFF_1X@ */ ACTCtl_sACCMCtlSpd Lookup1D_X_FLOAT32_IEEE 0 ME11_CM_single_rpm 5 0.0 10000.0 /end AXIS_PTS
/begin CHARACTERISTIC cal_AEXVCtrlDKi_CUR "" CURVE 0x0000 /* @ECU_Address@cal_AEXVCtrlDKi_CUR@ */ Lookup1D_FLOAT32_IEEE 0 ME11_CM_single_null 0.0 10.0
 /begin AXIS_DESCR COM_AXIS NO_INPUT_QUANTITY ME11_CM_single_C 8 -50.0 50.0 AXIS_PTS_REF cal_AEXVCtrlDKi_1X /end AXIS_DESCR
/end CHARACTERISTIC
/begin AXIS_PTS cal_AEXVCtrlDKi_1X "" 0x0000 /* @ECU_Address@cal_AEXVCtrlDKi_1X@ */ NO_INPUT_QUANTITY Lookup1D_X_FLOAT32_IEEE 0 ME11_CM_single_C 8 -50.0 50.0 /end AXIS_PTS
/begin CHARACTERISTIC cal_AEXVCtrlDKp_CUR "" CURVE 0x0000 /* @ECU_Address@cal_AEXVCtrlDKp_CUR@ */ Lookup1D_FLOAT32_IEEE 0 ME11_CM_single_null 0.0 100.0
 /begin AXIS_DESCR COM_AXIS NO_INPUT_QUANTITY ME11_CM_single_C 8 -50.0 50.0 AXIS_PTS_REF cal_AEXVCtrlDKp_1X /end AXIS_DESCR
/end CHARACTERISTIC
/begin AXIS_PTS cal_AEXVCtrlDKp_1X "" 0x0000 /* @ECU_Address@cal_AEXVCtrlDKp_1X@ */ NO_INPUT_QUANTITY Lookup1D_X_FLOAT32_IEEE 0 ME11_CM_single_C 8 -50.0 50.0 /end AXIS_PTS
/begin CHARACTERISTIC cal_AEXVCtrlDTrg_CUR "" CURVE 0x0000 /* @ECU_Address@cal_AEXVCtrlDTrg_CUR@ */ Lookup1D_FLOAT32_IEEE 0 ME11_CM_single_C -2.0 20.0
 /begin AXIS_DESCR COM_AXIS ACSen_sEnvTempCor ME11_CM_single_C 3 -10.0 40.0 AXIS_PTS_REF cal_AEXVCtrlDTrg_1X /end AXIS_DESCR
/end CHARACTERISTIC
/begin AXIS_PTS cal_AEXVCtrlDTrg_1X "" 0x0000 /* @ECU_Address@cal_AEXVCtrlDTrg_1X@ */ ACSen_sEnvTempCor Lookup1D_X_FLOAT32_IEEE 0 ME11_CM_single_C 3 -10.0 40.0 /end AXIS_PTS
/begin CHARACTERISTIC cal_BEXVCtrlBDCoolPIMin_CUR "" CURVE 0x0000 /* @ECU_Address@cal_BEXVCtrlBDCoolPIMin_CUR@ */ Lookup1D_FLOAT32_IEEE 0 ME11_CM_single_percent_ 0.0 100.0
 /begin AXIS_DESCR COM_AXIS COMP_EcompActSpd ME11_CM_single_rpm 6 0.0 8000.0 AXIS_PTS_REF cal_BEXVCtrlBDCoolPIMin_1X /end AXIS_DESCR
/end CHARACTERISTIC
/begin AXIS_PTS cal_BEXVCtrlBDCoolPIMin_1X "" 0x0000 /* @ECU_Address@cal_BEXVCtrlBDCoolPIMin_1X@ */ COMP_EcompActSpd Lookup1D_X_FLOAT32_IEEE 0 ME11_CM_single_rpm 6 0.0 8000.0 /end AXIS_PTS
/begin CHARACTERISTIC cal_BEXVCtrlBFF_CUR "" CURVE 0x0000 /* @ECU_Address@cal_BEXVCtrlBFF_CUR@ */ Lookup1D_FLOAT32_IEEE 0 ME11_CM_single_percent_ 0.0 100.0
 /begin AXIS_DESCR COM_AXIS ACTCtl_sACCMCtlSpd ME11_CM_single_rpm 5 0.0 8000.0 AXIS_PTS_REF cal_BEXVCtrlBFF_1X /end AXIS_DESCR
/end CHARACTERISTIC
/begin AXIS_PTS cal_BEXVCtrlBFF_1X "" 0x0000 /* @ECU_Address@cal_BEXVCtrlBFF_1X@ */ ACTCtl_sACCMCtlSpd Lookup1D_X_FLOAT32_IEEE 0 ME11_CM_single_rpm 5 0.0 8000.0 /end AXIS_PTS
/begin CHARACTERISTIC cal_BEXVCtrlBKi_CUR "" CURVE 0x0000 /* @ECU_Address@cal_BEXVCtrlBKi_CUR@ */ Lookup1D_FLOAT32_IEEE 0 ME11_CM_single_null 0.0 10.0
 /begin AXIS_DESCR COM_AXIS NO_INPUT_QUANTITY ME11_CM_single_C 7 -40.0 100.0 AXIS_PTS_REF cal_BEXVCtrlBKi_1X /end AXIS_DESCR
/end CHARACTERISTIC
/begin AXIS_PTS cal_BEXVCtrlBKi_1X "" 0x0000 /* @ECU_Address@cal_BEXVCtrlBKi_1X@ */ NO_INPUT_QUANTITY Lookup1D_X_FLOAT32_IEEE 0 ME11_CM_single_C 7 -40.0 100.0 /end AXIS_PTS
/begin CHARACTERISTIC cal_BEXVCtrlBKp_CUR "" CURVE 0x0000 /* @ECU_Address@cal_BEXVCtrlBKp_CUR@ */ Lookup1D_FLOAT32_IEEE 0 ME11_CM_single_null 0.0 100.0
 /begin AXIS_DESCR COM_AXIS NO_INPUT_QUANTITY ME11_CM_single_C 7 -40.0 100.0 AXIS_PTS_REF cal_BEXVCtrlBKp_1X /end AXIS_DESCR
/end CHARACTERISTIC
/begin AXIS_PTS cal_BEXVCtrlBKp_1X "" 0x0000 /* @ECU_Address@cal_BEXVCtrlBKp_1X@ */ NO_INPUT_QUANTITY Lookup1D_X_FLOAT32_IEEE 0 ME11_CM_single_C 7 -40.0 100.0 /end AXIS_PTS
/begin CHARACTERISTIC cal_BEXVCtrlBTrgCabinComp_CUR "" CURVE 0x0000 /* @ECU_Address@cal_BEXVCtrlBTrgCabinComp_CUR@ */ Lookup1D_FLOAT32_IEEE 0 ME11_CM_single_C -40.0 40.0
 /begin AXIS_DESCR COM_AXIS NO_INPUT_QUANTITY ME11_CM_single_C 5 -20.0 20.0 AXIS_PTS_REF cal_BEXVCtrlBTrgCabinComp_1X /end AXIS_DESCR
/end CHARACTERISTIC
/begin AXIS_PTS cal_BEXVCtrlBTrgCabinComp_1X "" 0x0000 /* @ECU_Address@cal_BEXVCtrlBTrgCabinComp_1X@ */ NO_INPUT_QUANTITY Lookup1D_X_FLOAT32_IEEE 0 ME11_CM_single_C 5 -20.0 20.0 /end AXIS_PTS
/begin CHARACTERISTIC cal_BEXVCtrlBTrgWtrTempDiff_CUR "" CURVE 0x0000 /* @ECU_Address@cal_BEXVCtrlBTrgWtrTempDiff_CUR@ */ Lookup1D_FLOAT32_IEEE 0 ME11_CM_single_C -40.0 40.0
 /begin AXIS_DESCR COM_AXIS NO_INPUT_QUANTITY ME11_CM_single_C 6 -20.0 20.0 AXIS_PTS_REF cal_BEXVCtrlBTrgWtrTempDiff_1X /end AXIS_DESCR
/end CHARACTERISTIC
/begin AXIS_PTS cal_BEXVCtrlBTrgWtrTempDiff_1X "" 0x0000 /* @ECU_Address@cal_BEXVCtrlBTrgWtrTempDiff_1X@ */ NO_INPUT_QUANTITY Lookup1D_X_FLOAT32_IEEE 0 ME11_CM_single_C 6 -20.0 20.0 /end AXIS_PTS
/begin CHARACTERISTIC cal_BEXVCtrlCBatCoolPIMin_CUR "" CURVE 0x0000 /* @ECU_Address@cal_BEXVCtrlCBatCoolPIMin_CUR@ */ Lookup1D_FLOAT32_IEEE 0 ME11_CM_single_percent_ 0.0 100.0
 /begin AXIS_DESCR COM_AXIS COMP_EcompActSpd ME11_CM_single_rpm 6 0.0 8000.0 AXIS_PTS_REF cal_BEXVCtrlCBatCoolPIMin_1X /end AXIS_DESCR
/end CHARACTERISTIC
/begin AXIS_PTS cal_BEXVCtrlCBatCoolPIMin_1X "" 0x0000 /* @ECU_Address@cal_BEXVCtrlCBatCoolPIMin_1X@ */ COMP_EcompActSpd Lookup1D_X_FLOAT32_IEEE 0 ME11_CM_single_rpm 6 0.0 8000.0 /end AXIS_PTS
/begin CHARACTERISTIC cal_BEXVCtrlCFF_CUR "" CURVE 0x0000 /* @ECU_Address@cal_BEXVCtrlCFF_CUR@ */ Lookup1D_FLOAT32_IEEE 0 ME11_CM_single_percent_ 0.0 100.0
 /begin AXIS_DESCR COM_AXIS ACTCtl_sACCMCtlSpd ME11_CM_single_rpm 5 0.0 8000.0 AXIS_PTS_REF cal_BEXVCtrlCFF_1X /end AXIS_DESCR
/end CHARACTERISTIC
/begin AXIS_PTS cal_BEXVCtrlCFF_1X "" 0x0000 /* @ECU_Address@cal_BEXVCtrlCFF_1X@ */ ACTCtl_sACCMCtlSpd Lookup1D_X_FLOAT32_IEEE 0 ME11_CM_single_rpm 5 0.0 8000.0 /end AXIS_PTS
/begin CHARACTERISTIC cal_BEXVCtrlCKi_CUR "" CURVE 0x0000 /* @ECU_Address@cal_BEXVCtrlCKi_CUR@ */ Lookup1D_FLOAT32_IEEE 0 ME11_CM_single_null 0.0 100.0
 /begin AXIS_DESCR COM_AXIS NO_INPUT_QUANTITY ME11_CM_single_C 8 -40.0 100.0 AXIS_PTS_REF cal_BEXVCtrlCKi_1X /end AXIS_DESCR
/end CHARACTERISTIC
/begin AXIS_PTS cal_BEXVCtrlCKi_1X "" 0x0000 /* @ECU_Address@cal_BEXVCtrlCKi_1X@ */ NO_INPUT_QUANTITY Lookup1D_X_FLOAT32_IEEE 0 ME11_CM_single_C 8 -40.0 100.0 /end AXIS_PTS
/begin CHARACTERISTIC cal_BEXVCtrlCKp_CUR "" CURVE 0x0000 /* @ECU_Address@cal_BEXVCtrlCKp_CUR@ */ Lookup1D_FLOAT32_IEEE 0 ME11_CM_single_null 0.0 100.0
 /begin AXIS_DESCR COM_AXIS NO_INPUT_QUANTITY ME11_CM_single_C 8 -40.0 100.0 AXIS_PTS_REF cal_BEXVCtrlCKp_1X /end AXIS_DESCR
/end CHARACTERISTIC
/begin AXIS_PTS cal_BEXVCtrlCKp_1X "" 0x0000 /* @ECU_Address@cal_BEXVCtrlCKp_1X@ */ NO_INPUT_QUANTITY Lookup1D_X_FLOAT32_IEEE 0 ME11_CM_single_C 8 -40.0 100.0 /end AXIS_PTS
/begin CHARACTERISTIC cal_BEXVCtrlCTrg_CUR "" CURVE 0x0000 /* @ECU_Address@cal_BEXVCtrlCTrg_CUR@ */ Lookup1D_FLOAT32_IEEE 0 ME11_CM_single_C 0.0 20.0
 /begin AXIS_DESCR COM_AXIS ACTCtl_sACCMCtlSpd ME11_CM_single_rpm 5 0.0 8000.0 AXIS_PTS_REF cal_BEXVCtrlCTrg_1X /end AXIS_DESCR
/end CHARACTERISTIC
/begin AXIS_PTS cal_BEXVCtrlCTrg_1X "" 0x0000 /* @ECU_Address@cal_BEXVCtrlCTrg_1X@ */ ACTCtl_sACCMCtlSpd Lookup1D_X_FLOAT32_IEEE 0 ME11_CM_single_rpm 5 0.0 8000.0 /end AXIS_PTS
/begin CHARACTERISTIC cal_HPEXVCtrlAFF_CUR "" CURVE 0x0000 /* @ECU_Address@cal_HPEXVCtrlAFF_CUR@ */ Lookup1D_FLOAT32_IEEE 0 ME11_CM_single_percent_ 0.0 100.0
 /begin AXIS_DESCR COM_AXIS ACTCtl_sACCMCtlSpd ME11_CM_single_rpm 5 0.0 10000.0 AXIS_PTS_REF cal_HPEXVCtrlAFF_1X /end AXIS_DESCR
/end CHARACTERISTIC
/begin AXIS_PTS cal_HPEXVCtrlAFF_1X "" 0x0000 /* @ECU_Address@cal_HPEXVCtrlAFF_1X@ */ ACTCtl_sACCMCtlSpd Lookup1D_X_FLOAT32_IEEE 0 ME11_CM_single_rpm 5 0.0 10000.0 /end AXIS_PTS
/begin CHARACTERISTIC cal_HPEXVCtrlAKi_CUR "" CURVE 0x0000 /* @ECU_Address@cal_HPEXVCtrlAKi_CUR@ */ Lookup1D_FLOAT32_IEEE 0 ME11_CM_single_r 0.0 50.0
 /begin AXIS_DESCR COM_AXIS NO_INPUT_QUANTITY ME11_CM_single_C 6 0.0 50.0 AXIS_PTS_REF cal_HPEXVCtrlAKi_1X /end AXIS_DESCR
/end CHARACTERISTIC
/begin AXIS_PTS cal_HPEXVCtrlAKi_1X "" 0x0000 /* @ECU_Address@cal_HPEXVCtrlAKi_1X@ */ NO_INPUT_QUANTITY Lookup1D_X_FLOAT32_IEEE 0 ME11_CM_single_C 6 0.0 50.0 /end AXIS_PTS
/begin CHARACTERISTIC cal_HPEXVCtrlAKp_CUR "" CURVE 0x0000 /* @ECU_Address@cal_HPEXVCtrlAKp_CUR@ */ Lookup1D_FLOAT32_IEEE 0 ME11_CM_single_r 0.0 50.0
 /begin AXIS_DESCR COM_AXIS NO_INPUT_QUANTITY ME11_CM_single_C 6 0.0 50.0 AXIS_PTS_REF cal_HPEXVCtrlAKp_1X /end AXIS_DESCR
/end CHARACTERISTIC
/begin AXIS_PTS cal_HPEXVCtrlAKp_1X "" 0x0000 /* @ECU_Address@cal_HPEXVCtrlAKp_1X@ */ NO_INPUT_QUANTITY Lookup1D_X_FLOAT32_IEEE 0 ME11_CM_single_C 6 0.0 50.0 /end AXIS_PTS
/begin CHARACTERISTIC cal_HPEXVCtrlATrgtSubcool_CUR "" CURVE 0x0000 /* @ECU_Address@cal_HPEXVCtrlATrgtSubcool_CUR@ */ Lookup1D_FLOAT32_IEEE 0 ME11_CM_single_C 0.0 100.0
 /begin AXIS_DESCR COM_AXIS ACTCtl_sACCMCtlSpd ME11_CM_single_rpm 5 0.0 10000.0 AXIS_PTS_REF cal_HPEXVCtrlATrgtSubcool_1X /end AXIS_DESCR
/end CHARACTERISTIC
/begin AXIS_PTS cal_HPEXVCtrlATrgtSubcool_1X "" 0x0000 /* @ECU_Address@cal_HPEXVCtrlATrgtSubcool_1X@ */ ACTCtl_sACCMCtlSpd Lookup1D_X_FLOAT32_IEEE 0 ME11_CM_single_rpm 5 0.0 10000.0 /end AXIS_PTS
/begin CHARACTERISTIC cal_ACBatHeatTrgTemp "" VALUE 0x0000 /* @ECU_Address@cal_ACBatHeatTrgTemp@ */ Scalar_FLOAT32_IEEE 0 ME11_CM_single_C -5.0 80.0 /end CHARACTERISTIC
/begin CHARACTERISTIC cal_AEXVCtrlBDeadzone "" VALUE 0x0000 /* @ECU_Address@cal_AEXVCtrlBDeadzone@ */ Scalar_FLOAT32_IEEE 0 ME11_CM_single_C 0.0 5.0 /end CHARACTERISTIC
/begin CHARACTERISTIC cal_AEXVCtrlBDelayTime "" VALUE 0x0000 /* @ECU_Address@cal_AEXVCtrlBDelayTime@ */ Scalar_FLOAT32_IEEE 0 ME11_CM_single_s 0.0 200.0 /end CHARACTERISTIC
/begin CHARACTERISTIC cal_AEXVCtrlBOpenVal "" VALUE 0x0000 /* @ECU_Address@cal_AEXVCtrlBOpenVal@ */ Scalar_FLOAT32_IEEE 0 ME11_CM_single_percent_ 0.0 200.0 /end CHARACTERISTIC
/begin CHARACTERISTIC cal_AEXVCtrlBPIMax "" VALUE 0x0000 /* @ECU_Address@cal_AEXVCtrlBPIMax@ */ Scalar_FLOAT32_IEEE 0 ME11_CM_single_percent_ 0.0 100.0 /end CHARACTERISTIC
/begin CHARACTERISTIC cal_AEXVCtrlBPIMin "" VALUE 0x0000 /* @ECU_Address@cal_AEXVCtrlBPIMin@ */ Scalar_FLOAT32_IEEE 0 ME11_CM_single_percent_ 0.0 100.0 /end CHARACTERISTIC
/begin CHARACTERISTIC cal_AEXVCtrlCDeadzone "" VALUE 0x0000 /* @ECU_Address@cal_AEXVCtrlCDeadzone@ */ Scalar_FLOAT32_IEEE 0 ME11_CM_single_C 0.0 5.0 /end CHARACTERISTIC
/begin CHARACTERISTIC cal_AEXVCtrlCDelayTime "" VALUE 0x0000 /* @ECU_Address@cal_AEXVCtrlCDelayTime@ */ Scalar_FLOAT32_IEEE 0 ME11_CM_single_s 0.0 200.0 /end CHARACTERISTIC
/begin CHARACTERISTIC cal_AEXVCtrlCOpenVal "" VALUE 0x0000 /* @ECU_Address@cal_AEXVCtrlCOpenVal@ */ Scalar_FLOAT32_IEEE 0 ME11_CM_single_percent_ 0.0 200.0 /end CHARACTERISTIC
/begin CHARACTERISTIC cal_AEXVCtrlCPIMax "" VALUE 0x0000 /* @ECU_Address@cal_AEXVCtrlCPIMax@ */ Scalar_FLOAT32_IEEE 0 ME11_CM_single_percent_ 0.0 100.0 /end CHARACTERISTIC
/begin CHARACTERISTIC cal_AEXVCtrlCPIMin "" VALUE 0x0000 /* @ECU_Address@cal_AEXVCtrlCPIMin@ */ Scalar_FLOAT32_IEEE 0 ME11_CM_single_percent_ 0.0 100.0 /end CHARACTERISTIC
/begin CHARACTERISTIC cal_AEXVCtrlCTrgflt "" VALUE 0x0000 /* @ECU_Address@cal_AEXVCtrlCTrgflt@ */ Scalar_FLOAT32_IEEE 0 ME11_CM_single_C 0.0 10.0 /end CHARACTERISTIC
/begin CHARACTERISTIC cal_AEXVCtrlDDeadzone "" VALUE 0x0000 /* @ECU_Address@cal_AEXVCtrlDDeadzone@ */ Scalar_FLOAT32_IEEE 0 ME11_CM_single_C 0.0 5.0 /end CHARACTERISTIC
/begin CHARACTERISTIC cal_AEXVCtrlDDelayTime "" VALUE 0x0000 /* @ECU_Address@cal_AEXVCtrlDDelayTime@ */ Scalar_FLOAT32_IEEE 0 ME11_CM_single_s 0.0 200.0 /end CHARACTERISTIC
/begin CHARACTERISTIC cal_AEXVCtrlDOpenVal "" VALUE 0x0000 /* @ECU_Address@cal_AEXVCtrlDOpenVal@ */ Scalar_FLOAT32_IEEE 0 ME11_CM_single_null 0.0 100.0 /end CHARACTERISTIC
/begin CHARACTERISTIC cal_AEXVCtrlDPIMax "" VALUE 0x0000 /* @ECU_Address@cal_AEXVCtrlDPIMax@ */ Scalar_FLOAT32_IEEE 0 ME11_CM_single_percent_ 0.0 100.0 /end CHARACTERISTIC
/begin CHARACTERISTIC cal_AEXVCtrlDPIMin "" VALUE 0x0000 /* @ECU_Address@cal_AEXVCtrlDPIMin@ */ Scalar_FLOAT32_IEEE 0 ME11_CM_single_percent_ 0.0 100.0 /end CHARACTERISTIC
/begin CHARACTERISTIC cal_AEXVCtrlDefaultPos "" VALUE 0x0000 /* @ECU_Address@cal_AEXVCtrlDefaultPos@ */ Scalar_FLOAT32_IEEE 0 ME11_CM_single_percent_ 0.0 100.0 /end CHARACTERISTIC
/begin CHARACTERISTIC cal_AEXVDiffDown "" VALUE 0x0000 /* @ECU_Address@cal_AEXVDiffDown@ */ Scalar_FLOAT32_IEEE 0 ME11_CM_single_percent__per_100ms 0.0 10.0 /end CHARACTERISTIC
/begin CHARACTERISTIC cal_AEXVDiffDownRate "" VALUE 0x0000 /* @ECU_Address@cal_AEXVDiffDownRate@ */ Scalar_FLOAT32_IEEE 0 ME11_CM_single_percent__per_100ms 0.0 10.0 /end CHARACTERISTIC
/begin CHARACTERISTIC cal_AEXVDiffUp "" VALUE 0x0000 /* @ECU_Address@cal_AEXVDiffUp@ */ Scalar_FLOAT32_IEEE 0 ME11_CM_single_percent__per_100ms 0.0 10.0 /end CHARACTERISTIC
/begin CHARACTERISTIC cal_AEXVDiffUpRate "" VALUE 0x0000 /* @ECU_Address@cal_AEXVDiffUpRate@ */ Scalar_FLOAT32_IEEE 0 ME11_CM_single_percent__per_100ms 0.0 10.0 /end CHARACTERISTIC
/begin CHARACTERISTIC cal_AEXVFloorDiff1 "" VALUE 0x0000 /* @ECU_Address@cal_AEXVFloorDiff1@ */ Scalar_FLOAT32_IEEE 0 ME11_CM_single_percent_ 0.0 1.0 /end CHARACTERISTIC
/begin CHARACTERISTIC cal_AEXVFloorDiff2 "" VALUE 0x0000 /* @ECU_Address@cal_AEXVFloorDiff2@ */ Scalar_FLOAT32_IEEE 0 ME11_CM_single_percent_ 0.0 1.0 /end CHARACTERISTIC
/begin CHARACTERISTIC cal_AEXVHighPressLmtOn "" VALUE 0x0000 /* @ECU_Address@cal_AEXVHighPressLmtOn@ */ Scalar_FLOAT32_IEEE 0 ME11_CM_single_Mpa 0.0 28.0 /end CHARACTERISTIC
/begin CHARACTERISTIC cal_AEXVLowPressLmtOn "" VALUE 0x0000 /* @ECU_Address@cal_AEXVLowPressLmtOn@ */ Scalar_FLOAT32_IEEE 0 ME11_CM_single_Mpa 0.0 5.0 /end CHARACTERISTIC
/begin CHARACTERISTIC cal_AEXVPosData "" VALUE 0x0000 /* @ECU_Address@cal_AEXVPosData@ */ Scalar_FLOAT32_IEEE 0 ME11_CM_single_percent_ 0.0 100.0 /end CHARACTERISTIC
/begin CHARACTERISTIC cal_AEXVSubCoolflt "" VALUE 0x0000 /* @ECU_Address@cal_AEXVSubCoolflt@ */ Scalar_FLOAT32_IEEE 0 ME11_CM_single_C 0.0 10.0 /end CHARACTERISTIC
/begin CHARACTERISTIC cal_AirInletRecInPCUTemp "" VALUE 0x0000 /* @ECU_Address@cal_AirInletRecInPCUTemp@ */ Scalar_FLOAT32_IEEE 0 ME11_CM_single_C -40.0 100.0 /end CHARACTERISTIC
/begin CHARACTERISTIC cal_AirInletRecOutPCUTemp "" VALUE 0x0000 /* @ECU_Address@cal_AirInletRecOutPCUTemp@ */ Scalar_FLOAT32_IEEE 0 ME11_CM_single_C -40.0 100.0 /end CHARACTERISTIC
/begin CHARACTERISTIC cal_BEXVCtrlBDeadzone "" VALUE 0x0000 /* @ECU_Address@cal_BEXVCtrlBDeadzone@ */ Scalar_FLOAT32_IEEE 0 ME11_CM_single_C 0.0 5.0 /end CHARACTERISTIC
/begin CHARACTERISTIC cal_BEXVCtrlBDelayTime "" VALUE 0x0000 /* @ECU_Address@cal_BEXVCtrlBDelayTime@ */ Scalar_FLOAT32_IEEE 0 ME11_CM_single_s 0.0 200.0 /end CHARACTERISTIC
/begin CHARACTERISTIC cal_BEXVCtrlBOpenVal "" VALUE 0x0000 /* @ECU_Address@cal_BEXVCtrlBOpenVal@ */ Scalar_FLOAT32_IEEE 0 ME11_CM_single_null 0.0 100.0 /end CHARACTERISTIC
/begin CHARACTERISTIC cal_BEXVCtrlBPIDown "" VALUE 0x0000 /* @ECU_Address@cal_BEXVCtrlBPIDown@ */ Scalar_FLOAT32_IEEE 0 ME11_CM_single_percent_ 0.0 10.0 /end CHARACTERISTIC
/begin CHARACTERISTIC cal_BEXVCtrlBPIUp "" VALUE 0x0000 /* @ECU_Address@cal_BEXVCtrlBPIUp@ */ Scalar_FLOAT32_IEEE 0 ME11_CM_single_percent_ 0.0 100.0 /end CHARACTERISTIC
/begin CHARACTERISTIC cal_BEXVCtrlCDeadzone "" VALUE 0x0000 /* @ECU_Address@cal_BEXVCtrlCDeadzone@ */ Scalar_FLOAT32_IEEE 0 ME11_CM_single_C 0.0 5.0 /end CHARACTERISTIC
/begin CHARACTERISTIC cal_BEXVCtrlCDelayTime "" VALUE 0x0000 /* @ECU_Address@cal_BEXVCtrlCDelayTime@ */ Scalar_FLOAT32_IEEE 0 ME11_CM_single_s 0.0 200.0 /end CHARACTERISTIC
/begin CHARACTERISTIC cal_BEXVCtrlCOpenVal "" VALUE 0x0000 /* @ECU_Address@cal_BEXVCtrlCOpenVal@ */ Scalar_FLOAT32_IEEE 0 ME11_CM_single_null 0.0 100.0 /end CHARACTERISTIC
/begin CHARACTERISTIC cal_BEXVCtrlCPIMax "" VALUE 0x0000 /* @ECU_Address@cal_BEXVCtrlCPIMax@ */ Scalar_FLOAT32_IEEE 0 ME11_CM_single_percent_ 0.0 100.0 /end CHARACTERISTIC
/begin CHARACTERISTIC cal_BEXVCtrlCPIMin "" VALUE 0x0000 /* @ECU_Address@cal_BEXVCtrlCPIMin@ */ Scalar_FLOAT32_IEEE 0 ME11_CM_single_percent_ 0.0 10.0 /end CHARACTERISTIC
/begin CHARACTERISTIC cal_BEXVDiffDown "" VALUE 0x0000 /* @ECU_Address@cal_BEXVDiffDown@ */ Scalar_FLOAT32_IEEE 0 ME11_CM_single_percent__per_100ms 0.0 10.0 /end CHARACTERISTIC
/begin CHARACTERISTIC cal_BEXVDiffDownRate "" VALUE 0x0000 /* @ECU_Address@cal_BEXVDiffDownRate@ */ Scalar_FLOAT32_IEEE 0 ME11_CM_single_percent__per_100ms 0.0 10.0 /end CHARACTERISTIC
/begin CHARACTERISTIC cal_BEXVDiffUp "" VALUE 0x0000 /* @ECU_Address@cal_BEXVDiffUp@ */ Scalar_FLOAT32_IEEE 0 ME11_CM_single_percent__per_100ms 0.0 10.0 /end CHARACTERISTIC
/begin CHARACTERISTIC cal_BEXVDiffUpRate "" VALUE 0x0000 /* @ECU_Address@cal_BEXVDiffUpRate@ */ Scalar_FLOAT32_IEEE 0 ME11_CM_single_percent__per_100ms 0.0 10.0 /end CHARACTERISTIC
/begin CHARACTERISTIC cal_BEXVHighPressLmtOn "" VALUE 0x0000 /* @ECU_Address@cal_BEXVHighPressLmtOn@ */ Scalar_FLOAT32_IEEE 0 ME11_CM_single_Mpa 0.0 28.0 /end CHARACTERISTIC
/begin CHARACTERISTIC cal_BEXVLowPressLmtOn "" VALUE 0x0000 /* @ECU_Address@cal_BEXVLowPressLmtOn@ */ Scalar_FLOAT32_IEEE 0 ME11_CM_single_Mpa 0.0 5.0 /end CHARACTERISTIC
/begin CHARACTERISTIC cal_BEXVSubCoolflt "" VALUE 0x0000 /* @ECU_Address@cal_BEXVSubCoolflt@ */ Scalar_FLOAT32_IEEE 0 ME11_CM_single_C 0.0 10.0 /end CHARACTERISTIC
/begin CHARACTERISTIC cal_BEXVSubHeatflt "" VALUE 0x0000 /* @ECU_Address@cal_BEXVSubHeatflt@ */ Scalar_FLOAT32_IEEE 0 ME11_CM_single_C 0.0 10.0 /end CHARACTERISTIC
/begin CHARACTERISTIC cal_BatBalCellTemp1 "" VALUE 0x0000 /* @ECU_Address@cal_BatBalCellTemp1@ */ Scalar_FLOAT32_IEEE 0 ME11_CM_single_C -40.0 50.0 /end CHARACTERISTIC
/begin CHARACTERISTIC cal_BatBalCellTemp2 "" VALUE 0x0000 /* @ECU_Address@cal_BatBalCellTemp2@ */ Scalar_FLOAT32_IEEE 0 ME11_CM_single_C -40.0 50.0 /end CHARACTERISTIC
/begin CHARACTERISTIC cal_COMPActlSpd1 "" VALUE 0x0000 /* @ECU_Address@cal_COMPActlSpd1@ */ Scalar_FLOAT32_IEEE 0 ME11_CM_single_rpm 0.0 8000.0 /end CHARACTERISTIC
/begin CHARACTERISTIC cal_COMPActlSpd2 "" VALUE 0x0000 /* @ECU_Address@cal_COMPActlSpd2@ */ Scalar_FLOAT32_IEEE 0 ME11_CM_single_rpm 0.0 8000.0 /end CHARACTERISTIC
/begin CHARACTERISTIC cal_COMPActlSpd3 "" VALUE 0x0000 /* @ECU_Address@cal_COMPActlSpd3@ */ Scalar_FLOAT32_IEEE 0 ME11_CM_single_rpm 0.0 8000.0 /end CHARACTERISTIC
/begin CHARACTERISTIC cal_COMPSpdDiffDown "" VALUE 0x0000 /* @ECU_Address@cal_COMPSpdDiffDown@ */ Scalar_FLOAT32_IEEE 0 ME11_CM_single_rpm 0.0 3000.0 /end CHARACTERISTIC
/begin CHARACTERISTIC cal_COMPSpdDiffDownRate "" VALUE 0x0000 /* @ECU_Address@cal_COMPSpdDiffDownRate@ */ Scalar_FLOAT32_IEEE 0 ME11_CM_single_rpm 0.0 2000.0 /end CHARACTERISTIC
/begin CHARACTERISTIC cal_COMPSpdDiffUp "" VALUE 0x0000 /* @ECU_Address@cal_COMPSpdDiffUp@ */ Scalar_FLOAT32_IEEE 0 ME11_CM_single_rpm 0.0 3000.0 /end CHARACTERISTIC
/begin CHARACTERISTIC cal_COMPSpdDiffUpRate "" VALUE 0x0000 /* @ECU_Address@cal_COMPSpdDiffUpRate@ */ Scalar_FLOAT32_IEEE 0 ME11_CM_single_rpm 0.0 2000.0 /end CHARACTERISTIC
/begin CHARACTERISTIC cal_CabinMD2F2MaxEnvTemp "" VALUE 0x0000 /* @ECU_Address@cal_CabinMD2F2MaxEnvTemp@ */ Scalar_FLOAT32_IEEE 0 ME11_CM_single_C 10.0 38.0 /end CHARACTERISTIC
/begin CHARACTERISTIC cal_CoolStartCompensate "" VALUE 0x0000 /* @ECU_Address@cal_CoolStartCompensate@ */ Scalar_FLOAT32_IEEE 0 ME11_CM_single_per_ -3.4E+38 3.4E+38 /end CHARACTERISTIC
/begin CHARACTERISTIC cal_DCBatHeatTrgTemp "" VALUE 0x0000 /* @ECU_Address@cal_DCBatHeatTrgTemp@ */ Scalar_FLOAT32_IEEE 0 ME11_CM_single_C -5.0 80.0 /end CHARACTERISTIC
/begin CHARACTERISTIC cal_DLTRIPUTempExitVal "" VALUE 0x0000 /* @ECU_Address@cal_DLTRIPUTempExitVal@ */ Scalar_FLOAT32_IEEE 0 ME11_CM_single_C 0.0 100.0 /end CHARACTERISTIC
/begin CHARACTERISTIC cal_DcutTPidDeadBand "" VALUE 0x0000 /* @ECU_Address@cal_DcutTPidDeadBand@ */ Scalar_FLOAT32_IEEE 0 ME11_CM_single_per_ -3.4E+38 3.4E+38 /end CHARACTERISTIC
/begin CHARACTERISTIC cal_DcutTempPidLL "" VALUE 0x0000 /* @ECU_Address@cal_DcutTempPidLL@ */ Scalar_FLOAT32_IEEE 0 ME11_CM_single_per_ -3.4E+38 3.4E+38 /end CHARACTERISTIC
/begin CHARACTERISTIC cal_DcutTempPidUL "" VALUE 0x0000 /* @ECU_Address@cal_DcutTempPidUL@ */ Scalar_FLOAT32_IEEE 0 ME11_CM_single_per_ -3.4E+38 3.4E+38 /end CHARACTERISTIC
/begin CHARACTERISTIC cal_DcutTempPid_IsumMax "" VALUE 0x0000 /* @ECU_Address@cal_DcutTempPid_IsumMax@ */ Scalar_FLOAT32_IEEE 0 ME11_CM_single_per_ -3.4E+38 3.4E+38 /end CHARACTERISTIC
/begin CHARACTERISTIC cal_DcutTempPid_IsumMin "" VALUE 0x0000 /* @ECU_Address@cal_DcutTempPid_IsumMin@ */ Scalar_FLOAT32_IEEE 0 ME11_CM_single_per_ -3.4E+38 3.4E+38 /end CHARACTERISTIC
/begin CHARACTERISTIC cal_DcutTempPid_Ki "" VALUE 0x0000 /* @ECU_Address@cal_DcutTempPid_Ki@ */ Scalar_FLOAT32_IEEE 0 ME11_CM_single_per_ -3.4E+38 3.4E+38 /end CHARACTERISTIC
/begin CHARACTERISTIC cal_DcutTempPid_KiNeg "" VALUE 0x0000 /* @ECU_Address@cal_DcutTempPid_KiNeg@ */ Scalar_FLOAT32_IEEE 0 ME11_CM_single_per_ -3.4E+38 3.4E+38 /end CHARACTERISTIC
/begin CHARACTERISTIC cal_DcutTempPid_KiPos "" VALUE 0x0000 /* @ECU_Address@cal_DcutTempPid_KiPos@ */ Scalar_FLOAT32_IEEE 0 ME11_CM_single_per_ -3.4E+38 3.4E+38 /end CHARACTERISTIC
/begin CHARACTERISTIC cal_DcutTempPid_Kp "" VALUE 0x0000 /* @ECU_Address@cal_DcutTempPid_Kp@ */ Scalar_FLOAT32_IEEE 0 ME11_CM_single_per_ -3.4E+38 3.4E+38 /end CHARACTERISTIC
/begin CHARACTERISTIC cal_DcutTempPid_KpNeg "" VALUE 0x0000 /* @ECU_Address@cal_DcutTempPid_KpNeg@ */ Scalar_FLOAT32_IEEE 0 ME11_CM_single_per_ -3.4E+38 3.4E+38 /end CHARACTERISTIC
/begin CHARACTERISTIC cal_DcutTempPid_KpPos "" VALUE 0x0000 /* @ECU_Address@cal_DcutTempPid_KpPos@ */ Scalar_FLOAT32_IEEE 0 ME11_CM_single_per_ -3.4E+38 3.4E+38 /end CHARACTERISTIC
/begin CHARACTERISTIC cal_DcutTempPid_pWinNeg "" VALUE 0x0000 /* @ECU_Address@cal_DcutTempPid_pWinNeg@ */ Scalar_FLOAT32_IEEE 0 ME11_CM_single_per_ -3.4E+38 3.4E+38 /end CHARACTERISTIC
/begin CHARACTERISTIC cal_DcutTempPid_pWinPos "" VALUE 0x0000 /* @ECU_Address@cal_DcutTempPid_pWinPos@ */ Scalar_FLOAT32_IEEE 0 ME11_CM_single_per_ -3.4E+38 3.4E+38 /end CHARACTERISTIC
/begin CHARACTERISTIC cal_DrDuctFaceFloorFaFactor "" VALUE 0x0000 /* @ECU_Address@cal_DrDuctFaceFloorFaFactor@ */ Scalar_FLOAT32_IEEE 0 ME11_CM_single_per_ -3.4E+38 3.4E+38 /end CHARACTERISTIC
/begin CHARACTERISTIC cal_DrDuctFaceFloorFoFactor "" VALUE 0x0000 /* @ECU_Address@cal_DrDuctFaceFloorFoFactor@ */ Scalar_FLOAT32_IEEE 0 ME11_CM_single_per_ -3.4E+38 3.4E+38 /end CHARACTERISTIC
/begin CHARACTERISTIC cal_DrErrOfEvaDVT2CoolMixOff "" VALUE 0x0000 /* @ECU_Address@cal_DrErrOfEvaDVT2CoolMixOff@ */ Scalar_FLOAT32_IEEE 0 ME11_CM_single_per_ -40.0 100.0 /end CHARACTERISTIC
/begin CHARACTERISTIC cal_DrErrOfEvaDVT2CoolMixOn "" VALUE 0x0000 /* @ECU_Address@cal_DrErrOfEvaDVT2CoolMixOn@ */ Scalar_FLOAT32_IEEE 0 ME11_CM_single_per_ -40.0 100.0 /end CHARACTERISTIC
/begin CHARACTERISTIC cal_DrErrOfPtcDVT2HeatMixOff "" VALUE 0x0000 /* @ECU_Address@cal_DrErrOfPtcDVT2HeatMixOff@ */ Scalar_FLOAT32_IEEE 0 ME11_CM_single_per_ -40.0 100.0 /end CHARACTERISTIC
/begin CHARACTERISTIC cal_DrErrOfPtcDVT2HeatMixOn "" VALUE 0x0000 /* @ECU_Address@cal_DrErrOfPtcDVT2HeatMixOn@ */ Scalar_FLOAT32_IEEE 0 ME11_CM_single_per_ -40.0 100.0 /end CHARACTERISTIC
/begin CHARACTERISTIC cal_DrMixDesValPIDIntegDeadBand "" VALUE 0x0000 /* @ECU_Address@cal_DrMixDesValPIDIntegDeadBand@ */ Scalar_FLOAT32_IEEE 0 ME11_CM_single_per_ -3.4E+38 3.4E+38 /end CHARACTERISTIC
/begin CHARACTERISTIC cal_DrMixDesValPID_IsumMax "" VALUE 0x0000 /* @ECU_Address@cal_DrMixDesValPID_IsumMax@ */ Scalar_FLOAT32_IEEE 0 ME11_CM_single_per_ -3.4E+38 3.4E+38 /end CHARACTERISTIC
/begin CHARACTERISTIC cal_DrMixDesValPID_IsumMin "" VALUE 0x0000 /* @ECU_Address@cal_DrMixDesValPID_IsumMin@ */ Scalar_FLOAT32_IEEE 0 ME11_CM_single_per_ -3.4E+38 3.4E+38 /end CHARACTERISTIC
/begin CHARACTERISTIC cal_DrMixDesValPID_Ki "" VALUE 0x0000 /* @ECU_Address@cal_DrMixDesValPID_Ki@ */ Scalar_FLOAT32_IEEE 0 ME11_CM_single_per_ -3.4E+38 3.4E+38 /end CHARACTERISTIC
/begin CHARACTERISTIC cal_DrMixDesValPID_KiNeg "" VALUE 0x0000 /* @ECU_Address@cal_DrMixDesValPID_KiNeg@ */ Scalar_FLOAT32_IEEE 0 ME11_CM_single_per_ -3.4E+38 3.4E+38 /end CHARACTERISTIC
/begin CHARACTERISTIC cal_DrMixDesValPID_KiPos "" VALUE 0x0000 /* @ECU_Address@cal_DrMixDesValPID_KiPos@ */ Scalar_FLOAT32_IEEE 0 ME11_CM_single_per_ -3.4E+38 3.4E+38 /end CHARACTERISTIC
/begin CHARACTERISTIC cal_DrMixDesValPID_Kp "" VALUE 0x0000 /* @ECU_Address@cal_DrMixDesValPID_Kp@ */ Scalar_FLOAT32_IEEE 0 ME11_CM_single_per_ -3.4E+38 3.4E+38 /end CHARACTERISTIC
/begin CHARACTERISTIC cal_DrMixDesValPID_KpNeg "" VALUE 0x0000 /* @ECU_Address@cal_DrMixDesValPID_KpNeg@ */ Scalar_FLOAT32_IEEE 0 ME11_CM_single_per_ -3.4E+38 3.4E+38 /end CHARACTERISTIC
/begin CHARACTERISTIC cal_DrMixDesValPID_KpPos "" VALUE 0x0000 /* @ECU_Address@cal_DrMixDesValPID_KpPos@ */ Scalar_FLOAT32_IEEE 0 ME11_CM_single_per_ -3.4E+38 3.4E+38 /end CHARACTERISTIC
/begin CHARACTERISTIC cal_DrMixDesValPID_pWinNeg "" VALUE 0x0000 /* @ECU_Address@cal_DrMixDesValPID_pWinNeg@ */ Scalar_FLOAT32_IEEE 0 ME11_CM_single_per_ -3.4E+38 3.4E+38 /end CHARACTERISTIC
/begin CHARACTERISTIC cal_DrMixDesValPID_pWinPos "" VALUE 0x0000 /* @ECU_Address@cal_DrMixDesValPID_pWinPos@ */ Scalar_FLOAT32_IEEE 0 ME11_CM_single_per_ -3.4E+38 3.4E+38 /end CHARACTERISTIC
/begin CHARACTERISTIC cal_DvtCoff "" VALUE 0x0000 /* @ECU_Address@cal_DvtCoff@ */ Scalar_FLOAT32_IEEE 0 ME11_CM_single_C 0.0 1.0 /end CHARACTERISTIC
/begin CHARACTERISTIC cal_DvtDesValPID_LL "" VALUE 0x0000 /* @ECU_Address@cal_DvtDesValPID_LL@ */ Scalar_FLOAT32_IEEE 0 ME11_CM_single_per_ -3.4E+38 3.4E+38 /end CHARACTERISTIC
/begin CHARACTERISTIC cal_DvtDesValPID_UL "" VALUE 0x0000 /* @ECU_Address@cal_DvtDesValPID_UL@ */ Scalar_FLOAT32_IEEE 0 ME11_CM_single_per_ -3.4E+38 3.4E+38 /end CHARACTERISTIC
/begin CHARACTERISTIC cal_EnvTempStep "" VALUE 0x0000 /* @ECU_Address@cal_EnvTempStep@ */ Scalar_FLOAT32_IEEE 0 ME11_CM_single_per_ -3.4E+38 3.4E+38 /end CHARACTERISTIC
/begin CHARACTERISTIC cal_EvaDesLLMin "" VALUE 0x0000 /* @ECU_Address@cal_EvaDesLLMin@ */ Scalar_FLOAT32_IEEE 0 ME11_CM_single_per_ -3.4E+38 3.4E+38 /end CHARACTERISTIC
/begin CHARACTERISTIC cal_HPEXVCtrlADeadzone "" VALUE 0x0000 /* @ECU_Address@cal_HPEXVCtrlADeadzone@ */ Scalar_FLOAT32_IEEE 0 ME11_CM_single_C 0.0 10.0 /end CHARACTERISTIC
/begin CHARACTERISTIC cal_HPEXVCtrlADelayTime "" VALUE 0x0000 /* @ECU_Address@cal_HPEXVCtrlADelayTime@ */ Scalar_FLOAT32_IEEE 0 ME11_CM_single_s 0.0 200.0 /end CHARACTERISTIC
/begin CHARACTERISTIC cal_HPEXVCtrlAFFLolmt "" VALUE 0x0000 /* @ECU_Address@cal_HPEXVCtrlAFFLolmt@ */ Scalar_FLOAT32_IEEE 0 ME11_CM_single_percent_ 0.0 100.0 /end CHARACTERISTIC
/begin CHARACTERISTIC cal_HPEXVCtrlAFFUplmt "" VALUE 0x0000 /* @ECU_Address@cal_HPEXVCtrlAFFUplmt@ */ Scalar_FLOAT32_IEEE 0 ME11_CM_single_percent_ 0.0 100.0 /end CHARACTERISTIC
/begin CHARACTERISTIC cal_HPEXVCtrlAMax "" VALUE 0x0000 /* @ECU_Address@cal_HPEXVCtrlAMax@ */ Scalar_FLOAT32_IEEE 0 ME11_CM_single_percent_ 0.0 100.0 /end CHARACTERISTIC
/begin CHARACTERISTIC cal_HPEXVCtrlAMin "" VALUE 0x0000 /* @ECU_Address@cal_HPEXVCtrlAMin@ */ Scalar_FLOAT32_IEEE 0 ME11_CM_single_percent_ 0.0 100.0 /end CHARACTERISTIC
/begin CHARACTERISTIC cal_HPEXVCtrlAOpenVal "" VALUE 0x0000 /* @ECU_Address@cal_HPEXVCtrlAOpenVal@ */ Scalar_FLOAT32_IEEE 0 ME11_CM_single_percent_ 0.0 100.0 /end CHARACTERISTIC
/begin CHARACTERISTIC cal_HPEXVDiffDown "" VALUE 0x0000 /* @ECU_Address@cal_HPEXVDiffDown@ */ Scalar_FLOAT32_IEEE 0 ME11_CM_single_percent__per_100ms 0.0 10.0 /end CHARACTERISTIC
/begin CHARACTERISTIC cal_HPEXVDiffDownRate "" VALUE 0x0000 /* @ECU_Address@cal_HPEXVDiffDownRate@ */ Scalar_FLOAT32_IEEE 0 ME11_CM_single_percent__per_100ms 0.0 10.0 /end CHARACTERISTIC
/begin CHARACTERISTIC cal_HPEXVDiffUp "" VALUE 0x0000 /* @ECU_Address@cal_HPEXVDiffUp@ */ Scalar_FLOAT32_IEEE 0 ME11_CM_single_percent__per_100ms 0.0 10.0 /end CHARACTERISTIC
/begin CHARACTERISTIC cal_HPEXVDiffUpRate "" VALUE 0x0000 /* @ECU_Address@cal_HPEXVDiffUpRate@ */ Scalar_FLOAT32_IEEE 0 ME11_CM_single_percent__per_100ms 0.0 10.0 /end CHARACTERISTIC
/begin CHARACTERISTIC cal_HPEXVFloorDiff1 "" VALUE 0x0000 /* @ECU_Address@cal_HPEXVFloorDiff1@ */ Scalar_FLOAT32_IEEE 0 ME11_CM_single_percent_ 0.0 1.0 /end CHARACTERISTIC
/begin CHARACTERISTIC cal_HPEXVFloorDiff2 "" VALUE 0x0000 /* @ECU_Address@cal_HPEXVFloorDiff2@ */ Scalar_FLOAT32_IEEE 0 ME11_CM_single_percent_ 0.0 1.0 /end CHARACTERISTIC
/begin CHARACTERISTIC cal_HPEXVHiPressProOpenSpd "" VALUE 0x0000 /* @ECU_Address@cal_HPEXVHiPressProOpenSpd@ */ Scalar_FLOAT32_IEEE 0 ME11_CM_single_percent__per_100ms 0.0 30.0 /end CHARACTERISTIC
/begin CHARACTERISTIC cal_HPEXVHiPressProhOff "" VALUE 0x0000 /* @ECU_Address@cal_HPEXVHiPressProhOff@ */ Scalar_FLOAT32_IEEE 0 ME11_CM_single_Mpa 0.0 30.0 /end CHARACTERISTIC
/begin CHARACTERISTIC cal_HPEXVHiPressProhOn "" VALUE 0x0000 /* @ECU_Address@cal_HPEXVHiPressProhOn@ */ Scalar_FLOAT32_IEEE 0 ME11_CM_single_Mpa 0.0 30.0 /end CHARACTERISTIC
/begin CHARACTERISTIC cal_HPEXVLowPressProOpenSpd "" VALUE 0x0000 /* @ECU_Address@cal_HPEXVLowPressProOpenSpd@ */ Scalar_FLOAT32_IEEE 0 ME11_CM_single_percent__per_100ms 0.0 30.0 /end CHARACTERISTIC
/begin CHARACTERISTIC cal_HPEXVPosData "" VALUE 0x0000 /* @ECU_Address@cal_HPEXVPosData@ */ Scalar_FLOAT32_IEEE 0 ME11_CM_single_percent_ 0.0 100.0 /end CHARACTERISTIC
/begin CHARACTERISTIC cal_HPEXVSubCoolflt "" VALUE 0x0000 /* @ECU_Address@cal_HPEXVSubCoolflt@ */ Scalar_FLOAT32_IEEE 0 ME11_CM_single_C 0.0 10.0 /end CHARACTERISTIC
/begin CHARACTERISTIC cal_HPEXVlowPressProhOff "" VALUE 0x0000 /* @ECU_Address@cal_HPEXVlowPressProhOff@ */ Scalar_FLOAT32_IEEE 0 ME11_CM_single_Mpa 0.0 1.0 /end CHARACTERISTIC
/begin CHARACTERISTIC cal_HPEXVlowPressProhOn "" VALUE 0x0000 /* @ECU_Address@cal_HPEXVlowPressProhOn@ */ Scalar_FLOAT32_IEEE 0 ME11_CM_single_Mpa 0.0 1.0 /end CHARACTERISTIC
/begin CHARACTERISTIC cal_HPProVal1 "" VALUE 0x0000 /* @ECU_Address@cal_HPProVal1@ */ Scalar_FLOAT32_IEEE 0 ME11_CM_single_Mpa 0.0 5.0 /end CHARACTERISTIC
/begin CHARACTERISTIC cal_HPProVal1Relay "" VALUE 0x0000 /* @ECU_Address@cal_HPProVal1Relay@ */ Scalar_FLOAT32_IEEE 0 ME11_CM_single_Mpa 0.0 5.0 /end CHARACTERISTIC
/begin CHARACTERISTIC cal_HPProVal2 "" VALUE 0x0000 /* @ECU_Address@cal_HPProVal2@ */ Scalar_FLOAT32_IEEE 0 ME11_CM_single_Mpa 0.0 5.0 /end CHARACTERISTIC
/begin CHARACTERISTIC cal_HPProVal2Relay "" VALUE 0x0000 /* @ECU_Address@cal_HPProVal2Relay@ */ Scalar_FLOAT32_IEEE 0 ME11_CM_single_Mpa 0.0 5.0 /end CHARACTERISTIC
/begin CHARACTERISTIC cal_HPProVal3 "" VALUE 0x0000 /* @ECU_Address@cal_HPProVal3@ */ Scalar_FLOAT32_IEEE 0 ME11_CM_single_Mpa 0.0 5.0 /end CHARACTERISTIC
/begin CHARACTERISTIC cal_HPProVal3Relay "" VALUE 0x0000 /* @ECU_Address@cal_HPProVal3Relay@ */ Scalar_FLOAT32_IEEE 0 ME11_CM_single_Mpa 0.0 5.0 /end CHARACTERISTIC
/begin CHARACTERISTIC cal_HPProVal4 "" VALUE 0x0000 /* @ECU_Address@cal_HPProVal4@ */ Scalar_FLOAT32_IEEE 0 ME11_CM_single_Mpa 0.0 10.0 /end CHARACTERISTIC
/begin CHARACTERISTIC cal_LTRIGBTMaxExitTempB "" VALUE 0x0000 /* @ECU_Address@cal_LTRIGBTMaxExitTempB@ */ Scalar_FLOAT32_IEEE 0 ME11_CM_single_C -40.0 80.0 /end CHARACTERISTIC
/begin CHARACTERISTIC cal_LTRMotorInletMaxExitTempA "" VALUE 0x0000 /* @ECU_Address@cal_LTRMotorInletMaxExitTempA@ */ Scalar_FLOAT32_IEEE 0 ME11_CM_single_C -40.0 80.0 /end CHARACTERISTIC
/begin CHARACTERISTIC cal_LTRMotorMaxEntTemp "" VALUE 0x0000 /* @ECU_Address@cal_LTRMotorMaxEntTemp@ */ Scalar_FLOAT32_IEEE 0 ME11_CM_single_C -40.0 80.0 /end CHARACTERISTIC
/begin CHARACTERISTIC cal_LTRMotorMaxExitTemp "" VALUE 0x0000 /* @ECU_Address@cal_LTRMotorMaxExitTemp@ */ Scalar_FLOAT32_IEEE 0 ME11_CM_single_C -40.0 80.0 /end CHARACTERISTIC
/begin CHARACTERISTIC cal_MBIGBTHighExitTempG "" VALUE 0x0000 /* @ECU_Address@cal_MBIGBTHighExitTempG@ */ Scalar_FLOAT32_IEEE 0 ME11_CM_single_C -40.0 80.0 /end CHARACTERISTIC
/begin CHARACTERISTIC cal_MBIPUDevHighExitTempI "" VALUE 0x0000 /* @ECU_Address@cal_MBIPUDevHighExitTempI@ */ Scalar_FLOAT32_IEEE 0 ME11_CM_single_C -40.0 80.0 /end CHARACTERISTIC
/begin CHARACTERISTIC cal_MBMotorInletHighExitTempH "" VALUE 0x0000 /* @ECU_Address@cal_MBMotorInletHighExitTempH@ */ Scalar_FLOAT32_IEEE 0 ME11_CM_single_C -40.0 80.0 /end CHARACTERISTIC
/begin CHARACTERISTIC cal_MotHeatBatMinTempDiff "" VALUE 0x0000 /* @ECU_Address@cal_MotHeatBatMinTempDiff@ */ Scalar_FLOAT32_IEEE 0 ME11_CM_single_C -10.0 10.0 /end CHARACTERISTIC
/begin CHARACTERISTIC cal_NmlBatHeatTrgTemp "" VALUE 0x0000 /* @ECU_Address@cal_NmlBatHeatTrgTemp@ */ Scalar_FLOAT32_IEEE 0 ME11_CM_single_C -5.0 80.0 /end CHARACTERISTIC
/begin CHARACTERISTIC cal_PTCTempRecircOff "" VALUE 0x0000 /* @ECU_Address@cal_PTCTempRecircOff@ */ Scalar_FLOAT32_IEEE 0 ME11_CM_single_per_ -3.4E+38 3.4E+38 /end CHARACTERISTIC
/begin CHARACTERISTIC cal_PTCTempRecircOn "" VALUE 0x0000 /* @ECU_Address@cal_PTCTempRecircOn@ */ Scalar_FLOAT32_IEEE 0 ME11_CM_single_per_ -3.4E+38 3.4E+38 /end CHARACTERISTIC
/begin CHARACTERISTIC cal_PressRateVal1 "" VALUE 0x0000 /* @ECU_Address@cal_PressRateVal1@ */ Scalar_FLOAT32_IEEE 0 ME11_CM_single_percent_ 0.0 30.0 /end CHARACTERISTIC
/begin CHARACTERISTIC cal_PressRateVal1Relay "" VALUE 0x0000 /* @ECU_Address@cal_PressRateVal1Relay@ */ Scalar_FLOAT32_IEEE 0 ME11_CM_single_percent_ 0.0 30.0 /end CHARACTERISTIC
/begin CHARACTERISTIC cal_PressRateVal2 "" VALUE 0x0000 /* @ECU_Address@cal_PressRateVal2@ */ Scalar_FLOAT32_IEEE 0 ME11_CM_single_percent_ 0.0 30.0 /end CHARACTERISTIC
/begin CHARACTERISTIC cal_PressRateVal2Relay "" VALUE 0x0000 /* @ECU_Address@cal_PressRateVal2Relay@ */ Scalar_FLOAT32_IEEE 0 ME11_CM_single_percent_ 0.0 30.0 /end CHARACTERISTIC
/begin CHARACTERISTIC cal_PressRateVal3 "" VALUE 0x0000 /* @ECU_Address@cal_PressRateVal3@ */ Scalar_FLOAT32_IEEE 0 ME11_CM_single_percent_ 0.0 30.0 /end CHARACTERISTIC
/begin CHARACTERISTIC cal_PressRateVal3Relay "" VALUE 0x0000 /* @ECU_Address@cal_PressRateVal3Relay@ */ Scalar_FLOAT32_IEEE 0 ME11_CM_single_percent_ 0.0 30.0 /end CHARACTERISTIC
/begin CHARACTERISTIC cal_PressRateVal4 "" VALUE 0x0000 /* @ECU_Address@cal_PressRateVal4@ */ Scalar_FLOAT32_IEEE 0 ME11_CM_single_percent_ 0.0 30.0 /end CHARACTERISTIC
/begin CHARACTERISTIC cal_PsDuctFaceFloorFaFactor "" VALUE 0x0000 /* @ECU_Address@cal_PsDuctFaceFloorFaFactor@ */ Scalar_FLOAT32_IEEE 0 ME11_CM_single_per_ -3.4E+38 3.4E+38 /end CHARACTERISTIC
/begin CHARACTERISTIC cal_PsDuctFaceFloorFoFactor "" VALUE 0x0000 /* @ECU_Address@cal_PsDuctFaceFloorFoFactor@ */ Scalar_FLOAT32_IEEE 0 ME11_CM_single_per_ -3.4E+38 3.4E+38 /end CHARACTERISTIC
/begin CHARACTERISTIC cal_PsErrOfEvaDVT2CoolMixOff "" VALUE 0x0000 /* @ECU_Address@cal_PsErrOfEvaDVT2CoolMixOff@ */ Scalar_FLOAT32_IEEE 0 ME11_CM_single_per_ -40.0 100.0 /end CHARACTERISTIC
/begin CHARACTERISTIC cal_PsErrOfEvaDVT2CoolMixOn "" VALUE 0x0000 /* @ECU_Address@cal_PsErrOfEvaDVT2CoolMixOn@ */ Scalar_FLOAT32_IEEE 0 ME11_CM_single_per_ -40.0 100.0 /end CHARACTERISTIC
/begin CHARACTERISTIC cal_PsErrOfPtcDVT2HeatMixOff "" VALUE 0x0000 /* @ECU_Address@cal_PsErrOfPtcDVT2HeatMixOff@ */ Scalar_FLOAT32_IEEE 0 ME11_CM_single_per_ -40.0 100.0 /end CHARACTERISTIC
/begin CHARACTERISTIC cal_PsErrOfPtcDVT2HeatMixOn "" VALUE 0x0000 /* @ECU_Address@cal_PsErrOfPtcDVT2HeatMixOn@ */ Scalar_FLOAT32_IEEE 0 ME11_CM_single_per_ -40.0 100.0 /end CHARACTERISTIC
/begin CHARACTERISTIC cal_PsMixDesValPIDIntegDeadBand "" VALUE 0x0000 /* @ECU_Address@cal_PsMixDesValPIDIntegDeadBand@ */ Scalar_FLOAT32_IEEE 0 ME11_CM_single_per_ -3.4E+38 3.4E+38 /end CHARACTERISTIC
/begin CHARACTERISTIC cal_PsMixDesValPID_IsumMax "" VALUE 0x0000 /* @ECU_Address@cal_PsMixDesValPID_IsumMax@ */ Scalar_FLOAT32_IEEE 0 ME11_CM_single_per_ -3.4E+38 3.4E+38 /end CHARACTERISTIC
/begin CHARACTERISTIC cal_PsMixDesValPID_IsumMin "" VALUE 0x0000 /* @ECU_Address@cal_PsMixDesValPID_IsumMin@ */ Scalar_FLOAT32_IEEE 0 ME11_CM_single_per_ -3.4E+38 3.4E+38 /end CHARACTERISTIC
/begin CHARACTERISTIC cal_PsMixDesValPID_Ki "" VALUE 0x0000 /* @ECU_Address@cal_PsMixDesValPID_Ki@ */ Scalar_FLOAT32_IEEE 0 ME11_CM_single_per_ -3.4E+38 3.4E+38 /end CHARACTERISTIC
/begin CHARACTERISTIC cal_PsMixDesValPID_KiNeg "" VALUE 0x0000 /* @ECU_Address@cal_PsMixDesValPID_KiNeg@ */ Scalar_FLOAT32_IEEE 0 ME11_CM_single_per_ -3.4E+38 3.4E+38 /end CHARACTERISTIC
/begin CHARACTERISTIC cal_PsMixDesValPID_KiPos "" VALUE 0x0000 /* @ECU_Address@cal_PsMixDesValPID_KiPos@ */ Scalar_FLOAT32_IEEE 0 ME11_CM_single_per_ -3.4E+38 3.4E+38 /end CHARACTERISTIC
/begin CHARACTERISTIC cal_PsMixDesValPID_Kp "" VALUE 0x0000 /* @ECU_Address@cal_PsMixDesValPID_Kp@ */ Scalar_FLOAT32_IEEE 0 ME11_CM_single_per_ -3.4E+38 3.4E+38 /end CHARACTERISTIC
/begin CHARACTERISTIC cal_PsMixDesValPID_KpNeg "" VALUE 0x0000 /* @ECU_Address@cal_PsMixDesValPID_KpNeg@ */ Scalar_FLOAT32_IEEE 0 ME11_CM_single_per_ -3.4E+38 3.4E+38 /end CHARACTERISTIC
/begin CHARACTERISTIC cal_PsMixDesValPID_KpPos "" VALUE 0x0000 /* @ECU_Address@cal_PsMixDesValPID_KpPos@ */ Scalar_FLOAT32_IEEE 0 ME11_CM_single_per_ -3.4E+38 3.4E+38 /end CHARACTERISTIC
/begin CHARACTERISTIC cal_PsMixDesValPID_pWinNeg "" VALUE 0x0000 /* @ECU_Address@cal_PsMixDesValPID_pWinNeg@ */ Scalar_FLOAT32_IEEE 0 ME11_CM_single_per_ -3.4E+38 3.4E+38 /end CHARACTERISTIC
/begin CHARACTERISTIC cal_PsMixDesValPID_pWinPos "" VALUE 0x0000 /* @ECU_Address@cal_PsMixDesValPID_pWinPos@ */ Scalar_FLOAT32_IEEE 0 ME11_CM_single_per_ -3.4E+38 3.4E+38 /end CHARACTERISTIC
/begin CHARACTERISTIC cal_PtcPwrDesValPIDDeadBandNeg "" VALUE 0x0000 /* @ECU_Address@cal_PtcPwrDesValPIDDeadBandNeg@ */ Scalar_FLOAT32_IEEE 0 ME11_CM_single_per_ -3.4E+38 3.4E+38 /end CHARACTERISTIC
/begin CHARACTERISTIC cal_PtcPwrDesValPIDDeadBandPos "" VALUE 0x0000 /* @ECU_Address@cal_PtcPwrDesValPIDDeadBandPos@ */ Scalar_FLOAT32_IEEE 0 ME11_CM_single_per_ -3.4E+38 3.4E+38 /end CHARACTERISTIC
/begin CHARACTERISTIC cal_PtcPwrDesValPID_IsumMax "" VALUE 0x0000 /* @ECU_Address@cal_PtcPwrDesValPID_IsumMax@ */ Scalar_FLOAT32_IEEE 0 ME11_CM_single_per_ -3.4E+38 3.4E+38 /end CHARACTERISTIC
/begin CHARACTERISTIC cal_PtcPwrDesValPID_IsumMin "" VALUE 0x0000 /* @ECU_Address@cal_PtcPwrDesValPID_IsumMin@ */ Scalar_FLOAT32_IEEE 0 ME11_CM_single_per_ -3.4E+38 3.4E+38 /end CHARACTERISTIC
/begin CHARACTERISTIC cal_PtcPwrDesValPID_Ki "" VALUE 0x0000 /* @ECU_Address@cal_PtcPwrDesValPID_Ki@ */ Scalar_FLOAT32_IEEE 0 ME11_CM_single_per_ -3.4E+38 3.4E+38 /end CHARACTERISTIC
/begin CHARACTERISTIC cal_PtcPwrDesValPID_KiNeg "" VALUE 0x0000 /* @ECU_Address@cal_PtcPwrDesValPID_KiNeg@ */ Scalar_FLOAT32_IEEE 0 ME11_CM_single_per_ -3.4E+38 3.4E+38 /end CHARACTERISTIC
/begin CHARACTERISTIC cal_PtcPwrDesValPID_KiPos "" VALUE 0x0000 /* @ECU_Address@cal_PtcPwrDesValPID_KiPos@ */ Scalar_FLOAT32_IEEE 0 ME11_CM_single_per_ -3.4E+38 3.4E+38 /end CHARACTERISTIC
/begin CHARACTERISTIC cal_PtcPwrDesValPID_Kp "" VALUE 0x0000 /* @ECU_Address@cal_PtcPwrDesValPID_Kp@ */ Scalar_FLOAT32_IEEE 0 ME11_CM_single_per_ -3.4E+38 3.4E+38 /end CHARACTERISTIC
/begin CHARACTERISTIC cal_PtcPwrDesValPID_KpNeg "" VALUE 0x0000 /* @ECU_Address@cal_PtcPwrDesValPID_KpNeg@ */ Scalar_FLOAT32_IEEE 0 ME11_CM_single_per_ -3.4E+38 3.4E+38 /end CHARACTERISTIC
/begin CHARACTERISTIC cal_PtcPwrDesValPID_KpPos "" VALUE 0x0000 /* @ECU_Address@cal_PtcPwrDesValPID_KpPos@ */ Scalar_FLOAT32_IEEE 0 ME11_CM_single_per_ -3.4E+38 3.4E+38 /end CHARACTERISTIC
/begin CHARACTERISTIC cal_PtcPwrDesValPID_pWinNeg "" VALUE 0x0000 /* @ECU_Address@cal_PtcPwrDesValPID_pWinNeg@ */ Scalar_FLOAT32_IEEE 0 ME11_CM_single_per_ -3.4E+38 3.4E+38 /end CHARACTERISTIC
/begin CHARACTERISTIC cal_PtcPwrDesValPID_pWinPos "" VALUE 0x0000 /* @ECU_Address@cal_PtcPwrDesValPID_pWinPos@ */ Scalar_FLOAT32_IEEE 0 ME11_CM_single_per_ -3.4E+38 3.4E+38 /end CHARACTERISTIC
/begin CHARACTERISTIC cal_REC_DVTFresh "" VALUE 0x0000 /* @ECU_Address@cal_REC_DVTFresh@ */ Scalar_FLOAT32_IEEE 0 ME11_CM_single_per_ -3.4E+38 3.4E+38 /end CHARACTERISTIC
/begin CHARACTERISTIC cal_REC_DVTRecirc "" VALUE 0x0000 /* @ECU_Address@cal_REC_DVTRecirc@ */ Scalar_FLOAT32_IEEE 0 ME11_CM_single_per_ -3.4E+38 3.4E+38 /end CHARACTERISTIC
/begin CHARACTERISTIC cal_SensorTempDownFlg "" VALUE 0x0000 /* @ECU_Address@cal_SensorTempDownFlg@ */ Scalar_FLOAT32_IEEE 0 ME11_CM_single_mv 0.0 5000.0 /end CHARACTERISTIC
/begin CHARACTERISTIC cal_SensorTempUpFlt "" VALUE 0x0000 /* @ECU_Address@cal_SensorTempUpFlt@ */ Scalar_FLOAT32_IEEE 0 ME11_CM_single_mv 0.0 5000.0 /end CHARACTERISTIC
/begin CHARACTERISTIC cal_U_DVTFFSolarFilterRate "" VALUE 0x0000 /* @ECU_Address@cal_U_DVTFFSolarFilterRate@ */ Scalar_FLOAT32_IEEE 0 ME11_CM_single_per_ -3.4E+38 3.4E+38 /end CHARACTERISTIC
/begin CHARACTERISTIC cal_VehHeatSOCOff "" VALUE 0x0000 /* @ECU_Address@cal_VehHeatSOCOff@ */ Scalar_FLOAT32_IEEE 0 ME11_CM_single_percent_ 0.0 10.0 /end CHARACTERISTIC
/begin CHARACTERISTIC cal_VehHeatSOCOn "" VALUE 0x0000 /* @ECU_Address@cal_VehHeatSOCOn@ */ Scalar_FLOAT32_IEEE 0 ME11_CM_single_percent_ 0.0 10.0 /end CHARACTERISTIC
/begin CHARACTERISTIC cal_tBatBalExitACChrgMinCellTemp "" VALUE 0x0000 /* @ECU_Address@cal_tBatBalExitACChrgMinCellTemp@ */ Scalar_FLOAT32_IEEE 0 ME11_CM_single_C 0.0 10.0 /end CHARACTERISTIC
/begin CHARACTERISTIC cal_tBatBalExitBal1ToBatDiff "" VALUE 0x0000 /* @ECU_Address@cal_tBatBalExitBal1ToBatDiff@ */ Scalar_FLOAT32_IEEE 0 ME11_CM_single_C -5.0 5.0 /end CHARACTERISTIC
/begin CHARACTERISTIC cal_tBatBalExitBatToBal2Diff "" VALUE 0x0000 /* @ECU_Address@cal_tBatBalExitBatToBal2Diff@ */ Scalar_FLOAT32_IEEE 0 ME11_CM_single_C -5.0 5.0 /end CHARACTERISTIC
/begin CHARACTERISTIC cal_tBatBalExitDCChrgMinCellTemp "" VALUE 0x0000 /* @ECU_Address@cal_tBatBalExitDCChrgMinCellTemp@ */ Scalar_FLOAT32_IEEE 0 ME11_CM_single_C -40.0 50.0 /end CHARACTERISTIC
/begin CHARACTERISTIC cal_tBatBalExitMaxToMinCellDiff "" VALUE 0x0000 /* @ECU_Address@cal_tBatBalExitMaxToMinCellDiff@ */ Scalar_FLOAT32_IEEE 0 ME11_CM_single_C 0.0 10.0 /end CHARACTERISTIC
/begin CHARACTERISTIC cal_tBatBalONACChrgMinCellTemp "" VALUE 0x0000 /* @ECU_Address@cal_tBatBalONACChrgMinCellTemp@ */ Scalar_FLOAT32_IEEE 0 ME11_CM_single_C 0.0 30.0 /end CHARACTERISTIC
/begin CHARACTERISTIC cal_tBatHeatExitMaxToMinCellDiff "" VALUE 0x0000 /* @ECU_Address@cal_tBatHeatExitMaxToMinCellDiff@ */ Scalar_FLOAT32_IEEE 0 ME11_CM_single_C -40.0 40.0 /end CHARACTERISTIC
/begin CHARACTERISTIC cal_tLTROffIPUTemp "" VALUE 0x0000 /* @ECU_Address@cal_tLTROffIPUTemp@ */ Scalar_FLOAT32_IEEE 0 ME11_CM_single_C 35.0 80.0 /end CHARACTERISTIC
/begin CHARACTERISTIC cal_tLTROnIPUTemp "" VALUE 0x0000 /* @ECU_Address@cal_tLTROnIPUTemp@ */ Scalar_FLOAT32_IEEE 0 ME11_CM_single_C 40.0 80.0 /end CHARACTERISTIC
/begin CHARACTERISTIC cal_tLTROnMotInletTemp "" VALUE 0x0000 /* @ECU_Address@cal_tLTROnMotInletTemp@ */ Scalar_FLOAT32_IEEE 0 ME11_CM_single_C -40.0 100.0 /end CHARACTERISTIC
/begin CHARACTERISTIC cal_tLTROnMotTemp "" VALUE 0x0000 /* @ECU_Address@cal_tLTROnMotTemp@ */ Scalar_FLOAT32_IEEE 0 ME11_CM_single_C 40.0 80.0 /end CHARACTERISTIC
/begin CHARACTERISTIC cal_tMotHeatBatACChrgMinCellTempLow "" VALUE 0x0000 /* @ECU_Address@cal_tMotHeatBatACChrgMinCellTempLow@ */ Scalar_FLOAT32_IEEE 0 ME11_CM_single_C -20.0 20.0 /end CHARACTERISTIC
/begin CHARACTERISTIC cal_tMotHeatBatMinCellTempLow "" VALUE 0x0000 /* @ECU_Address@cal_tMotHeatBatMinCellTempLow@ */ Scalar_FLOAT32_IEEE 0 ME11_CM_single_C -20.0 20.0 /end CHARACTERISTIC
/begin CHARACTERISTIC cal_tMotHeatExitMinCellToBal1Diff "" VALUE 0x0000 /* @ECU_Address@cal_tMotHeatExitMinCellToBal1Diff@ */ Scalar_FLOAT32_IEEE 0 ME11_CM_single_C 0.0 10.0 /end CHARACTERISTIC
/begin CHARACTERISTIC cal_tMotHeatExitMinCellToMotTempDiff "" VALUE 0x0000 /* @ECU_Address@cal_tMotHeatExitMinCellToMotTempDiff@ */ Scalar_FLOAT32_IEEE 0 ME11_CM_single_C 0.0 10.0 /end CHARACTERISTIC
/begin CHARACTERISTIC cal_tMotHeatOnMotToMinCellDiff "" VALUE 0x0000 /* @ECU_Address@cal_tMotHeatOnMotToMinCellDiff@ */ Scalar_FLOAT32_IEEE 0 ME11_CM_single_C 0.0 10.0 /end CHARACTERISTIC
/begin CHARACTERISTIC cal_tMotStorExitMaxCellTemp "" VALUE 0x0000 /* @ECU_Address@cal_tMotStorExitMaxCellTemp@ */ Scalar_FLOAT32_IEEE 0 ME11_CM_single_C 20.0 40.0 /end CHARACTERISTIC
/begin CHARACTERISTIC cal_tMotStorExitMotToMinCellDiff "" VALUE 0x0000 /* @ECU_Address@cal_tMotStorExitMotToMinCellDiff@ */ Scalar_FLOAT32_IEEE 0 ME11_CM_single_C -10.0 10.0 /end CHARACTERISTIC
/begin CHARACTERISTIC cal_tMotStorMinCellTempLow "" VALUE 0x0000 /* @ECU_Address@cal_tMotStorMinCellTempLow@ */ Scalar_FLOAT32_IEEE 0 ME11_CM_single_C 0.0 20.0 /end CHARACTERISTIC
/begin CHARACTERISTIC cal_tMotStorOnMotToMinCellDiff "" VALUE 0x0000 /* @ECU_Address@cal_tMotStorOnMotToMinCellDiff@ */ Scalar_FLOAT32_IEEE 0 ME11_CM_single_C 0.0 10.0 /end CHARACTERISTIC
/begin CHARACTERISTIC cal_FalseTime2EnvTamb "" VALUE 0x0000 /* @ECU_Address@cal_FalseTime2EnvTamb@ */ Scalar_UWORD 0 ME11_CM_uint16_per_ 0 65535 /end CHARACTERISTIC
/begin CHARACTERISTIC cal_PtcPwrDesValPID_LL "" VALUE 0x0000 /* @ECU_Address@cal_PtcPwrDesValPID_LL@ */ Scalar_UWORD 0 ME11_CM_uint16_per_ 0 65535 /end CHARACTERISTIC
/begin CHARACTERISTIC cal_PtcPwrDesValPID_UL "" VALUE 0x0000 /* @ECU_Address@cal_PtcPwrDesValPID_UL@ */ Scalar_UWORD 0 ME11_CM_uint16_per_ 0 65535 /end CHARACTERISTIC
/begin CHARACTERISTIC cal_RiseTime2EnvTamb "" VALUE 0x0000 /* @ECU_Address@cal_RiseTime2EnvTamb@ */ Scalar_UWORD 0 ME11_CM_uint16_per_ 0 65535 /end CHARACTERISTIC
/begin CHARACTERISTIC cal_tiAQSFresh2RecircDelay "" VALUE 0x0000 /* @ECU_Address@cal_tiAQSFresh2RecircDelay@ */ Scalar_UWORD 0 ME11_CM_uint16_per_ 0 65535 /end CHARACTERISTIC
/begin CHARACTERISTIC cal_tiAQSRecirc2FreshDelay "" VALUE 0x0000 /* @ECU_Address@cal_tiAQSRecirc2FreshDelay@ */ Scalar_UWORD 0 ME11_CM_uint16_per_ 0 65535 /end CHARACTERISTIC
/begin CHARACTERISTIC cal_tiCO2Fresh2RecircMax "" VALUE 0x0000 /* @ECU_Address@cal_tiCO2Fresh2RecircMax@ */ Scalar_UWORD 0 ME11_CM_uint16_per_ 0 65535 /end CHARACTERISTIC
/begin CHARACTERISTIC cal_tiCO2Recirc2FreshMax "" VALUE 0x0000 /* @ECU_Address@cal_tiCO2Recirc2FreshMax@ */ Scalar_UWORD 0 ME11_CM_uint16_per_ 0 65535 /end CHARACTERISTIC
/begin CHARACTERISTIC cal_BatModeData "" VALUE 0x0000 /* @ECU_Address@cal_BatModeData@ */ Scalar_UBYTE 0 ME11_CM_BatModes_null 0 6 /end CHARACTERISTIC
/begin CHARACTERISTIC cal_CabinModeData "" VALUE 0x0000 /* @ECU_Address@cal_CabinModeData@ */ Scalar_UBYTE 0 ME11_CM_CabinMode_null 0 7 /end CHARACTERISTIC
/begin CHARACTERISTIC cal_AEXVEnbData "" VALUE 0x0000 /* @ECU_Address@cal_AEXVEnbData@ */ Scalar_BOOLEAN 0 ME11_CM_boolean_flg 0.0 1.0 /end CHARACTERISTIC
/begin CHARACTERISTIC cal_AEXVEnbDataEnb "" VALUE 0x0000 /* @ECU_Address@cal_AEXVEnbDataEnb@ */ Scalar_BOOLEAN 0 ME11_CM_boolean_flg 0.0 1.0 /end CHARACTERISTIC
/begin CHARACTERISTIC cal_AEXVInitReqDataeEnb "" VALUE 0x0000 /* @ECU_Address@cal_AEXVInitReqDataeEnb@ */ Scalar_BOOLEAN 0 ME11_CM_boolean_flg 0.0 1.0 /end CHARACTERISTIC
/begin CHARACTERISTIC cal_AEXVPosDataEnb "" VALUE 0x0000 /* @ECU_Address@cal_AEXVPosDataEnb@ */ Scalar_BOOLEAN 0 ME11_CM_boolean_flg 0.0 1.0 /end CHARACTERISTIC
/begin CHARACTERISTIC cal_BEXVEnbData "" VALUE 0x0000 /* @ECU_Address@cal_BEXVEnbData@ */ Scalar_BOOLEAN 0 ME11_CM_boolean_flg 0.0 1.0 /end CHARACTERISTIC
/begin CHARACTERISTIC cal_BEXVEnbDataEnb "" VALUE 0x0000 /* @ECU_Address@cal_BEXVEnbDataEnb@ */ Scalar_BOOLEAN 0 ME11_CM_boolean_flg 0.0 1.0 /end CHARACTERISTIC
/begin CHARACTERISTIC cal_BEXVInitReqDataeEnb "" VALUE 0x0000 /* @ECU_Address@cal_BEXVInitReqDataeEnb@ */ Scalar_BOOLEAN 0 ME11_CM_boolean_flg 0.0 1.0 /end CHARACTERISTIC
/begin CHARACTERISTIC cal_BatCoolOverData "" VALUE 0x0000 /* @ECU_Address@cal_BatCoolOverData@ */ Scalar_BOOLEAN 0 ME11_CM_boolean_flg 0.0 1.0 /end CHARACTERISTIC
/begin CHARACTERISTIC cal_BatCoolOverEnb "" VALUE 0x0000 /* @ECU_Address@cal_BatCoolOverEnb@ */ Scalar_BOOLEAN 0 ME11_CM_boolean_flg 0.0 1.0 /end CHARACTERISTIC
/begin CHARACTERISTIC cal_BatHeatACCMEnb "" VALUE 0x0000 /* @ECU_Address@cal_BatHeatACCMEnb@ */ Scalar_BOOLEAN 0 ME11_CM_boolean_flg 0.0 1.0 /end CHARACTERISTIC
/begin CHARACTERISTIC cal_BatHeatOverData "" VALUE 0x0000 /* @ECU_Address@cal_BatHeatOverData@ */ Scalar_BOOLEAN 0 ME11_CM_boolean_flg 0.0 1.0 /end CHARACTERISTIC
/begin CHARACTERISTIC cal_BatHeatOverEnb "" VALUE 0x0000 /* @ECU_Address@cal_BatHeatOverEnb@ */ Scalar_BOOLEAN 0 ME11_CM_boolean_flg 0.0 1.0 /end CHARACTERISTIC
/begin CHARACTERISTIC cal_BatModeEnb "" VALUE 0x0000 /* @ECU_Address@cal_BatModeEnb@ */ Scalar_BOOLEAN 0 ME11_CM_boolean_flg 0.0 1.0 /end CHARACTERISTIC
/begin CHARACTERISTIC cal_C3WVSLStsDataEnb "" VALUE 0x0000 /* @ECU_Address@cal_C3WVSLStsDataEnb@ */ Scalar_BOOLEAN 0 ME11_CM_boolean_flg 0.0 1.0 /end CHARACTERISTIC
/begin CHARACTERISTIC cal_C5WVSLStsDataEnb "" VALUE 0x0000 /* @ECU_Address@cal_C5WVSLStsDataEnb@ */ Scalar_BOOLEAN 0 ME11_CM_boolean_flg 0.0 1.0 /end CHARACTERISTIC
/begin CHARACTERISTIC cal_CabinModeEnb "" VALUE 0x0000 /* @ECU_Address@cal_CabinModeEnb@ */ Scalar_BOOLEAN 0 ME11_CM_boolean_flg 0.0 1.0 /end CHARACTERISTIC
/begin CHARACTERISTIC cal_EvaDesLLSelect "" VALUE 0x0000 /* @ECU_Address@cal_EvaDesLLSelect@ */ Scalar_BOOLEAN 0 ME11_CM_boolean_per_ 0 1 /end CHARACTERISTIC
/begin CHARACTERISTIC cal_HPEXVEnbData "" VALUE 0x0000 /* @ECU_Address@cal_HPEXVEnbData@ */ Scalar_BOOLEAN 0 ME11_CM_boolean_flg 0.0 1.0 /end CHARACTERISTIC
/begin CHARACTERISTIC cal_HPEXVEnbDataEnb "" VALUE 0x0000 /* @ECU_Address@cal_HPEXVEnbDataEnb@ */ Scalar_BOOLEAN 0 ME11_CM_boolean_flg 0.0 1.0 /end CHARACTERISTIC
/begin CHARACTERISTIC cal_HPEXVPosDataEnb "" VALUE 0x0000 /* @ECU_Address@cal_HPEXVPosDataEnb@ */ Scalar_BOOLEAN 0 ME11_CM_boolean_flg 0.0 1.0 /end CHARACTERISTIC
/begin CHARACTERISTIC cal_LessThanT1CalSwt "" VALUE 0x0000 /* @ECU_Address@cal_LessThanT1CalSwt@ */ Scalar_BOOLEAN 0 ME11_CM_boolean_flg 0.0 1.0 /end CHARACTERISTIC
/begin CHARACTERISTIC cal_bACAutoData "" VALUE 0x0000 /* @ECU_Address@cal_bACAutoData@ */ Scalar_BOOLEAN 0 ME11_CM_boolean_flg 0.0 1.0 /end CHARACTERISTIC
/begin CHARACTERISTIC cal_bACAutoEnb "" VALUE 0x0000 /* @ECU_Address@cal_bACAutoEnb@ */ Scalar_BOOLEAN 0 ME11_CM_boolean_flg 0.0 1.0 /end CHARACTERISTIC
/begin CHARACTERISTIC cal_bACDefrostData "" VALUE 0x0000 /* @ECU_Address@cal_bACDefrostData@ */ Scalar_BOOLEAN 0 ME11_CM_boolean_flg 0.0 1.0 /end CHARACTERISTIC
/begin CHARACTERISTIC cal_bACDefrostEnb "" VALUE 0x0000 /* @ECU_Address@cal_bACDefrostEnb@ */ Scalar_BOOLEAN 0 ME11_CM_boolean_flg 0.0 1.0 /end CHARACTERISTIC
/begin CHARACTERISTIC cal_bACOnOffData "" VALUE 0x0000 /* @ECU_Address@cal_bACOnOffData@ */ Scalar_BOOLEAN 0 ME11_CM_boolean_flg 0.0 1.0 /end CHARACTERISTIC
/begin CHARACTERISTIC cal_bACOnOffEnb "" VALUE 0x0000 /* @ECU_Address@cal_bACOnOffEnb@ */ Scalar_BOOLEAN 0 ME11_CM_boolean_flg 0.0 1.0 /end CHARACTERISTIC
/begin CHARACTERISTIC cal_eACStsEnb "" VALUE 0x0000 /* @ECU_Address@cal_eACStsEnb@ */ Scalar_BOOLEAN 0 ME11_CM_boolean_flg 0.0 1.0 /end CHARACTERISTIC
/begin CHARACTERISTIC AC_ColdStart "" VALUE 0x0000 /* @ECU_Address@AC_ColdStart@ */ Scalar_UBYTE 0 ME11_CM_uint8_per_ 0.0 64.0 /end CHARACTERISTIC
/begin CHARACTERISTIC AC_HotStart "" VALUE 0x0000 /* @ECU_Address@AC_HotStart@ */ Scalar_UBYTE 0 ME11_CM_uint8_per_ 0.0 64.0 /end CHARACTERISTIC
/begin CHARACTERISTIC AC_LittleColdStart "" VALUE 0x0000 /* @ECU_Address@AC_LittleColdStart@ */ Scalar_UBYTE 0 ME11_CM_uint8_per_ 0.0 64.0 /end CHARACTERISTIC
/begin CHARACTERISTIC DriveFRESH "" VALUE 0x0000 /* @ECU_Address@DriveFRESH@ */ Scalar_UBYTE 0 ME11_CM_uint8_null 0.0 100.0 /end CHARACTERISTIC
/begin CHARACTERISTIC RECIRC "" VALUE 0x0000 /* @ECU_Address@RECIRC@ */ Scalar_UBYTE 0 ME11_CM_uint8_null 0.0 100.0 /end CHARACTERISTIC
/begin CHARACTERISTIC cal_AEXVInitReqData "" VALUE 0x0000 /* @ECU_Address@cal_AEXVInitReqData@ */ Scalar_UBYTE 0 ME11_CM_uint8_sts 0.0 4.0 /end CHARACTERISTIC
/begin CHARACTERISTIC cal_AQS2InRecThreVal "" VALUE 0x0000 /* @ECU_Address@cal_AQS2InRecThreVal@ */ Scalar_UBYTE 0 ME11_CM_uint8_per_ 0.0 255.0 /end CHARACTERISTIC
/begin CHARACTERISTIC cal_AQS2OutRecThreVal "" VALUE 0x0000 /* @ECU_Address@cal_AQS2OutRecThreVal@ */ Scalar_UBYTE 0 ME11_CM_uint8_per_ 0.0 255.0 /end CHARACTERISTIC
/begin CHARACTERISTIC cal_BEXVInitReqData "" VALUE 0x0000 /* @ECU_Address@cal_BEXVInitReqData@ */ Scalar_UBYTE 0 ME11_CM_uint8_sts 0.0 4.0 /end CHARACTERISTIC
/begin CHARACTERISTIC cal_BlowerFanSpdLL "" VALUE 0x0000 /* @ECU_Address@cal_BlowerFanSpdLL@ */ Scalar_UBYTE 0 ME11_CM_uint8_per_ 0 255 /end CHARACTERISTIC
/begin CHARACTERISTIC cal_BlowerFanSpdVentUL "" VALUE 0x0000 /* @ECU_Address@cal_BlowerFanSpdVentUL@ */ Scalar_UBYTE 0 ME11_CM_uint8_per_ 0 255 /end CHARACTERISTIC
/begin CHARACTERISTIC cal_C3WVSLStsData "" VALUE 0x0000 /* @ECU_Address@cal_C3WVSLStsData@ */ Scalar_UBYTE 0 ME11_CM_uint8_sts 0.0 5.0 /end CHARACTERISTIC
/begin CHARACTERISTIC cal_C5WVSLStsData "" VALUE 0x0000 /* @ECU_Address@cal_C5WVSLStsData@ */ Scalar_UBYTE 0 ME11_CM_uint8_sts 0.0 5.0 /end CHARACTERISTIC
/begin CHARACTERISTIC cal_DrMixDesValPIDLL "" VALUE 0x0000 /* @ECU_Address@cal_DrMixDesValPIDLL@ */ Scalar_UBYTE 0 ME11_CM_uint8_per_ 0 255 /end CHARACTERISTIC
/begin CHARACTERISTIC cal_DrMixDesValPIDUL "" VALUE 0x0000 /* @ECU_Address@cal_DrMixDesValPIDUL@ */ Scalar_UBYTE 0 ME11_CM_uint8_per_ 0 255 /end CHARACTERISTIC
/begin CHARACTERISTIC cal_FANSpdHotStartLL "" VALUE 0x0000 /* @ECU_Address@cal_FANSpdHotStartLL@ */ Scalar_UBYTE 0 ME11_CM_uint8_per_ 0 255 /end CHARACTERISTIC
/begin CHARACTERISTIC cal_FANSpdHotStartUL "" VALUE 0x0000 /* @ECU_Address@cal_FANSpdHotStartUL@ */ Scalar_UBYTE 0 ME11_CM_uint8_per_ 0 255 /end CHARACTERISTIC
/begin CHARACTERISTIC cal_FANSpdModeShiftMax "" VALUE 0x0000 /* @ECU_Address@cal_FANSpdModeShiftMax@ */ Scalar_UBYTE 0 ME11_CM_uint8_per_ 0 255 /end CHARACTERISTIC
/begin CHARACTERISTIC cal_MixDoor2CabinHeatingEn_OFF "" VALUE 0x0000 /* @ECU_Address@cal_MixDoor2CabinHeatingEn_OFF@ */ Scalar_UBYTE 0 ME11_CM_uint8_percent_ 0.0 100.0 /end CHARACTERISTIC
/begin CHARACTERISTIC cal_MixDoor2CabinHeatingEn_ON "" VALUE 0x0000 /* @ECU_Address@cal_MixDoor2CabinHeatingEn_ON@ */ Scalar_UBYTE 0 ME11_CM_uint8_percent_ 0.0 100.0 /end CHARACTERISTIC
/begin CHARACTERISTIC cal_PsMixDesValPIDLL "" VALUE 0x0000 /* @ECU_Address@cal_PsMixDesValPIDLL@ */ Scalar_UBYTE 0 ME11_CM_uint8_per_ 0 255 /end CHARACTERISTIC
/begin CHARACTERISTIC cal_PsMixDesValPIDUL "" VALUE 0x0000 /* @ECU_Address@cal_PsMixDesValPIDUL@ */ Scalar_UBYTE 0 ME11_CM_uint8_per_ 0 255 /end CHARACTERISTIC
/begin CHARACTERISTIC cal_eACStsData "" VALUE 0x0000 /* @ECU_Address@cal_eACStsData@ */ Scalar_UBYTE 0 ME11_CM_uint8_flg 0.0 10.0 /end CHARACTERISTIC
/begin MEASUREMENT ACSen_sEnvTempFilter "" FLOAT32_IEEE ME11_CM_single_C 0 0 -3.4E+38 3.4E+38 ECU_ADDRESS 0x0000 /* @ECU_Address@ACSen_sEnvTempFilter@ */ /end MEASUREMENT
/begin MEASUREMENT ACCtl_tDrDVTSolarCor "" FLOAT32_IEEE ME11_CM_single_null 0 0 -3.4E+38 3.4E+38 ECU_ADDRESS 0x0000 /* @ECU_Address@ACCtl_tDrDVTSolarCor@ */ /end MEASUREMENT
/begin MEASUREMENT ACCtl_tDrDVT "" FLOAT32_IEEE ME11_CM_single_null 0 0 -3.4E+38 3.4E+38 ECU_ADDRESS 0x0000 /* @ECU_Address@ACCtl_tDrDVT@ */ /end MEASUREMENT
/begin MEASUREMENT AC_Ps2DrSetTempDvt "" FLOAT32_IEEE ME11_CM_single_null 0 0 -3.4E+38 3.4E+38 ECU_ADDRESS 0x0000 /* @ECU_Address@AC_Ps2DrSetTempDvt@ */ /end MEASUREMENT
/begin MEASUREMENT ACCtl_tPsDVTCabinCor "" FLOAT32_IEEE ME11_CM_single_null 0 0 -3.4E+38 3.4E+38 ECU_ADDRESS 0x0000 /* @ECU_Address@ACCtl_tPsDVTCabinCor@ */ /end MEASUREMENT
/begin MEASUREMENT ACCtl_tPsDVTSolarCor "" FLOAT32_IEEE ME11_CM_single_null 0 0 -3.4E+38 3.4E+38 ECU_ADDRESS 0x0000 /* @ECU_Address@ACCtl_tPsDVTSolarCor@ */ /end MEASUREMENT
/begin MEASUREMENT ACCtl_tPsDVT "" FLOAT32_IEEE ME11_CM_single_null 0 0 -3.4E+38 3.4E+38 ECU_ADDRESS 0x0000 /* @ECU_Address@ACCtl_tPsDVT@ */ /end MEASUREMENT
/begin MEASUREMENT ACCtl_tDrEvapDes "" FLOAT32_IEEE ME11_CM_single_null 0 0 -3.4E+38 3.4E+38 ECU_ADDRESS 0x0000 /* @ECU_Address@ACCtl_tDrEvapDes@ */ /end MEASUREMENT
/begin MEASUREMENT ACCtl_tPsEvapDes "" FLOAT32_IEEE ME11_CM_single_null 0 0 -3.4E+38 3.4E+38 ECU_ADDRESS 0x0000 /* @ECU_Address@ACCtl_tPsEvapDes@ */ /end MEASUREMENT
/begin MEASUREMENT AC_DVT2PTCErr "" FLOAT32_IEEE ME11_CM_single_null 0 0 -3.4E+38 3.4E+38 ECU_ADDRESS 0x0000 /* @ECU_Address@AC_DVT2PTCErr@ */ /end MEASUREMENT
/begin MEASUREMENT SOMCtl_sBatHeatT2 "" FLOAT32_IEEE ME11_CM_single_C 0 0 -3.4E+38 3.4E+38 ECU_ADDRESS 0x0000 /* @ECU_Address@SOMCtl_sBatHeatT2@ */ /end MEASUREMENT
/begin MEASUREMENT ACTCtl_sBatHeatInletTrgT "" FLOAT32_IEEE ME11_CM_single_C 0 0 -3.4E+38 3.4E+38 ECU_ADDRESS 0x0000 /* @ECU_Address@ACTCtl_sBatHeatInletTrgT@ */ /end MEASUREMENT
/begin MEASUREMENT SOMCtl_sBatHeatT1 "" FLOAT32_IEEE ME11_CM_single_C 0 0 -3.4E+38 3.4E+38 ECU_ADDRESS 0x0000 /* @ECU_Address@SOMCtl_sBatHeatT1@ */ /end MEASUREMENT
/begin MEASUREMENT ACTCtl_sACCMI_Cor "" FLOAT32_IEEE ME11_CM_single_rpm 0 0 -3.4E+38 3.4E+38 ECU_ADDRESS 0x0000 /* @ECU_Address@ACTCtl_sACCMI_Cor@ */ /end MEASUREMENT
/begin MEASUREMENT ACTCtl_sAEXVCtrlBFF "" FLOAT32_IEEE ME11_CM_single_percent_ 0 0 -3.4E+38 3.4E+38 ECU_ADDRESS 0x0000 /* @ECU_Address@ACTCtl_sAEXVCtrlBFF@ */ /end MEASUREMENT
/begin MEASUREMENT ACTCtl_sCondDepDiff "" FLOAT32_IEEE ME11_CM_single_C 0 0 -3.4E+38 3.4E+38 ECU_ADDRESS 0x0000 /* @ECU_Address@ACTCtl_sCondDepDiff@ */ /end MEASUREMENT
/begin MEASUREMENT ACTCtl_sAEXVI_Sum "" FLOAT32_IEEE ME11_CM_single_percent_ 0 0 -3.4E+38 3.4E+38 ECU_ADDRESS 0x0000 /* @ECU_Address@ACTCtl_sAEXVI_Sum@ */ /end MEASUREMENT
/begin MEASUREMENT ACTCtl_sAEXVP_Cor "" FLOAT32_IEEE ME11_CM_single_percent_ 0 0 -3.4E+38 3.4E+38 ECU_ADDRESS 0x0000 /* @ECU_Address@ACTCtl_sAEXVP_Cor@ */ /end MEASUREMENT
/begin MEASUREMENT ACTCtl_sAEXVPI_Cor "" FLOAT32_IEEE ME11_CM_single_percent_ 0 0 -3.4E+38 3.4E+38 ECU_ADDRESS 0x0000 /* @ECU_Address@ACTCtl_sAEXVPI_Cor@ */ /end MEASUREMENT
/begin MEASUREMENT ACTCtl_sBEXVCtrlBFF "" FLOAT32_IEEE ME11_CM_single_percent_ 0 0 -3.4E+38 3.4E+38 ECU_ADDRESS 0x0000 /* @ECU_Address@ACTCtl_sBEXVCtrlBFF@ */ /end MEASUREMENT
/begin MEASUREMENT ACTCtl_sBEXVI_Sum "" FLOAT32_IEEE ME11_CM_single_percent_ 0 0 -3.4E+38 3.4E+38 ECU_ADDRESS 0x0000 /* @ECU_Address@ACTCtl_sBEXVI_Sum@ */ /end MEASUREMENT
/begin MEASUREMENT ACTCtl_sBEXVP_Cor "" FLOAT32_IEEE ME11_CM_single_percent_ 0 0 -3.4E+38 3.4E+38 ECU_ADDRESS 0x0000 /* @ECU_Address@ACTCtl_sBEXVP_Cor@ */ /end MEASUREMENT
/begin MEASUREMENT ACTCtl_sBEXVPI_Cor "" FLOAT32_IEEE ME11_CM_single_percent_ 0 0 -3.4E+38 3.4E+38 ECU_ADDRESS 0x0000 /* @ECU_Address@ACTCtl_sBEXVPI_Cor@ */ /end MEASUREMENT
/begin MEASUREMENT ACTCtl_sBEXVPos "" FLOAT32_IEEE ME11_CM_single_percent_ 0 0 -3.4E+38 3.4E+38 ECU_ADDRESS 0x0000 /* @ECU_Address@ACTCtl_sBEXVPos@ */ /end MEASUREMENT
/begin MEASUREMENT ACTCtl_sHPEXVCtrlADiff "" FLOAT32_IEEE ME11_CM_single_C 0 0 -3.4E+38 3.4E+38 ECU_ADDRESS 0x0000 /* @ECU_Address@ACTCtl_sHPEXVCtrlADiff@ */ /end MEASUREMENT
/begin MEASUREMENT ACTCtl_sHPEXVP_Cor "" FLOAT32_IEEE ME11_CM_single_percent_ 0 0 -3.4E+38 3.4E+38 ECU_ADDRESS 0x0000 /* @ECU_Address@ACTCtl_sHPEXVP_Cor@ */ /end MEASUREMENT
/begin MEASUREMENT ACTCtl_sHPEXVI_Sum "" FLOAT32_IEEE ME11_CM_single_percent_ 0 0 -3.4E+38 3.4E+38 ECU_ADDRESS 0x0000 /* @ECU_Address@ACTCtl_sHPEXVI_Sum@ */ /end MEASUREMENT
/begin MEASUREMENT ACTCtl_sHPEXVPI_Cor "" FLOAT32_IEEE ME11_CM_single_percent_ 0 0 -3.4E+38 3.4E+38 ECU_ADDRESS 0x0000 /* @ECU_Address@ACTCtl_sHPEXVPI_Cor@ */ /end MEASUREMENT
/begin MEASUREMENT ACTCtl_sHPEXVStepLmt "" FLOAT32_IEEE ME11_CM_single_percent_ 0 0 -3.4E+38 3.4E+38 ECU_ADDRESS 0x0000 /* @ECU_Address@ACTCtl_sHPEXVStepLmt@ */ /end MEASUREMENT
/begin MEASUREMENT ACCtl_rPsBlowerModeSet "" FLOAT32_IEEE ME11_CM_single_null 0 0 -3.4E+38 3.4E+38 ECU_ADDRESS 0x0000 /* @ECU_Address@ACCtl_rPsBlowerModeSet@ */ /end MEASUREMENT
/begin MEASUREMENT ACCtl_sMixDoorClsFF "" FLOAT32_IEEE ME11_CM_single_percent_ 0 0 -3.4E+38 3.4E+38 ECU_ADDRESS 0x0000 /* @ECU_Address@ACCtl_sMixDoorClsFF@ */ /end MEASUREMENT
/begin MEASUREMENT GlbDa_LeftSolar "" UWORD ME11_CM_uint16_null 0 0 0 65535 ECU_ADDRESS 0x0000 /* @ECU_Address@GlbDa_LeftSolar@ */ /end MEASUREMENT
/begin MEASUREMENT GlbDa_RightSolar "" UWORD ME11_CM_uint16_null 0 0 0 65535 ECU_ADDRESS 0x0000 /* @ECU_Address@GlbDa_RightSolar@ */ /end MEASUREMENT
/begin MEASUREMENT GlbDa_Solar "" UWORD ME11_CM_uint16_null 0 0 0 65535 ECU_ADDRESS 0x0000 /* @ECU_Address@GlbDa_Solar@ */ /end MEASUREMENT
/begin MEASUREMENT SOMCtl_eMotorHeatBatOffFlg "" UWORD ME11_CM_uint16_flg 0 0 0 65535 ECU_ADDRESS 0x0000 /* @ECU_Address@SOMCtl_eMotorHeatBatOffFlg@ */ /end MEASUREMENT
/begin MEASUREMENT SOMCtl_eBatBalEntBFlg "" UBYTE ME11_CM_uint8_flg 0 0 0 255 ECU_ADDRESS 0x0000 /* @ECU_Address@SOMCtl_eBatBalEntBFlg@ */ /end MEASUREMENT
/begin MEASUREMENT SOMCtl_eBatLTROnFlg "" UBYTE ME11_CM_uint8_flg 0 0 0 255 ECU_ADDRESS 0x0000 /* @ECU_Address@SOMCtl_eBatLTROnFlg@ */ /end MEASUREMENT
/begin MEASUREMENT SOMCtl_eMotLTRAndBatBalOffFlg "" UBYTE ME11_CM_uint8_flg 0 0 0 255 ECU_ADDRESS 0x0000 /* @ECU_Address@SOMCtl_eMotLTRAndBatBalOffFlg@ */ /end MEASUREMENT
/begin MEASUREMENT SOMCtl_eMotLTRAndBatBalOn1Flg "" UBYTE ME11_CM_uint8_flg 0 0 0 255 ECU_ADDRESS 0x0000 /* @ECU_Address@SOMCtl_eMotLTRAndBatBalOn1Flg@ */ /end MEASUREMENT
/begin MEASUREMENT SOMCtl_eMotLTRAndBatBalOn2Flg "" UBYTE ME11_CM_uint8_flg 0 0 0 255 ECU_ADDRESS 0x0000 /* @ECU_Address@SOMCtl_eMotLTRAndBatBalOn2Flg@ */ /end MEASUREMENT
/begin MEASUREMENT SOMCtl_eMotorHeatBatFlg "" UBYTE ME11_CM_uint8_flg 0 0 0 255 ECU_ADDRESS 0x0000 /* @ECU_Address@SOMCtl_eMotorHeatBatFlg@ */ /end MEASUREMENT
/begin MEASUREMENT SOMCtl_eMotorHeatBat2Flg "" UBYTE ME11_CM_uint8_flg 0 0 0 255 ECU_ADDRESS 0x0000 /* @ECU_Address@SOMCtl_eMotorHeatBat2Flg@ */ /end MEASUREMENT
/begin MEASUREMENT SOMCtl_eNmlBatLTROnFlg "" UBYTE ME11_CM_uint8_flg 0 0 0 255 ECU_ADDRESS 0x0000 /* @ECU_Address@SOMCtl_eNmlBatLTROnFlg@ */ /end MEASUREMENT
/begin MEASUREMENT ACTCtl_eCOMPJudgeFlg "" UBYTE ME11_CM_uint8_flg 0 0 0 255 ECU_ADDRESS 0x0000 /* @ECU_Address@ACTCtl_eCOMPJudgeFlg@ */ /end MEASUREMENT
/begin MEASUREMENT AC_BlowerFanSpeedMin "" UBYTE ME11_CM_uint8_null 0 0 0 255 ECU_ADDRESS 0x0000 /* @ECU_Address@AC_BlowerFanSpeedMin@ */ /end MEASUREMENT
/begin MEASUREMENT AC_BlowerFanSpeedMax "" UBYTE ME11_CM_uint8_null 0 0 0 255 ECU_ADDRESS 0x0000 /* @ECU_Address@AC_BlowerFanSpeedMax@ */ /end MEASUREMENT
/begin MEASUREMENT ACTCtl_eC3WVSLSts "" UBYTE ME11_CM_uint8_sts 0 0 0 255 ECU_ADDRESS 0x0000 /* @ECU_Address@ACTCtl_eC3WVSLSts@ */ /end MEASUREMENT
/begin MEASUREMENT ACTCtl_eC5WVSLSts "" UBYTE ME11_CM_uint8_sts 0 0 0 255 ECU_ADDRESS 0x0000 /* @ECU_Address@ACTCtl_eC5WVSLSts@ */ /end MEASUREMENT
/begin MEASUREMENT ACTCtl_bAEXVInitReq "" UBYTE ME11_CM_uint8_sts 0 0 0 255 ECU_ADDRESS 0x0000 /* @ECU_Address@ACTCtl_bAEXVInitReq@ */ /end MEASUREMENT
/begin MEASUREMENT ACTCtl_bBEXVInitReq "" UBYTE ME11_CM_uint8_sts 0 0 0 255 ECU_ADDRESS 0x0000 /* @ECU_Address@ACTCtl_bBEXVInitReq@ */ /end MEASUREMENT
/begin MEASUREMENT HMICtl_eACSts "" UBYTE ME11_CM_uint8_null 0 0 0 255 ECU_ADDRESS 0x0000 /* @ECU_Address@HMICtl_eACSts@ */ /end MEASUREMENT
/begin MEASUREMENT ACTCtl_eCOMPSpdSecSts "" UBYTE ME11_CM_uint8_flg 0 0 0 255 ECU_ADDRESS 0x0000 /* @ECU_Address@ACTCtl_eCOMPSpdSecSts@ */ /end MEASUREMENT
/begin MEASUREMENT ACCtl_rPsBasicMixDoor "" UBYTE ME11_CM_uint8_null 0 0 0 255 ECU_ADDRESS 0x0000 /* @ECU_Address@ACCtl_rPsBasicMixDoor@ */ /end MEASUREMENT
/begin MEASUREMENT ACCtl_rPsMixDoorDes "" UBYTE ME11_CM_uint8_null 0 0 0 255 ECU_ADDRESS 0x0000 /* @ECU_Address@ACCtl_rPsMixDoorDes@ */ /end MEASUREMENT
/begin MEASUREMENT ACCtl_rDrBasicMixDoor "" UBYTE ME11_CM_uint8_null 0 0 0 255 ECU_ADDRESS 0x0000 /* @ECU_Address@ACCtl_rDrBasicMixDoor@ */ /end MEASUREMENT
/begin MEASUREMENT ACCtl_rDrMixDoorDes "" UBYTE ME11_CM_uint8_null 0 0 0 255 ECU_ADDRESS 0x0000 /* @ECU_Address@ACCtl_rDrMixDoorDes@ */ /end MEASUREMENT
/begin MEASUREMENT ACCtl_stRecForceChangeEna "" UBYTE ME11_CM_boolean_null 0 0 0 1 ECU_ADDRESS 0x0000 /* @ECU_Address@ACCtl_stRecForceChangeEna@ */ /end MEASUREMENT
/begin MEASUREMENT ACCtl_stRecNormalDefogEna "" UBYTE ME11_CM_boolean_null 0 0 0 1 ECU_ADDRESS 0x0000 /* @ECU_Address@ACCtl_stRecNormalDefogEna@ */ /end MEASUREMENT
/begin MEASUREMENT ACCtl_stRecTargetOutTempEna "" UBYTE ME11_CM_boolean_null 0 0 0 1 ECU_ADDRESS 0x0000 /* @ECU_Address@ACCtl_stRecTargetOutTempEna@ */ /end MEASUREMENT
/begin MEASUREMENT ACCtl_stRecVentEna "" UBYTE ME11_CM_boolean_null 0 0 0 1 ECU_ADDRESS 0x0000 /* @ECU_Address@ACCtl_stRecVentEna@ */ /end MEASUREMENT
/begin MEASUREMENT ACCtl_stRecWinterCondEna "" UBYTE ME11_CM_boolean_null 0 0 0 1 ECU_ADDRESS 0x0000 /* @ECU_Address@ACCtl_stRecWinterCondEna@ */ /end MEASUREMENT
/begin MEASUREMENT ACCtl_stRecSummerCondEna "" UBYTE ME11_CM_boolean_null 0 0 0 1 ECU_ADDRESS 0x0000 /* @ECU_Address@ACCtl_stRecSummerCondEna@ */ /end MEASUREMENT
/begin MEASUREMENT ACCtl_stRecPTCDvtEna "" UBYTE ME11_CM_boolean_flg 0 0 0 1 ECU_ADDRESS 0x0000 /* @ECU_Address@ACCtl_stRecPTCDvtEna@ */ /end MEASUREMENT
/begin MEASUREMENT ACCtl_stRecACHotStartEna "" UBYTE ME11_CM_boolean_null 0 0 0 1 ECU_ADDRESS 0x0000 /* @ECU_Address@ACCtl_stRecACHotStartEna@ */ /end MEASUREMENT
/begin MEASUREMENT ACCtl_stRecForceDefogEna "" UBYTE ME11_CM_boolean_null 0 0 0 1 ECU_ADDRESS 0x0000 /* @ECU_Address@ACCtl_stRecForceDefogEna@ */ /end MEASUREMENT
/begin MEASUREMENT ACCtl_stRecManualEna "" UBYTE ME11_CM_boolean_null 0 0 0 1 ECU_ADDRESS 0x0000 /* @ECU_Address@ACCtl_stRecManualEna@ */ /end MEASUREMENT
/begin MEASUREMENT ACCtl_stRecRemoteACEna "" UBYTE ME11_CM_boolean_null 0 0 0 1 ECU_ADDRESS 0x0000 /* @ECU_Address@ACCtl_stRecRemoteACEna@ */ /end MEASUREMENT
/begin MEASUREMENT SOMCtl_bBatCoolFlg "" UBYTE ME11_CM_boolean_flg 0 0 0 1 ECU_ADDRESS 0x0000 /* @ECU_Address@SOMCtl_bBatCoolFlg@ */ /end MEASUREMENT
/begin MEASUREMENT SOMCtl_bBatBalEntBFlg "" UBYTE ME11_CM_boolean_flg 0 0 0 1 ECU_ADDRESS 0x0000 /* @ECU_Address@SOMCtl_bBatBalEntBFlg@ */ /end MEASUREMENT
/begin MEASUREMENT SOMCtl_bMotLTRAndBatBalOffFlg "" UBYTE ME11_CM_boolean_flg 0 0 0 1 ECU_ADDRESS 0x0000 /* @ECU_Address@SOMCtl_bMotLTRAndBatBalOffFlg@ */ /end MEASUREMENT
/begin MEASUREMENT SOMCtl_bMotLTRAndBatBalOn1Flg "" UBYTE ME11_CM_boolean_flg 0 0 0 1 ECU_ADDRESS 0x0000 /* @ECU_Address@SOMCtl_bMotLTRAndBatBalOn1Flg@ */ /end MEASUREMENT
/begin MEASUREMENT SOMCtl_bMotLTRAndBatBalOn2Flg "" UBYTE ME11_CM_boolean_flg 0 0 0 1 ECU_ADDRESS 0x0000 /* @ECU_Address@SOMCtl_bMotLTRAndBatBalOn2Flg@ */ /end MEASUREMENT
/begin MEASUREMENT SOMCtl_bDBatLTROffFlg "" UBYTE ME11_CM_boolean_flg 0 0 0 1 ECU_ADDRESS 0x0000 /* @ECU_Address@SOMCtl_bDBatLTROffFlg@ */ /end MEASUREMENT
/begin MEASUREMENT SOMCtl_bBatHeatFlg "" UBYTE ME11_CM_boolean_flg 0 0 0 1 ECU_ADDRESS 0x0000 /* @ECU_Address@SOMCtl_bBatHeatFlg@ */ /end MEASUREMENT
/begin MEASUREMENT SOMCtl_bBatTSExitFlg "" UBYTE ME11_CM_boolean_flg 0 0 0 1 ECU_ADDRESS 0x0000 /* @ECU_Address@SOMCtl_bBatTSExitFlg@ */ /end MEASUREMENT
/begin MEASUREMENT SOMCtl_bMotorHeatBatOffFlg "" UBYTE ME11_CM_boolean_flg 0 0 0 1 ECU_ADDRESS 0x0000 /* @ECU_Address@SOMCtl_bMotorHeatBatOffFlg@ */ /end MEASUREMENT
/begin MEASUREMENT SOMCtl_bNmlBatLTROnFlg "" UBYTE ME11_CM_boolean_flg 0 0 0 1 ECU_ADDRESS 0x0000 /* @ECU_Address@SOMCtl_bNmlBatLTROnFlg@ */ /end MEASUREMENT
/begin MEASUREMENT SOMCtl_bDCBatLTROnFlg "" UBYTE ME11_CM_boolean_flg 0 0 0 1 ECU_ADDRESS 0x0000 /* @ECU_Address@SOMCtl_bDCBatLTROnFlg@ */ /end MEASUREMENT
/begin MEASUREMENT SOMCtrl_bBatLTRDelayFlg "" UBYTE ME11_CM_boolean_flg 0 0 0 1 ECU_ADDRESS 0x0000 /* @ECU_Address@SOMCtrl_bBatLTRDelayFlg@ */ /end MEASUREMENT
/begin MEASUREMENT SOMCtl_bBatLTROffFlg "" UBYTE ME11_CM_boolean_flg 0 0 0 1 ECU_ADDRESS 0x0000 /* @ECU_Address@SOMCtl_bBatLTROffFlg@ */ /end MEASUREMENT
/begin MEASUREMENT SOMCtl_bBatHeatB31tB1Flg "" UBYTE ME11_CM_boolean_flg 0 0 0 1 ECU_ADDRESS 0x0000 /* @ECU_Address@SOMCtl_bBatHeatB31tB1Flg@ */ /end MEASUREMENT
/begin MEASUREMENT ACCtl_stRecQkChargeCoolingEna "" UBYTE ME11_CM_boolean_null 0 0 0 1 ECU_ADDRESS 0x0000 /* @ECU_Address@ACCtl_stRecQkChargeCoolingEna@ */ /end MEASUREMENT
/begin MEASUREMENT ACCtl_stRecPCUTempEna "" UBYTE ME11_CM_boolean_null 0 0 0 1 ECU_ADDRESS 0x0000 /* @ECU_Address@ACCtl_stRecPCUTempEna@ */ /end MEASUREMENT
/begin MEASUREMENT ACCtl_stCabinHeatingEn "" UBYTE ME11_CM_boolean_null 0 0 0 1 ECU_ADDRESS 0x0000 /* @ECU_Address@ACCtl_stCabinHeatingEn@ */ /end MEASUREMENT
/begin MEASUREMENT ACTCtl_bPTCOnOrOffPwrDiff "" UBYTE ME11_CM_boolean_flg 0 0 0 1 ECU_ADDRESS 0x0000 /* @ECU_Address@ACTCtl_bPTCOnOrOffPwrDiff@ */ /end MEASUREMENT
/begin MEASUREMENT ACTCtl_bCtrlFPTCOnOrOffPwrDiff "" UBYTE ME11_CM_boolean_flg 0 0 0 1 ECU_ADDRESS 0x0000 /* @ECU_Address@ACTCtl_bCtrlFPTCOnOrOffPwrDiff@ */ /end MEASUREMENT
/begin MEASUREMENT ACTCtl_bAEXVEnb "" UBYTE ME11_CM_boolean_flg 0 0 0 1 ECU_ADDRESS 0x0000 /* @ECU_Address@ACTCtl_bAEXVEnb@ */ /end MEASUREMENT
/begin MEASUREMENT ACTCtl_bBEXVEnb "" UBYTE ME11_CM_boolean_flg 0 0 0 1 ECU_ADDRESS 0x0000 /* @ECU_Address@ACTCtl_bBEXVEnb@ */ /end MEASUREMENT
/begin MEASUREMENT ACTCtl_bLowPressProFlg "" UBYTE ME11_CM_boolean_flg 0 0 0 1 ECU_ADDRESS 0x0000 /* @ECU_Address@ACTCtl_bLowPressProFlg@ */ /end MEASUREMENT
/begin MEASUREMENT ACTCtl_bHiPressProFlg "" UBYTE ME11_CM_boolean_flg 0 0 0 1 ECU_ADDRESS 0x0000 /* @ECU_Address@ACTCtl_bHiPressProFlg@ */ /end MEASUREMENT
/begin MEASUREMENT ACTCtl_bHPEXVEnb "" UBYTE ME11_CM_boolean_flg 0 0 0 1 ECU_ADDRESS 0x0000 /* @ECU_Address@ACTCtl_bHPEXVEnb@ */ /end MEASUREMENT
/begin MEASUREMENT SOMCtl_bCalTempBatHeatFlg "" UBYTE ME11_CM_boolean_flg 0 0 0 1 ECU_ADDRESS 0x0000 /* @ECU_Address@SOMCtl_bCalTempBatHeatFlg@ */ /end MEASUREMENT
/begin MEASUREMENT SOMCtl_bBatHStrFlg "" UBYTE ME11_CM_boolean_flg 0 0 0 1 ECU_ADDRESS 0x0000 /* @ECU_Address@SOMCtl_bBatHStrFlg@ */ /end MEASUREMENT
/begin MEASUREMENT HMICtl_bACDefrost "" UBYTE ME11_CM_boolean_flg 0 0 0 1 ECU_ADDRESS 0x0000 /* @ECU_Address@HMICtl_bACDefrost@ */ /end MEASUREMENT
/begin MEASUREMENT HMICtl_bACAuto "" UBYTE ME11_CM_boolean_flg 0 0 0 1 ECU_ADDRESS 0x0000 /* @ECU_Address@HMICtl_bACAuto@ */ /end MEASUREMENT
/begin MEASUREMENT HMICtl_bACOnOff "" UBYTE ME11_CM_boolean_flg 0 0 0 1 ECU_ADDRESS 0x0000 /* @ECU_Address@HMICtl_bACOnOff@ */ /end MEASUREMENT
/begin MEASUREMENT ACCtl_stRecAQSEna "" UBYTE ME11_CM_boolean_null 0 0 0 1 ECU_ADDRESS 0x0000 /* @ECU_Address@ACCtl_stRecAQSEna@ */ /end MEASUREMENT
/begin MEASUREMENT SOMCtl_eCabinMode "" UBYTE ME11_CM_CabinMode_null 0 0 0 7 ECU_ADDRESS 0x0000 /* @ECU_Address@SOMCtl_eCabinMode@ */ /end MEASUREMENT
/begin MEASUREMENT SOMCtl_eBatMode "" UBYTE ME11_CM_BatModes_null 0 0 0 6 ECU_ADDRESS 0x0000 /* @ECU_Address@SOMCtl_eBatMode@ */ /end MEASUREMENT
/begin MEASUREMENT ACCtl_pwrHeatingFeed "" UWORD ME11_CM_uint16_null 0 0 0 65535 ECU_ADDRESS 0x0000 /* @ECU_Address@ACCtl_pwrHeatingFeed@ */ /end MEASUREMENT
/begin COMPU_METHOD ME11_CM_single_C "Q = V" RAT_FUNC "%8.6" "C" COEFFS 0 1 0 0 0 1 /end COMPU_METHOD
/begin COMPU_METHOD ME11_CM_uint8_null "Q = V" RAT_FUNC "%3.0" "null" COEFFS 0 1 0 0 0 1 /end COMPU_METHOD
/begin COMPU_METHOD ME11_CM_single_Mpa "Q = V" RAT_FUNC "%8.6" "Mpa" COEFFS 0 1 0 0 0 1 /end COMPU_METHOD
/begin COMPU_METHOD ME11_CM_single_mv "Q = V" RAT_FUNC "%8.6" "mv" COEFFS 0 1 0 0 0 1 /end COMPU_METHOD
/begin COMPU_METHOD ME11_CM_single_percent_ "Q = V" RAT_FUNC "%8.6" "%" COEFFS 0 1 0 0 0 1 /end COMPU_METHOD
/begin COMPU_METHOD ME11_CM_uint8_percent_ "Q = V" RAT_FUNC "%3.0" "%" COEFFS 0 1 0 0 0 1 /end COMPU_METHOD
/begin COMPU_METHOD ME11_CM_uint16_w_per_m_2 "Q = V" RAT_FUNC "%5.0" "w/m^2" COEFFS 0 1 0 0 0 1 /end COMPU_METHOD
/begin COMPU_METHOD ME11_CM_single_null "Q = V" RAT_FUNC "%8.6" "null" COEFFS 0 1 0 0 0 1 /end COMPU_METHOD
/begin COMPU_METHOD ME11_CM_single_rpm "Q = V" RAT_FUNC "%8.6" "rpm" COEFFS 0 1 0 0 0 1 /end COMPU_METHOD
/begin COMPU_METHOD ME11_CM_uint16_w "Q = V" RAT_FUNC "%5.0" "w" COEFFS 0 1 0 0 0 1 /end COMPU_METHOD
/begin COMPU_METHOD ME11_CM_single_r "Q = V" RAT_FUNC "%8.6" "r" COEFFS 0 1 0 0 0 1 /end COMPU_METHOD
/begin COMPU_METHOD ME11_CM_single_s "Q = V" RAT_FUNC "%8.6" "s" COEFFS 0 1 0 0 0 1 /end COMPU_METHOD
/begin COMPU_METHOD ME11_CM_single_percent__per_100ms "Q = V" RAT_FUNC "%8.6" "%/100ms" COEFFS 0 1 0 0 0 1 /end COMPU_METHOD
/begin COMPU_METHOD ME11_CM_single_per_ "Q = V" RAT_FUNC "%8.6" "/" COEFFS 0 1 0 0 0 1 /end COMPU_METHOD
/begin COMPU_METHOD ME11_CM_uint16_per_ "Q = V" RAT_FUNC "%5.0" "/" COEFFS 0 1 0 0 0 1 /end COMPU_METHOD
/begin COMPU_METHOD ME11_CM_BatModes_null "Enumerated data type: BatModes" TAB_VERB "%0.6" "null" COMPU_TAB_REF VTAB_FOR_ME11_CM_BatModes_null /end COMPU_METHOD
/begin COMPU_VTAB VTAB_FOR_ME11_CM_BatModes_null "Enumerated data type: BatModes" TAB_VERB 7 0 "Off" 1 "Cool" 2 "ThermalHeat" 3 "MotorHeatBat" 4 "Balance" 5 "BatLTR" 6 "BatHeat" /end COMPU_VTAB
/begin COMPU_METHOD ME11_CM_CabinMode_null "Enumerated data type: CabinMode" TAB_VERB "%0.6" "null" COMPU_TAB_REF VTAB_FOR_ME11_CM_CabinMode_null /end COMPU_METHOD
/begin COMPU_VTAB VTAB_FOR_ME11_CM_CabinMode_null "Enumerated data type: CabinMode" TAB_VERB 7 0 "CabinMode_MD_Off" 1 "CabinMode_MD1_CLM" 2 "CabinMode_MD2_DHMD1" 3 "CabinMode_MD3_DHMD2" 4 "CabinMode_MD4_HP" 6 "CabinMode_VENT" 7 "CabinMode_STANDBY" /end COMPU_VTAB
/begin COMPU_METHOD ME11_CM_boolean_flg "Q = V" RAT_FUNC "%1.0" "flg" COEFFS 0 1 0 0 0 1 /end COMPU_METHOD
/begin COMPU_METHOD ME11_CM_boolean_per_ "Q = V" RAT_FUNC "%1.0" "/" COEFFS 0 1 0 0 0 1 /end COMPU_METHOD
/begin COMPU_METHOD ME11_CM_boolean_null "Q = V" RAT_FUNC "%1.0" "null" COEFFS 0 1 0 0 0 1 /end COMPU_METHOD
/begin COMPU_METHOD ME11_CM_uint8_flg "Q = V" RAT_FUNC "%3.0" "flg" COEFFS 0 1 0 0 0 1 /end COMPU_METHOD
/begin COMPU_METHOD ME11_CM_uint8_per_ "Q = V" RAT_FUNC "%3.0" "/" COEFFS 0 1 0 0 0 1 /end COMPU_METHOD
/begin COMPU_METHOD ME11_CM_uint8_sts "Q = V" RAT_FUNC "%3.0" "sts" COEFFS 0 1 0 0 0 1 /end COMPU_METHOD
/begin COMPU_METHOD ME11_CM_uint16_null "Q = V" RAT_FUNC "%5.0" "null" COEFFS 0 1 0 0 0 1 /end COMPU_METHOD
/begin COMPU_METHOD ME11_CM_uint16_flg "Q = V" RAT_FUNC "%5.0" "flg" COEFFS 0 1 0 0 0 1 /end COMPU_METHOD
/begin GROUP S1089_SenDiagnostic "ME11/ME11_TMS/EnvAndMotTemp/TempEnvironment/Env/SenDiagnostic" /begin REF_CHARACTERISTIC cal_SensorTempDownFlg cal_SensorTempUpFlt /end REF_CHARACTERISTIC /end GROUP
/begin GROUP S1090_median "ME11/ME11_TMS/EnvAndMotTemp/TempEnvironment/EnvCal/median" /begin REF_MEASUREMENT ACSen_sEnvTempFilter /end REF_MEASUREMENT /end GROUP
/begin GROUP S1100_SenDiagnostic "ME11/ME11_TMS/EnvAndMotTemp/TempMotor/motor/SenDiagnostic" /begin REF_CHARACTERISTIC cal_SensorTempDownFlg cal_SensorTempUpFlt /end REF_CHARACTERISTIC /end GROUP
/begin GROUP S1167_Override_bACAuto "ME11/ME11_TMS/HMI/Status/ACAuto/Override_bACAuto" /begin REF_CHARACTERISTIC cal_bACAutoData cal_bACAutoEnb /end REF_CHARACTERISTIC /begin REF_MEASUREMENT HMICtl_bACAuto /end REF_MEASUREMENT /end GROUP
/begin GROUP S1168_Override_bACDefrost "ME11/ME11_TMS/HMI/Status/ACDefrost/Override_bACDefrost" /begin REF_CHARACTERISTIC cal_bACDefrostData cal_bACDefrostEnb /end REF_CHARACTERISTIC /begin REF_MEASUREMENT HMICtl_bACDefrost /end REF_MEASUREMENT /end GROUP
/begin GROUP S1169_Override_bACOnOff "ME11/ME11_TMS/HMI/Status/ACOnOff/Override_bACOnOff" /begin REF_CHARACTERISTIC cal_bACOnOffData cal_bACOnOffEnb /end REF_CHARACTERISTIC /begin REF_MEASUREMENT HMICtl_bACOnOff /end REF_MEASUREMENT /end GROUP
/begin GROUP S1170_Override_eACSts "ME11/ME11_TMS/HMI/Status/ACSts/Override_eACSts" /begin REF_CHARACTERISTIC cal_eACStsData cal_eACStsEnb /end REF_CHARACTERISTIC /begin REF_MEASUREMENT HMICtl_eACSts /end REF_MEASUREMENT /end GROUP
/begin GROUP S1300_ACRunOffTimeCal "ME11/ME11_TMS/Power/RDCWorkMng/Stop_Manage/ACRunOffTimeCal" /begin SUB_GROUP S1302_Subsystem /end SUB_GROUP /end GROUP
/begin GROUP S1318_ACCharge "ME11/ME11_TMS/SOM/BattaryMode/Balance/ACCharge"
 /begin REF_CHARACTERISTIC cal_BatBalCellTemp2 cal_tBatBalONACChrgMinCellTemp cal_tBatHeatExitMaxToMinCellDiff /end REF_CHARACTERISTIC
/end GROUP
/begin GROUP S1318_Exit "ME11/ME11_TMS/SOM/BattaryMode/Balance/Exit"
 /begin REF_CHARACTERISTIC cal_BatBalCellTemp1 cal_BatBalCellTemp2 cal_VehHeatSOCOff cal_tBatBalExitACChrgMinCellTemp cal_tBatBalExitBal1ToBatDiff cal_tBatBalExitBatToBal2Diff cal_tBatBalExitDCChrgMinCellTemp cal_tBatBalExitMaxToMinCellDiff cal_tBatHeatExitMaxToMinCellDiff /end REF_CHARACTERISTIC
/end GROUP
/begin GROUP S1318_Ready "ME11/ME11_TMS/SOM/BattaryMode/Balance/Ready"
 /begin REF_CHARACTERISTIC cal_BatBalCellTemp1 cal_BatBalCellTemp2 cal_MotHeatBatMinTempDiff cal_VehHeatSOCOn cal_tBatHeatExitMaxToMinCellDiff /end REF_CHARACTERISTIC
/end GROUP
/begin GROUP S1318_thermal_storage_enter "ME11/ME11_TMS/SOM/BattaryMode/Balance/thermal_storage_enter" /begin SUB_GROUP S1337_A S1337_B /end SUB_GROUP /end GROUP
/begin GROUP S1318_thermal_storage_exit "ME11/ME11_TMS/SOM/BattaryMode/Balance/thermal_storage_exit"
 /begin SUB_GROUP S1338_B S1338_C S1338_D S1338_G S1338_H S1338_I S1338_J S1338_K S1338_M S1338_N S1338_P /end SUB_GROUP
 /begin REF_CHARACTERISTIC cal_tBatHeatExitMaxToMinCellDiff /end REF_CHARACTERISTIC
 /begin REF_MEASUREMENT SOMCtl_bBatTSExitFlg /end REF_MEASUREMENT
/end GROUP
/begin GROUP S1319_B1_B21 "ME11/ME11_TMS/SOM/BattaryMode/Cool/B1_B21"
 /begin SUB_GROUP S1392_ConditionABC S1392_ConditionE S1392_ConditionF S1392_Judge /end SUB_GROUP
/end GROUP
/begin GROUP S1319_B1_B22 "ME11/ME11_TMS/SOM/BattaryMode/Cool/B1_B22"
 /begin SUB_GROUP S1393_ConditionB S1393_ConditionD S1393_ConditionE S1393_Judge /end SUB_GROUP
/end GROUP
/begin GROUP S1319_B2_B1 "ME11/ME11_TMS/SOM/BattaryMode/Cool/B2_B1"
 /begin SUB_GROUP S1394_ConditionA S1394_ConditionD S1394_ConditionGHI S1394_Judge /end SUB_GROUP
/end GROUP
/begin GROUP S1319_Override_BatTrgTemp "ME11/ME11_TMS/SOM/BattaryMode/Cool/Override_BatTrgTemp" /begin REF_CHARACTERISTIC cal_BatCoolOverData cal_BatCoolOverEnb /end REF_CHARACTERISTIC /begin REF_MEASUREMENT SOMCtl_bBatCoolFlg /end REF_MEASUREMENT /end GROUP
/begin GROUP S1320_B1_B33 "ME11/ME11_TMS/SOM/BattaryMode/DLTR/B1_B33" /begin SUB_GROUP S1439_B S1439_B1C1 S1439_C S1439_D /end SUB_GROUP /begin REF_CHARACTERISTIC cal_VehHeatSOCOn cal_tLTROnIPUTemp /end REF_CHARACTERISTIC
 /begin REF_MEASUREMENT SOMCtl_bDCBatLTROnFlg SOMCtl_bNmlBatLTROnFlg SOMCtl_eNmlBatLTROnFlg /end REF_MEASUREMENT
/end GROUP
/begin GROUP S1320_B33_B1 "ME11/ME11_TMS/SOM/BattaryMode/DLTR/B33_B1" /begin SUB_GROUP S1440_A S1440_B S1440_D /end SUB_GROUP /begin REF_CHARACTERISTIC cal_VehHeatSOCOff cal_tLTROffIPUTemp /end REF_CHARACTERISTIC /begin REF_MEASUREMENT SOMCtl_bBatLTROffFlg SOMCtrl_bBatLTRDelayFlg /end REF_MEASUREMENT /end GROUP
/begin GROUP S1321_Override_BatModed "ME11/ME11_TMS/SOM/BattaryMode/DisplaySet/Override_BatModed" /begin REF_CHARACTERISTIC cal_BatModeData cal_BatModeEnb /end REF_CHARACTERISTIC /begin REF_MEASUREMENT SOMCtl_eBatMode /end REF_MEASUREMENT /end GROUP
/begin GROUP S1322_B1_B41 "ME11/ME11_TMS/SOM/BattaryMode/Heat/B1_B41"
 /begin SUB_GROUP S1476_ConditionAorB S1476_ConditionCorD S1476_ConditionE S1476_ConditionF S1476_Judge /end SUB_GROUP
/end GROUP
/begin GROUP S1322_B1_B42 "ME11/ME11_TMS/SOM/BattaryMode/Heat/B1_B42"
 /begin SUB_GROUP S1477_ConditionB S1477_ConditionD S1477_ConditionE S1477_ConditionF S1477_Judge /end SUB_GROUP
/end GROUP
/begin GROUP S1322_B41_B1 "ME11/ME11_TMS/SOM/BattaryMode/Heat/B41_B1"
 /begin SUB_GROUP S1478_ConditionA S1478_ConditionB S1478_ConditionD S1478_ConditionHIJ S1478_Judge /end SUB_GROUP
/end GROUP
/begin GROUP S1322_Override_BatTrgTemp "ME11/ME11_TMS/SOM/BattaryMode/Heat/Override_BatTrgTemp" /begin REF_CHARACTERISTIC cal_BatHeatOverData cal_BatHeatOverEnb /end REF_CHARACTERISTIC /begin REF_MEASUREMENT SOMCtl_bBatHeatFlg /end REF_MEASUREMENT /end GROUP
/begin GROUP S1322_calTemp "ME11/ME11_TMS/SOM/BattaryMode/Heat/calTemp"
 /begin SUB_GROUP S1481_ACCharge S1481_DCCharge S1481_Discharge S1481_HeatTrgTemp /end SUB_GROUP
 /begin REF_MEASUREMENT SOMCtl_bCalTempBatHeatFlg SOMCtl_sBatHeatT1 SOMCtl_sBatHeatT2 /end REF_MEASUREMENT
/end GROUP
/begin GROUP S1324_Enter "ME11/ME11_TMS/SOM/BattaryMode/MotorAndBatLTR/Enter"
 /begin SUB_GROUP S1541_A1 S1541_B S1541_B1 S1541_B1C1 S1541_C S1541_C1 S1541_D /end SUB_GROUP
 /begin REF_CHARACTERISTIC cal_tLTROnIPUTemp /end REF_CHARACTERISTIC
 /begin REF_MEASUREMENT SOMCtl_bMotLTRAndBatBalOn1Flg SOMCtl_bMotLTRAndBatBalOn2Flg SOMCtl_eMotLTRAndBatBalOn1Flg SOMCtl_eMotLTRAndBatBalOn2Flg /end REF_MEASUREMENT
/end GROUP
/begin GROUP S1324_Exit "ME11/ME11_TMS/SOM/BattaryMode/MotorAndBatLTR/Exit" /begin SUB_GROUP S1542_A S1542_BC S1542_D S1542_E /end SUB_GROUP /begin REF_CHARACTERISTIC cal_DLTRIPUTempExitVal /end REF_CHARACTERISTIC /begin REF_MEASUREMENT SOMCtl_bDBatLTROffFlg /end REF_MEASUREMENT /end GROUP
/begin GROUP S1325_B1_B30 "ME11/ME11_TMS/SOM/BattaryMode/MotorHeatBat/B1_B30"
 /begin REF_CHARACTERISTIC cal_BatBalCellTemp1 cal_VehHeatSOCOff cal_VehHeatSOCOn cal_tBatHeatExitMaxToMinCellDiff cal_tMotStorExitMaxCellTemp cal_tMotStorExitMotToMinCellDiff cal_tMotStorMinCellTempLow cal_tMotStorOnMotToMinCellDiff /end REF_CHARACTERISTIC
 /begin REF_MEASUREMENT SOMCtl_bBatHStrFlg /end REF_MEASUREMENT
/end GROUP
/begin GROUP S1325_B1_B31_AC "ME11/ME11_TMS/SOM/BattaryMode/MotorHeatBat/B1_B31_AC"
 /begin REF_CHARACTERISTIC cal_BatBalCellTemp1 cal_tBatHeatExitMaxToMinCellDiff cal_tMotHeatBatACChrgMinCellTempLow cal_tMotHeatOnMotToMinCellDiff /end REF_CHARACTERISTIC
/end GROUP
/begin GROUP S1325_B1_B31_PT "ME11/ME11_TMS/SOM/BattaryMode/MotorHeatBat/B1_B31_PT"
 /begin REF_CHARACTERISTIC cal_BatBalCellTemp1 cal_VehHeatSOCOn cal_tBatHeatExitMaxToMinCellDiff cal_tMotHeatBatMinCellTempLow cal_tMotHeatOnMotToMinCellDiff /end REF_CHARACTERISTIC
/end GROUP
/begin GROUP S1325_B31_B1 "ME11/ME11_TMS/SOM/BattaryMode/MotorHeatBat/B31_B1"
 /begin REF_CHARACTERISTIC cal_BatBalCellTemp1 cal_VehHeatSOCOff cal_tBatHeatExitMaxToMinCellDiff cal_tMotHeatExitMinCellToBal1Diff cal_tMotHeatExitMinCellToMotTempDiff cal_tMotStorExitMaxCellTemp /end REF_CHARACTERISTIC
 /begin REF_MEASUREMENT SOMCtl_bBatHeatB31tB1Flg /end REF_MEASUREMENT
/end GROUP
/begin GROUP S1326_Enter_AC "ME11/ME11_TMS/SOM/BattaryMode/MotorHeatBat_OTS/Enter_AC"
 /begin REF_CHARACTERISTIC cal_BatBalCellTemp1 cal_tBatHeatExitMaxToMinCellDiff cal_tMotHeatBatACChrgMinCellTempLow cal_tMotHeatOnMotToMinCellDiff /end REF_CHARACTERISTIC
 /begin REF_MEASUREMENT SOMCtl_eMotorHeatBat2Flg /end REF_MEASUREMENT
/end GROUP
/begin GROUP S1326_Enter_PT "ME11/ME11_TMS/SOM/BattaryMode/MotorHeatBat_OTS/Enter_PT"
 /begin REF_CHARACTERISTIC cal_BatBalCellTemp1 cal_tBatHeatExitMaxToMinCellDiff cal_tMotHeatBatMinCellTempLow cal_tMotHeatOnMotToMinCellDiff /end REF_CHARACTERISTIC
 /begin REF_MEASUREMENT SOMCtl_eMotorHeatBatFlg /end REF_MEASUREMENT
/end GROUP
/begin GROUP S1326_Exit "ME11/ME11_TMS/SOM/BattaryMode/MotorHeatBat_OTS/Exit"
 /begin REF_CHARACTERISTIC cal_BatBalCellTemp1 cal_MBIGBTHighExitTempG cal_MBIPUDevHighExitTempI cal_MBMotorInletHighExitTempH cal_tBatHeatExitMaxToMinCellDiff cal_tMotHeatExitMinCellToBal1Diff cal_tMotHeatExitMinCellToMotTempDiff cal_tMotStorExitMaxCellTemp /end REF_CHARACTERISTIC
 /begin REF_MEASUREMENT SOMCtl_bMotorHeatBatOffFlg SOMCtl_eMotorHeatBatOffFlg /end REF_MEASUREMENT
/end GROUP
/begin GROUP S1327_B33_B1 "ME11/ME11_TMS/SOM/BattaryMode/MotorLTRAndBatBalance/B33_B1" /begin SUB_GROUP S1633_C S1633_D S1633_E S1633_I /end SUB_GROUP
 /begin REF_CHARACTERISTIC cal_BatBalCellTemp2 cal_LTRIGBTMaxExitTempB cal_LTRMotorInletMaxExitTempA cal_LTRMotorMaxExitTemp /end REF_CHARACTERISTIC
 /begin REF_MEASUREMENT SOMCtl_bMotLTRAndBatBalOffFlg SOMCtl_eMotLTRAndBatBalOffFlg /end REF_MEASUREMENT
/end GROUP
/begin GROUP S1327_Balance "ME11/ME11_TMS/SOM/BattaryMode/MotorLTRAndBatBalance/Balance" /begin SUB_GROUP S1634_A S1634_B S1634_C S1634_D /end SUB_GROUP /begin REF_CHARACTERISTIC cal_tBatHeatExitMaxToMinCellDiff /end REF_CHARACTERISTIC /begin REF_MEASUREMENT SOMCtl_bBatBalEntBFlg SOMCtl_eBatBalEntBFlg /end REF_MEASUREMENT /end GROUP
/begin GROUP S1327_LTR "ME11/ME11_TMS/SOM/BattaryMode/MotorLTRAndBatBalance/LTR" /begin SUB_GROUP S1637_D /end SUB_GROUP
 /begin REF_CHARACTERISTIC cal_LTRMotorMaxEntTemp cal_tLTROnMotInletTemp cal_tLTROnMotTemp /end REF_CHARACTERISTIC
 /begin REF_MEASUREMENT SOMCtl_eBatLTROnFlg /end REF_MEASUREMENT
/end GROUP
/begin GROUP S1679_Enter "ME11/ME11_TMS/SOM/Cabin/MD2_DHMD1/Enter" /begin SUB_GROUP S1695_EnterCondition1 S1695_EnterCondition2 /end SUB_GROUP /end GROUP
/begin GROUP S1679_Exit "ME11/ME11_TMS/SOM/Cabin/MD2_DHMD1/Exit" /begin SUB_GROUP S1696_Condition1And2 S1696_Condition3 S1696_Contidion4 /end SUB_GROUP /end GROUP
/begin GROUP S1681_Enter "ME11/ME11_TMS/SOM/Cabin/MD3_DHMD2/Enter" /begin REF_CHARACTERISTIC cal_CabinMD2F2MaxEnvTemp /end REF_CHARACTERISTIC /end GROUP
/begin GROUP S1681_Exit "ME11/ME11_TMS/SOM/Cabin/MD3_DHMD2/Exit" /begin SUB_GROUP S1711_Condition1 S1711_Condition2 S1711_Contidion3 /end SUB_GROUP /end GROUP
/begin GROUP S1684_Override_CabinModed "ME11/ME11_TMS/SOM/Cabin/ModeDisplay/Override_CabinModed" /begin REF_CHARACTERISTIC cal_CabinModeData cal_CabinModeEnb /end REF_CHARACTERISTIC /begin REF_MEASUREMENT SOMCtl_eCabinMode /end REF_MEASUREMENT /end GROUP
/begin GROUP S1756_SenDiagnostic "ME11/ME11_TMS/Sensor/Cabin/Cabin/SenDiagnostic" /begin REF_CHARACTERISTIC cal_SensorTempDownFlg cal_SensorTempUpFlt /end REF_CHARACTERISTIC /end GROUP
/begin GROUP S1769_SenDiagnostic "ME11/ME11_TMS/Sensor/FaceDuct/Face/SenDiagnostic" /begin REF_CHARACTERISTIC cal_SensorTempDownFlg cal_SensorTempUpFlt /end REF_CHARACTERISTIC /end GROUP
/begin GROUP S1779_SenDiagnostic "ME11/ME11_TMS/Sensor/FootDuct/Foot/SenDiagnostic" /begin REF_CHARACTERISTIC cal_SensorTempDownFlg cal_SensorTempUpFlt /end REF_CHARACTERISTIC /end GROUP
/begin GROUP S1819_SenDiagnostic "ME11/ME11_TMS/Sensor/TempChiller/Chiller/SenDiagnostic" /begin REF_CHARACTERISTIC cal_SensorTempDownFlg cal_SensorTempUpFlt /end REF_CHARACTERISTIC /end GROUP
/begin GROUP S1827_SenDiagnostic "ME11/ME11_TMS/Sensor/TempEvap/EVAP/SenDiagnostic" /begin REF_CHARACTERISTIC cal_SensorTempDownFlg cal_SensorTempUpFlt /end REF_CHARACTERISTIC /end GROUP
/begin GROUP S1837_SenDiagnostic "ME11/ME11_TMS/Sensor/TempEvapSurface/EvapSurface/SenDiagnostic" /begin REF_CHARACTERISTIC cal_SensorTempDownFlg cal_SensorTempUpFlt /end REF_CHARACTERISTIC /end GROUP
/begin GROUP S1846_SenDiagnostic "ME11/ME11_TMS/Sensor/TempOHX/Env/SenDiagnostic" /begin REF_CHARACTERISTIC cal_SensorTempDownFlg cal_SensorTempUpFlt /end REF_CHARACTERISTIC /end GROUP
/begin GROUP S1855_SenDiagnostic "ME11/ME11_TMS/Sensor/WCCHiTemp/Env/SenDiagnostic" /begin REF_CHARACTERISTIC cal_SensorTempDownFlg cal_SensorTempUpFlt /end REF_CHARACTERISTIC /end GROUP
/begin GROUP S1871_SenDiagnostic "ME11/ME11_TMS/Sensor/tempACCMHi/ACCMHi/SenDiagnostic" /begin REF_CHARACTERISTIC cal_SensorTempDownFlg cal_SensorTempUpFlt /end REF_CHARACTERISTIC /end GROUP
/begin GROUP S42_BlowerFanSpeedCalEnable "ME11/ME11_TMS/ACC/AutoAc/AutoACFun/BlowerFanSpeed/BlowerFanSpeedCalEnable" /begin SUB_GROUP S49_ACFanLevelEnvCor S49_FanReqSpeedCal /end SUB_GROUP /end GROUP
/begin GROUP S42_FanMaxSpeedLimCal "ME11/ME11_TMS/ACC/AutoAc/AutoACFun/BlowerFanSpeed/FanMaxSpeedLimCal"
 /begin REF_CHARACTERISTIC AC_ColdStart AC_HotStart AC_LittleColdStart cal_ACFanMaxSpdCellTempLim_CUR cal_ACFanMaxSpdDvtLim_CUR cal_BlowerFanSpdVentUL cal_FANSpdHotStartUL cal_FANSpdModeShiftMax /end REF_CHARACTERISTIC
 /begin REF_MEASUREMENT AC_BlowerFanSpeedMax AC_DVT2PTCErr /end REF_MEASUREMENT
/end GROUP
/begin GROUP S42_FanMinSpeedLimCal "ME11/ME11_TMS/ACC/AutoAc/AutoACFun/BlowerFanSpeed/FanMinSpeedLimCal" /begin REF_CHARACTERISTIC AC_HotStart cal_BlowerFanSpdLL cal_FANSpdHotStartLL /end REF_CHARACTERISTIC /begin REF_MEASUREMENT AC_BlowerFanSpeedMin /end REF_MEASUREMENT /end GROUP
/begin GROUP S43_BlowerControlEnable "ME11/ME11_TMS/ACC/AutoAc/AutoACFun/BlowerMode/BlowerControlEnable" /begin SUB_GROUP S76_AutoMode /end SUB_GROUP /end GROUP
/begin GROUP S44_CabinAccmReqEnable "ME11/ME11_TMS/ACC/AutoAc/AutoACFun/Compressor_ACWorkModeCheck/CabinAccmReqEnable"
 /begin SUB_GROUP S84_Compressor_ACWorkModeCheck S84_Compressor_DefogWorkModeWithDefogCheck /end SUB_GROUP
/end GROUP
/begin GROUP S45_AC_PTCCalEnableState "ME11/ME11_TMS/ACC/AutoAc/AutoACFun/PTC_ACWorkModeCheck/AC_PTCCalEnableState" /begin SUB_GROUP S93_AC_PTCShutOffCond0 /end SUB_GROUP
 /begin REF_CHARACTERISTIC cal_MixDoor2CabinHeatingEn_OFF cal_MixDoor2CabinHeatingEn_ON /end REF_CHARACTERISTIC
 /begin REF_MEASUREMENT ACCtl_stCabinHeatingEn /end REF_MEASUREMENT
/end GROUP
/begin GROUP S45_PTC_PID "ME11/ME11_TMS/ACC/AutoAc/AutoACFun/PTC_ACWorkModeCheck/PTC_PID" /begin SUB_GROUP S94_IWin_Controller S94_NegAndPosCheck S94_pWin_Controller /end SUB_GROUP
 /begin REF_CHARACTERISTIC cal_ACPTCPwrPreSetByEnv_MAP cal_PtcPwrDesValPIDDeadBandNeg cal_PtcPwrDesValPIDDeadBandPos cal_PtcPwrDesValPID_IsumMax cal_PtcPwrDesValPID_IsumMin cal_PtcPwrDesValPID_Ki cal_PtcPwrDesValPID_KiNeg cal_PtcPwrDesValPID_KiPos cal_PtcPwrDesValPID_Kp cal_PtcPwrDesValPID_KpNeg cal_PtcPwrDesValPID_KpPos cal_PtcPwrDesValPID_LL cal_PtcPwrDesValPID_UL cal_PtcPwrDesValPID_pWinNeg cal_PtcPwrDesValPID_pWinPos /end REF_CHARACTERISTIC
 /begin REF_MEASUREMENT ACCtl_pwrHeatingFeed /end REF_MEASUREMENT
/end GROUP
/begin GROUP S46_ACCtlRecForForceDefog1 "ME11/ME11_TMS/ACC/AutoAc/AutoACFun/RecircModeEnaCalcu/ACCtlRecForForceDefog1" /begin REF_CHARACTERISTIC DriveFRESH RECIRC /end REF_CHARACTERISTIC /end GROUP
/begin GROUP S46_ACCtlRecForSummerOrWinterOrNormalDefog1 "ME11/ME11_TMS/ACC/AutoAc/AutoACFun/RecircModeEnaCalcu/ACCtlRecForSummerOrWinterOrNormalDefog1" /begin SUB_GROUP S122_DefogRiskLimIntakeRatio /end SUB_GROUP /end GROUP
/begin GROUP S46_ACCtlRecForVent1 "ME11/ME11_TMS/ACC/AutoAc/AutoACFun/RecircModeEnaCalcu/ACCtlRecForVent1" /begin REF_CHARACTERISTIC cal_ACInletEnvPrtSetCool_CUR cal_ACInletEnvPrtSetHeat_CUR /end REF_CHARACTERISTIC /end GROUP
/begin GROUP S46_Mannual "ME11/ME11_TMS/ACC/AutoAc/AutoACFun/RecircModeEnaCalcu/Mannual" /begin REF_MEASUREMENT ACCtl_stRecManualEna /end REF_MEASUREMENT /end GROUP
/begin GROUP S46_RecACHotStart "ME11/ME11_TMS/ACC/AutoAc/AutoACFun/RecircModeEnaCalcu/RecACHotStart" /begin REF_CHARACTERISTIC AC_HotStart /end REF_CHARACTERISTIC /begin REF_MEASUREMENT ACCtl_stRecACHotStartEna /end REF_MEASUREMENT /end GROUP
/begin GROUP S46_RecAQS "ME11/ME11_TMS/ACC/AutoAc/AutoACFun/RecircModeEnaCalcu/RecAQS"
 /begin REF_CHARACTERISTIC cal_AQS2InRecThreVal cal_AQS2OutRecThreVal cal_tiAQSFresh2RecircDelay cal_tiAQSRecirc2FreshDelay /end REF_CHARACTERISTIC
 /begin REF_MEASUREMENT ACCtl_stRecAQSEna /end REF_MEASUREMENT
/end GROUP
/begin GROUP S46_RecForceChange "ME11/ME11_TMS/ACC/AutoAc/AutoACFun/RecircModeEnaCalcu/RecForceChange" /begin REF_CHARACTERISTIC cal_tiCO2Fresh2RecircMax cal_tiCO2Recirc2FreshMax /end REF_CHARACTERISTIC /begin REF_MEASUREMENT ACCtl_stRecForceChangeEna /end REF_MEASUREMENT /end GROUP
/begin GROUP S46_RecForceDefog "ME11/ME11_TMS/ACC/AutoAc/AutoACFun/RecircModeEnaCalcu/RecForceDefog" /begin REF_MEASUREMENT ACCtl_stRecForceDefogEna /end REF_MEASUREMENT /end GROUP
/begin GROUP S46_RecNormalDefog "ME11/ME11_TMS/ACC/AutoAc/AutoACFun/RecircModeEnaCalcu/RecNormalDefog" /begin REF_MEASUREMENT ACCtl_stRecNormalDefogEna /end REF_MEASUREMENT /end GROUP
/begin GROUP S46_RecPCUTemp "ME11/ME11_TMS/ACC/AutoAc/AutoACFun/RecircModeEnaCalcu/RecPCUTemp" /begin REF_CHARACTERISTIC cal_AirInletRecInPCUTemp cal_AirInletRecOutPCUTemp /end REF_CHARACTERISTIC /begin REF_MEASUREMENT ACCtl_stRecPCUTempEna /end REF_MEASUREMENT /end GROUP
/begin GROUP S46_RecPTCDvt "ME11/ME11_TMS/ACC/AutoAc/AutoACFun/RecircModeEnaCalcu/RecPTCDvt" /begin REF_CHARACTERISTIC cal_PTCTempRecircOff cal_PTCTempRecircOn /end REF_CHARACTERISTIC /begin REF_MEASUREMENT ACCtl_stRecPTCDvtEna /end REF_MEASUREMENT /end GROUP
/begin GROUP S46_RecQkChargeCooling "ME11/ME11_TMS/ACC/AutoAc/AutoACFun/RecircModeEnaCalcu/RecQkChargeCooling" /begin REF_MEASUREMENT ACCtl_stRecQkChargeCoolingEna /end REF_MEASUREMENT /end GROUP
/begin GROUP S46_RecRemoteForce "ME11/ME11_TMS/ACC/AutoAc/AutoACFun/RecircModeEnaCalcu/RecRemoteForce" /begin REF_MEASUREMENT ACCtl_stRecRemoteACEna /end REF_MEASUREMENT /end GROUP
/begin GROUP S46_RecSummerCond "ME11/ME11_TMS/ACC/AutoAc/AutoACFun/RecircModeEnaCalcu/RecSummerCond" /begin REF_MEASUREMENT ACCtl_stRecSummerCondEna /end REF_MEASUREMENT /end GROUP
/begin GROUP S46_RecTargetOutTemp "ME11/ME11_TMS/ACC/AutoAc/AutoACFun/RecircModeEnaCalcu/RecTargetOutTemp" /begin REF_CHARACTERISTIC cal_REC_DVTFresh cal_REC_DVTRecirc /end REF_CHARACTERISTIC /begin REF_MEASUREMENT ACCtl_stRecTargetOutTempEna /end REF_MEASUREMENT /end GROUP
/begin GROUP S46_RecVent "ME11/ME11_TMS/ACC/AutoAc/AutoACFun/RecircModeEnaCalcu/RecVent" /begin REF_MEASUREMENT ACCtl_stRecVentEna /end REF_MEASUREMENT /end GROUP
/begin GROUP S46_RecWinterCond "ME11/ME11_TMS/ACC/AutoAc/AutoACFun/RecircModeEnaCalcu/RecWinterCond" /begin REF_MEASUREMENT ACCtl_stRecWinterCondEna /end REF_MEASUREMENT /end GROUP
/begin GROUP S47_ACCtlRecForForceDefog "ME11/ME11_TMS/ACC/AutoAc/AutoACFun/RecircModeOut/ACCtlRecForForceDefog" /begin REF_CHARACTERISTIC DriveFRESH RECIRC /end REF_CHARACTERISTIC /end GROUP
/begin GROUP S47_Subsystem13 "ME11/ME11_TMS/ACC/AutoAc/AutoACFun/RecircModeOut/Subsystem13"
 /begin SUB_GROUP S157_Subsystem S157_Subsystem1 S157_Subsystem10 S157_Subsystem11 S157_Subsystem12 S157_Subsystem2 S157_Subsystem3 S157_Subsystem4 S157_Subsystem5 S157_Subsystem6 S157_Subsystem7 S157_Subsystem8 S157_Subsystem9 /end SUB_GROUP
/end GROUP
/begin GROUP S174_CalFrontVentDesireTemp "ME11/ME11_TMS/ACC/AutoAc/EvaporatorAndPTCAimTempCal_FIX/DesiredVentTempCal_FIX/CalFrontVentDesireTemp"
 /begin SUB_GROUP S180_FrontCabinAimTempBasCal S180_FrontCabinAimTempFeedfowardCorCal S180_TempRamp /end SUB_GROUP
 /begin REF_CHARACTERISTIC cal_EnvTempStep cal_FalseTime2EnvTamb cal_RiseTime2EnvTamb /end REF_CHARACTERISTIC
/end GROUP
/begin GROUP S174_CalLeftVentDesireTemp "ME11/ME11_TMS/ACC/AutoAc/EvaporatorAndPTCAimTempCal_FIX/DesiredVentTempCal_FIX/CalLeftVentDesireTemp"
 /begin REF_CHARACTERISTIC cal_ACDrDVTSolarCor_MAP cal_DvtDesValPID_LL cal_DvtDesValPID_UL cal_U_DVTFFSolarFilterRate /end REF_CHARACTERISTIC
 /begin REF_MEASUREMENT ACCtl_tDrDVT ACCtl_tDrDVTSolarCor GlbDa_LeftSolar /end REF_MEASUREMENT
/end GROUP
/begin GROUP S174_CalRightVentDesireTemp "ME11/ME11_TMS/ACC/AutoAc/EvaporatorAndPTCAimTempCal_FIX/DesiredVentTempCal_FIX/CalRightVentDesireTemp"
 /begin REF_CHARACTERISTIC cal_ACPsDVTSetCorByEnv_MAP cal_ACPsDVTSolarCor_MAP cal_DvtDesValPID_LL cal_DvtDesValPID_UL cal_U_DVTFFSolarFilterRate /end REF_CHARACTERISTIC
 /begin REF_MEASUREMENT ACCtl_tPsDVT ACCtl_tPsDVTCabinCor ACCtl_tPsDVTSolarCor AC_Ps2DrSetTempDvt GlbDa_RightSolar /end REF_MEASUREMENT
/end GROUP
/begin GROUP S174_DVTWeightCal "ME11/ME11_TMS/ACC/AutoAc/EvaporatorAndPTCAimTempCal_FIX/DesiredVentTempCal_FIX/DVTWeightCal" /begin REF_CHARACTERISTIC cal_DvtCoff /end REF_CHARACTERISTIC /end GROUP
/begin GROUP S175_CalDrDuctActualTemperature "ME11/ME11_TMS/ACC/AutoAc/EvaporatorAndPTCAimTempCal_FIX/DuctActualTemperature/CalDrDuctActualTemperature" /begin REF_CHARACTERISTIC cal_DrDuctFaceFloorFaFactor cal_DrDuctFaceFloorFoFactor /end REF_CHARACTERISTIC /end GROUP
/begin GROUP S175_CalPsDuctActualTemperature "ME11/ME11_TMS/ACC/AutoAc/EvaporatorAndPTCAimTempCal_FIX/DuctActualTemperature/CalPsDuctActualTemperature" /begin REF_CHARACTERISTIC cal_PsDuctFaceFloorFaFactor cal_PsDuctFaceFloorFoFactor /end REF_CHARACTERISTIC /end GROUP
/begin GROUP S175_LeftMixDoorPI "ME11/ME11_TMS/ACC/AutoAc/EvaporatorAndPTCAimTempCal_FIX/DuctActualTemperature/LeftMixDoorPI"
 /begin REF_CHARACTERISTIC cal_DcutTPidDeadBand cal_DcutTempPidLL cal_DcutTempPidUL cal_DcutTempPid_IsumMax cal_DcutTempPid_IsumMin cal_DcutTempPid_Ki cal_DcutTempPid_KiNeg cal_DcutTempPid_KiPos cal_DcutTempPid_Kp cal_DcutTempPid_KpNeg cal_DcutTempPid_KpPos cal_DcutTempPid_pWinNeg cal_DcutTempPid_pWinPos /end REF_CHARACTERISTIC
/end GROUP
/begin GROUP S175_RightMixDoorPI "ME11/ME11_TMS/ACC/AutoAc/EvaporatorAndPTCAimTempCal_FIX/DuctActualTemperature/RightMixDoorPI"
 /begin REF_CHARACTERISTIC cal_DcutTPidDeadBand cal_DcutTempPidLL cal_DcutTempPidUL cal_DcutTempPid_IsumMax cal_DcutTempPid_IsumMin cal_DcutTempPid_Ki cal_DcutTempPid_KiNeg cal_DcutTempPid_KiPos cal_DcutTempPid_Kp cal_DcutTempPid_KpNeg cal_DcutTempPid_KpPos cal_DcutTempPid_pWinNeg cal_DcutTempPid_pWinPos /end REF_CHARACTERISTIC
/end GROUP
/begin GROUP S178_CalAirCondDrEvapAimTemp "ME11/ME11_TMS/ACC/AutoAc/EvaporatorAndPTCAimTempCal_FIX/TargetEvaporatorTempGov/CalAirCondDrEvapAimTemp"
 /begin SUB_GROUP S275_CalAirCondEvapAimTemp_FIXPID S275_CalAirCondEvapDesTemp /end SUB_GROUP
 /begin REF_CHARACTERISTIC cal_DrEvaDesValPIDLL_MAP cal_EvaDesLLMin /end REF_CHARACTERISTIC
 /begin REF_MEASUREMENT ACCtl_tDrEvapDes /end REF_MEASUREMENT
/end GROUP
/begin GROUP S178_CalAirCondPsEvapAimTemp "ME11/ME11_TMS/ACC/AutoAc/EvaporatorAndPTCAimTempCal_FIX/TargetEvaporatorTempGov/CalAirCondPsEvapAimTemp"
 /begin SUB_GROUP S276_CalAirCondEvapAimTemp_RightDes S276_CalAirCondMixVlvRightTrgBasicTemp /end SUB_GROUP
 /begin REF_CHARACTERISTIC cal_EvaDesLLMin cal_PsEvaDesValPIDLL_MAP /end REF_CHARACTERISTIC
 /begin REF_MEASUREMENT ACCtl_tPsEvapDes /end REF_MEASUREMENT
/end GROUP
/begin GROUP S178_EvapTargetLowest "ME11/ME11_TMS/ACC/AutoAc/EvaporatorAndPTCAimTempCal_FIX/TargetEvaporatorTempGov/EvapTargetLowest"
 /begin REF_CHARACTERISTIC cal_CoolStartCompensate cal_EvaDesLLMin cal_EvaDesLLSelect cal_EvapDesLoLimByEnv_CUR cal_EvapDesLoLimBySolarCor_CUR /end REF_CHARACTERISTIC
 /begin REF_MEASUREMENT GlbDa_Solar /end REF_MEASUREMENT
/end GROUP
/begin GROUP S179_CalPTCAimTemp_LeftDes "ME11/ME11_TMS/ACC/AutoAc/EvaporatorAndPTCAimTempCal_FIX/TargetPTCTempGov/CalPTCAimTemp_LeftDes"
 /begin SUB_GROUP S335_CalAirCondMixVlvRightTrgBasicTemp S335_CalAirCondPTCAimTemp_FIXPID /end SUB_GROUP
/end GROUP
/begin GROUP S179_CalPTCAimTemp_RightDes "ME11/ME11_TMS/ACC/AutoAc/EvaporatorAndPTCAimTempCal_FIX/TargetPTCTempGov/CalPTCAimTemp_RightDes"
 /begin SUB_GROUP S336_CalAirCondMixVlvRightTrgBasicTemp S336_CalAirCondPTCAimTemp_LeftDes /end SUB_GROUP
/end GROUP
/begin GROUP S386_CalAirCondMixVlvLeftTrgTemp "ME11/ME11_TMS/ACC/AutoAc/MixDoorOpenCloseDesCal/CalDrMixDoorDesRatio/CalAirCondMixVlvLeftTrgTemp" /begin SUB_GROUP S389_CalFactorNominalTemp2ACPtcTemp /end SUB_GROUP
 /begin REF_CHARACTERISTIC cal_DrErrOfEvaDVT2CoolMixOff cal_DrErrOfEvaDVT2CoolMixOn cal_DrErrOfPtcDVT2HeatMixOff cal_DrErrOfPtcDVT2HeatMixOn cal_DrMixBacSetDefog_CUR cal_DrMixBacSetFaceHeater_CUR cal_DrMixBacSetFace_CUR cal_DrMixBacSetHeaterDeforst_CUR cal_DrMixBacSetHeater_CUR /end REF_CHARACTERISTIC
 /begin REF_MEASUREMENT ACCtl_rDrBasicMixDoor /end REF_MEASUREMENT
/end GROUP
/begin GROUP S386_CalDrMixDoorDesRatio_FIXPID "ME11/ME11_TMS/ACC/AutoAc/MixDoorOpenCloseDesCal/CalDrMixDoorDesRatio/CalDrMixDoorDesRatio_FIXPID" /begin SUB_GROUP S390_IWin_Controller S390_pWin_Controller /end SUB_GROUP
 /begin REF_CHARACTERISTIC cal_DrMixDesValPIDIntegDeadBand cal_DrMixDesValPIDLL cal_DrMixDesValPIDUL cal_DrMixDesValPID_IsumMax cal_DrMixDesValPID_IsumMin cal_DrMixDesValPID_Ki cal_DrMixDesValPID_KiNeg cal_DrMixDesValPID_KiPos cal_DrMixDesValPID_Kp cal_DrMixDesValPID_KpNeg cal_DrMixDesValPID_KpPos cal_DrMixDesValPID_pWinNeg cal_DrMixDesValPID_pWinPos cal_MixDoorClsFF_CUR cal_MixDoorKi_CUR cal_MixDoorKp_CUR /end REF_CHARACTERISTIC
 /begin REF_MEASUREMENT ACCtl_rDrMixDoorDes ACCtl_sMixDoorClsFF /end REF_MEASUREMENT
/end GROUP
/begin GROUP S387_CalAirCondMixVlvRightTrgTemp "ME11/ME11_TMS/ACC/AutoAc/MixDoorOpenCloseDesCal/CalPsMixDoorDesRatio/CalAirCondMixVlvRightTrgTemp" /begin SUB_GROUP S415_CalFactorNominalTemp2ACPtcTemp /end SUB_GROUP
 /begin REF_CHARACTERISTIC cal_PsErrOfEvaDVT2CoolMixOff cal_PsErrOfEvaDVT2CoolMixOn cal_PsErrOfPtcDVT2HeatMixOff cal_PsErrOfPtcDVT2HeatMixOn cal_PsMixBacSetAC_CUR cal_PsMixBacSetBi_CUR cal_PsMixBacSetDefog_CUR cal_PsMixBacSetFootDe_CUR cal_PsMixBacSetFoot_CUR /end REF_CHARACTERISTIC
 /begin REF_MEASUREMENT ACCtl_rPsBasicMixDoor ACCtl_rPsBlowerModeSet /end REF_MEASUREMENT
/end GROUP
/begin GROUP S387_CalPsMixDoorDesRatio "ME11/ME11_TMS/ACC/AutoAc/MixDoorOpenCloseDesCal/CalPsMixDoorDesRatio/CalPsMixDoorDesRatio" /begin SUB_GROUP S416_IWin_Controller S416_pWin_Controller /end SUB_GROUP
 /begin REF_CHARACTERISTIC cal_PsMixDesValPIDIntegDeadBand cal_PsMixDesValPIDLL cal_PsMixDesValPIDUL cal_PsMixDesValPID_IsumMax cal_PsMixDesValPID_IsumMin cal_PsMixDesValPID_Ki cal_PsMixDesValPID_KiNeg cal_PsMixDesValPID_KiPos cal_PsMixDesValPID_Kp cal_PsMixDesValPID_KpNeg cal_PsMixDesValPID_KpPos cal_PsMixDesValPID_pWinNeg cal_PsMixDesValPID_pWinPos /end REF_CHARACTERISTIC
 /begin REF_MEASUREMENT ACCtl_rPsMixDoorDes /end REF_MEASUREMENT
/end GROUP
/begin GROUP S459_ModeJudge "ME11/ME11_TMS/Actuator/COMP/ACCMEnble/ModeOnOrOff/ModeJudge" /begin REF_CHARACTERISTIC cal_BatHeatACCMEnb /end REF_CHARACTERISTIC /begin REF_MEASUREMENT ACTCtl_eCOMPJudgeFlg /end REF_MEASUREMENT /end GROUP
/begin GROUP S480_ISum "ME11/ME11_TMS/Actuator/COMP/ACCMPICtrl/IWin_Controller/ISum" /begin REF_MEASUREMENT ACTCtl_sACCMI_Cor /end REF_MEASUREMENT /end GROUP
/begin GROUP S504_Flg1Cal "ME11/ME11_TMS/Actuator/COMP/COMPFaultHandling/PressRateProtect/Flg1Cal" /begin REF_CHARACTERISTIC cal_HPProVal3 cal_HPProVal3Relay /end REF_CHARACTERISTIC /end GROUP
/begin GROUP S504_Flg1Cal1 "ME11/ME11_TMS/Actuator/COMP/COMPFaultHandling/PressRateProtect/Flg1Cal1" /begin REF_CHARACTERISTIC cal_PressRateVal3 cal_PressRateVal3Relay /end REF_CHARACTERISTIC /end GROUP
/begin GROUP S504_Flg1Cal2 "ME11/ME11_TMS/Actuator/COMP/COMPFaultHandling/PressRateProtect/Flg1Cal2" /begin REF_CHARACTERISTIC cal_HPProVal3 cal_HPProVal4 /end REF_CHARACTERISTIC /end GROUP
/begin GROUP S504_Flg2Cal "ME11/ME11_TMS/Actuator/COMP/COMPFaultHandling/PressRateProtect/Flg2Cal"
 /begin REF_CHARACTERISTIC cal_HPProVal2 cal_HPProVal2Relay cal_HPProVal3 cal_HPProVal3Relay /end REF_CHARACTERISTIC
/end GROUP
/begin GROUP S504_Flg2Cal1 "ME11/ME11_TMS/Actuator/COMP/COMPFaultHandling/PressRateProtect/Flg2Cal1"
 /begin REF_CHARACTERISTIC cal_PressRateVal2 cal_PressRateVal2Relay cal_PressRateVal3 cal_PressRateVal3Relay /end REF_CHARACTERISTIC
/end GROUP
/begin GROUP S504_Flg3Cal "ME11/ME11_TMS/Actuator/COMP/COMPFaultHandling/PressRateProtect/Flg3Cal"
 /begin REF_CHARACTERISTIC cal_HPProVal1 cal_HPProVal1Relay cal_HPProVal2 cal_HPProVal2Relay cal_HPProVal3 cal_HPProVal3Relay /end REF_CHARACTERISTIC
/end GROUP
/begin GROUP S504_Flg3Cal1 "ME11/ME11_TMS/Actuator/COMP/COMPFaultHandling/PressRateProtect/Flg3Cal1"
 /begin REF_CHARACTERISTIC cal_PressRateVal1 cal_PressRateVal1Relay cal_PressRateVal2 cal_PressRateVal2Relay cal_PressRateVal3 cal_PressRateVal3Relay /end REF_CHARACTERISTIC
/end GROUP
/begin GROUP S504_FlgCal "ME11/ME11_TMS/Actuator/COMP/COMPFaultHandling/PressRateProtect/FlgCal" /begin REF_CHARACTERISTIC cal_COMPActlSpd1 cal_COMPActlSpd2 cal_COMPActlSpd3 /end REF_CHARACTERISTIC /begin REF_MEASUREMENT ACTCtl_eCOMPSpdSecSts /end REF_MEASUREMENT /end GROUP
/begin GROUP S504_Other "ME11/ME11_TMS/Actuator/COMP/COMPFaultHandling/PressRateProtect/Other" /begin REF_CHARACTERISTIC cal_PressRateVal3 cal_PressRateVal4 /end REF_CHARACTERISTIC /end GROUP
/begin GROUP S567_Deal "ME11/ME11_TMS/Actuator/COMP/COMPSpeedLmt/OpenOrCloseFilter/Deal"
 /begin REF_CHARACTERISTIC cal_COMPSpdDiffDown cal_COMPSpdDiffDownRate cal_COMPSpdDiffUp cal_COMPSpdDiffUpRate /end REF_CHARACTERISTIC
/end GROUP
/begin GROUP S582_Target_computation "ME11/ME11_TMS/Actuator/COMP/ParameterCal/ACCMCtrlA/Target_computation" /begin REF_CHARACTERISTIC cal_BatHeatACCMEnb /end REF_CHARACTERISTIC /end GROUP
/begin GROUP S582_relay "ME11/ME11_TMS/Actuator/COMP/ParameterCal/ACCMCtrlA/relay" /begin REF_MEASUREMENT ACTCtl_bPTCOnOrOffPwrDiff /end REF_MEASUREMENT /end GROUP
/begin GROUP S587_relay "ME11/ME11_TMS/Actuator/COMP/ParameterCal/ACCMCtrlF/relay" /begin REF_MEASUREMENT ACTCtl_bCtrlFPTCOnOrOffPwrDiff /end REF_MEASUREMENT /end GROUP
/begin GROUP S641_FallInBetweenT1AndT2 "ME11/ME11_TMS/Actuator/CWV/C3WV_MCV/MUL/FallInBetweenT1AndT2" /begin SUB_GROUP S647_UpOrDown /end SUB_GROUP
 /begin REF_CHARACTERISTIC cal_BetwT1AndT2DownMCV_CUR cal_BetwT1AndT2StbyMCV_CUR cal_BetwT1AndT2UpMCV_CUR cal_LessThanT1CalSwt /end REF_CHARACTERISTIC
/end GROUP
/begin GROUP S641_HeatTemp "ME11/ME11_TMS/Actuator/CWV/C3WV_MCV/MUL/HeatTemp"
 /begin REF_CHARACTERISTIC cal_ACBatHeatTrgTemp cal_DCBatHeatTrgTemp cal_NmlBatHeatTrgTemp /end REF_CHARACTERISTIC
 /begin REF_MEASUREMENT ACTCtl_sBatHeatInletTrgT /end REF_MEASUREMENT
/end GROUP
/begin GROUP S641_MinTempLessThanT1 "ME11/ME11_TMS/Actuator/CWV/C3WV_MCV/MUL/MinTempLessThanT1" /begin SUB_GROUP S649_UpOrDown /end SUB_GROUP
 /begin REF_CHARACTERISTIC cal_LTT1DownMCV_CUR cal_LTT1StbyMCV_CUR cal_LTT1UpMCV_CUR cal_LessThanT1CalSwt /end REF_CHARACTERISTIC
/end GROUP
/begin GROUP S642_Override_C5WV "ME11/ME11_TMS/Actuator/CWV/C3WV_MCV/selflearning/Override_C5WV" /begin REF_CHARACTERISTIC cal_C3WVSLStsData cal_C3WVSLStsDataEnb /end REF_CHARACTERISTIC /begin REF_MEASUREMENT ACTCtl_eC3WVSLSts /end REF_MEASUREMENT /end GROUP
/begin GROUP S664_Override_C5WV "ME11/ME11_TMS/Actuator/CWV/C5WV_BCV/selflearning/Override_C5WV" /begin REF_CHARACTERISTIC cal_C5WVSLStsData cal_C5WVSLStsDataEnb /end REF_CHARACTERISTIC /begin REF_MEASUREMENT ACTCtl_eC5WVSLSts /end REF_MEASUREMENT /end GROUP
/begin GROUP S677_Override "ME11/ME11_TMS/Actuator/EXV/AEXV/AEXVEnble/Override" /begin REF_CHARACTERISTIC cal_AEXVEnbData cal_AEXVEnbDataEnb /end REF_CHARACTERISTIC /begin REF_MEASUREMENT ACTCtl_bAEXVEnb /end REF_MEASUREMENT /end GROUP
/begin GROUP S679_Override "ME11/ME11_TMS/Actuator/EXV/AEXV/AEXVInit/Override" /begin REF_CHARACTERISTIC cal_AEXVInitReqData cal_AEXVInitReqDataeEnb /end REF_CHARACTERISTIC /begin REF_MEASUREMENT ACTCtl_bAEXVInitReq /end REF_MEASUREMENT /end GROUP
/begin GROUP S680_IWin_Controller "ME11/ME11_TMS/Actuator/EXV/AEXV/AEXVPICtrl/IWin_Controller" /begin SUB_GROUP S697_ISum /end SUB_GROUP /begin REF_MEASUREMENT ACTCtl_sAEXVI_Sum /end REF_MEASUREMENT /end GROUP
/begin GROUP S680_PI_Controller "ME11/ME11_TMS/Actuator/EXV/AEXV/AEXVPICtrl/PI_Controller" /begin REF_MEASUREMENT ACTCtl_sAEXVPI_Cor /end REF_MEASUREMENT /end GROUP
/begin GROUP S680_pWin_Controller "ME11/ME11_TMS/Actuator/EXV/AEXV/AEXVPICtrl/pWin_Controller" /begin REF_MEASUREMENT ACTCtl_sAEXVP_Cor /end REF_MEASUREMENT /end GROUP
/begin GROUP S681_AEXVCtrlB "ME11/ME11_TMS/Actuator/EXV/AEXV/AEXVPIParameter/AEXVCtrlB"
 /begin REF_CHARACTERISTIC cal_AEXVCtrlBCabinCoolPIMin_CUR cal_AEXVCtrlBDCoolPIMin_CUR cal_AEXVCtrlBDeadzone cal_AEXVCtrlBDelayTime cal_AEXVCtrlBFF_CUR cal_AEXVCtrlBKi_CUR cal_AEXVCtrlBKp_CUR cal_AEXVCtrlBOpenVal cal_AEXVCtrlBPIMax cal_AEXVCtrlBPIMin cal_AEXVCtrlBTrgSubCoolCOMPSpd_CUR cal_AEXVCtrlBTrgSubCool_CUR cal_AEXVSubCoolflt /end REF_CHARACTERISTIC
 /begin REF_MEASUREMENT ACTCtl_sAEXVCtrlBFF ACTCtl_sCondDepDiff /end REF_MEASUREMENT
/end GROUP
/begin GROUP S681_AEXVCtrlC "ME11/ME11_TMS/Actuator/EXV/AEXV/AEXVPIParameter/AEXVCtrlC"
 /begin REF_CHARACTERISTIC cal_AEXVCtrlCDeadzone cal_AEXVCtrlCDelayTime cal_AEXVCtrlCFF_CUR cal_AEXVCtrlCKi_CUR cal_AEXVCtrlCKp_CUR cal_AEXVCtrlCOpenVal cal_AEXVCtrlCPIMax cal_AEXVCtrlCPIMin cal_AEXVCtrlCTrgflt cal_AEXVCtrlCTrgtSuperHeat_CUR /end REF_CHARACTERISTIC
/end GROUP
/begin GROUP S681_AEXVCtrlD "ME11/ME11_TMS/Actuator/EXV/AEXV/AEXVPIParameter/AEXVCtrlD"
 /begin REF_CHARACTERISTIC cal_AEXVCtrlDDeadzone cal_AEXVCtrlDDelayTime cal_AEXVCtrlDFF_CUR cal_AEXVCtrlDKi_CUR cal_AEXVCtrlDKp_CUR cal_AEXVCtrlDOpenVal cal_AEXVCtrlDPIMax cal_AEXVCtrlDPIMin cal_AEXVCtrlDTrg_CUR /end REF_CHARACTERISTIC
/end GROUP
/begin GROUP S681_AEXVCtrlDefault "ME11/ME11_TMS/Actuator/EXV/AEXV/AEXVPIParameter/AEXVCtrlDefault" /begin REF_CHARACTERISTIC cal_AEXVCtrlDefaultPos /end REF_CHARACTERISTIC /end GROUP
/begin GROUP S683_OpenOrCloseAEXVPos "ME11/ME11_TMS/Actuator/EXV/AEXV/pressureprotection/OpenOrCloseAEXVPos" /begin SUB_GROUP S739_Filter S739_Filter1 /end SUB_GROUP
 /begin REF_CHARACTERISTIC cal_AEXVDiffDown cal_AEXVDiffDownRate cal_AEXVDiffUp cal_AEXVDiffUpRate cal_AEXVHighPressLmtOn cal_AEXVLowPressLmtOn /end REF_CHARACTERISTIC
/end GROUP
/begin GROUP S683_Override "ME11/ME11_TMS/Actuator/EXV/AEXV/pressureprotection/Override" /begin REF_CHARACTERISTIC cal_AEXVPosData cal_AEXVPosDataEnb /end REF_CHARACTERISTIC /end GROUP
/begin GROUP S683_StepLimit "ME11/ME11_TMS/Actuator/EXV/AEXV/pressureprotection/StepLimit" /begin REF_CHARACTERISTIC cal_AEXVFloorDiff1 cal_AEXVFloorDiff2 /end REF_CHARACTERISTIC /end GROUP
/begin GROUP S749_Override "ME11/ME11_TMS/Actuator/EXV/BEXV/BEXVInit/Override" /begin REF_CHARACTERISTIC cal_BEXVInitReqData cal_BEXVInitReqDataeEnb /end REF_CHARACTERISTIC /begin REF_MEASUREMENT ACTCtl_bBEXVInitReq /end REF_MEASUREMENT /end GROUP
/begin GROUP S750_IWin_Controller "ME11/ME11_TMS/Actuator/EXV/BEXV/BEXVPICtrl/IWin_Controller" /begin SUB_GROUP S765_ISum /end SUB_GROUP /begin REF_MEASUREMENT ACTCtl_sBEXVI_Sum /end REF_MEASUREMENT /end GROUP
/begin GROUP S750_PI_Controller "ME11/ME11_TMS/Actuator/EXV/BEXV/BEXVPICtrl/PI_Controller" /begin REF_MEASUREMENT ACTCtl_sBEXVPI_Cor /end REF_MEASUREMENT /end GROUP
/begin GROUP S750_pWin_Controller "ME11/ME11_TMS/Actuator/EXV/BEXV/BEXVPICtrl/pWin_Controller" /begin REF_MEASUREMENT ACTCtl_sBEXVP_Cor /end REF_MEASUREMENT /end GROUP
/begin GROUP S751_BEXVCtrlB "ME11/ME11_TMS/Actuator/EXV/BEXV/BEXVPIParameter/BEXVCtrlB"
 /begin REF_CHARACTERISTIC cal_BEXVCtrlBDCoolPIMin_CUR cal_BEXVCtrlBDeadzone cal_BEXVCtrlBDelayTime cal_BEXVCtrlBFF_CUR cal_BEXVCtrlBKi_CUR cal_BEXVCtrlBKp_CUR cal_BEXVCtrlBOpenVal cal_BEXVCtrlBPIDown cal_BEXVCtrlBPIUp cal_BEXVCtrlBTrgCabinComp_CUR cal_BEXVCtrlBTrgWtrTempDiff_CUR cal_BEXVSubHeatflt /end REF_CHARACTERISTIC
 /begin REF_MEASUREMENT ACTCtl_sBEXVCtrlBFF /end REF_MEASUREMENT
/end GROUP
/begin GROUP S751_BEXVCtrlC "ME11/ME11_TMS/Actuator/EXV/BEXV/BEXVPIParameter/BEXVCtrlC"
 /begin REF_CHARACTERISTIC cal_BEXVCtrlCBatCoolPIMin_CUR cal_BEXVCtrlCDeadzone cal_BEXVCtrlCDelayTime cal_BEXVCtrlCFF_CUR cal_BEXVCtrlCKi_CUR cal_BEXVCtrlCKp_CUR cal_BEXVCtrlCOpenVal cal_BEXVCtrlCPIMax cal_BEXVCtrlCPIMin cal_BEXVCtrlCTrg_CUR cal_BEXVSubCoolflt /end REF_CHARACTERISTIC
/end GROUP
/begin GROUP S752_Override "ME11/ME11_TMS/Actuator/EXV/BEXV/EXVEnble/Override" /begin REF_CHARACTERISTIC cal_BEXVEnbData cal_BEXVEnbDataEnb /end REF_CHARACTERISTIC /begin REF_MEASUREMENT ACTCtl_bBEXVEnb /end REF_MEASUREMENT /end GROUP
/begin GROUP S754_Choose "ME11/ME11_TMS/Actuator/EXV/BEXV/pressure-protection/Choose" /begin SUB_GROUP S807_Override S807_StepLimit /end SUB_GROUP /begin REF_MEASUREMENT ACTCtl_sBEXVPos /end REF_MEASUREMENT /end GROUP
/begin GROUP S754_OpenOrCloseControl "ME11/ME11_TMS/Actuator/EXV/BEXV/pressure-protection/OpenOrCloseControl" /begin SUB_GROUP S809_Filter S809_Filter1 /end SUB_GROUP
 /begin REF_CHARACTERISTIC cal_BEXVDiffDown cal_BEXVDiffDownRate cal_BEXVDiffUp cal_BEXVDiffUpRate cal_BEXVHighPressLmtOn cal_BEXVLowPressLmtOn /end REF_CHARACTERISTIC
/end GROUP
/begin GROUP S818_HPEXVLimit "ME11/ME11_TMS/Actuator/EXV/HPEXV/Arbitration/HPEXVLimit" /begin SUB_GROUP S825_Filter S825_Filter1 /end SUB_GROUP
 /begin REF_CHARACTERISTIC cal_HPEXVDiffDown cal_HPEXVDiffDownRate cal_HPEXVDiffUp cal_HPEXVDiffUpRate cal_HPEXVHiPressProOpenSpd cal_HPEXVHiPressProhOff cal_HPEXVHiPressProhOn cal_HPEXVLowPressProOpenSpd cal_HPEXVlowPressProhOff cal_HPEXVlowPressProhOn /end REF_CHARACTERISTIC
 /begin REF_MEASUREMENT ACTCtl_bHiPressProFlg ACTCtl_bLowPressProFlg /end REF_MEASUREMENT
/end GROUP
/begin GROUP S818_Override "ME11/ME11_TMS/Actuator/EXV/HPEXV/Arbitration/Override" /begin REF_CHARACTERISTIC cal_HPEXVPosData cal_HPEXVPosDataEnb /end REF_CHARACTERISTIC /end GROUP
/begin GROUP S818_StepLimit "ME11/ME11_TMS/Actuator/EXV/HPEXV/Arbitration/StepLimit" /begin REF_CHARACTERISTIC cal_HPEXVFloorDiff1 cal_HPEXVFloorDiff2 /end REF_CHARACTERISTIC /begin REF_MEASUREMENT ACTCtl_sHPEXVStepLmt /end REF_MEASUREMENT /end GROUP
/begin GROUP S819_Override "ME11/ME11_TMS/Actuator/EXV/HPEXV/FFCal/Override" /begin REF_CHARACTERISTIC cal_HPEXVEnbData cal_HPEXVEnbDataEnb /end REF_CHARACTERISTIC /begin REF_MEASUREMENT ACTCtl_bHPEXVEnb /end REF_MEASUREMENT /end GROUP
/begin GROUP S821_IWin_Controller "ME11/ME11_TMS/Actuator/EXV/HPEXV/HPEXVPICtrl/IWin_Controller" /begin SUB_GROUP S841_ISum /end SUB_GROUP /begin REF_MEASUREMENT ACTCtl_sHPEXVI_Sum /end REF_MEASUREMENT /end GROUP
/begin GROUP S821_PI_Controller "ME11/ME11_TMS/Actuator/EXV/HPEXV/HPEXVPICtrl/PI_Controller" /begin REF_MEASUREMENT ACTCtl_sHPEXVPI_Cor /end REF_MEASUREMENT /end GROUP
/begin GROUP S821_pWin_Controller "ME11/ME11_TMS/Actuator/EXV/HPEXV/HPEXVPICtrl/pWin_Controller" /begin REF_MEASUREMENT ACTCtl_sHPEXVP_Cor /end REF_MEASUREMENT /end GROUP
/begin GROUP S822_HPEXVCtrlA "ME11/ME11_TMS/Actuator/EXV/HPEXV/HPEXVParameterCal/HPEXVCtrlA"
 /begin REF_CHARACTERISTIC cal_HPEXVCtrlADeadzone cal_HPEXVCtrlADelayTime cal_HPEXVCtrlAFFLolmt cal_HPEXVCtrlAFFUplmt cal_HPEXVCtrlAFF_CUR cal_HPEXVCtrlAKi_CUR cal_HPEXVCtrlAKp_CUR cal_HPEXVCtrlAMax cal_HPEXVCtrlAMin cal_HPEXVCtrlAOpenVal cal_HPEXVCtrlATrgtSubcool_CUR cal_HPEXVSubCoolflt /end REF_CHARACTERISTIC
 /begin REF_MEASUREMENT ACTCtl_sHPEXVCtrlADiff /end REF_MEASUREMENT
/end GROUP
/begin GROUP S822_HPEXVCtrlD "ME11/ME11_TMS/Actuator/EXV/HPEXV/HPEXVParameterCal/HPEXVCtrlD" /begin REF_CHARACTERISTIC cal_HPEXVSubCoolflt /end REF_CHARACTERISTIC /end GROUP
/begin GROUP S822_HPEXVCtrlE "ME11/ME11_TMS/Actuator/EXV/HPEXV/HPEXVParameterCal/HPEXVCtrlE" /begin REF_CHARACTERISTIC cal_HPEXVSubCoolflt /end REF_CHARACTERISTIC /end GROUP
/begin GROUP S1337_A "ME11/ME11_TMS/SOM/BattaryMode/Balance/thermal_storage_enter/A" /begin REF_CHARACTERISTIC cal_BatBalCellTemp1 cal_tBatHeatExitMaxToMinCellDiff /end REF_CHARACTERISTIC /end GROUP
/begin GROUP S1337_B "ME11/ME11_TMS/SOM/BattaryMode/Balance/thermal_storage_enter/B" /begin REF_CHARACTERISTIC cal_tBatHeatExitMaxToMinCellDiff /end REF_CHARACTERISTIC /end GROUP
/begin GROUP S1338_B "ME11/ME11_TMS/SOM/BattaryMode/Balance/thermal_storage_exit/B" /begin REF_CHARACTERISTIC cal_BatBalCellTemp1 /end REF_CHARACTERISTIC /end GROUP
/begin GROUP S1392_ConditionF "ME11/ME11_TMS/SOM/BattaryMode/Cool/B1_B21/ConditionF" /begin REF_CHARACTERISTIC cal_tBatHeatExitMaxToMinCellDiff /end REF_CHARACTERISTIC /end GROUP
/begin GROUP S1393_ConditionE "ME11/ME11_TMS/SOM/BattaryMode/Cool/B1_B22/ConditionE" /begin REF_CHARACTERISTIC cal_tBatHeatExitMaxToMinCellDiff /end REF_CHARACTERISTIC /end GROUP
/begin GROUP S1394_ConditionA "ME11/ME11_TMS/SOM/BattaryMode/Cool/B2_B1/ConditionA" /begin REF_CHARACTERISTIC cal_tBatHeatExitMaxToMinCellDiff /end REF_CHARACTERISTIC /end GROUP
/begin GROUP S1439_B "ME11/ME11_TMS/SOM/BattaryMode/DLTR/B1_B33/B" /begin REF_CHARACTERISTIC cal_BatBalCellTemp2 /end REF_CHARACTERISTIC /end GROUP
/begin GROUP S1439_D "ME11/ME11_TMS/SOM/BattaryMode/DLTR/B1_B33/D" /begin REF_CHARACTERISTIC cal_tBatHeatExitMaxToMinCellDiff /end REF_CHARACTERISTIC /end GROUP
/begin GROUP S1440_A "ME11/ME11_TMS/SOM/BattaryMode/DLTR/B33_B1/A" /begin REF_CHARACTERISTIC cal_BatBalCellTemp2 /end REF_CHARACTERISTIC /end GROUP
/begin GROUP S1440_D "ME11/ME11_TMS/SOM/BattaryMode/DLTR/B33_B1/D" /begin REF_CHARACTERISTIC cal_tBatHeatExitMaxToMinCellDiff /end REF_CHARACTERISTIC /end GROUP
/begin GROUP S1476_ConditionE "ME11/ME11_TMS/SOM/BattaryMode/Heat/B1_B41/ConditionE" /begin REF_CHARACTERISTIC cal_tBatHeatExitMaxToMinCellDiff /end REF_CHARACTERISTIC /end GROUP
/begin GROUP S1477_ConditionD "ME11/ME11_TMS/SOM/BattaryMode/Heat/B1_B42/ConditionD" /begin REF_CHARACTERISTIC cal_VehHeatSOCOn /end REF_CHARACTERISTIC /end GROUP
/begin GROUP S1477_ConditionE "ME11/ME11_TMS/SOM/BattaryMode/Heat/B1_B42/ConditionE" /begin REF_CHARACTERISTIC cal_tBatHeatExitMaxToMinCellDiff /end REF_CHARACTERISTIC /end GROUP
/begin GROUP S1478_ConditionA "ME11/ME11_TMS/SOM/BattaryMode/Heat/B41_B1/ConditionA" /begin REF_CHARACTERISTIC cal_tBatHeatExitMaxToMinCellDiff /end REF_CHARACTERISTIC /end GROUP
/begin GROUP S1478_ConditionD "ME11/ME11_TMS/SOM/BattaryMode/Heat/B41_B1/ConditionD" /begin REF_CHARACTERISTIC cal_VehHeatSOCOff /end REF_CHARACTERISTIC /end GROUP
/begin GROUP S1481_ACCharge "ME11/ME11_TMS/SOM/BattaryMode/Heat/calTemp/ACCharge" /begin REF_CHARACTERISTIC cal_ACBatHeatTrgTemp /end REF_CHARACTERISTIC /end GROUP
/begin GROUP S1481_DCCharge "ME11/ME11_TMS/SOM/BattaryMode/Heat/calTemp/DCCharge" /begin REF_CHARACTERISTIC cal_DCBatHeatTrgTemp /end REF_CHARACTERISTIC /end GROUP
/begin GROUP S1481_Discharge "ME11/ME11_TMS/SOM/BattaryMode/Heat/calTemp/Discharge" /begin REF_CHARACTERISTIC cal_NmlBatHeatTrgTemp /end REF_CHARACTERISTIC /end GROUP
/begin GROUP S1541_B "ME11/ME11_TMS/SOM/BattaryMode/MotorAndBatLTR/Enter/B" /begin REF_CHARACTERISTIC cal_BatBalCellTemp2 /end REF_CHARACTERISTIC /end GROUP
/begin GROUP S1541_D "ME11/ME11_TMS/SOM/BattaryMode/MotorAndBatLTR/Enter/D" /begin REF_CHARACTERISTIC cal_tBatHeatExitMaxToMinCellDiff /end REF_CHARACTERISTIC /end GROUP
/begin GROUP S1542_A "ME11/ME11_TMS/SOM/BattaryMode/MotorAndBatLTR/Exit/A" /begin REF_CHARACTERISTIC cal_BatBalCellTemp2 /end REF_CHARACTERISTIC /end GROUP
/begin GROUP S1542_E "ME11/ME11_TMS/SOM/BattaryMode/MotorAndBatLTR/Exit/E" /begin REF_CHARACTERISTIC cal_tBatHeatExitMaxToMinCellDiff /end REF_CHARACTERISTIC /end GROUP
/begin GROUP S1634_A "ME11/ME11_TMS/SOM/BattaryMode/MotorLTRAndBatBalance/Balance/A" /begin REF_CHARACTERISTIC cal_BatBalCellTemp2 /end REF_CHARACTERISTIC /end GROUP
/begin GROUP S1634_B "ME11/ME11_TMS/SOM/BattaryMode/MotorLTRAndBatBalance/Balance/B" /begin REF_CHARACTERISTIC cal_BatBalCellTemp2 /end REF_CHARACTERISTIC /end GROUP
/begin GROUP S1634_C "ME11/ME11_TMS/SOM/BattaryMode/MotorLTRAndBatBalance/Balance/C" /begin REF_CHARACTERISTIC cal_BatBalCellTemp2 /end REF_CHARACTERISTIC /end GROUP
/begin GROUP S1634_D "ME11/ME11_TMS/SOM/BattaryMode/MotorLTRAndBatBalance/Balance/D" /begin REF_CHARACTERISTIC cal_BatBalCellTemp1 cal_BatBalCellTemp2 /end REF_CHARACTERISTIC /end GROUP
/begin GROUP S1637_D "ME11/ME11_TMS/SOM/BattaryMode/MotorLTRAndBatBalance/LTR/D" /begin REF_CHARACTERISTIC cal_BatBalCellTemp2 /end REF_CHARACTERISTIC /end GROUP
/begin GROUP S1695_EnterCondition1 "ME11/ME11_TMS/SOM/Cabin/MD2_DHMD1/Enter/EnterCondition1" /begin REF_CHARACTERISTIC cal_CabinMD2F2MaxEnvTemp /end REF_CHARACTERISTIC /end GROUP
/begin GROUP S1695_EnterCondition2 "ME11/ME11_TMS/SOM/Cabin/MD2_DHMD1/Enter/EnterCondition2" /begin REF_CHARACTERISTIC cal_CabinMD2F2MaxEnvTemp /end REF_CHARACTERISTIC /end GROUP
/begin GROUP S1696_Condition3 "ME11/ME11_TMS/SOM/Cabin/MD2_DHMD1/Exit/Condition3" /begin REF_CHARACTERISTIC cal_CabinMD2F2MaxEnvTemp /end REF_CHARACTERISTIC /end GROUP
/begin GROUP S1711_Condition2 "ME11/ME11_TMS/SOM/Cabin/MD3_DHMD2/Exit/Condition2" /begin REF_CHARACTERISTIC cal_CabinMD2F2MaxEnvTemp /end REF_CHARACTERISTIC /end GROUP
/begin GROUP S1711_Contidion3 "ME11/ME11_TMS/SOM/Cabin/MD3_DHMD2/Exit/Contidion3" /begin REF_CHARACTERISTIC cal_CabinMD2F2MaxEnvTemp /end REF_CHARACTERISTIC /end GROUP
/begin GROUP S180_FrontCabinAimTempFeedfowardCorCal "ME11/ME11_TMS/ACC/AutoAc/EvaporatorAndPTCAimTempCal_FIX/DesiredVentTempCal_FIX/CalFrontVentDesireTemp/FrontCabinAimTempFeedfowardCorCal" /begin REF_CHARACTERISTIC cal_U_DVTFFSolarFilterRate /end REF_CHARACTERISTIC /end GROUP
/begin GROUP S1359_A "ME11/ME11_TMS/SOM/BattaryMode/Balance/thermal_storage_enter/B/A" /begin REF_CHARACTERISTIC cal_BatBalCellTemp2 /end REF_CHARACTERISTIC /end GROUP
/begin GROUP S1359_B "ME11/ME11_TMS/SOM/BattaryMode/Balance/thermal_storage_enter/B/B" /begin REF_CHARACTERISTIC cal_BatBalCellTemp2 /end REF_CHARACTERISTIC /end GROUP
/begin GROUP S1359_C "ME11/ME11_TMS/SOM/BattaryMode/Balance/thermal_storage_enter/B/C" /begin REF_CHARACTERISTIC cal_BatBalCellTemp2 /end REF_CHARACTERISTIC /end GROUP
/begin GROUP S184_PID_CalDVT_FIX "ME11/ME11_TMS/ACC/AutoAc/EvaporatorAndPTCAimTempCal_FIX/DesiredVentTempCal_FIX/CalFrontVentDesireTemp/FrontCabinAimTempBasCal/PID_CalDVT_FIX" /begin REF_CHARACTERISTIC cal_DvtDesValPID_LL /end REF_CHARACTERISTIC /end GROUP
