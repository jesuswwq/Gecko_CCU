ASAP2_VERSION 1 31
/begin PROJECT ProjectName "Project Comment Goes Here"
/begin HEADER "Header Comments go here" /end HEADER
/begin MODULE ModuleName "Module Comment Goes Here"
/begin MOD_COMMON "Mod Common Comment Here" BYTE_ORDER MSB_LAST /end MOD_COMMON
/begin RECORD_LAYOUT Scalar_BOOLEAN FNC_VALUES 1 UBYTE COLUMN_DIR DIRECT /end RECORD_LAYOUT
/begin RECORD_LAYOUT Scalar_UBYTE FNC_VALUES 1 UBYTE COLUMN_DIR DIRECT /end RECORD_LAYOUT
/begin RECORD_LAYOUT Scalar_UWORD FNC_VALUES 1 UWORD COLUMN_DIR DIRECT /end RECORD_LAYOUT
/begin RECORD_LAYOUT Scalar_FLOAT32_IEEE FNC_VALUES 1 FLOAT32_IEEE COLUMN_DIR DIRECT /end RECORD_LAYOUT
/begin RECORD_LAYOUT Lookup2D_BYTE FNC_VALUES 1 SBYTE COLUMN_DIR DIRECT /end RECORD_LAYOUT
/begin RECORD_LAYOUT Lookup2D_X_BYTE AXIS_PTS_X 1 SBYTE INDEX_INCR DIRECT /end RECORD_LAYOUT
/begin RECORD_LAYOUT Lookup2D_UWORD FNC_VALUES 1 UWORD COLUMN_DIR DIRECT /end RECORD_LAYOUT
/begin RECORD_LAYOUT Lookup2D_X_UWORD AXIS_PTS_X 1 UWORD INDEX_INCR DIRECT /end RECORD_LAYOUT
/begin RECORD_LAYOUT Lookup2D_WORD FNC_VALUES 1 SWORD COLUMN_DIR DIRECT /end RECORD_LAYOUT
/begin RECORD_LAYOUT Lookup2D_X_WORD AXIS_PTS_X 1 SWORD INDEX_INCR DIRECT /end RECORD_LAYOUT
/begin RECORD_LAYOUT Lookup2D_ULONG FNC_VALUES 1 ULONG COLUMN_DIR DIRECT /end RECORD_LAYOUT
/begin RECORD_LAYOUT Lookup2D_X_ULONG AXIS_PTS_X 1 ULONG INDEX_INCR DIRECT /end RECORD_LAYOUT
/begin RECORD_LAYOUT Lookup2D_LONG FNC_VALUES 1 SLONG COLUMN_DIR DIRECT /end RECORD_LAYOUT
/begin RECORD_LAYOUT Lookup2D_X_LONG AXIS_PTS_X 1 SLONG INDEX_INCR DIRECT /end RECORD_LAYOUT
/begin RECORD_LAYOUT Lookup2D_FLOAT32_IEEE FNC_VALUES 1 FLOAT32_IEEE COLUMN_DIR DIRECT /end RECORD_LAYOUT
/begin RECORD_LAYOUT Lookup2D_X_FLOAT32_IEEE AXIS_PTS_X 1 FLOAT32_IEEE INDEX_INCR DIRECT /end RECORD_LAYOUT
/begin RECORD_LAYOUT Lookup2D_FLOAT64_IEEE FNC_VALUES 1 FLOAT64_IEEE COLUMN_DIR DIRECT /end RECORD_LAYOUT
/begin RECORD_LAYOUT Lookup2D_X_FLOAT64_IEEE AXIS_PTS_X 1 FLOAT64_IEEE INDEX_INCR DIRECT /end RECORD_LAYOUT
/begin CHARACTERISTIC KOPM_BCMKeyBattLvlHi_pct "BCM_B_Package_BAC" VALUE 0x0000 /* @ECU_Address@KOPM_BCMKeyBattLvlHi_pct@ */ Scalar_FLOAT32_IEEE 0 AppSwcOpm_CM_single_pct -100000.0 100000.0 /end CHARACTERISTIC
/begin CHARACTERISTIC KOPM_BCMKeyBattLvlLo_pct "BCM_B_Package_BAC" VALUE 0x0000 /* @ECU_Address@KOPM_BCMKeyBattLvlLo_pct@ */ Scalar_FLOAT32_IEEE 0 AppSwcOpm_CM_single_pct -100000.0 100000.0 /end CHARACTERISTIC
/begin CHARACTERISTIC KOPM_BCMKeyBattLvl_pct_ovrdval "BCM_B_Package_BAC" VALUE 0x0000 /* @ECU_Address@KOPM_BCMKeyBattLvl_pct_ovrdval@ */ Scalar_FLOAT32_IEEE 0 AppSwcOpm_CM_single_pct -100000.0 100000.0 /end CHARACTERISTIC
/begin CHARACTERISTIC KOPM_BCMMaiDrvrSeatTempHi_C "BCM_B_Package_BAC" VALUE 0x0000 /* @ECU_Address@KOPM_BCMMaiDrvrSeatTempHi_C@ */ Scalar_FLOAT32_IEEE 0 AppSwcOpm_CM_single_C -100000.0 100000.0 /end CHARACTERISTIC
/begin CHARACTERISTIC KOPM_BCMMaiDrvrSeatTempLo_C "BCM_B_Package_BAC" VALUE 0x0000 /* @ECU_Address@KOPM_BCMMaiDrvrSeatTempLo_C@ */ Scalar_FLOAT32_IEEE 0 AppSwcOpm_CM_single_C -100000.0 100000.0 /end CHARACTERISTIC
/begin CHARACTERISTIC KOPM_BCMMaiDrvrSeatTemp_C_ovrdval "BCM_B_Package_BAC" VALUE 0x0000 /* @ECU_Address@KOPM_BCMMaiDrvrSeatTemp_C_ovrdval@ */ Scalar_FLOAT32_IEEE 0 AppSwcOpm_CM_single_C -100000.0 100000.0 /end CHARACTERISTIC
/begin CHARACTERISTIC KOPM_BCMSteerWhlTempHi_C "BCM_B_Package_BAC" VALUE 0x0000 /* @ECU_Address@KOPM_BCMSteerWhlTempHi_C@ */ Scalar_FLOAT32_IEEE 0 AppSwcOpm_CM_single_C -100000.0 100000.0 /end CHARACTERISTIC
/begin CHARACTERISTIC KOPM_BCMSteerWhlTempLo_C "BCM_B_Package_BAC" VALUE 0x0000 /* @ECU_Address@KOPM_BCMSteerWhlTempLo_C@ */ Scalar_FLOAT32_IEEE 0 AppSwcOpm_CM_single_C -100000.0 100000.0 /end CHARACTERISTIC
/begin CHARACTERISTIC KOPM_BCMSteerWhlTemp_C_ovrdval "BCM_B_Package_BAC" VALUE 0x0000 /* @ECU_Address@KOPM_BCMSteerWhlTemp_C_ovrdval@ */ Scalar_FLOAT32_IEEE 0 AppSwcOpm_CM_single_C -100000.0 100000.0 /end CHARACTERISTIC
/begin CHARACTERISTIC KOPM_DCCBoostHvVoltHi_V "VCU_C_OprtCmd_EPT" VALUE 0x0000 /* @ECU_Address@KOPM_DCCBoostHvVoltHi_V@ */ Scalar_FLOAT32_IEEE 0 AppSwcOpm_CM_single_V -100000.0 100000.0 /end CHARACTERISTIC
/begin CHARACTERISTIC KOPM_DCCBoostHvVoltLo_V "VCU_C_OprtCmd_EPT" VALUE 0x0000 /* @ECU_Address@KOPM_DCCBoostHvVoltLo_V@ */ Scalar_FLOAT32_IEEE 0 AppSwcOpm_CM_single_V -100000.0 100000.0 /end CHARACTERISTIC
/begin CHARACTERISTIC KOPM_DCCBoostHvVolt_V_ovrdval "VCU_C_OprtCmd_EPT" VALUE 0x0000 /* @ECU_Address@KOPM_DCCBoostHvVolt_V_ovrdval@ */ Scalar_FLOAT32_IEEE 0 AppSwcOpm_CM_single_V -100000.0 100000.0 /end CHARACTERISTIC
/begin CHARACTERISTIC KOPM_DCCBuckLVVoltHi_V "VCU_C_OprtCmd_EPT" VALUE 0x0000 /* @ECU_Address@KOPM_DCCBuckLVVoltHi_V@ */ Scalar_FLOAT32_IEEE 0 AppSwcOpm_CM_single_V -100000.0 100000.0 /end CHARACTERISTIC
/begin CHARACTERISTIC KOPM_DCCBuckLVVoltLo_V "VCU_C_OprtCmd_EPT" VALUE 0x0000 /* @ECU_Address@KOPM_DCCBuckLVVoltLo_V@ */ Scalar_FLOAT32_IEEE 0 AppSwcOpm_CM_single_V -100000.0 100000.0 /end CHARACTERISTIC
/begin CHARACTERISTIC KOPM_DCCBuckLVVolt_V_ovrdval "VCU_C_OprtCmd_EPT" VALUE 0x0000 /* @ECU_Address@KOPM_DCCBuckLVVolt_V_ovrdval@ */ Scalar_FLOAT32_IEEE 0 AppSwcOpm_CM_single_V -100000.0 100000.0 /end CHARACTERISTIC
/begin CHARACTERISTIC KOPM_MaxHVDCCurntACHi_A "VCU_C_OprtCmd_EPT" VALUE 0x0000 /* @ECU_Address@KOPM_MaxHVDCCurntACHi_A@ */ Scalar_FLOAT32_IEEE 0 AppSwcOpm_CM_single_A -100000.0 100000.0 /end CHARACTERISTIC
/begin CHARACTERISTIC KOPM_MaxHVDCCurntACLo_A "VCU_C_OprtCmd_EPT" VALUE 0x0000 /* @ECU_Address@KOPM_MaxHVDCCurntACLo_A@ */ Scalar_FLOAT32_IEEE 0 AppSwcOpm_CM_single_A -100000.0 100000.0 /end CHARACTERISTIC
/begin CHARACTERISTIC KOPM_MaxHVDCCurntAC_A_ovrdval "VCU_C_OprtCmd_EPT" VALUE 0x0000 /* @ECU_Address@KOPM_MaxHVDCCurntAC_A_ovrdval@ */ Scalar_FLOAT32_IEEE 0 AppSwcOpm_CM_single_A -100000.0 100000.0 /end CHARACTERISTIC
/begin CHARACTERISTIC KOPM_MaxHVDCVoltACHi_V "VCU_C_OprtCmd_EPT" VALUE 0x0000 /* @ECU_Address@KOPM_MaxHVDCVoltACHi_V@ */ Scalar_FLOAT32_IEEE 0 AppSwcOpm_CM_single_V -100000.0 100000.0 /end CHARACTERISTIC
/begin CHARACTERISTIC KOPM_MaxHVDCVoltACLo_V "VCU_C_OprtCmd_EPT" VALUE 0x0000 /* @ECU_Address@KOPM_MaxHVDCVoltACLo_V@ */ Scalar_FLOAT32_IEEE 0 AppSwcOpm_CM_single_V -100000.0 100000.0 /end CHARACTERISTIC
/begin CHARACTERISTIC KOPM_MaxHVDCVoltAC_V_ovrdval "VCU_C_OprtCmd_EPT" VALUE 0x0000 /* @ECU_Address@KOPM_MaxHVDCVoltAC_V_ovrdval@ */ Scalar_FLOAT32_IEEE 0 AppSwcOpm_CM_single_V -100000.0 100000.0 /end CHARACTERISTIC
/begin CHARACTERISTIC KOPM_BCMKeyLocnHi_mm "BCM_B_Package_BAC" VALUE 0x0000 /* @ECU_Address@KOPM_BCMKeyLocnHi_mm@ */ Scalar_UWORD 0 AppSwcOpm_CM_uint16_mm 0.0 65535.0 /end CHARACTERISTIC
/begin CHARACTERISTIC KOPM_BCMKeyLocnLo_mm "BCM_B_Package_BAC" VALUE 0x0000 /* @ECU_Address@KOPM_BCMKeyLocnLo_mm@ */ Scalar_UWORD 0 AppSwcOpm_CM_uint16_mm 0.0 65535.0 /end CHARACTERISTIC
/begin CHARACTERISTIC KOPM_BCMKeyLocn_mm_ovrdval "BCM_B_Package_BAC" VALUE 0x0000 /* @ECU_Address@KOPM_BCMKeyLocn_mm_ovrdval@ */ Scalar_UWORD 0 AppSwcOpm_CM_uint16_mm 0.0 65535.0 /end CHARACTERISTIC
/begin CHARACTERISTIC KOPM_PrstlsStaFb_enum_ovrdval "CCU_VehInfo_BAC" VALUE 0x0000 /* @ECU_Address@KOPM_PrstlsStaFb_enum_ovrdval@ */ Scalar_UBYTE 0 AppSwcOpm_CM_EnumCrpModeAct 0 2 /end CHARACTERISTIC
/begin CHARACTERISTIC KOPM_VehActDrvMod1_enum_ovrdval "CCU_VehInfo_BAC" VALUE 0x0000 /* @ECU_Address@KOPM_VehActDrvMod1_enum_ovrdval@ */ Scalar_UBYTE 0 AppSwcOpm_CM_EnumDrvModeAct 0 4 /end CHARACTERISTIC
/begin CHARACTERISTIC KOPM_VehActlGearPos_enum_ovrdval "CCU_VehInfo_BAC" VALUE 0x0000 /* @ECU_Address@KOPM_VehActlGearPos_enum_ovrdval@ */ Scalar_UBYTE 0 AppSwcOpm_CM_EnumGearPstn 0 3 /end CHARACTERISTIC
/begin CHARACTERISTIC KOPM_PTActlOprtMode_enum_ovrdval "CCU_VehInfo_BAC" VALUE 0x0000 /* @ECU_Address@KOPM_PTActlOprtMode_enum_ovrdval@ */ Scalar_UBYTE 0 AppSwcOpm_CM_EnumPTActMd 0 3 /end CHARACTERISTIC
/begin CHARACTERISTIC KOPM_PwrRecupIntnsty_enum_ovrdval "CCU_VehInfo_BAC" VALUE 0x0000 /* @ECU_Address@KOPM_PwrRecupIntnsty_enum_ovrdval@ */ Scalar_UBYTE 0 AppSwcOpm_CM_EnumRegenModeAct 0 2 /end CHARACTERISTIC
/begin CHARACTERISTIC KOPM_12VBatLowVolSta_enum_ovrdflg "CCU_VehInfo_BAC" VALUE 0x0000 /* @ECU_Address@KOPM_12VBatLowVolSta_enum_ovrdflg@ */ Scalar_BOOLEAN 0 AppSwcOpm_CM_boolean_flg 0.0 1.0 /end CHARACTERISTIC
/begin CHARACTERISTIC KOPM_BCMAjarStaHood_flg_ovrdflg "BCM_B_Package_BAC" VALUE 0x0000 /* @ECU_Address@KOPM_BCMAjarStaHood_flg_ovrdflg@ */ Scalar_BOOLEAN 0 AppSwcOpm_CM_boolean_flg 0.0 1.0 /end CHARACTERISTIC
/begin CHARACTERISTIC KOPM_BCMAjarStaHood_flg_ovrdval "BCM_B_Package_BAC" VALUE 0x0000 /* @ECU_Address@KOPM_BCMAjarStaHood_flg_ovrdval@ */ Scalar_BOOLEAN 0 AppSwcOpm_CM_boolean_flg 0.0 1.0 /end CHARACTERISTIC
/begin CHARACTERISTIC KOPM_BCMAjarStaTrunk_flg_ovrdflg "BCM_B_Package_BAC" VALUE 0x0000 /* @ECU_Address@KOPM_BCMAjarStaTrunk_flg_ovrdflg@ */ Scalar_BOOLEAN 0 AppSwcOpm_CM_boolean_flg 0.0 1.0 /end CHARACTERISTIC
/begin CHARACTERISTIC KOPM_BCMAjarStaTrunk_flg_ovrdval "BCM_B_Package_BAC" VALUE 0x0000 /* @ECU_Address@KOPM_BCMAjarStaTrunk_flg_ovrdval@ */ Scalar_BOOLEAN 0 AppSwcOpm_CM_boolean_flg 0.0 1.0 /end CHARACTERISTIC
/begin CHARACTERISTIC KOPM_BCMAjarStaVHoodVld_flg_ovrdflg "BCM_B_Package_BAC" VALUE 0x0000 /* @ECU_Address@KOPM_BCMAjarStaVHoodVld_flg_ovrdflg@ */ Scalar_BOOLEAN 0 AppSwcOpm_CM_boolean_flg 0.0 1.0 /end CHARACTERISTIC
/begin CHARACTERISTIC KOPM_BCMAjarStaVHoodVld_flg_ovrdval "BCM_B_Package_BAC" VALUE 0x0000 /* @ECU_Address@KOPM_BCMAjarStaVHoodVld_flg_ovrdval@ */ Scalar_BOOLEAN 0 AppSwcOpm_CM_boolean_flg 0.0 1.0 /end CHARACTERISTIC
/begin CHARACTERISTIC KOPM_BCMAlrmHornReq_flg_ovrdflg "BCM_B_Package_BAC" VALUE 0x0000 /* @ECU_Address@KOPM_BCMAlrmHornReq_flg_ovrdflg@ */ Scalar_BOOLEAN 0 AppSwcOpm_CM_boolean_flg 0.0 1.0 /end CHARACTERISTIC
/begin CHARACTERISTIC KOPM_BCMAlrmHornReq_flg_ovrdval "BCM_B_Package_BAC" VALUE 0x0000 /* @ECU_Address@KOPM_BCMAlrmHornReq_flg_ovrdval@ */ Scalar_BOOLEAN 0 AppSwcOpm_CM_boolean_flg 0.0 1.0 /end CHARACTERISTIC
/begin CHARACTERISTIC KOPM_BCMAuthentKeyNr_enum_ovrdflg "BCM_B_Package_BAC" VALUE 0x0000 /* @ECU_Address@KOPM_BCMAuthentKeyNr_enum_ovrdflg@ */ Scalar_BOOLEAN 0 AppSwcOpm_CM_boolean_flg 0.0 1.0 /end CHARACTERISTIC
/begin CHARACTERISTIC KOPM_BCMAutoLampStatus_flg_ovrdflg "BCM_B_Package_BAC" VALUE 0x0000 /* @ECU_Address@KOPM_BCMAutoLampStatus_flg_ovrdflg@ */ Scalar_BOOLEAN 0 AppSwcOpm_CM_boolean_flg 0.0 1.0 /end CHARACTERISTIC
/begin CHARACTERISTIC KOPM_BCMAutoLampStatus_flg_ovrdval "BCM_B_Package_BAC" VALUE 0x0000 /* @ECU_Address@KOPM_BCMAutoLampStatus_flg_ovrdval@ */ Scalar_BOOLEAN 0 AppSwcOpm_CM_boolean_flg 0.0 1.0 /end CHARACTERISTIC
/begin CHARACTERISTIC KOPM_BCMAvaluebleKeyInCar_flg_ovrdflg "BCM_B_Package_BAC" VALUE 0x0000 /* @ECU_Address@KOPM_BCMAvaluebleKeyInCar_flg_ovrdflg@ */ Scalar_BOOLEAN 0 AppSwcOpm_CM_boolean_flg 0.0 1.0 /end CHARACTERISTIC
/begin CHARACTERISTIC KOPM_BCMAvaluebleKeyInCar_flg_ovrdval "BCM_B_Package_BAC" VALUE 0x0000 /* @ECU_Address@KOPM_BCMAvaluebleKeyInCar_flg_ovrdval@ */ Scalar_BOOLEAN 0 AppSwcOpm_CM_boolean_flg 0.0 1.0 /end CHARACTERISTIC
/begin CHARACTERISTIC KOPM_BCMBackLadjvalFb_enum_ovrdflg "BCM_B_Package_BAC" VALUE 0x0000 /* @ECU_Address@KOPM_BCMBackLadjvalFb_enum_ovrdflg@ */ Scalar_BOOLEAN 0 AppSwcOpm_CM_boolean_flg 0.0 1.0 /end CHARACTERISTIC
/begin CHARACTERISTIC KOPM_BCMBassHornReq_enum_ovrdflg "BCM_B_Package_BAC" VALUE 0x0000 /* @ECU_Address@KOPM_BCMBassHornReq_enum_ovrdflg@ */ Scalar_BOOLEAN 0 AppSwcOpm_CM_boolean_flg 0.0 1.0 /end CHARACTERISTIC
/begin CHARACTERISTIC KOPM_BCMBodyWarnSts_enum_ovrdflg "BCM_B_Package_BAC" VALUE 0x0000 /* @ECU_Address@KOPM_BCMBodyWarnSts_enum_ovrdflg@ */ Scalar_BOOLEAN 0 AppSwcOpm_CM_boolean_flg 0.0 1.0 /end CHARACTERISTIC
/begin CHARACTERISTIC KOPM_BCMBrakeLampSta_flg_ovrdflg "BCM_B_Package_BAC" VALUE 0x0000 /* @ECU_Address@KOPM_BCMBrakeLampSta_flg_ovrdflg@ */ Scalar_BOOLEAN 0 AppSwcOpm_CM_boolean_flg 0.0 1.0 /end CHARACTERISTIC
/begin CHARACTERISTIC KOPM_BCMBrakeLampSta_flg_ovrdval "BCM_B_Package_BAC" VALUE 0x0000 /* @ECU_Address@KOPM_BCMBrakeLampSta_flg_ovrdval@ */ Scalar_BOOLEAN 0 AppSwcOpm_CM_boolean_flg 0.0 1.0 /end CHARACTERISTIC
/begin CHARACTERISTIC KOPM_BCMBrkPedSta_flg_ovrdflg "CCU_VehInfo_BAC" VALUE 0x0000 /* @ECU_Address@KOPM_BCMBrkPedSta_flg_ovrdflg@ */ Scalar_BOOLEAN 0 AppSwcOpm_CM_boolean_flg 0.0 1.0 /end CHARACTERISTIC
/begin CHARACTERISTIC KOPM_BCMBrkPedSta_flg_ovrdval "CCU_VehInfo_BAC" VALUE 0x0000 /* @ECU_Address@KOPM_BCMBrkPedSta_flg_ovrdval@ */ Scalar_BOOLEAN 0 AppSwcOpm_CM_boolean_flg 0.0 1.0 /end CHARACTERISTIC
/begin CHARACTERISTIC KOPM_BCMCenLckSts_enum_ovrdflg "CCU_VehInfo_BAC" VALUE 0x0000 /* @ECU_Address@KOPM_BCMCenLckSts_enum_ovrdflg@ */ Scalar_BOOLEAN 0 AppSwcOpm_CM_boolean_flg 0.0 1.0 /end CHARACTERISTIC
/begin CHARACTERISTIC KOPM_BCMCenLckSwCtrlFb_enum_ovrdflg "CCU_VehInfo_BAC" VALUE 0x0000 /* @ECU_Address@KOPM_BCMCenLckSwCtrlFb_enum_ovrdflg@ */ Scalar_BOOLEAN 0 AppSwcOpm_CM_boolean_flg 0.0 1.0 /end CHARACTERISTIC
/begin CHARACTERISTIC KOPM_BCMChgWiprMtMdSwSetFb_enum_ovrdflg "BCM_B_Package_BAC" VALUE 0x0000 /* @ECU_Address@KOPM_BCMChgWiprMtMdSwSetFb_enum_ovrdflg@ */ Scalar_BOOLEAN 0 AppSwcOpm_CM_boolean_flg 0.0 1.0 /end CHARACTERISTIC
/begin CHARACTERISTIC KOPM_BCMChrgLidLockReq_enum_ovrdflg "BCM_B_Package_BAC" VALUE 0x0000 /* @ECU_Address@KOPM_BCMChrgLidLockReq_enum_ovrdflg@ */ Scalar_BOOLEAN 0 AppSwcOpm_CM_boolean_flg 0.0 1.0 /end CHARACTERISTIC
/begin CHARACTERISTIC KOPM_BCMDayRunLiSwSig_flg_ovrdflg "BCM_B_Package_BAC" VALUE 0x0000 /* @ECU_Address@KOPM_BCMDayRunLiSwSig_flg_ovrdflg@ */ Scalar_BOOLEAN 0 AppSwcOpm_CM_boolean_flg 0.0 1.0 /end CHARACTERISTIC
/begin CHARACTERISTIC KOPM_BCMDayRunLiSwSig_flg_ovrdval "BCM_B_Package_BAC" VALUE 0x0000 /* @ECU_Address@KOPM_BCMDayRunLiSwSig_flg_ovrdval@ */ Scalar_BOOLEAN 0 AppSwcOpm_CM_boolean_flg 0.0 1.0 /end CHARACTERISTIC
/begin CHARACTERISTIC KOPM_BCMDayRunLightSta_flg_ovrdflg "BCM_B_Package_BAC" VALUE 0x0000 /* @ECU_Address@KOPM_BCMDayRunLightSta_flg_ovrdflg@ */ Scalar_BOOLEAN 0 AppSwcOpm_CM_boolean_flg 0.0 1.0 /end CHARACTERISTIC
/begin CHARACTERISTIC KOPM_BCMDayRunLightSta_flg_ovrdval "BCM_B_Package_BAC" VALUE 0x0000 /* @ECU_Address@KOPM_BCMDayRunLightSta_flg_ovrdval@ */ Scalar_BOOLEAN 0 AppSwcOpm_CM_boolean_flg 0.0 1.0 /end CHARACTERISTIC
/begin CHARACTERISTIC KOPM_BCMDoorAjarStaFL_flg_ovrdflg "BCM_B_Package_BAC" VALUE 0x0000 /* @ECU_Address@KOPM_BCMDoorAjarStaFL_flg_ovrdflg@ */ Scalar_BOOLEAN 0 AppSwcOpm_CM_boolean_flg 0.0 1.0 /end CHARACTERISTIC
/begin CHARACTERISTIC KOPM_BCMDoorAjarStaFL_flg_ovrdval "BCM_B_Package_BAC" VALUE 0x0000 /* @ECU_Address@KOPM_BCMDoorAjarStaFL_flg_ovrdval@ */ Scalar_BOOLEAN 0 AppSwcOpm_CM_boolean_flg 0.0 1.0 /end CHARACTERISTIC
/begin CHARACTERISTIC KOPM_BCMDoorAjarStaFR_flg_ovrdflg "BCM_B_Package_BAC" VALUE 0x0000 /* @ECU_Address@KOPM_BCMDoorAjarStaFR_flg_ovrdflg@ */ Scalar_BOOLEAN 0 AppSwcOpm_CM_boolean_flg 0.0 1.0 /end CHARACTERISTIC
/begin CHARACTERISTIC KOPM_BCMDoorAjarStaFR_flg_ovrdval "BCM_B_Package_BAC" VALUE 0x0000 /* @ECU_Address@KOPM_BCMDoorAjarStaFR_flg_ovrdval@ */ Scalar_BOOLEAN 0 AppSwcOpm_CM_boolean_flg 0.0 1.0 /end CHARACTERISTIC
/begin CHARACTERISTIC KOPM_BCMDoorAjarStaRL_flg_ovrdflg "BCM_B_Package_BAC" VALUE 0x0000 /* @ECU_Address@KOPM_BCMDoorAjarStaRL_flg_ovrdflg@ */ Scalar_BOOLEAN 0 AppSwcOpm_CM_boolean_flg 0.0 1.0 /end CHARACTERISTIC
/begin CHARACTERISTIC KOPM_BCMDoorAjarStaRL_flg_ovrdval "BCM_B_Package_BAC" VALUE 0x0000 /* @ECU_Address@KOPM_BCMDoorAjarStaRL_flg_ovrdval@ */ Scalar_BOOLEAN 0 AppSwcOpm_CM_boolean_flg 0.0 1.0 /end CHARACTERISTIC
/begin CHARACTERISTIC KOPM_BCMDoorAjarStaRR_flg_ovrdflg "BCM_B_Package_BAC" VALUE 0x0000 /* @ECU_Address@KOPM_BCMDoorAjarStaRR_flg_ovrdflg@ */ Scalar_BOOLEAN 0 AppSwcOpm_CM_boolean_flg 0.0 1.0 /end CHARACTERISTIC
/begin CHARACTERISTIC KOPM_BCMDoorAjarStaRR_flg_ovrdval "BCM_B_Package_BAC" VALUE 0x0000 /* @ECU_Address@KOPM_BCMDoorAjarStaRR_flg_ovrdval@ */ Scalar_BOOLEAN 0 AppSwcOpm_CM_boolean_flg 0.0 1.0 /end CHARACTERISTIC
/begin CHARACTERISTIC KOPM_BCMDoorLckStaFL_flg_ovrdflg "CCU_VehInfo_BAC" VALUE 0x0000 /* @ECU_Address@KOPM_BCMDoorLckStaFL_flg_ovrdflg@ */ Scalar_BOOLEAN 0 AppSwcOpm_CM_boolean_flg 0.0 1.0 /end CHARACTERISTIC
/begin CHARACTERISTIC KOPM_BCMDoorLckStaFL_flg_ovrdval "CCU_VehInfo_BAC" VALUE 0x0000 /* @ECU_Address@KOPM_BCMDoorLckStaFL_flg_ovrdval@ */ Scalar_BOOLEAN 0 AppSwcOpm_CM_boolean_flg 0.0 1.0 /end CHARACTERISTIC
/begin CHARACTERISTIC KOPM_BCMDrvPEAuthentAcsd_enum_ovrdflg "BCM_B_Package_BAC" VALUE 0x0000 /* @ECU_Address@KOPM_BCMDrvPEAuthentAcsd_enum_ovrdflg@ */ Scalar_BOOLEAN 0 AppSwcOpm_CM_boolean_flg 0.0 1.0 /end CHARACTERISTIC
/begin CHARACTERISTIC KOPM_BCMDrvSeatOccptSnsrSts_enum_ovrdflg "BCM_B_Package_BAC" VALUE 0x0000 /* @ECU_Address@KOPM_BCMDrvSeatOccptSnsrSts_enum_ovrdflg@ */ Scalar_BOOLEAN 0 AppSwcOpm_CM_boolean_flg 0.0 1.0 /end CHARACTERISTIC
/begin CHARACTERISTIC KOPM_BCMDrvrWinSwSig_enum_ovrdflg "BCM_B_Package_BAC" VALUE 0x0000 /* @ECU_Address@KOPM_BCMDrvrWinSwSig_enum_ovrdflg@ */ Scalar_BOOLEAN 0 AppSwcOpm_CM_boolean_flg 0.0 1.0 /end CHARACTERISTIC
/begin CHARACTERISTIC KOPM_BCMFLWinSts_flg_ovrdflg "BCM_B_Package_BAC" VALUE 0x0000 /* @ECU_Address@KOPM_BCMFLWinSts_flg_ovrdflg@ */ Scalar_BOOLEAN 0 AppSwcOpm_CM_boolean_flg 0.0 1.0 /end CHARACTERISTIC
/begin CHARACTERISTIC KOPM_BCMFLWinSts_flg_ovrdval "BCM_B_Package_BAC" VALUE 0x0000 /* @ECU_Address@KOPM_BCMFLWinSts_flg_ovrdval@ */ Scalar_BOOLEAN 0 AppSwcOpm_CM_boolean_flg 0.0 1.0 /end CHARACTERISTIC
/begin CHARACTERISTIC KOPM_BCMFLWinmotorSts_enum_ovrdflg "BCM_B_Package_BAC" VALUE 0x0000 /* @ECU_Address@KOPM_BCMFLWinmotorSts_enum_ovrdflg@ */ Scalar_BOOLEAN 0 AppSwcOpm_CM_boolean_flg 0.0 1.0 /end CHARACTERISTIC
/begin CHARACTERISTIC KOPM_BCMFRPEAuthentAcsd_enum_ovrdflg "BCM_B_Package_BAC" VALUE 0x0000 /* @ECU_Address@KOPM_BCMFRPEAuthentAcsd_enum_ovrdflg@ */ Scalar_BOOLEAN 0 AppSwcOpm_CM_boolean_flg 0.0 1.0 /end CHARACTERISTIC
/begin CHARACTERISTIC KOPM_BCMFRWinSts_flg_ovrdflg "BCM_B_Package_BAC" VALUE 0x0000 /* @ECU_Address@KOPM_BCMFRWinSts_flg_ovrdflg@ */ Scalar_BOOLEAN 0 AppSwcOpm_CM_boolean_flg 0.0 1.0 /end CHARACTERISTIC
/begin CHARACTERISTIC KOPM_BCMFRWinSts_flg_ovrdval "BCM_B_Package_BAC" VALUE 0x0000 /* @ECU_Address@KOPM_BCMFRWinSts_flg_ovrdval@ */ Scalar_BOOLEAN 0 AppSwcOpm_CM_boolean_flg 0.0 1.0 /end CHARACTERISTIC
/begin CHARACTERISTIC KOPM_BCMFRWinmotorSts_enum_ovrdflg "BCM_B_Package_BAC" VALUE 0x0000 /* @ECU_Address@KOPM_BCMFRWinmotorSts_enum_ovrdflg@ */ Scalar_BOOLEAN 0 AppSwcOpm_CM_boolean_flg 0.0 1.0 /end CHARACTERISTIC
/begin CHARACTERISTIC KOPM_BCMFlwrMeHmCtrlFb_enum_ovrdflg "BCM_B_Package_BAC" VALUE 0x0000 /* @ECU_Address@KOPM_BCMFlwrMeHmCtrlFb_enum_ovrdflg@ */ Scalar_BOOLEAN 0 AppSwcOpm_CM_boolean_flg 0.0 1.0 /end CHARACTERISTIC
/begin CHARACTERISTIC KOPM_BCMFogLampStaFront_flg_ovrdflg "BCM_B_Package_BAC" VALUE 0x0000 /* @ECU_Address@KOPM_BCMFogLampStaFront_flg_ovrdflg@ */ Scalar_BOOLEAN 0 AppSwcOpm_CM_boolean_flg 0.0 1.0 /end CHARACTERISTIC
/begin CHARACTERISTIC KOPM_BCMFogLampStaFront_flg_ovrdval "BCM_B_Package_BAC" VALUE 0x0000 /* @ECU_Address@KOPM_BCMFogLampStaFront_flg_ovrdval@ */ Scalar_BOOLEAN 0 AppSwcOpm_CM_boolean_flg 0.0 1.0 /end CHARACTERISTIC
/begin CHARACTERISTIC KOPM_BCMFogLampStaRear_flg_ovrdflg "BCM_B_Package_BAC" VALUE 0x0000 /* @ECU_Address@KOPM_BCMFogLampStaRear_flg_ovrdflg@ */ Scalar_BOOLEAN 0 AppSwcOpm_CM_boolean_flg 0.0 1.0 /end CHARACTERISTIC
/begin CHARACTERISTIC KOPM_BCMFogLampStaRear_flg_ovrdval "BCM_B_Package_BAC" VALUE 0x0000 /* @ECU_Address@KOPM_BCMFogLampStaRear_flg_ovrdval@ */ Scalar_BOOLEAN 0 AppSwcOpm_CM_boolean_flg 0.0 1.0 /end CHARACTERISTIC
/begin CHARACTERISTIC KOPM_BCMFrbdnKeyNr_enum_ovrdflg "BCM_B_Package_BAC" VALUE 0x0000 /* @ECU_Address@KOPM_BCMFrbdnKeyNr_enum_ovrdflg@ */ Scalar_BOOLEAN 0 AppSwcOpm_CM_boolean_flg 0.0 1.0 /end CHARACTERISTIC
/begin CHARACTERISTIC KOPM_BCMFrntFogLiSwSig_flg_ovrdflg "BCM_B_Package_BAC" VALUE 0x0000 /* @ECU_Address@KOPM_BCMFrntFogLiSwSig_flg_ovrdflg@ */ Scalar_BOOLEAN 0 AppSwcOpm_CM_boolean_flg 0.0 1.0 /end CHARACTERISTIC
/begin CHARACTERISTIC KOPM_BCMFrntFogLiSwSig_flg_ovrdval "BCM_B_Package_BAC" VALUE 0x0000 /* @ECU_Address@KOPM_BCMFrntFogLiSwSig_flg_ovrdval@ */ Scalar_BOOLEAN 0 AppSwcOpm_CM_boolean_flg 0.0 1.0 /end CHARACTERISTIC
/begin CHARACTERISTIC KOPM_BCMFrntLeDoorHndlSwt_enum_ovrdflg "BCM_B_Package_BAC" VALUE 0x0000 /* @ECU_Address@KOPM_BCMFrntLeDoorHndlSwt_enum_ovrdflg@ */ Scalar_BOOLEAN 0 AppSwcOpm_CM_boolean_flg 0.0 1.0 /end CHARACTERISTIC
/begin CHARACTERISTIC KOPM_BCMFrntRiDoorHndlSwt_enum_ovrdflg "BCM_B_Package_BAC" VALUE 0x0000 /* @ECU_Address@KOPM_BCMFrntRiDoorHndlSwt_enum_ovrdflg@ */ Scalar_BOOLEAN 0 AppSwcOpm_CM_boolean_flg 0.0 1.0 /end CHARACTERISTIC
/begin CHARACTERISTIC KOPM_BCMFrntWiprMotSts_enum_ovrdflg "BCM_B_Package_BAC" VALUE 0x0000 /* @ECU_Address@KOPM_BCMFrntWiprMotSts_enum_ovrdflg@ */ Scalar_BOOLEAN 0 AppSwcOpm_CM_boolean_flg 0.0 1.0 /end CHARACTERISTIC
/begin CHARACTERISTIC KOPM_BCMFrntWshrSwSig_flg_ovrdflg "BCM_B_Package_BAC" VALUE 0x0000 /* @ECU_Address@KOPM_BCMFrntWshrSwSig_flg_ovrdflg@ */ Scalar_BOOLEAN 0 AppSwcOpm_CM_boolean_flg 0.0 1.0 /end CHARACTERISTIC
/begin CHARACTERISTIC KOPM_BCMFrntWshrSwSig_flg_ovrdval "BCM_B_Package_BAC" VALUE 0x0000 /* @ECU_Address@KOPM_BCMFrntWshrSwSig_flg_ovrdval@ */ Scalar_BOOLEAN 0 AppSwcOpm_CM_boolean_flg 0.0 1.0 /end CHARACTERISTIC
/begin CHARACTERISTIC KOPM_BCMFrontWashSts_flg_ovrdflg "BCM_B_Package_BAC" VALUE 0x0000 /* @ECU_Address@KOPM_BCMFrontWashSts_flg_ovrdflg@ */ Scalar_BOOLEAN 0 AppSwcOpm_CM_boolean_flg 0.0 1.0 /end CHARACTERISTIC
/begin CHARACTERISTIC KOPM_BCMFrontWashSts_flg_ovrdval "BCM_B_Package_BAC" VALUE 0x0000 /* @ECU_Address@KOPM_BCMFrontWashSts_flg_ovrdval@ */ Scalar_BOOLEAN 0 AppSwcOpm_CM_boolean_flg 0.0 1.0 /end CHARACTERISTIC
/begin CHARACTERISTIC KOPM_BCMHazardLampSts_flg_ovrdflg "BCM_B_Package_BAC" VALUE 0x0000 /* @ECU_Address@KOPM_BCMHazardLampSts_flg_ovrdflg@ */ Scalar_BOOLEAN 0 AppSwcOpm_CM_boolean_flg 0.0 1.0 /end CHARACTERISTIC
/begin CHARACTERISTIC KOPM_BCMHazardLampSts_flg_ovrdval "BCM_B_Package_BAC" VALUE 0x0000 /* @ECU_Address@KOPM_BCMHazardLampSts_flg_ovrdval@ */ Scalar_BOOLEAN 0 AppSwcOpm_CM_boolean_flg 0.0 1.0 /end CHARACTERISTIC
/begin CHARACTERISTIC KOPM_BCMHiBeamSwSig_enum_ovrdflg "BCM_B_Package_BAC" VALUE 0x0000 /* @ECU_Address@KOPM_BCMHiBeamSwSig_enum_ovrdflg@ */ Scalar_BOOLEAN 0 AppSwcOpm_CM_boolean_flg 0.0 1.0 /end CHARACTERISTIC
/begin CHARACTERISTIC KOPM_BCMHighBeamSta_flg_ovrdflg "BCM_B_Package_BAC" VALUE 0x0000 /* @ECU_Address@KOPM_BCMHighBeamSta_flg_ovrdflg@ */ Scalar_BOOLEAN 0 AppSwcOpm_CM_boolean_flg 0.0 1.0 /end CHARACTERISTIC
/begin CHARACTERISTIC KOPM_BCMHighBeamSta_flg_ovrdval "BCM_B_Package_BAC" VALUE 0x0000 /* @ECU_Address@KOPM_BCMHighBeamSta_flg_ovrdval@ */ Scalar_BOOLEAN 0 AppSwcOpm_CM_boolean_flg 0.0 1.0 /end CHARACTERISTIC
/begin CHARACTERISTIC KOPM_BCMHvyRainInd_flg_ovrdflg "BCM_B_Package_BAC" VALUE 0x0000 /* @ECU_Address@KOPM_BCMHvyRainInd_flg_ovrdflg@ */ Scalar_BOOLEAN 0 AppSwcOpm_CM_boolean_flg 0.0 1.0 /end CHARACTERISTIC
/begin CHARACTERISTIC KOPM_BCMHvyRainInd_flg_ovrdval "BCM_B_Package_BAC" VALUE 0x0000 /* @ECU_Address@KOPM_BCMHvyRainInd_flg_ovrdval@ */ Scalar_BOOLEAN 0 AppSwcOpm_CM_boolean_flg 0.0 1.0 /end CHARACTERISTIC
/begin CHARACTERISTIC KOPM_BCMHzrdWrngLghtSwSig_flg_ovrdflg "BCM_B_Package_BAC" VALUE 0x0000 /* @ECU_Address@KOPM_BCMHzrdWrngLghtSwSig_flg_ovrdflg@ */ Scalar_BOOLEAN 0 AppSwcOpm_CM_boolean_flg 0.0 1.0 /end CHARACTERISTIC
/begin CHARACTERISTIC KOPM_BCMHzrdWrngLghtSwSig_flg_ovrdval "BCM_B_Package_BAC" VALUE 0x0000 /* @ECU_Address@KOPM_BCMHzrdWrngLghtSwSig_flg_ovrdval@ */ Scalar_BOOLEAN 0 AppSwcOpm_CM_boolean_flg 0.0 1.0 /end CHARACTERISTIC
/begin CHARACTERISTIC KOPM_BCMIllmndEntryStsFb_flg_ovrdflg "BCM_B_Package_BAC" VALUE 0x0000 /* @ECU_Address@KOPM_BCMIllmndEntryStsFb_flg_ovrdflg@ */ Scalar_BOOLEAN 0 AppSwcOpm_CM_boolean_flg 0.0 1.0 /end CHARACTERISTIC
/begin CHARACTERISTIC KOPM_BCMIllmndEntryStsFb_flg_ovrdval "BCM_B_Package_BAC" VALUE 0x0000 /* @ECU_Address@KOPM_BCMIllmndEntryStsFb_flg_ovrdval@ */ Scalar_BOOLEAN 0 AppSwcOpm_CM_boolean_flg 0.0 1.0 /end CHARACTERISTIC
/begin CHARACTERISTIC KOPM_BCMIllmndLampReq_flg_ovrdflg "BCM_B_Package_BAC" VALUE 0x0000 /* @ECU_Address@KOPM_BCMIllmndLampReq_flg_ovrdflg@ */ Scalar_BOOLEAN 0 AppSwcOpm_CM_boolean_flg 0.0 1.0 /end CHARACTERISTIC
/begin CHARACTERISTIC KOPM_BCMIllmndLampReq_flg_ovrdval "BCM_B_Package_BAC" VALUE 0x0000 /* @ECU_Address@KOPM_BCMIllmndLampReq_flg_ovrdval@ */ Scalar_BOOLEAN 0 AppSwcOpm_CM_boolean_flg 0.0 1.0 /end CHARACTERISTIC
/begin CHARACTERISTIC KOPM_BCMIllmndLockReq_enum_ovrdflg "BCM_B_Package_BAC" VALUE 0x0000 /* @ECU_Address@KOPM_BCMIllmndLockReq_enum_ovrdflg@ */ Scalar_BOOLEAN 0 AppSwcOpm_CM_boolean_flg 0.0 1.0 /end CHARACTERISTIC
/begin CHARACTERISTIC KOPM_BCMIllmndSts_enum_ovrdflg "BCM_B_Package_BAC" VALUE 0x0000 /* @ECU_Address@KOPM_BCMIllmndSts_enum_ovrdflg@ */ Scalar_BOOLEAN 0 AppSwcOpm_CM_boolean_flg 0.0 1.0 /end CHARACTERISTIC
/begin CHARACTERISTIC KOPM_BCMIndcnKeyClsr_flg_ovrdflg "BCM_B_Package_BAC" VALUE 0x0000 /* @ECU_Address@KOPM_BCMIndcnKeyClsr_flg_ovrdflg@ */ Scalar_BOOLEAN 0 AppSwcOpm_CM_boolean_flg 0.0 1.0 /end CHARACTERISTIC
/begin CHARACTERISTIC KOPM_BCMIndcnKeyClsr_flg_ovrdval "BCM_B_Package_BAC" VALUE 0x0000 /* @ECU_Address@KOPM_BCMIndcnKeyClsr_flg_ovrdval@ */ Scalar_BOOLEAN 0 AppSwcOpm_CM_boolean_flg 0.0 1.0 /end CHARACTERISTIC
/begin CHARACTERISTIC KOPM_BCMIndcnShfttoNeut_flg_ovrdflg "BCM_B_Package_BAC" VALUE 0x0000 /* @ECU_Address@KOPM_BCMIndcnShfttoNeut_flg_ovrdflg@ */ Scalar_BOOLEAN 0 AppSwcOpm_CM_boolean_flg 0.0 1.0 /end CHARACTERISTIC
/begin CHARACTERISTIC KOPM_BCMIndcnShfttoNeut_flg_ovrdval "BCM_B_Package_BAC" VALUE 0x0000 /* @ECU_Address@KOPM_BCMIndcnShfttoNeut_flg_ovrdval@ */ Scalar_BOOLEAN 0 AppSwcOpm_CM_boolean_flg 0.0 1.0 /end CHARACTERISTIC
/begin CHARACTERISTIC KOPM_BCMKeyBattLvlSts_flg_ovrdflg "BCM_B_Package_BAC" VALUE 0x0000 /* @ECU_Address@KOPM_BCMKeyBattLvlSts_flg_ovrdflg@ */ Scalar_BOOLEAN 0 AppSwcOpm_CM_boolean_flg 0.0 1.0 /end CHARACTERISTIC
/begin CHARACTERISTIC KOPM_BCMKeyBattLvlSts_flg_ovrdval "BCM_B_Package_BAC" VALUE 0x0000 /* @ECU_Address@KOPM_BCMKeyBattLvlSts_flg_ovrdval@ */ Scalar_BOOLEAN 0 AppSwcOpm_CM_boolean_flg 0.0 1.0 /end CHARACTERISTIC
/begin CHARACTERISTIC KOPM_BCMKeyBattLvl_pct_ovrdflg "BCM_B_Package_BAC" VALUE 0x0000 /* @ECU_Address@KOPM_BCMKeyBattLvl_pct_ovrdflg@ */ Scalar_BOOLEAN 0 AppSwcOpm_CM_boolean_flg 0.0 1.0 /end CHARACTERISTIC
/begin CHARACTERISTIC KOPM_BCMKeyFrbdn_flg_ovrdflg "BCM_B_Package_BAC" VALUE 0x0000 /* @ECU_Address@KOPM_BCMKeyFrbdn_flg_ovrdflg@ */ Scalar_BOOLEAN 0 AppSwcOpm_CM_boolean_flg 0.0 1.0 /end CHARACTERISTIC
/begin CHARACTERISTIC KOPM_BCMKeyFrbdn_flg_ovrdval "BCM_B_Package_BAC" VALUE 0x0000 /* @ECU_Address@KOPM_BCMKeyFrbdn_flg_ovrdval@ */ Scalar_BOOLEAN 0 AppSwcOpm_CM_boolean_flg 0.0 1.0 /end CHARACTERISTIC
/begin CHARACTERISTIC KOPM_BCMKeyIDFb_enum_ovrdflg "BCM_B_Package_BAC" VALUE 0x0000 /* @ECU_Address@KOPM_BCMKeyIDFb_enum_ovrdflg@ */ Scalar_BOOLEAN 0 AppSwcOpm_CM_boolean_flg 0.0 1.0 /end CHARACTERISTIC
/begin CHARACTERISTIC KOPM_BCMKeyInCarSta_flg_ovrdflg "BCM_B_Package_BAC" VALUE 0x0000 /* @ECU_Address@KOPM_BCMKeyInCarSta_flg_ovrdflg@ */ Scalar_BOOLEAN 0 AppSwcOpm_CM_boolean_flg 0.0 1.0 /end CHARACTERISTIC
/begin CHARACTERISTIC KOPM_BCMKeyInCarSta_flg_ovrdval "BCM_B_Package_BAC" VALUE 0x0000 /* @ECU_Address@KOPM_BCMKeyInCarSta_flg_ovrdval@ */ Scalar_BOOLEAN 0 AppSwcOpm_CM_boolean_flg 0.0 1.0 /end CHARACTERISTIC
/begin CHARACTERISTIC KOPM_BCMKeyLoBattLvlWarn_flg_ovrdflg "BCM_B_Package_BAC" VALUE 0x0000 /* @ECU_Address@KOPM_BCMKeyLoBattLvlWarn_flg_ovrdflg@ */ Scalar_BOOLEAN 0 AppSwcOpm_CM_boolean_flg 0.0 1.0 /end CHARACTERISTIC
/begin CHARACTERISTIC KOPM_BCMKeyLoBattLvlWarn_flg_ovrdval "BCM_B_Package_BAC" VALUE 0x0000 /* @ECU_Address@KOPM_BCMKeyLoBattLvlWarn_flg_ovrdval@ */ Scalar_BOOLEAN 0 AppSwcOpm_CM_boolean_flg 0.0 1.0 /end CHARACTERISTIC
/begin CHARACTERISTIC KOPM_BCMKeyLocn_mm_ovrdflg "BCM_B_Package_BAC" VALUE 0x0000 /* @ECU_Address@KOPM_BCMKeyLocn_mm_ovrdflg@ */ Scalar_BOOLEAN 0 AppSwcOpm_CM_boolean_flg 0.0 1.0 /end CHARACTERISTIC
/begin CHARACTERISTIC KOPM_BCMKeySta_enum_ovrdflg "BCM_B_Package_BAC" VALUE 0x0000 /* @ECU_Address@KOPM_BCMKeySta_enum_ovrdflg@ */ Scalar_BOOLEAN 0 AppSwcOpm_CM_boolean_flg 0.0 1.0 /end CHARACTERISTIC
/begin CHARACTERISTIC KOPM_BCMLckHornOnStFb_flg_ovrdflg "BCM_B_Package_BAC" VALUE 0x0000 /* @ECU_Address@KOPM_BCMLckHornOnStFb_flg_ovrdflg@ */ Scalar_BOOLEAN 0 AppSwcOpm_CM_boolean_flg 0.0 1.0 /end CHARACTERISTIC
/begin CHARACTERISTIC KOPM_BCMLckHornOnStFb_flg_ovrdval "BCM_B_Package_BAC" VALUE 0x0000 /* @ECU_Address@KOPM_BCMLckHornOnStFb_flg_ovrdval@ */ Scalar_BOOLEAN 0 AppSwcOpm_CM_boolean_flg 0.0 1.0 /end CHARACTERISTIC
/begin CHARACTERISTIC KOPM_BCMLeTrnLiFltFb_enum_ovrdflg "BCM_B_Package_BAC" VALUE 0x0000 /* @ECU_Address@KOPM_BCMLeTrnLiFltFb_enum_ovrdflg@ */ Scalar_BOOLEAN 0 AppSwcOpm_CM_boolean_flg 0.0 1.0 /end CHARACTERISTIC
/begin CHARACTERISTIC KOPM_BCMLghtSwSig_enum_ovrdflg "BCM_B_Package_BAC" VALUE 0x0000 /* @ECU_Address@KOPM_BCMLghtSwSig_enum_ovrdflg@ */ Scalar_BOOLEAN 0 AppSwcOpm_CM_boolean_flg 0.0 1.0 /end CHARACTERISTIC
/begin CHARACTERISTIC KOPM_BCMLightIntensity_enum_ovrdflg "BCM_B_Package_BAC" VALUE 0x0000 /* @ECU_Address@KOPM_BCMLightIntensity_enum_ovrdflg@ */ Scalar_BOOLEAN 0 AppSwcOpm_CM_boolean_flg 0.0 1.0 /end CHARACTERISTIC
/begin CHARACTERISTIC KOPM_BCMLogoActvFlg_enum_ovrdflg "BCM_B_Package_BAC" VALUE 0x0000 /* @ECU_Address@KOPM_BCMLogoActvFlg_enum_ovrdflg@ */ Scalar_BOOLEAN 0 AppSwcOpm_CM_boolean_flg 0.0 1.0 /end CHARACTERISTIC
/begin CHARACTERISTIC KOPM_BCMLowBeamSta_flg_ovrdflg "BCM_B_Package_BAC" VALUE 0x0000 /* @ECU_Address@KOPM_BCMLowBeamSta_flg_ovrdflg@ */ Scalar_BOOLEAN 0 AppSwcOpm_CM_boolean_flg 0.0 1.0 /end CHARACTERISTIC
/begin CHARACTERISTIC KOPM_BCMLowBeamSta_flg_ovrdval "BCM_B_Package_BAC" VALUE 0x0000 /* @ECU_Address@KOPM_BCMLowBeamSta_flg_ovrdval@ */ Scalar_BOOLEAN 0 AppSwcOpm_CM_boolean_flg 0.0 1.0 /end CHARACTERISTIC
/begin CHARACTERISTIC KOPM_BCMMaiDrvrSeatSts_enum_ovrdflg "BCM_B_Package_BAC" VALUE 0x0000 /* @ECU_Address@KOPM_BCMMaiDrvrSeatSts_enum_ovrdflg@ */ Scalar_BOOLEAN 0 AppSwcOpm_CM_boolean_flg 0.0 1.0 /end CHARACTERISTIC
/begin CHARACTERISTIC KOPM_BCMMaiDrvrSeatTemp_C_ovrdflg "BCM_B_Package_BAC" VALUE 0x0000 /* @ECU_Address@KOPM_BCMMaiDrvrSeatTemp_C_ovrdflg@ */ Scalar_BOOLEAN 0 AppSwcOpm_CM_boolean_flg 0.0 1.0 /end CHARACTERISTIC
/begin CHARACTERISTIC KOPM_BCMOvrspdCntrlLckSetFb_flg_ovrdflg "BCM_B_Package_BAC" VALUE 0x0000 /* @ECU_Address@KOPM_BCMOvrspdCntrlLckSetFb_flg_ovrdflg@ */ Scalar_BOOLEAN 0 AppSwcOpm_CM_boolean_flg 0.0 1.0 /end CHARACTERISTIC
/begin CHARACTERISTIC KOPM_BCMOvrspdCntrlLckSetFb_flg_ovrdval "BCM_B_Package_BAC" VALUE 0x0000 /* @ECU_Address@KOPM_BCMOvrspdCntrlLckSetFb_flg_ovrdval@ */ Scalar_BOOLEAN 0 AppSwcOpm_CM_boolean_flg 0.0 1.0 /end CHARACTERISTIC
/begin CHARACTERISTIC KOPM_BCMPSAuthentRes_enum_ovrdflg "BCM_B_Package_BAC" VALUE 0x0000 /* @ECU_Address@KOPM_BCMPSAuthentRes_enum_ovrdflg@ */ Scalar_BOOLEAN 0 AppSwcOpm_CM_boolean_flg 0.0 1.0 /end CHARACTERISTIC
/begin CHARACTERISTIC KOPM_BCMPSReq_flg_ovrdflg "BCM_B_Package_BAC" VALUE 0x0000 /* @ECU_Address@KOPM_BCMPSReq_flg_ovrdflg@ */ Scalar_BOOLEAN 0 AppSwcOpm_CM_boolean_flg 0.0 1.0 /end CHARACTERISTIC
/begin CHARACTERISTIC KOPM_BCMPSReq_flg_ovrdval "BCM_B_Package_BAC" VALUE 0x0000 /* @ECU_Address@KOPM_BCMPSReq_flg_ovrdval@ */ Scalar_BOOLEAN 0 AppSwcOpm_CM_boolean_flg 0.0 1.0 /end CHARACTERISTIC
/begin CHARACTERISTIC KOPM_BCMParkAutoUnlckSetFb_flg_ovrdflg "BCM_B_Package_BAC" VALUE 0x0000 /* @ECU_Address@KOPM_BCMParkAutoUnlckSetFb_flg_ovrdflg@ */ Scalar_BOOLEAN 0 AppSwcOpm_CM_boolean_flg 0.0 1.0 /end CHARACTERISTIC
/begin CHARACTERISTIC KOPM_BCMParkAutoUnlckSetFb_flg_ovrdval "BCM_B_Package_BAC" VALUE 0x0000 /* @ECU_Address@KOPM_BCMParkAutoUnlckSetFb_flg_ovrdval@ */ Scalar_BOOLEAN 0 AppSwcOpm_CM_boolean_flg 0.0 1.0 /end CHARACTERISTIC
/begin CHARACTERISTIC KOPM_BCMPassWinSwSig_enum_ovrdflg "BCM_B_Package_BAC" VALUE 0x0000 /* @ECU_Address@KOPM_BCMPassWinSwSig_enum_ovrdflg@ */ Scalar_BOOLEAN 0 AppSwcOpm_CM_boolean_flg 0.0 1.0 /end CHARACTERISTIC
/begin CHARACTERISTIC KOPM_BCMPaswdwInit_flg_ovrdflg "BCM_B_Package_BAC" VALUE 0x0000 /* @ECU_Address@KOPM_BCMPaswdwInit_flg_ovrdflg@ */ Scalar_BOOLEAN 0 AppSwcOpm_CM_boolean_flg 0.0 1.0 /end CHARACTERISTIC
/begin CHARACTERISTIC KOPM_BCMPaswdwInit_flg_ovrdval "BCM_B_Package_BAC" VALUE 0x0000 /* @ECU_Address@KOPM_BCMPaswdwInit_flg_ovrdval@ */ Scalar_BOOLEAN 0 AppSwcOpm_CM_boolean_flg 0.0 1.0 /end CHARACTERISTIC
/begin CHARACTERISTIC KOPM_BCMPosLampSta_flg_ovrdflg "BCM_B_Package_BAC" VALUE 0x0000 /* @ECU_Address@KOPM_BCMPosLampSta_flg_ovrdflg@ */ Scalar_BOOLEAN 0 AppSwcOpm_CM_boolean_flg 0.0 1.0 /end CHARACTERISTIC
/begin CHARACTERISTIC KOPM_BCMPosLampSta_flg_ovrdval "BCM_B_Package_BAC" VALUE 0x0000 /* @ECU_Address@KOPM_BCMPosLampSta_flg_ovrdval@ */ Scalar_BOOLEAN 0 AppSwcOpm_CM_boolean_flg 0.0 1.0 /end CHARACTERISTIC
/begin CHARACTERISTIC KOPM_BCMRFInitSta_flg_ovrdflg "BCM_B_Package_BAC" VALUE 0x0000 /* @ECU_Address@KOPM_BCMRFInitSta_flg_ovrdflg@ */ Scalar_BOOLEAN 0 AppSwcOpm_CM_boolean_flg 0.0 1.0 /end CHARACTERISTIC
/begin CHARACTERISTIC KOPM_BCMRFInitSta_flg_ovrdval "BCM_B_Package_BAC" VALUE 0x0000 /* @ECU_Address@KOPM_BCMRFInitSta_flg_ovrdval@ */ Scalar_BOOLEAN 0 AppSwcOpm_CM_boolean_flg 0.0 1.0 /end CHARACTERISTIC
/begin CHARACTERISTIC KOPM_BCMRKEReq_enum_ovrdflg "BCM_B_Package_BAC" VALUE 0x0000 /* @ECU_Address@KOPM_BCMRKEReq_enum_ovrdflg@ */ Scalar_BOOLEAN 0 AppSwcOpm_CM_boolean_flg 0.0 1.0 /end CHARACTERISTIC
/begin CHARACTERISTIC KOPM_BCMReverseLampSta_flg_ovrdflg "BCM_B_Package_BAC" VALUE 0x0000 /* @ECU_Address@KOPM_BCMReverseLampSta_flg_ovrdflg@ */ Scalar_BOOLEAN 0 AppSwcOpm_CM_boolean_flg 0.0 1.0 /end CHARACTERISTIC
/begin CHARACTERISTIC KOPM_BCMReverseLampSta_flg_ovrdval "BCM_B_Package_BAC" VALUE 0x0000 /* @ECU_Address@KOPM_BCMReverseLampSta_flg_ovrdval@ */ Scalar_BOOLEAN 0 AppSwcOpm_CM_boolean_flg 0.0 1.0 /end CHARACTERISTIC
/begin CHARACTERISTIC KOPM_BCMRiTrnLiFltFb_enum_ovrdflg "BCM_B_Package_BAC" VALUE 0x0000 /* @ECU_Address@KOPM_BCMRiTrnLiFltFb_enum_ovrdflg@ */ Scalar_BOOLEAN 0 AppSwcOpm_CM_boolean_flg 0.0 1.0 /end CHARACTERISTIC
/begin CHARACTERISTIC KOPM_BCMRrFogLiSwSig_flg_ovrdflg "BCM_B_Package_BAC" VALUE 0x0000 /* @ECU_Address@KOPM_BCMRrFogLiSwSig_flg_ovrdflg@ */ Scalar_BOOLEAN 0 AppSwcOpm_CM_boolean_flg 0.0 1.0 /end CHARACTERISTIC
/begin CHARACTERISTIC KOPM_BCMRrFogLiSwSig_flg_ovrdval "BCM_B_Package_BAC" VALUE 0x0000 /* @ECU_Address@KOPM_BCMRrFogLiSwSig_flg_ovrdval@ */ Scalar_BOOLEAN 0 AppSwcOpm_CM_boolean_flg 0.0 1.0 /end CHARACTERISTIC
/begin CHARACTERISTIC KOPM_BCMRrMirrHeatSts_flg_ovrdflg "BCM_B_Package_BAC" VALUE 0x0000 /* @ECU_Address@KOPM_BCMRrMirrHeatSts_flg_ovrdflg@ */ Scalar_BOOLEAN 0 AppSwcOpm_CM_boolean_flg 0.0 1.0 /end CHARACTERISTIC
/begin CHARACTERISTIC KOPM_BCMRrMirrHeatSts_flg_ovrdval "BCM_B_Package_BAC" VALUE 0x0000 /* @ECU_Address@KOPM_BCMRrMirrHeatSts_flg_ovrdval@ */ Scalar_BOOLEAN 0 AppSwcOpm_CM_boolean_flg 0.0 1.0 /end CHARACTERISTIC
/begin CHARACTERISTIC KOPM_BCMStartReq_enum_ovrdflg "BCM_B_Package_BAC" VALUE 0x0000 /* @ECU_Address@KOPM_BCMStartReq_enum_ovrdflg@ */ Scalar_BOOLEAN 0 AppSwcOpm_CM_boolean_flg 0.0 1.0 /end CHARACTERISTIC
/begin CHARACTERISTIC KOPM_BCMSteerWhlHeatStsHi_flg "BCM_B_Package_BAC" VALUE 0x0000 /* @ECU_Address@KOPM_BCMSteerWhlHeatStsHi_flg@ */ Scalar_BOOLEAN 0 AppSwcOpm_CM_boolean_flg 0.0 1.0 /end CHARACTERISTIC
/begin CHARACTERISTIC KOPM_BCMSteerWhlHeatStsLo_flg "BCM_B_Package_BAC" VALUE 0x0000 /* @ECU_Address@KOPM_BCMSteerWhlHeatStsLo_flg@ */ Scalar_BOOLEAN 0 AppSwcOpm_CM_boolean_flg 0.0 1.0 /end CHARACTERISTIC
/begin CHARACTERISTIC KOPM_BCMSteerWhlHeatSts_flg_ovrdflg "BCM_B_Package_BAC" VALUE 0x0000 /* @ECU_Address@KOPM_BCMSteerWhlHeatSts_flg_ovrdflg@ */ Scalar_BOOLEAN 0 AppSwcOpm_CM_boolean_flg 0.0 1.0 /end CHARACTERISTIC
/begin CHARACTERISTIC KOPM_BCMSteerWhlHeatSts_flg_ovrdval "BCM_B_Package_BAC" VALUE 0x0000 /* @ECU_Address@KOPM_BCMSteerWhlHeatSts_flg_ovrdval@ */ Scalar_BOOLEAN 0 AppSwcOpm_CM_boolean_flg 0.0 1.0 /end CHARACTERISTIC
/begin CHARACTERISTIC KOPM_BCMSteerWhlTemp_C_ovrdflg "BCM_B_Package_BAC" VALUE 0x0000 /* @ECU_Address@KOPM_BCMSteerWhlTemp_C_ovrdflg@ */ Scalar_BOOLEAN 0 AppSwcOpm_CM_boolean_flg 0.0 1.0 /end CHARACTERISTIC
/begin CHARACTERISTIC KOPM_BCMSysPowerSts_enum_ovrdflg "CCU_VehInfo_BAC" VALUE 0x0000 /* @ECU_Address@KOPM_BCMSysPowerSts_enum_ovrdflg@ */ Scalar_BOOLEAN 0 AppSwcOpm_CM_boolean_flg 0.0 1.0 /end CHARACTERISTIC
/begin CHARACTERISTIC KOPM_BCMSysPwrModeVld_flg_ovrdflg "CCU_VehInfo_BAC" VALUE 0x0000 /* @ECU_Address@KOPM_BCMSysPwrModeVld_flg_ovrdflg@ */ Scalar_BOOLEAN 0 AppSwcOpm_CM_boolean_flg 0.0 1.0 /end CHARACTERISTIC
/begin CHARACTERISTIC KOPM_BCMSysPwrModeVld_flg_ovrdval "CCU_VehInfo_BAC" VALUE 0x0000 /* @ECU_Address@KOPM_BCMSysPwrModeVld_flg_ovrdval@ */ Scalar_BOOLEAN 0 AppSwcOpm_CM_boolean_flg 0.0 1.0 /end CHARACTERISTIC
/begin CHARACTERISTIC KOPM_BCMSysPwrMode_enum_ovrdflg "CCU_VehInfo_BAC" VALUE 0x0000 /* @ECU_Address@KOPM_BCMSysPwrMode_enum_ovrdflg@ */ Scalar_BOOLEAN 0 AppSwcOpm_CM_boolean_flg 0.0 1.0 /end CHARACTERISTIC
/begin CHARACTERISTIC KOPM_BCMTPMSRstSts_enum_ovrdflg "BCM_B_Package_BAC" VALUE 0x0000 /* @ECU_Address@KOPM_BCMTPMSRstSts_enum_ovrdflg@ */ Scalar_BOOLEAN 0 AppSwcOpm_CM_boolean_flg 0.0 1.0 /end CHARACTERISTIC
/begin CHARACTERISTIC KOPM_BCMTrnkLckSta_flg_ovrdflg "BCM_B_Package_BAC" VALUE 0x0000 /* @ECU_Address@KOPM_BCMTrnkLckSta_flg_ovrdflg@ */ Scalar_BOOLEAN 0 AppSwcOpm_CM_boolean_flg 0.0 1.0 /end CHARACTERISTIC
/begin CHARACTERISTIC KOPM_BCMTrnkLckSta_flg_ovrdval "BCM_B_Package_BAC" VALUE 0x0000 /* @ECU_Address@KOPM_BCMTrnkLckSta_flg_ovrdval@ */ Scalar_BOOLEAN 0 AppSwcOpm_CM_boolean_flg 0.0 1.0 /end CHARACTERISTIC
/begin CHARACTERISTIC KOPM_BCMTrnkLckSwCtrlFb_flg_ovrdflg "BCM_B_Package_BAC" VALUE 0x0000 /* @ECU_Address@KOPM_BCMTrnkLckSwCtrlFb_flg_ovrdflg@ */ Scalar_BOOLEAN 0 AppSwcOpm_CM_boolean_flg 0.0 1.0 /end CHARACTERISTIC
/begin CHARACTERISTIC KOPM_BCMTrnkLckSwCtrlFb_flg_ovrdval "BCM_B_Package_BAC" VALUE 0x0000 /* @ECU_Address@KOPM_BCMTrnkLckSwCtrlFb_flg_ovrdval@ */ Scalar_BOOLEAN 0 AppSwcOpm_CM_boolean_flg 0.0 1.0 /end CHARACTERISTIC
/begin CHARACTERISTIC KOPM_BCMTrnngLiSwSig_enum_ovrdflg "BCM_B_Package_BAC" VALUE 0x0000 /* @ECU_Address@KOPM_BCMTrnngLiSwSig_enum_ovrdflg@ */ Scalar_BOOLEAN 0 AppSwcOpm_CM_boolean_flg 0.0 1.0 /end CHARACTERISTIC
/begin CHARACTERISTIC KOPM_BCMTrunkSwtSig_flg_ovrdflg "BCM_B_Package_BAC" VALUE 0x0000 /* @ECU_Address@KOPM_BCMTrunkSwtSig_flg_ovrdflg@ */ Scalar_BOOLEAN 0 AppSwcOpm_CM_boolean_flg 0.0 1.0 /end CHARACTERISTIC
/begin CHARACTERISTIC KOPM_BCMTrunkSwtSig_flg_ovrdval "BCM_B_Package_BAC" VALUE 0x0000 /* @ECU_Address@KOPM_BCMTrunkSwtSig_flg_ovrdval@ */ Scalar_BOOLEAN 0 AppSwcOpm_CM_boolean_flg 0.0 1.0 /end CHARACTERISTIC
/begin CHARACTERISTIC KOPM_BCMTurnLampStaLeft_flg_ovrdflg "BCM_B_Package_BAC" VALUE 0x0000 /* @ECU_Address@KOPM_BCMTurnLampStaLeft_flg_ovrdflg@ */ Scalar_BOOLEAN 0 AppSwcOpm_CM_boolean_flg 0.0 1.0 /end CHARACTERISTIC
/begin CHARACTERISTIC KOPM_BCMTurnLampStaLeft_flg_ovrdval "BCM_B_Package_BAC" VALUE 0x0000 /* @ECU_Address@KOPM_BCMTurnLampStaLeft_flg_ovrdval@ */ Scalar_BOOLEAN 0 AppSwcOpm_CM_boolean_flg 0.0 1.0 /end CHARACTERISTIC
/begin CHARACTERISTIC KOPM_BCMTurnLampStaRight_flg_ovrdflg "BCM_B_Package_BAC" VALUE 0x0000 /* @ECU_Address@KOPM_BCMTurnLampStaRight_flg_ovrdflg@ */ Scalar_BOOLEAN 0 AppSwcOpm_CM_boolean_flg 0.0 1.0 /end CHARACTERISTIC
/begin CHARACTERISTIC KOPM_BCMTurnLampStaRight_flg_ovrdval "BCM_B_Package_BAC" VALUE 0x0000 /* @ECU_Address@KOPM_BCMTurnLampStaRight_flg_ovrdval@ */ Scalar_BOOLEAN 0 AppSwcOpm_CM_boolean_flg 0.0 1.0 /end CHARACTERISTIC
/begin CHARACTERISTIC KOPM_BCMTurnLiSts_enum_ovrdflg "BCM_B_Package_BAC" VALUE 0x0000 /* @ECU_Address@KOPM_BCMTurnLiSts_enum_ovrdflg@ */ Scalar_BOOLEAN 0 AppSwcOpm_CM_boolean_flg 0.0 1.0 /end CHARACTERISTIC
/begin CHARACTERISTIC KOPM_BCMVehSeek_flg_ovrdflg "BCM_B_Package_BAC" VALUE 0x0000 /* @ECU_Address@KOPM_BCMVehSeek_flg_ovrdflg@ */ Scalar_BOOLEAN 0 AppSwcOpm_CM_boolean_flg 0.0 1.0 /end CHARACTERISTIC
/begin CHARACTERISTIC KOPM_BCMVehSeek_flg_ovrdval "BCM_B_Package_BAC" VALUE 0x0000 /* @ECU_Address@KOPM_BCMVehSeek_flg_ovrdval@ */ Scalar_BOOLEAN 0 AppSwcOpm_CM_boolean_flg 0.0 1.0 /end CHARACTERISTIC
/begin CHARACTERISTIC KOPM_BCMWarnKeyOutRmndr_flg_ovrdflg "BCM_B_Package_BAC" VALUE 0x0000 /* @ECU_Address@KOPM_BCMWarnKeyOutRmndr_flg_ovrdflg@ */ Scalar_BOOLEAN 0 AppSwcOpm_CM_boolean_flg 0.0 1.0 /end CHARACTERISTIC
/begin CHARACTERISTIC KOPM_BCMWarnKeyOutRmndr_flg_ovrdval "BCM_B_Package_BAC" VALUE 0x0000 /* @ECU_Address@KOPM_BCMWarnKeyOutRmndr_flg_ovrdval@ */ Scalar_BOOLEAN 0 AppSwcOpm_CM_boolean_flg 0.0 1.0 /end CHARACTERISTIC
/begin CHARACTERISTIC KOPM_BCMWarnNoKeyFound_flg_ovrdflg "BCM_B_Package_BAC" VALUE 0x0000 /* @ECU_Address@KOPM_BCMWarnNoKeyFound_flg_ovrdflg@ */ Scalar_BOOLEAN 0 AppSwcOpm_CM_boolean_flg 0.0 1.0 /end CHARACTERISTIC
/begin CHARACTERISTIC KOPM_BCMWarnNoKeyFound_flg_ovrdval "BCM_B_Package_BAC" VALUE 0x0000 /* @ECU_Address@KOPM_BCMWarnNoKeyFound_flg_ovrdval@ */ Scalar_BOOLEAN 0 AppSwcOpm_CM_boolean_flg 0.0 1.0 /end CHARACTERISTIC
/begin CHARACTERISTIC KOPM_BCMWashLiquidLvlWarn_flg_ovrdflg "BCM_B_Package_BAC" VALUE 0x0000 /* @ECU_Address@KOPM_BCMWashLiquidLvlWarn_flg_ovrdflg@ */ Scalar_BOOLEAN 0 AppSwcOpm_CM_boolean_flg 0.0 1.0 /end CHARACTERISTIC
/begin CHARACTERISTIC KOPM_BCMWashLiquidLvlWarn_flg_ovrdval "BCM_B_Package_BAC" VALUE 0x0000 /* @ECU_Address@KOPM_BCMWashLiquidLvlWarn_flg_ovrdval@ */ Scalar_BOOLEAN 0 AppSwcOpm_CM_boolean_flg 0.0 1.0 /end CHARACTERISTIC
/begin CHARACTERISTIC KOPM_BCMWinLockSig_flg_ovrdflg "BCM_B_Package_BAC" VALUE 0x0000 /* @ECU_Address@KOPM_BCMWinLockSig_flg_ovrdflg@ */ Scalar_BOOLEAN 0 AppSwcOpm_CM_boolean_flg 0.0 1.0 /end CHARACTERISTIC
/begin CHARACTERISTIC KOPM_BCMWinLockSig_flg_ovrdval "BCM_B_Package_BAC" VALUE 0x0000 /* @ECU_Address@KOPM_BCMWinLockSig_flg_ovrdval@ */ Scalar_BOOLEAN 0 AppSwcOpm_CM_boolean_flg 0.0 1.0 /end CHARACTERISTIC
/begin CHARACTERISTIC KOPM_BCMWinLockSts_flg_ovrdflg "BCM_B_Package_BAC" VALUE 0x0000 /* @ECU_Address@KOPM_BCMWinLockSts_flg_ovrdflg@ */ Scalar_BOOLEAN 0 AppSwcOpm_CM_boolean_flg 0.0 1.0 /end CHARACTERISTIC
/begin CHARACTERISTIC KOPM_BCMWinLockSts_flg_ovrdval "BCM_B_Package_BAC" VALUE 0x0000 /* @ECU_Address@KOPM_BCMWinLockSts_flg_ovrdval@ */ Scalar_BOOLEAN 0 AppSwcOpm_CM_boolean_flg 0.0 1.0 /end CHARACTERISTIC
/begin CHARACTERISTIC KOPM_BCMWiperCtrlFront_enum_ovrdflg "BCM_B_Package_BAC" VALUE 0x0000 /* @ECU_Address@KOPM_BCMWiperCtrlFront_enum_ovrdflg@ */ Scalar_BOOLEAN 0 AppSwcOpm_CM_boolean_flg 0.0 1.0 /end CHARACTERISTIC
/begin CHARACTERISTIC KOPM_BCMWiperSwSig_enum_ovrdflg "BCM_B_Package_BAC" VALUE 0x0000 /* @ECU_Address@KOPM_BCMWiperSwSig_enum_ovrdflg@ */ Scalar_BOOLEAN 0 AppSwcOpm_CM_boolean_flg 0.0 1.0 /end CHARACTERISTIC
/begin CHARACTERISTIC KOPM_BCMWiprIntlGrSwtSig_enum_ovrdflg "BCM_B_Package_BAC" VALUE 0x0000 /* @ECU_Address@KOPM_BCMWiprIntlGrSwtSig_enum_ovrdflg@ */ Scalar_BOOLEAN 0 AppSwcOpm_CM_boolean_flg 0.0 1.0 /end CHARACTERISTIC
/begin CHARACTERISTIC KOPM_BCMWiprIntlTimeSetFb_enum_ovrdflg "BCM_B_Package_BAC" VALUE 0x0000 /* @ECU_Address@KOPM_BCMWiprIntlTimeSetFb_enum_ovrdflg@ */ Scalar_BOOLEAN 0 AppSwcOpm_CM_boolean_flg 0.0 1.0 /end CHARACTERISTIC
/begin CHARACTERISTIC KOPM_DCCBoostHvVolt_V_ovrdflg "VCU_C_OprtCmd_EPT" VALUE 0x0000 /* @ECU_Address@KOPM_DCCBoostHvVolt_V_ovrdflg@ */ Scalar_BOOLEAN 0 AppSwcOpm_CM_boolean_flg 0.0 1.0 /end CHARACTERISTIC
/begin CHARACTERISTIC KOPM_DCCBuckLVVolt_V_ovrdflg "VCU_C_OprtCmd_EPT" VALUE 0x0000 /* @ECU_Address@KOPM_DCCBuckLVVolt_V_ovrdflg@ */ Scalar_BOOLEAN 0 AppSwcOpm_CM_boolean_flg 0.0 1.0 /end CHARACTERISTIC
/begin CHARACTERISTIC KOPM_HDCStat_enum_ovrdflg "CCU_VehInfo_BAC" VALUE 0x0000 /* @ECU_Address@KOPM_HDCStat_enum_ovrdflg@ */ Scalar_BOOLEAN 0 AppSwcOpm_CM_boolean_flg 0.0 1.0 /end CHARACTERISTIC
/begin CHARACTERISTIC KOPM_LimpHomeSta_flg_ovrdflg "CCU_VehInfo_BAC" VALUE 0x0000 /* @ECU_Address@KOPM_LimpHomeSta_flg_ovrdflg@ */ Scalar_BOOLEAN 0 AppSwcOpm_CM_boolean_flg 0.0 1.0 /end CHARACTERISTIC
/begin CHARACTERISTIC KOPM_LimpHomeSta_flg_ovrdval "CCU_VehInfo_BAC" VALUE 0x0000 /* @ECU_Address@KOPM_LimpHomeSta_flg_ovrdval@ */ Scalar_BOOLEAN 0 AppSwcOpm_CM_boolean_flg 0.0 1.0 /end CHARACTERISTIC
/begin CHARACTERISTIC KOPM_MaxHVDCCurntAC_A_ovrdflg "VCU_C_OprtCmd_EPT" VALUE 0x0000 /* @ECU_Address@KOPM_MaxHVDCCurntAC_A_ovrdflg@ */ Scalar_BOOLEAN 0 AppSwcOpm_CM_boolean_flg 0.0 1.0 /end CHARACTERISTIC
/begin CHARACTERISTIC KOPM_MaxHVDCVoltAC_V_ovrdflg "VCU_C_OprtCmd_EPT" VALUE 0x0000 /* @ECU_Address@KOPM_MaxHVDCVoltAC_V_ovrdflg@ */ Scalar_BOOLEAN 0 AppSwcOpm_CM_boolean_flg 0.0 1.0 /end CHARACTERISTIC
/begin CHARACTERISTIC KOPM_OBCIntDchrgEna_flg_ovrdflg "VCU_C_OprtCmd_EPT" VALUE 0x0000 /* @ECU_Address@KOPM_OBCIntDchrgEna_flg_ovrdflg@ */ Scalar_BOOLEAN 0 AppSwcOpm_CM_boolean_flg 0.0 1.0 /end CHARACTERISTIC
/begin CHARACTERISTIC KOPM_OBCIntDchrgEna_flg_ovrdval "VCU_C_OprtCmd_EPT" VALUE 0x0000 /* @ECU_Address@KOPM_OBCIntDchrgEna_flg_ovrdval@ */ Scalar_BOOLEAN 0 AppSwcOpm_CM_boolean_flg 0.0 1.0 /end CHARACTERISTIC
/begin CHARACTERISTIC KOPM_PCUFailSta_flg_ovrdflg "CCU_VehInfo_BAC" VALUE 0x0000 /* @ECU_Address@KOPM_PCUFailSta_flg_ovrdflg@ */ Scalar_BOOLEAN 0 AppSwcOpm_CM_boolean_flg 0.0 1.0 /end CHARACTERISTIC
/begin CHARACTERISTIC KOPM_PCUFailSta_flg_ovrdval "CCU_VehInfo_BAC" VALUE 0x0000 /* @ECU_Address@KOPM_PCUFailSta_flg_ovrdval@ */ Scalar_BOOLEAN 0 AppSwcOpm_CM_boolean_flg 0.0 1.0 /end CHARACTERISTIC
/begin CHARACTERISTIC KOPM_PTActlOprtMode_enum_ovrdflg "CCU_VehInfo_BAC" VALUE 0x0000 /* @ECU_Address@KOPM_PTActlOprtMode_enum_ovrdflg@ */ Scalar_BOOLEAN 0 AppSwcOpm_CM_boolean_flg 0.0 1.0 /end CHARACTERISTIC
/begin CHARACTERISTIC KOPM_PrstlsStaFb_enum_ovrdflg "CCU_VehInfo_BAC" VALUE 0x0000 /* @ECU_Address@KOPM_PrstlsStaFb_enum_ovrdflg@ */ Scalar_BOOLEAN 0 AppSwcOpm_CM_boolean_flg 0.0 1.0 /end CHARACTERISTIC
/begin CHARACTERISTIC KOPM_PwrRecupIntnsty_enum_ovrdflg "CCU_VehInfo_BAC" VALUE 0x0000 /* @ECU_Address@KOPM_PwrRecupIntnsty_enum_ovrdflg@ */ Scalar_BOOLEAN 0 AppSwcOpm_CM_boolean_flg 0.0 1.0 /end CHARACTERISTIC
/begin CHARACTERISTIC KOPM_TMPSAbnmPrsrWarn_flg_ovrdflg "BCM_B_Package_BAC" VALUE 0x0000 /* @ECU_Address@KOPM_TMPSAbnmPrsrWarn_flg_ovrdflg@ */ Scalar_BOOLEAN 0 AppSwcOpm_CM_boolean_flg 0.0 1.0 /end CHARACTERISTIC
/begin CHARACTERISTIC KOPM_TMPSAbnmPrsrWarn_flg_ovrdval "BCM_B_Package_BAC" VALUE 0x0000 /* @ECU_Address@KOPM_TMPSAbnmPrsrWarn_flg_ovrdval@ */ Scalar_BOOLEAN 0 AppSwcOpm_CM_boolean_flg 0.0 1.0 /end CHARACTERISTIC
/begin CHARACTERISTIC KOPM_TPMSPressureStaFL_enum_ovrdflg "BCM_B_Package_BAC" VALUE 0x0000 /* @ECU_Address@KOPM_TPMSPressureStaFL_enum_ovrdflg@ */ Scalar_BOOLEAN 0 AppSwcOpm_CM_boolean_flg 0.0 1.0 /end CHARACTERISTIC
/begin CHARACTERISTIC KOPM_TPMSPressureStaFR_enum_ovrdflg "BCM_B_Package_BAC" VALUE 0x0000 /* @ECU_Address@KOPM_TPMSPressureStaFR_enum_ovrdflg@ */ Scalar_BOOLEAN 0 AppSwcOpm_CM_boolean_flg 0.0 1.0 /end CHARACTERISTIC
/begin CHARACTERISTIC KOPM_TPMSPressureStaRL_enum_ovrdflg "BCM_B_Package_BAC" VALUE 0x0000 /* @ECU_Address@KOPM_TPMSPressureStaRL_enum_ovrdflg@ */ Scalar_BOOLEAN 0 AppSwcOpm_CM_boolean_flg 0.0 1.0 /end CHARACTERISTIC
/begin CHARACTERISTIC KOPM_TPMSPressureStaRR_enum_ovrdflg "BCM_B_Package_BAC" VALUE 0x0000 /* @ECU_Address@KOPM_TPMSPressureStaRR_enum_ovrdflg@ */ Scalar_BOOLEAN 0 AppSwcOpm_CM_boolean_flg 0.0 1.0 /end CHARACTERISTIC
/begin CHARACTERISTIC KOPM_VehActDrvMod1_enum_ovrdflg "CCU_VehInfo_BAC" VALUE 0x0000 /* @ECU_Address@KOPM_VehActDrvMod1_enum_ovrdflg@ */ Scalar_BOOLEAN 0 AppSwcOpm_CM_boolean_flg 0.0 1.0 /end CHARACTERISTIC
/begin CHARACTERISTIC KOPM_VehActlGearPosVld_flg_ovrdflg "CCU_VehInfo_BAC" VALUE 0x0000 /* @ECU_Address@KOPM_VehActlGearPosVld_flg_ovrdflg@ */ Scalar_BOOLEAN 0 AppSwcOpm_CM_boolean_flg 0.0 1.0 /end CHARACTERISTIC
/begin CHARACTERISTIC KOPM_VehActlGearPosVld_flg_ovrdval "CCU_VehInfo_BAC" VALUE 0x0000 /* @ECU_Address@KOPM_VehActlGearPosVld_flg_ovrdval@ */ Scalar_BOOLEAN 0 AppSwcOpm_CM_boolean_flg 0.0 1.0 /end CHARACTERISTIC
/begin CHARACTERISTIC KOPM_VehActlGearPos_enum_ovrdflg "CCU_VehInfo_BAC" VALUE 0x0000 /* @ECU_Address@KOPM_VehActlGearPos_enum_ovrdflg@ */ Scalar_BOOLEAN 0 AppSwcOpm_CM_boolean_flg 0.0 1.0 /end CHARACTERISTIC
/begin CHARACTERISTIC KOPM_12VBatLowVolStaHi_enum "CCU_VehInfo_BAC" VALUE 0x0000 /* @ECU_Address@KOPM_12VBatLowVolStaHi_enum@ */ Scalar_UBYTE 0 AppSwcOpm_CM_uint8_enum 0.0 255.0 /end CHARACTERISTIC
/begin CHARACTERISTIC KOPM_12VBatLowVolStaLo_enum "CCU_VehInfo_BAC" VALUE 0x0000 /* @ECU_Address@KOPM_12VBatLowVolStaLo_enum@ */ Scalar_UBYTE 0 AppSwcOpm_CM_uint8_enum 0.0 255.0 /end CHARACTERISTIC
/begin CHARACTERISTIC KOPM_12VBatLowVolSta_enum_ovrdval "CCU_VehInfo_BAC" VALUE 0x0000 /* @ECU_Address@KOPM_12VBatLowVolSta_enum_ovrdval@ */ Scalar_UBYTE 0 AppSwcOpm_CM_uint8_enum 0.0 255.0 /end CHARACTERISTIC
/begin CHARACTERISTIC KOPM_BCMAuthentKeyNrHi_enum "BCM_B_Package_BAC" VALUE 0x0000 /* @ECU_Address@KOPM_BCMAuthentKeyNrHi_enum@ */ Scalar_UBYTE 0 AppSwcOpm_CM_uint8_enum 0.0 255.0 /end CHARACTERISTIC
/begin CHARACTERISTIC KOPM_BCMAuthentKeyNrLo_enum "BCM_B_Package_BAC" VALUE 0x0000 /* @ECU_Address@KOPM_BCMAuthentKeyNrLo_enum@ */ Scalar_UBYTE 0 AppSwcOpm_CM_uint8_enum 0.0 255.0 /end CHARACTERISTIC
/begin CHARACTERISTIC KOPM_BCMAuthentKeyNr_enum_ovrdval "BCM_B_Package_BAC" VALUE 0x0000 /* @ECU_Address@KOPM_BCMAuthentKeyNr_enum_ovrdval@ */ Scalar_UBYTE 0 AppSwcOpm_CM_uint8_enum 0.0 255.0 /end CHARACTERISTIC
/begin CHARACTERISTIC KOPM_BCMBackLadjvalFbHi_enum "BCM_B_Package_BAC" VALUE 0x0000 /* @ECU_Address@KOPM_BCMBackLadjvalFbHi_enum@ */ Scalar_UBYTE 0 AppSwcOpm_CM_uint8_enum 0.0 255.0 /end CHARACTERISTIC
/begin CHARACTERISTIC KOPM_BCMBackLadjvalFbLo_enum "BCM_B_Package_BAC" VALUE 0x0000 /* @ECU_Address@KOPM_BCMBackLadjvalFbLo_enum@ */ Scalar_UBYTE 0 AppSwcOpm_CM_uint8_enum 0.0 255.0 /end CHARACTERISTIC
/begin CHARACTERISTIC KOPM_BCMBackLadjvalFb_enum_ovrdval "BCM_B_Package_BAC" VALUE 0x0000 /* @ECU_Address@KOPM_BCMBackLadjvalFb_enum_ovrdval@ */ Scalar_UBYTE 0 AppSwcOpm_CM_uint8_enum 0.0 255.0 /end CHARACTERISTIC
/begin CHARACTERISTIC KOPM_BCMBassHornReqHi_enum "BCM_B_Package_BAC" VALUE 0x0000 /* @ECU_Address@KOPM_BCMBassHornReqHi_enum@ */ Scalar_UBYTE 0 AppSwcOpm_CM_uint8_enum 0.0 255.0 /end CHARACTERISTIC
/begin CHARACTERISTIC KOPM_BCMBassHornReqLo_enum "BCM_B_Package_BAC" VALUE 0x0000 /* @ECU_Address@KOPM_BCMBassHornReqLo_enum@ */ Scalar_UBYTE 0 AppSwcOpm_CM_uint8_enum 0.0 255.0 /end CHARACTERISTIC
/begin CHARACTERISTIC KOPM_BCMBassHornReq_enum_ovrdval "BCM_B_Package_BAC" VALUE 0x0000 /* @ECU_Address@KOPM_BCMBassHornReq_enum_ovrdval@ */ Scalar_UBYTE 0 AppSwcOpm_CM_uint8_enum 0.0 255.0 /end CHARACTERISTIC
/begin CHARACTERISTIC KOPM_BCMBodyWarnStsHi_enum "BCM_B_Package_BAC" VALUE 0x0000 /* @ECU_Address@KOPM_BCMBodyWarnStsHi_enum@ */ Scalar_UBYTE 0 AppSwcOpm_CM_uint8_enum 0.0 255.0 /end CHARACTERISTIC
/begin CHARACTERISTIC KOPM_BCMBodyWarnStsLo_enum "BCM_B_Package_BAC" VALUE 0x0000 /* @ECU_Address@KOPM_BCMBodyWarnStsLo_enum@ */ Scalar_UBYTE 0 AppSwcOpm_CM_uint8_enum 0.0 255.0 /end CHARACTERISTIC
/begin CHARACTERISTIC KOPM_BCMBodyWarnSts_enum_ovrdval "BCM_B_Package_BAC" VALUE 0x0000 /* @ECU_Address@KOPM_BCMBodyWarnSts_enum_ovrdval@ */ Scalar_UBYTE 0 AppSwcOpm_CM_uint8_enum 0.0 255.0 /end CHARACTERISTIC
/begin CHARACTERISTIC KOPM_BCMCenLckStsHi_enum "CCU_VehInfo_BAC" VALUE 0x0000 /* @ECU_Address@KOPM_BCMCenLckStsHi_enum@ */ Scalar_UBYTE 0 AppSwcOpm_CM_uint8_enum 0.0 255.0 /end CHARACTERISTIC
/begin CHARACTERISTIC KOPM_BCMCenLckStsLo_enum "CCU_VehInfo_BAC" VALUE 0x0000 /* @ECU_Address@KOPM_BCMCenLckStsLo_enum@ */ Scalar_UBYTE 0 AppSwcOpm_CM_uint8_enum 0.0 255.0 /end CHARACTERISTIC
/begin CHARACTERISTIC KOPM_BCMCenLckSts_enum_ovrdval "CCU_VehInfo_BAC" VALUE 0x0000 /* @ECU_Address@KOPM_BCMCenLckSts_enum_ovrdval@ */ Scalar_UBYTE 0 AppSwcOpm_CM_uint8_enum 0.0 255.0 /end CHARACTERISTIC
/begin CHARACTERISTIC KOPM_BCMCenLckSwCtrlFbHi_enum "CCU_VehInfo_BAC" VALUE 0x0000 /* @ECU_Address@KOPM_BCMCenLckSwCtrlFbHi_enum@ */ Scalar_UBYTE 0 AppSwcOpm_CM_uint8_enum 0.0 255.0 /end CHARACTERISTIC
/begin CHARACTERISTIC KOPM_BCMCenLckSwCtrlFbLo_enum "CCU_VehInfo_BAC" VALUE 0x0000 /* @ECU_Address@KOPM_BCMCenLckSwCtrlFbLo_enum@ */ Scalar_UBYTE 0 AppSwcOpm_CM_uint8_enum 0.0 255.0 /end CHARACTERISTIC
/begin CHARACTERISTIC KOPM_BCMCenLckSwCtrlFb_enum_ovrdval "CCU_VehInfo_BAC" VALUE 0x0000 /* @ECU_Address@KOPM_BCMCenLckSwCtrlFb_enum_ovrdval@ */ Scalar_UBYTE 0 AppSwcOpm_CM_uint8_enum 0.0 255.0 /end CHARACTERISTIC
/begin CHARACTERISTIC KOPM_BCMChgWiprMtMdSwSetFbHi_enum "BCM_B_Package_BAC" VALUE 0x0000 /* @ECU_Address@KOPM_BCMChgWiprMtMdSwSetFbHi_enum@ */ Scalar_UBYTE 0 AppSwcOpm_CM_uint8_enum 0.0 255.0 /end CHARACTERISTIC
/begin CHARACTERISTIC KOPM_BCMChgWiprMtMdSwSetFbLo_enum "BCM_B_Package_BAC" VALUE 0x0000 /* @ECU_Address@KOPM_BCMChgWiprMtMdSwSetFbLo_enum@ */ Scalar_UBYTE 0 AppSwcOpm_CM_uint8_enum 0.0 255.0 /end CHARACTERISTIC
/begin CHARACTERISTIC KOPM_BCMChgWiprMtMdSwSetFb_enum_ovrdval "BCM_B_Package_BAC" VALUE 0x0000 /* @ECU_Address@KOPM_BCMChgWiprMtMdSwSetFb_enum_ovrdval@ */ Scalar_UBYTE 0 AppSwcOpm_CM_uint8_enum 0.0 255.0 /end CHARACTERISTIC
/begin CHARACTERISTIC KOPM_BCMChrgLidLockReqHi_enum "BCM_B_Package_BAC" VALUE 0x0000 /* @ECU_Address@KOPM_BCMChrgLidLockReqHi_enum@ */ Scalar_UBYTE 0 AppSwcOpm_CM_uint8_enum 0.0 255.0 /end CHARACTERISTIC
/begin CHARACTERISTIC KOPM_BCMChrgLidLockReqLo_enum "BCM_B_Package_BAC" VALUE 0x0000 /* @ECU_Address@KOPM_BCMChrgLidLockReqLo_enum@ */ Scalar_UBYTE 0 AppSwcOpm_CM_uint8_enum 0.0 255.0 /end CHARACTERISTIC
/begin CHARACTERISTIC KOPM_BCMChrgLidLockReq_enum_ovrdval "BCM_B_Package_BAC" VALUE 0x0000 /* @ECU_Address@KOPM_BCMChrgLidLockReq_enum_ovrdval@ */ Scalar_UBYTE 0 AppSwcOpm_CM_uint8_enum 0.0 255.0 /end CHARACTERISTIC
/begin CHARACTERISTIC KOPM_BCMDrvPEAuthentAcsdHi_enum "BCM_B_Package_BAC" VALUE 0x0000 /* @ECU_Address@KOPM_BCMDrvPEAuthentAcsdHi_enum@ */ Scalar_UBYTE 0 AppSwcOpm_CM_uint8_enum 0.0 255.0 /end CHARACTERISTIC
/begin CHARACTERISTIC KOPM_BCMDrvPEAuthentAcsdLo_enum "BCM_B_Package_BAC" VALUE 0x0000 /* @ECU_Address@KOPM_BCMDrvPEAuthentAcsdLo_enum@ */ Scalar_UBYTE 0 AppSwcOpm_CM_uint8_enum 0.0 255.0 /end CHARACTERISTIC
/begin CHARACTERISTIC KOPM_BCMDrvPEAuthentAcsd_enum_ovrdval "BCM_B_Package_BAC" VALUE 0x0000 /* @ECU_Address@KOPM_BCMDrvPEAuthentAcsd_enum_ovrdval@ */ Scalar_UBYTE 0 AppSwcOpm_CM_uint8_enum 0.0 255.0 /end CHARACTERISTIC
/begin CHARACTERISTIC KOPM_BCMDrvSeatOccptSnsrStsHi_enum "BCM_B_Package_BAC" VALUE 0x0000 /* @ECU_Address@KOPM_BCMDrvSeatOccptSnsrStsHi_enum@ */ Scalar_UBYTE 0 AppSwcOpm_CM_uint8_enum 0.0 255.0 /end CHARACTERISTIC
/begin CHARACTERISTIC KOPM_BCMDrvSeatOccptSnsrStsLo_enum "BCM_B_Package_BAC" VALUE 0x0000 /* @ECU_Address@KOPM_BCMDrvSeatOccptSnsrStsLo_enum@ */ Scalar_UBYTE 0 AppSwcOpm_CM_uint8_enum 0.0 255.0 /end CHARACTERISTIC
/begin CHARACTERISTIC KOPM_BCMDrvSeatOccptSnsrSts_enum_ovrdval "BCM_B_Package_BAC" VALUE 0x0000 /* @ECU_Address@KOPM_BCMDrvSeatOccptSnsrSts_enum_ovrdval@ */ Scalar_UBYTE 0 AppSwcOpm_CM_uint8_enum 0.0 255.0 /end CHARACTERISTIC
/begin CHARACTERISTIC KOPM_BCMDrvrWinSwSigHi_enum "BCM_B_Package_BAC" VALUE 0x0000 /* @ECU_Address@KOPM_BCMDrvrWinSwSigHi_enum@ */ Scalar_UBYTE 0 AppSwcOpm_CM_uint8_enum 0.0 255.0 /end CHARACTERISTIC
/begin CHARACTERISTIC KOPM_BCMDrvrWinSwSigLo_enum "BCM_B_Package_BAC" VALUE 0x0000 /* @ECU_Address@KOPM_BCMDrvrWinSwSigLo_enum@ */ Scalar_UBYTE 0 AppSwcOpm_CM_uint8_enum 0.0 255.0 /end CHARACTERISTIC
/begin CHARACTERISTIC KOPM_BCMDrvrWinSwSig_enum_ovrdval "BCM_B_Package_BAC" VALUE 0x0000 /* @ECU_Address@KOPM_BCMDrvrWinSwSig_enum_ovrdval@ */ Scalar_UBYTE 0 AppSwcOpm_CM_uint8_enum 0.0 255.0 /end CHARACTERISTIC
/begin CHARACTERISTIC KOPM_BCMFLWinmotorStsHi_enum "BCM_B_Package_BAC" VALUE 0x0000 /* @ECU_Address@KOPM_BCMFLWinmotorStsHi_enum@ */ Scalar_UBYTE 0 AppSwcOpm_CM_uint8_enum 0.0 255.0 /end CHARACTERISTIC
/begin CHARACTERISTIC KOPM_BCMFLWinmotorStsLo_enum "BCM_B_Package_BAC" VALUE 0x0000 /* @ECU_Address@KOPM_BCMFLWinmotorStsLo_enum@ */ Scalar_UBYTE 0 AppSwcOpm_CM_uint8_enum 0.0 255.0 /end CHARACTERISTIC
/begin CHARACTERISTIC KOPM_BCMFLWinmotorSts_enum_ovrdval "BCM_B_Package_BAC" VALUE 0x0000 /* @ECU_Address@KOPM_BCMFLWinmotorSts_enum_ovrdval@ */ Scalar_UBYTE 0 AppSwcOpm_CM_uint8_enum 0.0 255.0 /end CHARACTERISTIC
/begin CHARACTERISTIC KOPM_BCMFRPEAuthentAcsdHi_enum "BCM_B_Package_BAC" VALUE 0x0000 /* @ECU_Address@KOPM_BCMFRPEAuthentAcsdHi_enum@ */ Scalar_UBYTE 0 AppSwcOpm_CM_uint8_enum 0.0 255.0 /end CHARACTERISTIC
/begin CHARACTERISTIC KOPM_BCMFRPEAuthentAcsdLo_enum "BCM_B_Package_BAC" VALUE 0x0000 /* @ECU_Address@KOPM_BCMFRPEAuthentAcsdLo_enum@ */ Scalar_UBYTE 0 AppSwcOpm_CM_uint8_enum 0.0 255.0 /end CHARACTERISTIC
/begin CHARACTERISTIC KOPM_BCMFRPEAuthentAcsd_enum_ovrdval "BCM_B_Package_BAC" VALUE 0x0000 /* @ECU_Address@KOPM_BCMFRPEAuthentAcsd_enum_ovrdval@ */ Scalar_UBYTE 0 AppSwcOpm_CM_uint8_enum 0.0 255.0 /end CHARACTERISTIC
/begin CHARACTERISTIC KOPM_BCMFRWinmotorStsHi_enum "BCM_B_Package_BAC" VALUE 0x0000 /* @ECU_Address@KOPM_BCMFRWinmotorStsHi_enum@ */ Scalar_UBYTE 0 AppSwcOpm_CM_uint8_enum 0.0 255.0 /end CHARACTERISTIC
/begin CHARACTERISTIC KOPM_BCMFRWinmotorStsLo_enum "BCM_B_Package_BAC" VALUE 0x0000 /* @ECU_Address@KOPM_BCMFRWinmotorStsLo_enum@ */ Scalar_UBYTE 0 AppSwcOpm_CM_uint8_enum 0.0 255.0 /end CHARACTERISTIC
/begin CHARACTERISTIC KOPM_BCMFRWinmotorSts_enum_ovrdval "BCM_B_Package_BAC" VALUE 0x0000 /* @ECU_Address@KOPM_BCMFRWinmotorSts_enum_ovrdval@ */ Scalar_UBYTE 0 AppSwcOpm_CM_uint8_enum 0.0 255.0 /end CHARACTERISTIC
/begin CHARACTERISTIC KOPM_BCMFlwrMeHmCtrlFbHi_enum "BCM_B_Package_BAC" VALUE 0x0000 /* @ECU_Address@KOPM_BCMFlwrMeHmCtrlFbHi_enum@ */ Scalar_UBYTE 0 AppSwcOpm_CM_uint8_enum 0.0 255.0 /end CHARACTERISTIC
/begin CHARACTERISTIC KOPM_BCMFlwrMeHmCtrlFbLo_enum "BCM_B_Package_BAC" VALUE 0x0000 /* @ECU_Address@KOPM_BCMFlwrMeHmCtrlFbLo_enum@ */ Scalar_UBYTE 0 AppSwcOpm_CM_uint8_enum 0.0 255.0 /end CHARACTERISTIC
/begin CHARACTERISTIC KOPM_BCMFlwrMeHmCtrlFb_enum_ovrdval "BCM_B_Package_BAC" VALUE 0x0000 /* @ECU_Address@KOPM_BCMFlwrMeHmCtrlFb_enum_ovrdval@ */ Scalar_UBYTE 0 AppSwcOpm_CM_uint8_enum 0.0 255.0 /end CHARACTERISTIC
/begin CHARACTERISTIC KOPM_BCMFrbdnKeyNrHi_enum "BCM_B_Package_BAC" VALUE 0x0000 /* @ECU_Address@KOPM_BCMFrbdnKeyNrHi_enum@ */ Scalar_UBYTE 0 AppSwcOpm_CM_uint8_enum 0.0 255.0 /end CHARACTERISTIC
/begin CHARACTERISTIC KOPM_BCMFrbdnKeyNrLo_enum "BCM_B_Package_BAC" VALUE 0x0000 /* @ECU_Address@KOPM_BCMFrbdnKeyNrLo_enum@ */ Scalar_UBYTE 0 AppSwcOpm_CM_uint8_enum 0.0 255.0 /end CHARACTERISTIC
/begin CHARACTERISTIC KOPM_BCMFrbdnKeyNr_enum_ovrdval "BCM_B_Package_BAC" VALUE 0x0000 /* @ECU_Address@KOPM_BCMFrbdnKeyNr_enum_ovrdval@ */ Scalar_UBYTE 0 AppSwcOpm_CM_uint8_enum 0.0 255.0 /end CHARACTERISTIC
/begin CHARACTERISTIC KOPM_BCMFrntLeDoorHndlSwtHi_enum "BCM_B_Package_BAC" VALUE 0x0000 /* @ECU_Address@KOPM_BCMFrntLeDoorHndlSwtHi_enum@ */ Scalar_UBYTE 0 AppSwcOpm_CM_uint8_enum 0.0 255.0 /end CHARACTERISTIC
/begin CHARACTERISTIC KOPM_BCMFrntLeDoorHndlSwtLo_enum "BCM_B_Package_BAC" VALUE 0x0000 /* @ECU_Address@KOPM_BCMFrntLeDoorHndlSwtLo_enum@ */ Scalar_UBYTE 0 AppSwcOpm_CM_uint8_enum 0.0 255.0 /end CHARACTERISTIC
/begin CHARACTERISTIC KOPM_BCMFrntLeDoorHndlSwt_enum_ovrdval "BCM_B_Package_BAC" VALUE 0x0000 /* @ECU_Address@KOPM_BCMFrntLeDoorHndlSwt_enum_ovrdval@ */ Scalar_UBYTE 0 AppSwcOpm_CM_uint8_enum 0.0 255.0 /end CHARACTERISTIC
/begin CHARACTERISTIC KOPM_BCMFrntRiDoorHndlSwtHi_enum "BCM_B_Package_BAC" VALUE 0x0000 /* @ECU_Address@KOPM_BCMFrntRiDoorHndlSwtHi_enum@ */ Scalar_UBYTE 0 AppSwcOpm_CM_uint8_enum 0.0 255.0 /end CHARACTERISTIC
/begin CHARACTERISTIC KOPM_BCMFrntRiDoorHndlSwtLo_enum "BCM_B_Package_BAC" VALUE 0x0000 /* @ECU_Address@KOPM_BCMFrntRiDoorHndlSwtLo_enum@ */ Scalar_UBYTE 0 AppSwcOpm_CM_uint8_enum 0.0 255.0 /end CHARACTERISTIC
/begin CHARACTERISTIC KOPM_BCMFrntRiDoorHndlSwt_enum_ovrdval "BCM_B_Package_BAC" VALUE 0x0000 /* @ECU_Address@KOPM_BCMFrntRiDoorHndlSwt_enum_ovrdval@ */ Scalar_UBYTE 0 AppSwcOpm_CM_uint8_enum 0.0 255.0 /end CHARACTERISTIC
/begin CHARACTERISTIC KOPM_BCMFrntWiprMotStsHi_enum "BCM_B_Package_BAC" VALUE 0x0000 /* @ECU_Address@KOPM_BCMFrntWiprMotStsHi_enum@ */ Scalar_UBYTE 0 AppSwcOpm_CM_uint8_enum 0.0 255.0 /end CHARACTERISTIC
/begin CHARACTERISTIC KOPM_BCMFrntWiprMotStsLo_enum "BCM_B_Package_BAC" VALUE 0x0000 /* @ECU_Address@KOPM_BCMFrntWiprMotStsLo_enum@ */ Scalar_UBYTE 0 AppSwcOpm_CM_uint8_enum 0.0 255.0 /end CHARACTERISTIC
/begin CHARACTERISTIC KOPM_BCMFrntWiprMotSts_enum_ovrdval "BCM_B_Package_BAC" VALUE 0x0000 /* @ECU_Address@KOPM_BCMFrntWiprMotSts_enum_ovrdval@ */ Scalar_UBYTE 0 AppSwcOpm_CM_uint8_enum 0.0 255.0 /end CHARACTERISTIC
/begin CHARACTERISTIC KOPM_BCMHiBeamSwSigHi_enum "BCM_B_Package_BAC" VALUE 0x0000 /* @ECU_Address@KOPM_BCMHiBeamSwSigHi_enum@ */ Scalar_UBYTE 0 AppSwcOpm_CM_uint8_enum 0.0 255.0 /end CHARACTERISTIC
/begin CHARACTERISTIC KOPM_BCMHiBeamSwSigLo_enum "BCM_B_Package_BAC" VALUE 0x0000 /* @ECU_Address@KOPM_BCMHiBeamSwSigLo_enum@ */ Scalar_UBYTE 0 AppSwcOpm_CM_uint8_enum 0.0 255.0 /end CHARACTERISTIC
/begin CHARACTERISTIC KOPM_BCMHiBeamSwSig_enum_ovrdval "BCM_B_Package_BAC" VALUE 0x0000 /* @ECU_Address@KOPM_BCMHiBeamSwSig_enum_ovrdval@ */ Scalar_UBYTE 0 AppSwcOpm_CM_uint8_enum 0.0 255.0 /end CHARACTERISTIC
/begin CHARACTERISTIC KOPM_BCMIllmndLockReqHi_enum "BCM_B_Package_BAC" VALUE 0x0000 /* @ECU_Address@KOPM_BCMIllmndLockReqHi_enum@ */ Scalar_UBYTE 0 AppSwcOpm_CM_uint8_enum 0.0 255.0 /end CHARACTERISTIC
/begin CHARACTERISTIC KOPM_BCMIllmndLockReqLo_enum "BCM_B_Package_BAC" VALUE 0x0000 /* @ECU_Address@KOPM_BCMIllmndLockReqLo_enum@ */ Scalar_UBYTE 0 AppSwcOpm_CM_uint8_enum 0.0 255.0 /end CHARACTERISTIC
/begin CHARACTERISTIC KOPM_BCMIllmndLockReq_enum_ovrdval "BCM_B_Package_BAC" VALUE 0x0000 /* @ECU_Address@KOPM_BCMIllmndLockReq_enum_ovrdval@ */ Scalar_UBYTE 0 AppSwcOpm_CM_uint8_enum 0.0 255.0 /end CHARACTERISTIC
/begin CHARACTERISTIC KOPM_BCMIllmndStsHi_enum "BCM_B_Package_BAC" VALUE 0x0000 /* @ECU_Address@KOPM_BCMIllmndStsHi_enum@ */ Scalar_UBYTE 0 AppSwcOpm_CM_uint8_enum 0.0 255.0 /end CHARACTERISTIC
/begin CHARACTERISTIC KOPM_BCMIllmndStsLo_enum "BCM_B_Package_BAC" VALUE 0x0000 /* @ECU_Address@KOPM_BCMIllmndStsLo_enum@ */ Scalar_UBYTE 0 AppSwcOpm_CM_uint8_enum 0.0 255.0 /end CHARACTERISTIC
/begin CHARACTERISTIC KOPM_BCMIllmndSts_enum_ovrdval "BCM_B_Package_BAC" VALUE 0x0000 /* @ECU_Address@KOPM_BCMIllmndSts_enum_ovrdval@ */ Scalar_UBYTE 0 AppSwcOpm_CM_uint8_enum 0.0 255.0 /end CHARACTERISTIC
/begin CHARACTERISTIC KOPM_BCMKeyIDFbHi_enum "BCM_B_Package_BAC" VALUE 0x0000 /* @ECU_Address@KOPM_BCMKeyIDFbHi_enum@ */ Scalar_UBYTE 0 AppSwcOpm_CM_uint8_enum 0.0 255.0 /end CHARACTERISTIC
/begin CHARACTERISTIC KOPM_BCMKeyIDFbLo_enum "BCM_B_Package_BAC" VALUE 0x0000 /* @ECU_Address@KOPM_BCMKeyIDFbLo_enum@ */ Scalar_UBYTE 0 AppSwcOpm_CM_uint8_enum 0.0 255.0 /end CHARACTERISTIC
/begin CHARACTERISTIC KOPM_BCMKeyIDFb_enum_ovrdval "BCM_B_Package_BAC" VALUE 0x0000 /* @ECU_Address@KOPM_BCMKeyIDFb_enum_ovrdval@ */ Scalar_UBYTE 0 AppSwcOpm_CM_uint8_enum 0.0 255.0 /end CHARACTERISTIC
/begin CHARACTERISTIC KOPM_BCMKeyStaHi_enum "BCM_B_Package_BAC" VALUE 0x0000 /* @ECU_Address@KOPM_BCMKeyStaHi_enum@ */ Scalar_UBYTE 0 AppSwcOpm_CM_uint8_enum 0.0 255.0 /end CHARACTERISTIC
/begin CHARACTERISTIC KOPM_BCMKeyStaLo_enum "BCM_B_Package_BAC" VALUE 0x0000 /* @ECU_Address@KOPM_BCMKeyStaLo_enum@ */ Scalar_UBYTE 0 AppSwcOpm_CM_uint8_enum 0.0 255.0 /end CHARACTERISTIC
/begin CHARACTERISTIC KOPM_BCMKeySta_enum_ovrdval "BCM_B_Package_BAC" VALUE 0x0000 /* @ECU_Address@KOPM_BCMKeySta_enum_ovrdval@ */ Scalar_UBYTE 0 AppSwcOpm_CM_uint8_enum 0.0 255.0 /end CHARACTERISTIC
/begin CHARACTERISTIC KOPM_BCMLeTrnLiFltFbHi_enum "BCM_B_Package_BAC" VALUE 0x0000 /* @ECU_Address@KOPM_BCMLeTrnLiFltFbHi_enum@ */ Scalar_UBYTE 0 AppSwcOpm_CM_uint8_enum 0.0 255.0 /end CHARACTERISTIC
/begin CHARACTERISTIC KOPM_BCMLeTrnLiFltFbLo_enum "BCM_B_Package_BAC" VALUE 0x0000 /* @ECU_Address@KOPM_BCMLeTrnLiFltFbLo_enum@ */ Scalar_UBYTE 0 AppSwcOpm_CM_uint8_enum 0.0 255.0 /end CHARACTERISTIC
/begin CHARACTERISTIC KOPM_BCMLeTrnLiFltFb_enum_ovrdval "BCM_B_Package_BAC" VALUE 0x0000 /* @ECU_Address@KOPM_BCMLeTrnLiFltFb_enum_ovrdval@ */ Scalar_UBYTE 0 AppSwcOpm_CM_uint8_enum 0.0 255.0 /end CHARACTERISTIC
/begin CHARACTERISTIC KOPM_BCMLghtSwSigHi_enum "BCM_B_Package_BAC" VALUE 0x0000 /* @ECU_Address@KOPM_BCMLghtSwSigHi_enum@ */ Scalar_UBYTE 0 AppSwcOpm_CM_uint8_enum 0.0 255.0 /end CHARACTERISTIC
/begin CHARACTERISTIC KOPM_BCMLghtSwSigLo_enum "BCM_B_Package_BAC" VALUE 0x0000 /* @ECU_Address@KOPM_BCMLghtSwSigLo_enum@ */ Scalar_UBYTE 0 AppSwcOpm_CM_uint8_enum 0.0 255.0 /end CHARACTERISTIC
/begin CHARACTERISTIC KOPM_BCMLghtSwSig_enum_ovrdval "BCM_B_Package_BAC" VALUE 0x0000 /* @ECU_Address@KOPM_BCMLghtSwSig_enum_ovrdval@ */ Scalar_UBYTE 0 AppSwcOpm_CM_uint8_enum 0.0 255.0 /end CHARACTERISTIC
/begin CHARACTERISTIC KOPM_BCMLightIntensityHi_enum "BCM_B_Package_BAC" VALUE 0x0000 /* @ECU_Address@KOPM_BCMLightIntensityHi_enum@ */ Scalar_UBYTE 0 AppSwcOpm_CM_uint8_enum 0.0 255.0 /end CHARACTERISTIC
/begin CHARACTERISTIC KOPM_BCMLightIntensityLo_enum "BCM_B_Package_BAC" VALUE 0x0000 /* @ECU_Address@KOPM_BCMLightIntensityLo_enum@ */ Scalar_UBYTE 0 AppSwcOpm_CM_uint8_enum 0.0 255.0 /end CHARACTERISTIC
/begin CHARACTERISTIC KOPM_BCMLightIntensity_enum_ovrdval "BCM_B_Package_BAC" VALUE 0x0000 /* @ECU_Address@KOPM_BCMLightIntensity_enum_ovrdval@ */ Scalar_UBYTE 0 AppSwcOpm_CM_uint8_enum 0.0 255.0 /end CHARACTERISTIC
/begin CHARACTERISTIC KOPM_BCMLogoActvFlgHi_enum "BCM_B_Package_BAC" VALUE 0x0000 /* @ECU_Address@KOPM_BCMLogoActvFlgHi_enum@ */ Scalar_UBYTE 0 AppSwcOpm_CM_uint8_enum 0.0 255.0 /end CHARACTERISTIC
/begin CHARACTERISTIC KOPM_BCMLogoActvFlgLo_enum "BCM_B_Package_BAC" VALUE 0x0000 /* @ECU_Address@KOPM_BCMLogoActvFlgLo_enum@ */ Scalar_UBYTE 0 AppSwcOpm_CM_uint8_enum 0.0 255.0 /end CHARACTERISTIC
/begin CHARACTERISTIC KOPM_BCMLogoActvFlg_enum_ovrdval "BCM_B_Package_BAC" VALUE 0x0000 /* @ECU_Address@KOPM_BCMLogoActvFlg_enum_ovrdval@ */ Scalar_UBYTE 0 AppSwcOpm_CM_uint8_enum 0.0 255.0 /end CHARACTERISTIC
/begin CHARACTERISTIC KOPM_BCMMaiDrvrSeatStsHi_enum "BCM_B_Package_BAC" VALUE 0x0000 /* @ECU_Address@KOPM_BCMMaiDrvrSeatStsHi_enum@ */ Scalar_UBYTE 0 AppSwcOpm_CM_uint8_enum 0.0 255.0 /end CHARACTERISTIC
/begin CHARACTERISTIC KOPM_BCMMaiDrvrSeatStsLo_enum "BCM_B_Package_BAC" VALUE 0x0000 /* @ECU_Address@KOPM_BCMMaiDrvrSeatStsLo_enum@ */ Scalar_UBYTE 0 AppSwcOpm_CM_uint8_enum 0.0 255.0 /end CHARACTERISTIC
/begin CHARACTERISTIC KOPM_BCMMaiDrvrSeatSts_enum_ovrdval "BCM_B_Package_BAC" VALUE 0x0000 /* @ECU_Address@KOPM_BCMMaiDrvrSeatSts_enum_ovrdval@ */ Scalar_UBYTE 0 AppSwcOpm_CM_uint8_enum 0.0 255.0 /end CHARACTERISTIC
/begin CHARACTERISTIC KOPM_BCMPSAuthentResHi_enum "BCM_B_Package_BAC" VALUE 0x0000 /* @ECU_Address@KOPM_BCMPSAuthentResHi_enum@ */ Scalar_UBYTE 0 AppSwcOpm_CM_uint8_enum 0.0 255.0 /end CHARACTERISTIC
/begin CHARACTERISTIC KOPM_BCMPSAuthentResLo_enum "BCM_B_Package_BAC" VALUE 0x0000 /* @ECU_Address@KOPM_BCMPSAuthentResLo_enum@ */ Scalar_UBYTE 0 AppSwcOpm_CM_uint8_enum 0.0 255.0 /end CHARACTERISTIC
/begin CHARACTERISTIC KOPM_BCMPSAuthentRes_enum_ovrdval "BCM_B_Package_BAC" VALUE 0x0000 /* @ECU_Address@KOPM_BCMPSAuthentRes_enum_ovrdval@ */ Scalar_UBYTE 0 AppSwcOpm_CM_uint8_enum 0.0 255.0 /end CHARACTERISTIC
/begin CHARACTERISTIC KOPM_BCMPassWinSwSigHi_enum "BCM_B_Package_BAC" VALUE 0x0000 /* @ECU_Address@KOPM_BCMPassWinSwSigHi_enum@ */ Scalar_UBYTE 0 AppSwcOpm_CM_uint8_enum 0.0 255.0 /end CHARACTERISTIC
/begin CHARACTERISTIC KOPM_BCMPassWinSwSigLo_enum "BCM_B_Package_BAC" VALUE 0x0000 /* @ECU_Address@KOPM_BCMPassWinSwSigLo_enum@ */ Scalar_UBYTE 0 AppSwcOpm_CM_uint8_enum 0.0 255.0 /end CHARACTERISTIC
/begin CHARACTERISTIC KOPM_BCMPassWinSwSig_enum_ovrdval "BCM_B_Package_BAC" VALUE 0x0000 /* @ECU_Address@KOPM_BCMPassWinSwSig_enum_ovrdval@ */ Scalar_UBYTE 0 AppSwcOpm_CM_uint8_enum 0.0 255.0 /end CHARACTERISTIC
/begin CHARACTERISTIC KOPM_BCMRKEReqHi_enum "BCM_B_Package_BAC" VALUE 0x0000 /* @ECU_Address@KOPM_BCMRKEReqHi_enum@ */ Scalar_UBYTE 0 AppSwcOpm_CM_uint8_enum 0.0 255.0 /end CHARACTERISTIC
/begin CHARACTERISTIC KOPM_BCMRKEReqLo_enum "BCM_B_Package_BAC" VALUE 0x0000 /* @ECU_Address@KOPM_BCMRKEReqLo_enum@ */ Scalar_UBYTE 0 AppSwcOpm_CM_uint8_enum 0.0 255.0 /end CHARACTERISTIC
/begin CHARACTERISTIC KOPM_BCMRKEReq_enum_ovrdval "BCM_B_Package_BAC" VALUE 0x0000 /* @ECU_Address@KOPM_BCMRKEReq_enum_ovrdval@ */ Scalar_UBYTE 0 AppSwcOpm_CM_uint8_enum 0.0 255.0 /end CHARACTERISTIC
/begin CHARACTERISTIC KOPM_BCMRiTrnLiFltFbHi_enum "BCM_B_Package_BAC" VALUE 0x0000 /* @ECU_Address@KOPM_BCMRiTrnLiFltFbHi_enum@ */ Scalar_UBYTE 0 AppSwcOpm_CM_uint8_enum 0.0 255.0 /end CHARACTERISTIC
/begin CHARACTERISTIC KOPM_BCMRiTrnLiFltFbLo_enum "BCM_B_Package_BAC" VALUE 0x0000 /* @ECU_Address@KOPM_BCMRiTrnLiFltFbLo_enum@ */ Scalar_UBYTE 0 AppSwcOpm_CM_uint8_enum 0.0 255.0 /end CHARACTERISTIC
/begin CHARACTERISTIC KOPM_BCMRiTrnLiFltFb_enum_ovrdval "BCM_B_Package_BAC" VALUE 0x0000 /* @ECU_Address@KOPM_BCMRiTrnLiFltFb_enum_ovrdval@ */ Scalar_UBYTE 0 AppSwcOpm_CM_uint8_enum 0.0 255.0 /end CHARACTERISTIC
/begin CHARACTERISTIC KOPM_BCMStartReqHi_enum "BCM_B_Package_BAC" VALUE 0x0000 /* @ECU_Address@KOPM_BCMStartReqHi_enum@ */ Scalar_UBYTE 0 AppSwcOpm_CM_uint8_enum 0.0 255.0 /end CHARACTERISTIC
/begin CHARACTERISTIC KOPM_BCMStartReqLo_enum "BCM_B_Package_BAC" VALUE 0x0000 /* @ECU_Address@KOPM_BCMStartReqLo_enum@ */ Scalar_UBYTE 0 AppSwcOpm_CM_uint8_enum 0.0 255.0 /end CHARACTERISTIC
/begin CHARACTERISTIC KOPM_BCMStartReq_enum_ovrdval "BCM_B_Package_BAC" VALUE 0x0000 /* @ECU_Address@KOPM_BCMStartReq_enum_ovrdval@ */ Scalar_UBYTE 0 AppSwcOpm_CM_uint8_enum 0.0 255.0 /end CHARACTERISTIC
/begin CHARACTERISTIC KOPM_BCMSysPowerStsHi_enum "CCU_VehInfo_BAC" VALUE 0x0000 /* @ECU_Address@KOPM_BCMSysPowerStsHi_enum@ */ Scalar_UBYTE 0 AppSwcOpm_CM_uint8_enum 0.0 255.0 /end CHARACTERISTIC
/begin CHARACTERISTIC KOPM_BCMSysPowerStsLo_enum "CCU_VehInfo_BAC" VALUE 0x0000 /* @ECU_Address@KOPM_BCMSysPowerStsLo_enum@ */ Scalar_UBYTE 0 AppSwcOpm_CM_uint8_enum 0.0 255.0 /end CHARACTERISTIC
/begin CHARACTERISTIC KOPM_BCMSysPowerSts_enum_ovrdval "CCU_VehInfo_BAC" VALUE 0x0000 /* @ECU_Address@KOPM_BCMSysPowerSts_enum_ovrdval@ */ Scalar_UBYTE 0 AppSwcOpm_CM_uint8_enum 0.0 255.0 /end CHARACTERISTIC
/begin CHARACTERISTIC KOPM_BCMSysPwrModeHi_enum "CCU_VehInfo_BAC" VALUE 0x0000 /* @ECU_Address@KOPM_BCMSysPwrModeHi_enum@ */ Scalar_UBYTE 0 AppSwcOpm_CM_uint8_enum 0.0 255.0 /end CHARACTERISTIC
/begin CHARACTERISTIC KOPM_BCMSysPwrModeLo_enum "CCU_VehInfo_BAC" VALUE 0x0000 /* @ECU_Address@KOPM_BCMSysPwrModeLo_enum@ */ Scalar_UBYTE 0 AppSwcOpm_CM_uint8_enum 0.0 255.0 /end CHARACTERISTIC
/begin CHARACTERISTIC KOPM_BCMSysPwrMode_enum_ovrdval "CCU_VehInfo_BAC" VALUE 0x0000 /* @ECU_Address@KOPM_BCMSysPwrMode_enum_ovrdval@ */ Scalar_UBYTE 0 AppSwcOpm_CM_uint8_enum 0.0 255.0 /end CHARACTERISTIC
/begin CHARACTERISTIC KOPM_BCMTPMSRstStsHi_enum "BCM_B_Package_BAC" VALUE 0x0000 /* @ECU_Address@KOPM_BCMTPMSRstStsHi_enum@ */ Scalar_UBYTE 0 AppSwcOpm_CM_uint8_enum 0.0 255.0 /end CHARACTERISTIC
/begin CHARACTERISTIC KOPM_BCMTPMSRstStsLo_enum "BCM_B_Package_BAC" VALUE 0x0000 /* @ECU_Address@KOPM_BCMTPMSRstStsLo_enum@ */ Scalar_UBYTE 0 AppSwcOpm_CM_uint8_enum 0.0 255.0 /end CHARACTERISTIC
/begin CHARACTERISTIC KOPM_BCMTPMSRstSts_enum_ovrdval "BCM_B_Package_BAC" VALUE 0x0000 /* @ECU_Address@KOPM_BCMTPMSRstSts_enum_ovrdval@ */ Scalar_UBYTE 0 AppSwcOpm_CM_uint8_enum 0.0 255.0 /end CHARACTERISTIC
/begin CHARACTERISTIC KOPM_BCMTrnngLiSwSigHi_enum "BCM_B_Package_BAC" VALUE 0x0000 /* @ECU_Address@KOPM_BCMTrnngLiSwSigHi_enum@ */ Scalar_UBYTE 0 AppSwcOpm_CM_uint8_enum 0.0 255.0 /end CHARACTERISTIC
/begin CHARACTERISTIC KOPM_BCMTrnngLiSwSigLo_enum "BCM_B_Package_BAC" VALUE 0x0000 /* @ECU_Address@KOPM_BCMTrnngLiSwSigLo_enum@ */ Scalar_UBYTE 0 AppSwcOpm_CM_uint8_enum 0.0 255.0 /end CHARACTERISTIC
/begin CHARACTERISTIC KOPM_BCMTrnngLiSwSig_enum_ovrdval "BCM_B_Package_BAC" VALUE 0x0000 /* @ECU_Address@KOPM_BCMTrnngLiSwSig_enum_ovrdval@ */ Scalar_UBYTE 0 AppSwcOpm_CM_uint8_enum 0.0 255.0 /end CHARACTERISTIC
/begin CHARACTERISTIC KOPM_BCMTurnLiStsHi_enum "BCM_B_Package_BAC" VALUE 0x0000 /* @ECU_Address@KOPM_BCMTurnLiStsHi_enum@ */ Scalar_UBYTE 0 AppSwcOpm_CM_uint8_enum 0.0 255.0 /end CHARACTERISTIC
/begin CHARACTERISTIC KOPM_BCMTurnLiStsLo_enum "BCM_B_Package_BAC" VALUE 0x0000 /* @ECU_Address@KOPM_BCMTurnLiStsLo_enum@ */ Scalar_UBYTE 0 AppSwcOpm_CM_uint8_enum 0.0 255.0 /end CHARACTERISTIC
/begin CHARACTERISTIC KOPM_BCMTurnLiSts_enum_ovrdval "BCM_B_Package_BAC" VALUE 0x0000 /* @ECU_Address@KOPM_BCMTurnLiSts_enum_ovrdval@ */ Scalar_UBYTE 0 AppSwcOpm_CM_uint8_enum 0.0 255.0 /end CHARACTERISTIC
/begin CHARACTERISTIC KOPM_BCMWiperCtrlFrontHi_enum "BCM_B_Package_BAC" VALUE 0x0000 /* @ECU_Address@KOPM_BCMWiperCtrlFrontHi_enum@ */ Scalar_UBYTE 0 AppSwcOpm_CM_uint8_enum 0.0 255.0 /end CHARACTERISTIC
/begin CHARACTERISTIC KOPM_BCMWiperCtrlFrontLo_enum "BCM_B_Package_BAC" VALUE 0x0000 /* @ECU_Address@KOPM_BCMWiperCtrlFrontLo_enum@ */ Scalar_UBYTE 0 AppSwcOpm_CM_uint8_enum 0.0 255.0 /end CHARACTERISTIC
/begin CHARACTERISTIC KOPM_BCMWiperCtrlFront_enum_ovrdval "BCM_B_Package_BAC" VALUE 0x0000 /* @ECU_Address@KOPM_BCMWiperCtrlFront_enum_ovrdval@ */ Scalar_UBYTE 0 AppSwcOpm_CM_uint8_enum 0.0 255.0 /end CHARACTERISTIC
/begin CHARACTERISTIC KOPM_BCMWiperSwSigHi_enum "BCM_B_Package_BAC" VALUE 0x0000 /* @ECU_Address@KOPM_BCMWiperSwSigHi_enum@ */ Scalar_UBYTE 0 AppSwcOpm_CM_uint8_enum 0.0 255.0 /end CHARACTERISTIC
/begin CHARACTERISTIC KOPM_BCMWiperSwSigLo_enum "BCM_B_Package_BAC" VALUE 0x0000 /* @ECU_Address@KOPM_BCMWiperSwSigLo_enum@ */ Scalar_UBYTE 0 AppSwcOpm_CM_uint8_enum 0.0 255.0 /end CHARACTERISTIC
/begin CHARACTERISTIC KOPM_BCMWiperSwSig_enum_ovrdval "BCM_B_Package_BAC" VALUE 0x0000 /* @ECU_Address@KOPM_BCMWiperSwSig_enum_ovrdval@ */ Scalar_UBYTE 0 AppSwcOpm_CM_uint8_enum 0.0 255.0 /end CHARACTERISTIC
/begin CHARACTERISTIC KOPM_BCMWiprIntlGrSwtSigHi_enum "BCM_B_Package_BAC" VALUE 0x0000 /* @ECU_Address@KOPM_BCMWiprIntlGrSwtSigHi_enum@ */ Scalar_UBYTE 0 AppSwcOpm_CM_uint8_enum 0.0 255.0 /end CHARACTERISTIC
/begin CHARACTERISTIC KOPM_BCMWiprIntlGrSwtSigLo_enum "BCM_B_Package_BAC" VALUE 0x0000 /* @ECU_Address@KOPM_BCMWiprIntlGrSwtSigLo_enum@ */ Scalar_UBYTE 0 AppSwcOpm_CM_uint8_enum 0.0 255.0 /end CHARACTERISTIC
/begin CHARACTERISTIC KOPM_BCMWiprIntlGrSwtSig_enum_ovrdval "BCM_B_Package_BAC" VALUE 0x0000 /* @ECU_Address@KOPM_BCMWiprIntlGrSwtSig_enum_ovrdval@ */ Scalar_UBYTE 0 AppSwcOpm_CM_uint8_enum 0.0 255.0 /end CHARACTERISTIC
/begin CHARACTERISTIC KOPM_BCMWiprIntlTimeSetFbHi_enum "BCM_B_Package_BAC" VALUE 0x0000 /* @ECU_Address@KOPM_BCMWiprIntlTimeSetFbHi_enum@ */ Scalar_UBYTE 0 AppSwcOpm_CM_uint8_enum 0.0 255.0 /end CHARACTERISTIC
/begin CHARACTERISTIC KOPM_BCMWiprIntlTimeSetFbLo_enum "BCM_B_Package_BAC" VALUE 0x0000 /* @ECU_Address@KOPM_BCMWiprIntlTimeSetFbLo_enum@ */ Scalar_UBYTE 0 AppSwcOpm_CM_uint8_enum 0.0 255.0 /end CHARACTERISTIC
/begin CHARACTERISTIC KOPM_BCMWiprIntlTimeSetFb_enum_ovrdval "BCM_B_Package_BAC" VALUE 0x0000 /* @ECU_Address@KOPM_BCMWiprIntlTimeSetFb_enum_ovrdval@ */ Scalar_UBYTE 0 AppSwcOpm_CM_uint8_enum 0.0 255.0 /end CHARACTERISTIC
/begin CHARACTERISTIC KOPM_HDCStatHi_enum "CCU_VehInfo_BAC" VALUE 0x0000 /* @ECU_Address@KOPM_HDCStatHi_enum@ */ Scalar_UBYTE 0 AppSwcOpm_CM_uint8_enum 0.0 255.0 /end CHARACTERISTIC
/begin CHARACTERISTIC KOPM_HDCStatLo_enum "CCU_VehInfo_BAC" VALUE 0x0000 /* @ECU_Address@KOPM_HDCStatLo_enum@ */ Scalar_UBYTE 0 AppSwcOpm_CM_uint8_enum 0.0 255.0 /end CHARACTERISTIC
/begin CHARACTERISTIC KOPM_HDCStat_enum_ovrdval "CCU_VehInfo_BAC" VALUE 0x0000 /* @ECU_Address@KOPM_HDCStat_enum_ovrdval@ */ Scalar_UBYTE 0 AppSwcOpm_CM_uint8_enum 0.0 255.0 /end CHARACTERISTIC
/begin CHARACTERISTIC KOPM_PTActlOprtModeHi_enum "CCU_VehInfo_BAC" VALUE 0x0000 /* @ECU_Address@KOPM_PTActlOprtModeHi_enum@ */ Scalar_UBYTE 0 AppSwcOpm_CM_uint8_enum 0.0 255.0 /end CHARACTERISTIC
/begin CHARACTERISTIC KOPM_PTActlOprtModeLo_enum "CCU_VehInfo_BAC" VALUE 0x0000 /* @ECU_Address@KOPM_PTActlOprtModeLo_enum@ */ Scalar_UBYTE 0 AppSwcOpm_CM_uint8_enum 0.0 255.0 /end CHARACTERISTIC
/begin CHARACTERISTIC KOPM_PrstlsStaFbHi_enum "CCU_VehInfo_BAC" VALUE 0x0000 /* @ECU_Address@KOPM_PrstlsStaFbHi_enum@ */ Scalar_UBYTE 0 AppSwcOpm_CM_uint8_enum 0.0 255.0 /end CHARACTERISTIC
/begin CHARACTERISTIC KOPM_PrstlsStaFbLo_enum "CCU_VehInfo_BAC" VALUE 0x0000 /* @ECU_Address@KOPM_PrstlsStaFbLo_enum@ */ Scalar_UBYTE 0 AppSwcOpm_CM_uint8_enum 0.0 255.0 /end CHARACTERISTIC
/begin CHARACTERISTIC KOPM_PwrRecupIntnstyHi_enum "CCU_VehInfo_BAC" VALUE 0x0000 /* @ECU_Address@KOPM_PwrRecupIntnstyHi_enum@ */ Scalar_UBYTE 0 AppSwcOpm_CM_uint8_enum 0.0 255.0 /end CHARACTERISTIC
/begin CHARACTERISTIC KOPM_PwrRecupIntnstyLo_enum "CCU_VehInfo_BAC" VALUE 0x0000 /* @ECU_Address@KOPM_PwrRecupIntnstyLo_enum@ */ Scalar_UBYTE 0 AppSwcOpm_CM_uint8_enum 0.0 255.0 /end CHARACTERISTIC
/begin CHARACTERISTIC KOPM_TPMSPressureStaFLHi_enum "BCM_B_Package_BAC" VALUE 0x0000 /* @ECU_Address@KOPM_TPMSPressureStaFLHi_enum@ */ Scalar_UBYTE 0 AppSwcOpm_CM_uint8_enum 0.0 255.0 /end CHARACTERISTIC
/begin CHARACTERISTIC KOPM_TPMSPressureStaFLLo_enum "BCM_B_Package_BAC" VALUE 0x0000 /* @ECU_Address@KOPM_TPMSPressureStaFLLo_enum@ */ Scalar_UBYTE 0 AppSwcOpm_CM_uint8_enum 0.0 255.0 /end CHARACTERISTIC
/begin CHARACTERISTIC KOPM_TPMSPressureStaFL_enum_ovrdval "BCM_B_Package_BAC" VALUE 0x0000 /* @ECU_Address@KOPM_TPMSPressureStaFL_enum_ovrdval@ */ Scalar_UBYTE 0 AppSwcOpm_CM_uint8_enum 0.0 255.0 /end CHARACTERISTIC
/begin CHARACTERISTIC KOPM_TPMSPressureStaFRHi_enum "BCM_B_Package_BAC" VALUE 0x0000 /* @ECU_Address@KOPM_TPMSPressureStaFRHi_enum@ */ Scalar_UBYTE 0 AppSwcOpm_CM_uint8_enum 0.0 255.0 /end CHARACTERISTIC
/begin CHARACTERISTIC KOPM_TPMSPressureStaFRLo_enum "BCM_B_Package_BAC" VALUE 0x0000 /* @ECU_Address@KOPM_TPMSPressureStaFRLo_enum@ */ Scalar_UBYTE 0 AppSwcOpm_CM_uint8_enum 0.0 255.0 /end CHARACTERISTIC
/begin CHARACTERISTIC KOPM_TPMSPressureStaFR_enum_ovrdval "BCM_B_Package_BAC" VALUE 0x0000 /* @ECU_Address@KOPM_TPMSPressureStaFR_enum_ovrdval@ */ Scalar_UBYTE 0 AppSwcOpm_CM_uint8_enum 0.0 255.0 /end CHARACTERISTIC
/begin CHARACTERISTIC KOPM_TPMSPressureStaRLHi_enum "BCM_B_Package_BAC" VALUE 0x0000 /* @ECU_Address@KOPM_TPMSPressureStaRLHi_enum@ */ Scalar_UBYTE 0 AppSwcOpm_CM_uint8_enum 0.0 255.0 /end CHARACTERISTIC
/begin CHARACTERISTIC KOPM_TPMSPressureStaRLLo_enum "BCM_B_Package_BAC" VALUE 0x0000 /* @ECU_Address@KOPM_TPMSPressureStaRLLo_enum@ */ Scalar_UBYTE 0 AppSwcOpm_CM_uint8_enum 0.0 255.0 /end CHARACTERISTIC
/begin CHARACTERISTIC KOPM_TPMSPressureStaRL_enum_ovrdval "BCM_B_Package_BAC" VALUE 0x0000 /* @ECU_Address@KOPM_TPMSPressureStaRL_enum_ovrdval@ */ Scalar_UBYTE 0 AppSwcOpm_CM_uint8_enum 0.0 255.0 /end CHARACTERISTIC
/begin CHARACTERISTIC KOPM_TPMSPressureStaRRHi_enum "BCM_B_Package_BAC" VALUE 0x0000 /* @ECU_Address@KOPM_TPMSPressureStaRRHi_enum@ */ Scalar_UBYTE 0 AppSwcOpm_CM_uint8_enum 0.0 255.0 /end CHARACTERISTIC
/begin CHARACTERISTIC KOPM_TPMSPressureStaRRLo_enum "BCM_B_Package_BAC" VALUE 0x0000 /* @ECU_Address@KOPM_TPMSPressureStaRRLo_enum@ */ Scalar_UBYTE 0 AppSwcOpm_CM_uint8_enum 0.0 255.0 /end CHARACTERISTIC
/begin CHARACTERISTIC KOPM_TPMSPressureStaRR_enum_ovrdval "BCM_B_Package_BAC" VALUE 0x0000 /* @ECU_Address@KOPM_TPMSPressureStaRR_enum_ovrdval@ */ Scalar_UBYTE 0 AppSwcOpm_CM_uint8_enum 0.0 255.0 /end CHARACTERISTIC
/begin CHARACTERISTIC KOPM_VehActDrvMod1Hi_enum "CCU_VehInfo_BAC" VALUE 0x0000 /* @ECU_Address@KOPM_VehActDrvMod1Hi_enum@ */ Scalar_UBYTE 0 AppSwcOpm_CM_uint8_enum 0.0 255.0 /end CHARACTERISTIC
/begin CHARACTERISTIC KOPM_VehActDrvMod1Lo_enum "CCU_VehInfo_BAC" VALUE 0x0000 /* @ECU_Address@KOPM_VehActDrvMod1Lo_enum@ */ Scalar_UBYTE 0 AppSwcOpm_CM_uint8_enum 0.0 255.0 /end CHARACTERISTIC
/begin CHARACTERISTIC KOPM_VehActlGearPosHi_enum "CCU_VehInfo_BAC" VALUE 0x0000 /* @ECU_Address@KOPM_VehActlGearPosHi_enum@ */ Scalar_UBYTE 0 AppSwcOpm_CM_uint8_enum 0.0 255.0 /end CHARACTERISTIC
/begin CHARACTERISTIC KOPM_VehActlGearPosLo_enum "CCU_VehInfo_BAC" VALUE 0x0000 /* @ECU_Address@KOPM_VehActlGearPosLo_enum@ */ Scalar_UBYTE 0 AppSwcOpm_CM_uint8_enum 0.0 255.0 /end CHARACTERISTIC
/begin MEASUREMENT VOPM_BCMSteerWhlTemp_C "BCM_B_Package_BAC" FLOAT32_IEEE AppSwcOpm_CM_single_C 0 0 -100000.0 100000.0 ECU_ADDRESS 0x0000 /* @ECU_Address@VOPM_BCMSteerWhlTemp_C@ */ /end MEASUREMENT
/begin MEASUREMENT VOPM_BCMMaiDrvrSeatTemp_C "BCM_B_Package_BAC" FLOAT32_IEEE AppSwcOpm_CM_single_C 0 0 -100000.0 100000.0 ECU_ADDRESS 0x0000 /* @ECU_Address@VOPM_BCMMaiDrvrSeatTemp_C@ */ /end MEASUREMENT
/begin MEASUREMENT VOPM_BCMKeyBattLvl_pct "BCM_B_Package_BAC" FLOAT32_IEEE AppSwcOpm_CM_single_pct 0 0 -100000.0 100000.0 ECU_ADDRESS 0x0000 /* @ECU_Address@VOPM_BCMKeyBattLvl_pct@ */ /end MEASUREMENT
/begin MEASUREMENT VOPM_MaxHVDCVoltAC_V "VCU_C_OprtCmd_EPT" FLOAT32_IEEE AppSwcOpm_CM_single_V 0 0 -100000.0 100000.0 ECU_ADDRESS 0x0000 /* @ECU_Address@VOPM_MaxHVDCVoltAC_V@ */ /end MEASUREMENT
/begin MEASUREMENT VOPM_MaxHVDCCurntAC_A "VCU_C_OprtCmd_EPT" FLOAT32_IEEE AppSwcOpm_CM_single_A 0 0 -100000.0 100000.0 ECU_ADDRESS 0x0000 /* @ECU_Address@VOPM_MaxHVDCCurntAC_A@ */ /end MEASUREMENT
/begin MEASUREMENT VOPM_DCCBuckLVVolt_V "VCU_C_OprtCmd_EPT" FLOAT32_IEEE AppSwcOpm_CM_single_V 0 0 -100000.0 100000.0 ECU_ADDRESS 0x0000 /* @ECU_Address@VOPM_DCCBuckLVVolt_V@ */ /end MEASUREMENT
/begin MEASUREMENT VOPM_DCCBoostHvVolt_V "VCU_C_OprtCmd_EPT" FLOAT32_IEEE AppSwcOpm_CM_single_V 0 0 -100000.0 100000.0 ECU_ADDRESS 0x0000 /* @ECU_Address@VOPM_DCCBoostHvVolt_V@ */ /end MEASUREMENT
/begin MEASUREMENT VOPM_BCMKeyLocn_mm "BCM_B_Package_BAC" UWORD AppSwcOpm_CM_uint16_mm 0 0 0.0 65535.0 ECU_ADDRESS 0x0000 /* @ECU_Address@VOPM_BCMKeyLocn_mm@ */ /end MEASUREMENT
/begin MEASUREMENT VOPM_TPMSPressureStaRR_enum "BCM_B_Package_BAC" UBYTE AppSwcOpm_CM_uint8_enum 0 0 0.0 255.0 ECU_ADDRESS 0x0000 /* @ECU_Address@VOPM_TPMSPressureStaRR_enum@ */ /end MEASUREMENT
/begin MEASUREMENT VOPM_TPMSPressureStaRL_enum "BCM_B_Package_BAC" UBYTE AppSwcOpm_CM_uint8_enum 0 0 0.0 255.0 ECU_ADDRESS 0x0000 /* @ECU_Address@VOPM_TPMSPressureStaRL_enum@ */ /end MEASUREMENT
/begin MEASUREMENT VOPM_TPMSPressureStaFR_enum "BCM_B_Package_BAC" UBYTE AppSwcOpm_CM_uint8_enum 0 0 0.0 255.0 ECU_ADDRESS 0x0000 /* @ECU_Address@VOPM_TPMSPressureStaFR_enum@ */ /end MEASUREMENT
/begin MEASUREMENT VOPM_TPMSPressureStaFL_enum "BCM_B_Package_BAC" UBYTE AppSwcOpm_CM_uint8_enum 0 0 0.0 255.0 ECU_ADDRESS 0x0000 /* @ECU_Address@VOPM_TPMSPressureStaFL_enum@ */ /end MEASUREMENT
/begin MEASUREMENT VOPM_BCMWiprIntlTimeSetFb_enum "BCM_B_Package_BAC" UBYTE AppSwcOpm_CM_uint8_enum 0 0 0.0 255.0 ECU_ADDRESS 0x0000 /* @ECU_Address@VOPM_BCMWiprIntlTimeSetFb_enum@ */ /end MEASUREMENT
/begin MEASUREMENT VOPM_BCMWiprIntlGrSwtSig_enum "BCM_B_Package_BAC" UBYTE AppSwcOpm_CM_uint8_enum 0 0 0.0 255.0 ECU_ADDRESS 0x0000 /* @ECU_Address@VOPM_BCMWiprIntlGrSwtSig_enum@ */ /end MEASUREMENT
/begin MEASUREMENT VOPM_BCMWiperSwSig_enum "BCM_B_Package_BAC" UBYTE AppSwcOpm_CM_uint8_enum 0 0 0.0 255.0 ECU_ADDRESS 0x0000 /* @ECU_Address@VOPM_BCMWiperSwSig_enum@ */ /end MEASUREMENT
/begin MEASUREMENT VOPM_BCMWiperCtrlFront_enum "BCM_B_Package_BAC" UBYTE AppSwcOpm_CM_uint8_enum 0 0 0.0 255.0 ECU_ADDRESS 0x0000 /* @ECU_Address@VOPM_BCMWiperCtrlFront_enum@ */ /end MEASUREMENT
/begin MEASUREMENT VOPM_BCMTurnLiSts_enum "BCM_B_Package_BAC" UBYTE AppSwcOpm_CM_uint8_enum 0 0 0.0 255.0 ECU_ADDRESS 0x0000 /* @ECU_Address@VOPM_BCMTurnLiSts_enum@ */ /end MEASUREMENT
/begin MEASUREMENT VOPM_BCMTrnngLiSwSig_enum "BCM_B_Package_BAC" UBYTE AppSwcOpm_CM_uint8_enum 0 0 0.0 255.0 ECU_ADDRESS 0x0000 /* @ECU_Address@VOPM_BCMTrnngLiSwSig_enum@ */ /end MEASUREMENT
/begin MEASUREMENT VOPM_BCMTPMSRstSts_enum "BCM_B_Package_BAC" UBYTE AppSwcOpm_CM_uint8_enum 0 0 0.0 255.0 ECU_ADDRESS 0x0000 /* @ECU_Address@VOPM_BCMTPMSRstSts_enum@ */ /end MEASUREMENT
/begin MEASUREMENT VOPM_BCMStartReq_enum "BCM_B_Package_BAC" UBYTE AppSwcOpm_CM_uint8_enum 0 0 0.0 255.0 ECU_ADDRESS 0x0000 /* @ECU_Address@VOPM_BCMStartReq_enum@ */ /end MEASUREMENT
/begin MEASUREMENT VOPM_BCMRiTrnLiFltFb_enum "BCM_B_Package_BAC" UBYTE AppSwcOpm_CM_uint8_enum 0 0 0.0 255.0 ECU_ADDRESS 0x0000 /* @ECU_Address@VOPM_BCMRiTrnLiFltFb_enum@ */ /end MEASUREMENT
/begin MEASUREMENT VOPM_BCMRKEReq_enum "BCM_B_Package_BAC" UBYTE AppSwcOpm_CM_uint8_enum 0 0 0.0 255.0 ECU_ADDRESS 0x0000 /* @ECU_Address@VOPM_BCMRKEReq_enum@ */ /end MEASUREMENT
/begin MEASUREMENT VOPM_BCMPassWinSwSig_enum "BCM_B_Package_BAC" UBYTE AppSwcOpm_CM_uint8_enum 0 0 0.0 255.0 ECU_ADDRESS 0x0000 /* @ECU_Address@VOPM_BCMPassWinSwSig_enum@ */ /end MEASUREMENT
/begin MEASUREMENT VOPM_BCMPSAuthentRes_enum "BCM_B_Package_BAC" UBYTE AppSwcOpm_CM_uint8_enum 0 0 0.0 255.0 ECU_ADDRESS 0x0000 /* @ECU_Address@VOPM_BCMPSAuthentRes_enum@ */ /end MEASUREMENT
/begin MEASUREMENT VOPM_BCMMaiDrvrSeatSts_enum "BCM_B_Package_BAC" UBYTE AppSwcOpm_CM_uint8_enum 0 0 0.0 255.0 ECU_ADDRESS 0x0000 /* @ECU_Address@VOPM_BCMMaiDrvrSeatSts_enum@ */ /end MEASUREMENT
/begin MEASUREMENT VOPM_BCMLogoActvFlg_enum "BCM_B_Package_BAC" UBYTE AppSwcOpm_CM_uint8_enum 0 0 0.0 255.0 ECU_ADDRESS 0x0000 /* @ECU_Address@VOPM_BCMLogoActvFlg_enum@ */ /end MEASUREMENT
/begin MEASUREMENT VOPM_BCMLightIntensity_enum "BCM_B_Package_BAC" UBYTE AppSwcOpm_CM_uint8_enum 0 0 0.0 255.0 ECU_ADDRESS 0x0000 /* @ECU_Address@VOPM_BCMLightIntensity_enum@ */ /end MEASUREMENT
/begin MEASUREMENT VOPM_BCMLghtSwSig_enum "BCM_B_Package_BAC" UBYTE AppSwcOpm_CM_uint8_enum 0 0 0.0 255.0 ECU_ADDRESS 0x0000 /* @ECU_Address@VOPM_BCMLghtSwSig_enum@ */ /end MEASUREMENT
/begin MEASUREMENT VOPM_BCMLeTrnLiFltFb_enum "BCM_B_Package_BAC" UBYTE AppSwcOpm_CM_uint8_enum 0 0 0.0 255.0 ECU_ADDRESS 0x0000 /* @ECU_Address@VOPM_BCMLeTrnLiFltFb_enum@ */ /end MEASUREMENT
/begin MEASUREMENT VOPM_BCMKeySta_enum "BCM_B_Package_BAC" UBYTE AppSwcOpm_CM_uint8_enum 0 0 0.0 255.0 ECU_ADDRESS 0x0000 /* @ECU_Address@VOPM_BCMKeySta_enum@ */ /end MEASUREMENT
/begin MEASUREMENT VOPM_BCMKeyIDFb_enum "BCM_B_Package_BAC" UBYTE AppSwcOpm_CM_uint8_enum 0 0 0.0 255.0 ECU_ADDRESS 0x0000 /* @ECU_Address@VOPM_BCMKeyIDFb_enum@ */ /end MEASUREMENT
/begin MEASUREMENT VOPM_BCMIllmndSts_enum "BCM_B_Package_BAC" UBYTE AppSwcOpm_CM_uint8_enum 0 0 0.0 255.0 ECU_ADDRESS 0x0000 /* @ECU_Address@VOPM_BCMIllmndSts_enum@ */ /end MEASUREMENT
/begin MEASUREMENT VOPM_BCMIllmndLockReq_enum "BCM_B_Package_BAC" UBYTE AppSwcOpm_CM_uint8_enum 0 0 0.0 255.0 ECU_ADDRESS 0x0000 /* @ECU_Address@VOPM_BCMIllmndLockReq_enum@ */ /end MEASUREMENT
/begin MEASUREMENT VOPM_BCMHiBeamSwSig_enum "BCM_B_Package_BAC" UBYTE AppSwcOpm_CM_uint8_enum 0 0 0.0 255.0 ECU_ADDRESS 0x0000 /* @ECU_Address@VOPM_BCMHiBeamSwSig_enum@ */ /end MEASUREMENT
/begin MEASUREMENT VOPM_BCMFrntWiprMotSts_enum "BCM_B_Package_BAC" UBYTE AppSwcOpm_CM_uint8_enum 0 0 0.0 255.0 ECU_ADDRESS 0x0000 /* @ECU_Address@VOPM_BCMFrntWiprMotSts_enum@ */ /end MEASUREMENT
/begin MEASUREMENT VOPM_BCMFrntRiDoorHndlSwt_enum "BCM_B_Package_BAC" UBYTE AppSwcOpm_CM_uint8_enum 0 0 0.0 255.0 ECU_ADDRESS 0x0000 /* @ECU_Address@VOPM_BCMFrntRiDoorHndlSwt_enum@ */ /end MEASUREMENT
/begin MEASUREMENT VOPM_BCMFrntLeDoorHndlSwt_enum "BCM_B_Package_BAC" UBYTE AppSwcOpm_CM_uint8_enum 0 0 0.0 255.0 ECU_ADDRESS 0x0000 /* @ECU_Address@VOPM_BCMFrntLeDoorHndlSwt_enum@ */ /end MEASUREMENT
/begin MEASUREMENT VOPM_BCMFrbdnKeyNr_enum "BCM_B_Package_BAC" UBYTE AppSwcOpm_CM_uint8_enum 0 0 0.0 255.0 ECU_ADDRESS 0x0000 /* @ECU_Address@VOPM_BCMFrbdnKeyNr_enum@ */ /end MEASUREMENT
/begin MEASUREMENT VOPM_BCMFlwrMeHmCtrlFb_enum "BCM_B_Package_BAC" UBYTE AppSwcOpm_CM_uint8_enum 0 0 0.0 255.0 ECU_ADDRESS 0x0000 /* @ECU_Address@VOPM_BCMFlwrMeHmCtrlFb_enum@ */ /end MEASUREMENT
/begin MEASUREMENT VOPM_BCMFRWinmotorSts_enum "BCM_B_Package_BAC" UBYTE AppSwcOpm_CM_uint8_enum 0 0 0.0 255.0 ECU_ADDRESS 0x0000 /* @ECU_Address@VOPM_BCMFRWinmotorSts_enum@ */ /end MEASUREMENT
/begin MEASUREMENT VOPM_BCMFRPEAuthentAcsd_enum "BCM_B_Package_BAC" UBYTE AppSwcOpm_CM_uint8_enum 0 0 0.0 255.0 ECU_ADDRESS 0x0000 /* @ECU_Address@VOPM_BCMFRPEAuthentAcsd_enum@ */ /end MEASUREMENT
/begin MEASUREMENT VOPM_BCMFLWinmotorSts_enum "BCM_B_Package_BAC" UBYTE AppSwcOpm_CM_uint8_enum 0 0 0.0 255.0 ECU_ADDRESS 0x0000 /* @ECU_Address@VOPM_BCMFLWinmotorSts_enum@ */ /end MEASUREMENT
/begin MEASUREMENT VOPM_BCMDrvrWinSwSig_enum "BCM_B_Package_BAC" UBYTE AppSwcOpm_CM_uint8_enum 0 0 0.0 255.0 ECU_ADDRESS 0x0000 /* @ECU_Address@VOPM_BCMDrvrWinSwSig_enum@ */ /end MEASUREMENT
/begin MEASUREMENT VOPM_BCMDrvSeatOccptSnsrSts_enum "BCM_B_Package_BAC" UBYTE AppSwcOpm_CM_uint8_enum 0 0 0.0 255.0 ECU_ADDRESS 0x0000 /* @ECU_Address@VOPM_BCMDrvSeatOccptSnsrSts_enum@ */ /end MEASUREMENT
/begin MEASUREMENT VOPM_BCMDrvPEAuthentAcsd_enum "BCM_B_Package_BAC" UBYTE AppSwcOpm_CM_uint8_enum 0 0 0.0 255.0 ECU_ADDRESS 0x0000 /* @ECU_Address@VOPM_BCMDrvPEAuthentAcsd_enum@ */ /end MEASUREMENT
/begin MEASUREMENT VOPM_BCMChrgLidLockReq_enum "BCM_B_Package_BAC" UBYTE AppSwcOpm_CM_uint8_enum 0 0 0.0 255.0 ECU_ADDRESS 0x0000 /* @ECU_Address@VOPM_BCMChrgLidLockReq_enum@ */ /end MEASUREMENT
/begin MEASUREMENT VOPM_BCMChgWiprMtMdSwSetFb_enum "BCM_B_Package_BAC" UBYTE AppSwcOpm_CM_uint8_enum 0 0 0.0 255.0 ECU_ADDRESS 0x0000 /* @ECU_Address@VOPM_BCMChgWiprMtMdSwSetFb_enum@ */ /end MEASUREMENT
/begin MEASUREMENT VOPM_BCMBodyWarnSts_enum "BCM_B_Package_BAC" UBYTE AppSwcOpm_CM_uint8_enum 0 0 0.0 255.0 ECU_ADDRESS 0x0000 /* @ECU_Address@VOPM_BCMBodyWarnSts_enum@ */ /end MEASUREMENT
/begin MEASUREMENT VOPM_BCMBassHornReq_enum "BCM_B_Package_BAC" UBYTE AppSwcOpm_CM_uint8_enum 0 0 0.0 255.0 ECU_ADDRESS 0x0000 /* @ECU_Address@VOPM_BCMBassHornReq_enum@ */ /end MEASUREMENT
/begin MEASUREMENT VOPM_BCMBackLadjvalFb_enum "BCM_B_Package_BAC" UBYTE AppSwcOpm_CM_uint8_enum 0 0 0.0 255.0 ECU_ADDRESS 0x0000 /* @ECU_Address@VOPM_BCMBackLadjvalFb_enum@ */ /end MEASUREMENT
/begin MEASUREMENT VOPM_BCMAuthentKeyNr_enum "BCM_B_Package_BAC" UBYTE AppSwcOpm_CM_uint8_enum 0 0 0.0 255.0 ECU_ADDRESS 0x0000 /* @ECU_Address@VOPM_BCMAuthentKeyNr_enum@ */ /end MEASUREMENT
/begin MEASUREMENT VOPM_HDCStat_enum "CCU_VehInfo_BAC" UBYTE AppSwcOpm_CM_uint8_enum 0 0 0.0 255.0 ECU_ADDRESS 0x0000 /* @ECU_Address@VOPM_HDCStat_enum@ */ /end MEASUREMENT
/begin MEASUREMENT VOPM_BCMSysPwrMode_enum "CCU_VehInfo_BAC" UBYTE AppSwcOpm_CM_uint8_enum 0 0 0.0 255.0 ECU_ADDRESS 0x0000 /* @ECU_Address@VOPM_BCMSysPwrMode_enum@ */ /end MEASUREMENT
/begin MEASUREMENT VOPM_BCMSysPowerSts_enum "CCU_VehInfo_BAC" UBYTE AppSwcOpm_CM_uint8_enum 0 0 0.0 255.0 ECU_ADDRESS 0x0000 /* @ECU_Address@VOPM_BCMSysPowerSts_enum@ */ /end MEASUREMENT
/begin MEASUREMENT VOPM_BCMCenLckSwCtrlFb_enum "CCU_VehInfo_BAC" UBYTE AppSwcOpm_CM_uint8_enum 0 0 0.0 255.0 ECU_ADDRESS 0x0000 /* @ECU_Address@VOPM_BCMCenLckSwCtrlFb_enum@ */ /end MEASUREMENT
/begin MEASUREMENT VOPM_BCMCenLckSts_enum "CCU_VehInfo_BAC" UBYTE AppSwcOpm_CM_uint8_enum 0 0 0.0 255.0 ECU_ADDRESS 0x0000 /* @ECU_Address@VOPM_BCMCenLckSts_enum@ */ /end MEASUREMENT
/begin MEASUREMENT VOPM_12VBatLowVolSta_enum "CCU_VehInfo_BAC" UBYTE AppSwcOpm_CM_uint8_enum 0 0 0.0 255.0 ECU_ADDRESS 0x0000 /* @ECU_Address@VOPM_12VBatLowVolSta_enum@ */ /end MEASUREMENT
/begin MEASUREMENT VOPM_TMPSAbnmPrsrWarn_flg "BCM_B_Package_BAC" UBYTE AppSwcOpm_CM_boolean_flg 0 0 0.0 1.0 ECU_ADDRESS 0x0000 /* @ECU_Address@VOPM_TMPSAbnmPrsrWarn_flg@ */ /end MEASUREMENT
/begin MEASUREMENT VOPM_BCMWinLockSts_flg "BCM_B_Package_BAC" UBYTE AppSwcOpm_CM_boolean_flg 0 0 0.0 1.0 ECU_ADDRESS 0x0000 /* @ECU_Address@VOPM_BCMWinLockSts_flg@ */ /end MEASUREMENT
/begin MEASUREMENT VOPM_BCMWinLockSig_flg "BCM_B_Package_BAC" UBYTE AppSwcOpm_CM_boolean_flg 0 0 0.0 1.0 ECU_ADDRESS 0x0000 /* @ECU_Address@VOPM_BCMWinLockSig_flg@ */ /end MEASUREMENT
/begin MEASUREMENT VOPM_BCMWashLiquidLvlWarn_flg "BCM_B_Package_BAC" UBYTE AppSwcOpm_CM_boolean_flg 0 0 0.0 1.0 ECU_ADDRESS 0x0000 /* @ECU_Address@VOPM_BCMWashLiquidLvlWarn_flg@ */ /end MEASUREMENT
/begin MEASUREMENT VOPM_BCMWarnNoKeyFound_flg "BCM_B_Package_BAC" UBYTE AppSwcOpm_CM_boolean_flg 0 0 0.0 1.0 ECU_ADDRESS 0x0000 /* @ECU_Address@VOPM_BCMWarnNoKeyFound_flg@ */ /end MEASUREMENT
/begin MEASUREMENT VOPM_BCMWarnKeyOutRmndr_flg "BCM_B_Package_BAC" UBYTE AppSwcOpm_CM_boolean_flg 0 0 0.0 1.0 ECU_ADDRESS 0x0000 /* @ECU_Address@VOPM_BCMWarnKeyOutRmndr_flg@ */ /end MEASUREMENT
/begin MEASUREMENT VOPM_BCMVehSeek_flg "BCM_B_Package_BAC" UBYTE AppSwcOpm_CM_boolean_flg 0 0 0.0 1.0 ECU_ADDRESS 0x0000 /* @ECU_Address@VOPM_BCMVehSeek_flg@ */ /end MEASUREMENT
/begin MEASUREMENT VOPM_BCMTurnLampStaRight_flg "BCM_B_Package_BAC" UBYTE AppSwcOpm_CM_boolean_flg 0 0 0.0 1.0 ECU_ADDRESS 0x0000 /* @ECU_Address@VOPM_BCMTurnLampStaRight_flg@ */ /end MEASUREMENT
/begin MEASUREMENT VOPM_BCMTurnLampStaLeft_flg "BCM_B_Package_BAC" UBYTE AppSwcOpm_CM_boolean_flg 0 0 0.0 1.0 ECU_ADDRESS 0x0000 /* @ECU_Address@VOPM_BCMTurnLampStaLeft_flg@ */ /end MEASUREMENT
/begin MEASUREMENT VOPM_BCMTrunkSwtSig_flg "BCM_B_Package_BAC" UBYTE AppSwcOpm_CM_boolean_flg 0 0 0.0 1.0 ECU_ADDRESS 0x0000 /* @ECU_Address@VOPM_BCMTrunkSwtSig_flg@ */ /end MEASUREMENT
/begin MEASUREMENT VOPM_BCMTrnkLckSwCtrlFb_flg "BCM_B_Package_BAC" UBYTE AppSwcOpm_CM_boolean_flg 0 0 0.0 1.0 ECU_ADDRESS 0x0000 /* @ECU_Address@VOPM_BCMTrnkLckSwCtrlFb_flg@ */ /end MEASUREMENT
/begin MEASUREMENT VOPM_BCMTrnkLckSta_flg "BCM_B_Package_BAC" UBYTE AppSwcOpm_CM_boolean_flg 0 0 0.0 1.0 ECU_ADDRESS 0x0000 /* @ECU_Address@VOPM_BCMTrnkLckSta_flg@ */ /end MEASUREMENT
/begin MEASUREMENT VOPM_BCMSteerWhlHeatSts_flg "BCM_B_Package_BAC" UBYTE AppSwcOpm_CM_boolean_flg 0 0 0.0 1.0 ECU_ADDRESS 0x0000 /* @ECU_Address@VOPM_BCMSteerWhlHeatSts_flg@ */ /end MEASUREMENT
/begin MEASUREMENT VOPM_BCMRrMirrHeatSts_flg "BCM_B_Package_BAC" UBYTE AppSwcOpm_CM_boolean_flg 0 0 0.0 1.0 ECU_ADDRESS 0x0000 /* @ECU_Address@VOPM_BCMRrMirrHeatSts_flg@ */ /end MEASUREMENT
/begin MEASUREMENT VOPM_BCMRrFogLiSwSig_flg "BCM_B_Package_BAC" UBYTE AppSwcOpm_CM_boolean_flg 0 0 0.0 1.0 ECU_ADDRESS 0x0000 /* @ECU_Address@VOPM_BCMRrFogLiSwSig_flg@ */ /end MEASUREMENT
/begin MEASUREMENT VOPM_BCMReverseLampSta_flg "BCM_B_Package_BAC" UBYTE AppSwcOpm_CM_boolean_flg 0 0 0.0 1.0 ECU_ADDRESS 0x0000 /* @ECU_Address@VOPM_BCMReverseLampSta_flg@ */ /end MEASUREMENT
/begin MEASUREMENT VOPM_BCMRFInitSta_flg "BCM_B_Package_BAC" UBYTE AppSwcOpm_CM_boolean_flg 0 0 0.0 1.0 ECU_ADDRESS 0x0000 /* @ECU_Address@VOPM_BCMRFInitSta_flg@ */ /end MEASUREMENT
/begin MEASUREMENT VOPM_BCMPosLampSta_flg "BCM_B_Package_BAC" UBYTE AppSwcOpm_CM_boolean_flg 0 0 0.0 1.0 ECU_ADDRESS 0x0000 /* @ECU_Address@VOPM_BCMPosLampSta_flg@ */ /end MEASUREMENT
/begin MEASUREMENT VOPM_BCMPaswdwInit_flg "BCM_B_Package_BAC" UBYTE AppSwcOpm_CM_boolean_flg 0 0 0.0 1.0 ECU_ADDRESS 0x0000 /* @ECU_Address@VOPM_BCMPaswdwInit_flg@ */ /end MEASUREMENT
/begin MEASUREMENT VOPM_BCMParkAutoUnlckSetFb_flg "BCM_B_Package_BAC" UBYTE AppSwcOpm_CM_boolean_flg 0 0 0.0 1.0 ECU_ADDRESS 0x0000 /* @ECU_Address@VOPM_BCMParkAutoUnlckSetFb_flg@ */ /end MEASUREMENT
/begin MEASUREMENT VOPM_BCMPSReq_flg "BCM_B_Package_BAC" UBYTE AppSwcOpm_CM_boolean_flg 0 0 0.0 1.0 ECU_ADDRESS 0x0000 /* @ECU_Address@VOPM_BCMPSReq_flg@ */ /end MEASUREMENT
/begin MEASUREMENT VOPM_BCMOvrspdCntrlLckSetFb_flg "BCM_B_Package_BAC" UBYTE AppSwcOpm_CM_boolean_flg 0 0 0.0 1.0 ECU_ADDRESS 0x0000 /* @ECU_Address@VOPM_BCMOvrspdCntrlLckSetFb_flg@ */ /end MEASUREMENT
/begin MEASUREMENT VOPM_BCMLowBeamSta_flg "BCM_B_Package_BAC" UBYTE AppSwcOpm_CM_boolean_flg 0 0 0.0 1.0 ECU_ADDRESS 0x0000 /* @ECU_Address@VOPM_BCMLowBeamSta_flg@ */ /end MEASUREMENT
/begin MEASUREMENT VOPM_BCMLckHornOnStFb_flg "BCM_B_Package_BAC" UBYTE AppSwcOpm_CM_boolean_flg 0 0 0.0 1.0 ECU_ADDRESS 0x0000 /* @ECU_Address@VOPM_BCMLckHornOnStFb_flg@ */ /end MEASUREMENT
/begin MEASUREMENT VOPM_BCMKeyLoBattLvlWarn_flg "BCM_B_Package_BAC" UBYTE AppSwcOpm_CM_boolean_flg 0 0 0.0 1.0 ECU_ADDRESS 0x0000 /* @ECU_Address@VOPM_BCMKeyLoBattLvlWarn_flg@ */ /end MEASUREMENT
/begin MEASUREMENT VOPM_BCMKeyInCarSta_flg "BCM_B_Package_BAC" UBYTE AppSwcOpm_CM_boolean_flg 0 0 0.0 1.0 ECU_ADDRESS 0x0000 /* @ECU_Address@VOPM_BCMKeyInCarSta_flg@ */ /end MEASUREMENT
/begin MEASUREMENT VOPM_BCMKeyFrbdn_flg "BCM_B_Package_BAC" UBYTE AppSwcOpm_CM_boolean_flg 0 0 0.0 1.0 ECU_ADDRESS 0x0000 /* @ECU_Address@VOPM_BCMKeyFrbdn_flg@ */ /end MEASUREMENT
/begin MEASUREMENT VOPM_BCMKeyBattLvlSts_flg "BCM_B_Package_BAC" UBYTE AppSwcOpm_CM_boolean_flg 0 0 0.0 1.0 ECU_ADDRESS 0x0000 /* @ECU_Address@VOPM_BCMKeyBattLvlSts_flg@ */ /end MEASUREMENT
/begin MEASUREMENT VOPM_BCMIndcnShfttoNeut_flg "BCM_B_Package_BAC" UBYTE AppSwcOpm_CM_boolean_flg 0 0 0.0 1.0 ECU_ADDRESS 0x0000 /* @ECU_Address@VOPM_BCMIndcnShfttoNeut_flg@ */ /end MEASUREMENT
/begin MEASUREMENT VOPM_BCMIndcnKeyClsr_flg "BCM_B_Package_BAC" UBYTE AppSwcOpm_CM_boolean_flg 0 0 0.0 1.0 ECU_ADDRESS 0x0000 /* @ECU_Address@VOPM_BCMIndcnKeyClsr_flg@ */ /end MEASUREMENT
/begin MEASUREMENT VOPM_BCMIllmndLampReq_flg "BCM_B_Package_BAC" UBYTE AppSwcOpm_CM_boolean_flg 0 0 0.0 1.0 ECU_ADDRESS 0x0000 /* @ECU_Address@VOPM_BCMIllmndLampReq_flg@ */ /end MEASUREMENT
/begin MEASUREMENT VOPM_BCMIllmndEntryStsFb_flg "BCM_B_Package_BAC" UBYTE AppSwcOpm_CM_boolean_flg 0 0 0.0 1.0 ECU_ADDRESS 0x0000 /* @ECU_Address@VOPM_BCMIllmndEntryStsFb_flg@ */ /end MEASUREMENT
/begin MEASUREMENT VOPM_BCMHzrdWrngLghtSwSig_flg "BCM_B_Package_BAC" UBYTE AppSwcOpm_CM_boolean_flg 0 0 0.0 1.0 ECU_ADDRESS 0x0000 /* @ECU_Address@VOPM_BCMHzrdWrngLghtSwSig_flg@ */ /end MEASUREMENT
/begin MEASUREMENT VOPM_BCMHvyRainInd_flg "BCM_B_Package_BAC" UBYTE AppSwcOpm_CM_boolean_flg 0 0 0.0 1.0 ECU_ADDRESS 0x0000 /* @ECU_Address@VOPM_BCMHvyRainInd_flg@ */ /end MEASUREMENT
/begin MEASUREMENT VOPM_BCMHighBeamSta_flg "BCM_B_Package_BAC" UBYTE AppSwcOpm_CM_boolean_flg 0 0 0.0 1.0 ECU_ADDRESS 0x0000 /* @ECU_Address@VOPM_BCMHighBeamSta_flg@ */ /end MEASUREMENT
/begin MEASUREMENT VOPM_BCMHazardLampSts_flg "BCM_B_Package_BAC" UBYTE AppSwcOpm_CM_boolean_flg 0 0 0.0 1.0 ECU_ADDRESS 0x0000 /* @ECU_Address@VOPM_BCMHazardLampSts_flg@ */ /end MEASUREMENT
/begin MEASUREMENT VOPM_BCMFrontWashSts_flg "BCM_B_Package_BAC" UBYTE AppSwcOpm_CM_boolean_flg 0 0 0.0 1.0 ECU_ADDRESS 0x0000 /* @ECU_Address@VOPM_BCMFrontWashSts_flg@ */ /end MEASUREMENT
/begin MEASUREMENT VOPM_BCMFrntWshrSwSig_flg "BCM_B_Package_BAC" UBYTE AppSwcOpm_CM_boolean_flg 0 0 0.0 1.0 ECU_ADDRESS 0x0000 /* @ECU_Address@VOPM_BCMFrntWshrSwSig_flg@ */ /end MEASUREMENT
/begin MEASUREMENT VOPM_BCMFrntFogLiSwSig_flg "BCM_B_Package_BAC" UBYTE AppSwcOpm_CM_boolean_flg 0 0 0.0 1.0 ECU_ADDRESS 0x0000 /* @ECU_Address@VOPM_BCMFrntFogLiSwSig_flg@ */ /end MEASUREMENT
/begin MEASUREMENT VOPM_BCMFogLampStaRear_flg "BCM_B_Package_BAC" UBYTE AppSwcOpm_CM_boolean_flg 0 0 0.0 1.0 ECU_ADDRESS 0x0000 /* @ECU_Address@VOPM_BCMFogLampStaRear_flg@ */ /end MEASUREMENT
/begin MEASUREMENT VOPM_BCMFogLampStaFront_flg "BCM_B_Package_BAC" UBYTE AppSwcOpm_CM_boolean_flg 0 0 0.0 1.0 ECU_ADDRESS 0x0000 /* @ECU_Address@VOPM_BCMFogLampStaFront_flg@ */ /end MEASUREMENT
/begin MEASUREMENT VOPM_BCMFRWinSts_flg "BCM_B_Package_BAC" UBYTE AppSwcOpm_CM_boolean_flg 0 0 0.0 1.0 ECU_ADDRESS 0x0000 /* @ECU_Address@VOPM_BCMFRWinSts_flg@ */ /end MEASUREMENT
/begin MEASUREMENT VOPM_BCMFLWinSts_flg "BCM_B_Package_BAC" UBYTE AppSwcOpm_CM_boolean_flg 0 0 0.0 1.0 ECU_ADDRESS 0x0000 /* @ECU_Address@VOPM_BCMFLWinSts_flg@ */ /end MEASUREMENT
/begin MEASUREMENT VOPM_BCMDoorAjarStaRR_flg "BCM_B_Package_BAC" UBYTE AppSwcOpm_CM_boolean_flg 0 0 0.0 1.0 ECU_ADDRESS 0x0000 /* @ECU_Address@VOPM_BCMDoorAjarStaRR_flg@ */ /end MEASUREMENT
/begin MEASUREMENT VOPM_BCMDoorAjarStaRL_flg "BCM_B_Package_BAC" UBYTE AppSwcOpm_CM_boolean_flg 0 0 0.0 1.0 ECU_ADDRESS 0x0000 /* @ECU_Address@VOPM_BCMDoorAjarStaRL_flg@ */ /end MEASUREMENT
/begin MEASUREMENT VOPM_BCMDoorAjarStaFR_flg "BCM_B_Package_BAC" UBYTE AppSwcOpm_CM_boolean_flg 0 0 0.0 1.0 ECU_ADDRESS 0x0000 /* @ECU_Address@VOPM_BCMDoorAjarStaFR_flg@ */ /end MEASUREMENT
/begin MEASUREMENT VOPM_BCMDoorAjarStaFL_flg "BCM_B_Package_BAC" UBYTE AppSwcOpm_CM_boolean_flg 0 0 0.0 1.0 ECU_ADDRESS 0x0000 /* @ECU_Address@VOPM_BCMDoorAjarStaFL_flg@ */ /end MEASUREMENT
/begin MEASUREMENT VOPM_BCMDayRunLightSta_flg "BCM_B_Package_BAC" UBYTE AppSwcOpm_CM_boolean_flg 0 0 0.0 1.0 ECU_ADDRESS 0x0000 /* @ECU_Address@VOPM_BCMDayRunLightSta_flg@ */ /end MEASUREMENT
/begin MEASUREMENT VOPM_BCMDayRunLiSwSig_flg "BCM_B_Package_BAC" UBYTE AppSwcOpm_CM_boolean_flg 0 0 0.0 1.0 ECU_ADDRESS 0x0000 /* @ECU_Address@VOPM_BCMDayRunLiSwSig_flg@ */ /end MEASUREMENT
/begin MEASUREMENT VOPM_BCMBrakeLampSta_flg "BCM_B_Package_BAC" UBYTE AppSwcOpm_CM_boolean_flg 0 0 0.0 1.0 ECU_ADDRESS 0x0000 /* @ECU_Address@VOPM_BCMBrakeLampSta_flg@ */ /end MEASUREMENT
/begin MEASUREMENT VOPM_BCMAvaluebleKeyInCar_flg "BCM_B_Package_BAC" UBYTE AppSwcOpm_CM_boolean_flg 0 0 0.0 1.0 ECU_ADDRESS 0x0000 /* @ECU_Address@VOPM_BCMAvaluebleKeyInCar_flg@ */ /end MEASUREMENT
/begin MEASUREMENT VOPM_BCMAutoLampStatus_flg "BCM_B_Package_BAC" UBYTE AppSwcOpm_CM_boolean_flg 0 0 0.0 1.0 ECU_ADDRESS 0x0000 /* @ECU_Address@VOPM_BCMAutoLampStatus_flg@ */ /end MEASUREMENT
/begin MEASUREMENT VOPM_BCMAlrmHornReq_flg "BCM_B_Package_BAC" UBYTE AppSwcOpm_CM_boolean_flg 0 0 0.0 1.0 ECU_ADDRESS 0x0000 /* @ECU_Address@VOPM_BCMAlrmHornReq_flg@ */ /end MEASUREMENT
/begin MEASUREMENT VOPM_BCMAjarStaVHoodVld_flg "BCM_B_Package_BAC" UBYTE AppSwcOpm_CM_boolean_flg 0 0 0.0 1.0 ECU_ADDRESS 0x0000 /* @ECU_Address@VOPM_BCMAjarStaVHoodVld_flg@ */ /end MEASUREMENT
/begin MEASUREMENT VOPM_BCMAjarStaTrunk_flg "BCM_B_Package_BAC" UBYTE AppSwcOpm_CM_boolean_flg 0 0 0.0 1.0 ECU_ADDRESS 0x0000 /* @ECU_Address@VOPM_BCMAjarStaTrunk_flg@ */ /end MEASUREMENT
/begin MEASUREMENT VOPM_BCMAjarStaHood_flg "BCM_B_Package_BAC" UBYTE AppSwcOpm_CM_boolean_flg 0 0 0.0 1.0 ECU_ADDRESS 0x0000 /* @ECU_Address@VOPM_BCMAjarStaHood_flg@ */ /end MEASUREMENT
/begin MEASUREMENT VOPM_VehActlGearPosVld_flg "CCU_VehInfo_BAC" UBYTE AppSwcOpm_CM_boolean_flg 0 0 0.0 1.0 ECU_ADDRESS 0x0000 /* @ECU_Address@VOPM_VehActlGearPosVld_flg@ */ /end MEASUREMENT
/begin MEASUREMENT VOPM_PCUFailSta_flg "CCU_VehInfo_BAC" UBYTE AppSwcOpm_CM_boolean_flg 0 0 0.0 1.0 ECU_ADDRESS 0x0000 /* @ECU_Address@VOPM_PCUFailSta_flg@ */ /end MEASUREMENT
/begin MEASUREMENT VOPM_LimpHomeSta_flg "CCU_VehInfo_BAC" UBYTE AppSwcOpm_CM_boolean_flg 0 0 0.0 1.0 ECU_ADDRESS 0x0000 /* @ECU_Address@VOPM_LimpHomeSta_flg@ */ /end MEASUREMENT
/begin MEASUREMENT VOPM_BCMSysPwrModeVld_flg "CCU_VehInfo_BAC" UBYTE AppSwcOpm_CM_boolean_flg 0 0 0.0 1.0 ECU_ADDRESS 0x0000 /* @ECU_Address@VOPM_BCMSysPwrModeVld_flg@ */ /end MEASUREMENT
/begin MEASUREMENT VOPM_BCMDoorLckStaFL_flg "CCU_VehInfo_BAC" UBYTE AppSwcOpm_CM_boolean_flg 0 0 0.0 1.0 ECU_ADDRESS 0x0000 /* @ECU_Address@VOPM_BCMDoorLckStaFL_flg@ */ /end MEASUREMENT
/begin MEASUREMENT VOPM_BCMBrkPedSta_flg "CCU_VehInfo_BAC" UBYTE AppSwcOpm_CM_boolean_flg 0 0 0.0 1.0 ECU_ADDRESS 0x0000 /* @ECU_Address@VOPM_BCMBrkPedSta_flg@ */ /end MEASUREMENT
/begin MEASUREMENT VOPM_OBCIntDchrgEna_flg "VCU_C_OprtCmd_EPT" UBYTE AppSwcOpm_CM_boolean_flg 0 0 0.0 1.0 ECU_ADDRESS 0x0000 /* @ECU_Address@VOPM_OBCIntDchrgEna_flg@ */ /end MEASUREMENT
/begin MEASUREMENT VOPM_PwrRecupIntnsty_enum "CCU_VehInfo_BAC" UBYTE AppSwcOpm_CM_EnumRegenModeAct 0 0 0 2 ECU_ADDRESS 0x0000 /* @ECU_Address@VOPM_PwrRecupIntnsty_enum@ */ /end MEASUREMENT
/begin MEASUREMENT VOPM_PTActlOprtMode_enum "CCU_VehInfo_BAC" UBYTE AppSwcOpm_CM_EnumPTActMd 0 0 0 3 ECU_ADDRESS 0x0000 /* @ECU_Address@VOPM_PTActlOprtMode_enum@ */ /end MEASUREMENT
/begin MEASUREMENT VOPM_VehActlGearPos_enum "CCU_VehInfo_BAC" UBYTE AppSwcOpm_CM_EnumGearPstn 0 0 0 3 ECU_ADDRESS 0x0000 /* @ECU_Address@VOPM_VehActlGearPos_enum@ */ /end MEASUREMENT
/begin MEASUREMENT VOPM_VehActDrvMod1_enum "CCU_VehInfo_BAC" UBYTE AppSwcOpm_CM_EnumDrvModeAct 0 0 0 4 ECU_ADDRESS 0x0000 /* @ECU_Address@VOPM_VehActDrvMod1_enum@ */ /end MEASUREMENT
/begin MEASUREMENT VOPM_PrstlsStaFb_enum "CCU_VehInfo_BAC" UBYTE AppSwcOpm_CM_EnumCrpModeAct 0 0 0 2 ECU_ADDRESS 0x0000 /* @ECU_Address@VOPM_PrstlsStaFb_enum@ */ /end MEASUREMENT
/begin COMPU_METHOD AppSwcOpm_CM_single_C "Q = V" RAT_FUNC "%8.6" "C" COEFFS 0 1 0 0 0 1 /end COMPU_METHOD
/begin COMPU_METHOD AppSwcOpm_CM_single_pct "Q = V" RAT_FUNC "%8.6" "pct" COEFFS 0 1 0 0 0 1 /end COMPU_METHOD
/begin COMPU_METHOD AppSwcOpm_CM_single_V "Q = V" RAT_FUNC "%8.6" "V" COEFFS 0 1 0 0 0 1 /end COMPU_METHOD
/begin COMPU_METHOD AppSwcOpm_CM_single_A "Q = V" RAT_FUNC "%8.6" "A" COEFFS 0 1 0 0 0 1 /end COMPU_METHOD
/begin COMPU_METHOD AppSwcOpm_CM_uint16_mm "Q = V" RAT_FUNC "%5.0" "mm" COEFFS 0 1 0 0 0 1 /end COMPU_METHOD
/begin COMPU_METHOD AppSwcOpm_CM_EnumCrpModeAct "Enumerated data type: EnumCrpModeAct" TAB_VERB "%0.6" "" COMPU_TAB_REF VTAB_FOR_AppSwcOpm_CM_EnumCrpModeAct /end COMPU_METHOD
/begin COMPU_VTAB VTAB_FOR_AppSwcOpm_CM_EnumCrpModeAct "Enumerated data type: EnumCrpModeAct" TAB_VERB 3 0 "EnumCrpModeAct_Open" 1 "EnumCrpModeAct_Closed" 2 "EnumCrpModeAct_StandStill" /end COMPU_VTAB
/begin COMPU_METHOD AppSwcOpm_CM_EnumDrvModeAct "Enumerated data type: EnumDrvModeAct" TAB_VERB "%0.6" "" COMPU_TAB_REF VTAB_FOR_AppSwcOpm_CM_EnumDrvModeAct /end COMPU_METHOD
/begin COMPU_VTAB VTAB_FOR_AppSwcOpm_CM_EnumDrvModeAct "Enumerated data type: EnumDrvModeAct" TAB_VERB 5 0 "EnumDrvModeAct_Invalid" 1 "EnumDrvModeAct_Eco" 2 "EnumDrvModeAct_Auto" 3 "EnumDrvModeAct_Manual" 4 "EnumDrvModeAct_Eped" /end COMPU_VTAB
/begin COMPU_METHOD AppSwcOpm_CM_EnumGearPstn "Enumerated data type: EnumGearPstn" TAB_VERB "%0.6" "" COMPU_TAB_REF VTAB_FOR_AppSwcOpm_CM_EnumGearPstn /end COMPU_METHOD
/begin COMPU_VTAB VTAB_FOR_AppSwcOpm_CM_EnumGearPstn "Enumerated data type: EnumGearPstn" TAB_VERB 4 0 "EnumGearPstn_P" 1 "EnumGearPstn_N" 2 "EnumGearPstn_D" 3 "EnumGearPstn_R" /end COMPU_VTAB
/begin COMPU_METHOD AppSwcOpm_CM_EnumPTActMd "Enumerated data type: EnumPTActMd" TAB_VERB "%0.6" "" COMPU_TAB_REF VTAB_FOR_AppSwcOpm_CM_EnumPTActMd /end COMPU_METHOD
/begin COMPU_VTAB VTAB_FOR_AppSwcOpm_CM_EnumPTActMd "Enumerated data type: EnumPTActMd" TAB_VERB 4 0 "EnumPTActMd_OFF" 1 "EnumPTActMd_Standby" 2 "EnumPTActMd_Ready" 3 "EnumPTActMd_EmgcySdn" /end COMPU_VTAB
/begin COMPU_METHOD AppSwcOpm_CM_EnumRegenModeAct "Enumerated data type: EnumRegenModeAct" TAB_VERB "%0.6" "" COMPU_TAB_REF VTAB_FOR_AppSwcOpm_CM_EnumRegenModeAct /end COMPU_METHOD
/begin COMPU_VTAB VTAB_FOR_AppSwcOpm_CM_EnumRegenModeAct "Enumerated data type: EnumRegenModeAct" TAB_VERB 3 0 "EnumRegenModeAct_Off" 1 "EnumRegenModeAct_Weak" 2 "EnumRegenModeAct_Strong" /end COMPU_VTAB
/begin COMPU_METHOD AppSwcOpm_CM_boolean_flg "Q = V" RAT_FUNC "%1.0" "flg" COEFFS 0 1 0 0 0 1 /end COMPU_METHOD
/begin COMPU_METHOD AppSwcOpm_CM_uint8_enum "Q = V" RAT_FUNC "%3.0" "enum" COEFFS 0 1 0 0 0 1 /end COMPU_METHOD
/begin GROUP S297_Subsys_VOPM_DCCBoostHvVolt_V "AppSwcOpm/Opm20ms/EptCAN_OUT_20ms/Msg_VCU_C_OprtCmd_EPT/Subsys_VOPM_DCCBoostHvVolt_V"
 /begin REF_CHARACTERISTIC KOPM_DCCBoostHvVoltHi_V KOPM_DCCBoostHvVoltLo_V KOPM_DCCBoostHvVolt_V_ovrdflg KOPM_DCCBoostHvVolt_V_ovrdval /end REF_CHARACTERISTIC
 /begin REF_MEASUREMENT VOPM_DCCBoostHvVolt_V /end REF_MEASUREMENT
/end GROUP
/begin GROUP S297_Subsys_VOPM_DCCBuckLVVolt_V "AppSwcOpm/Opm20ms/EptCAN_OUT_20ms/Msg_VCU_C_OprtCmd_EPT/Subsys_VOPM_DCCBuckLVVolt_V"
 /begin REF_CHARACTERISTIC KOPM_DCCBuckLVVoltHi_V KOPM_DCCBuckLVVoltLo_V KOPM_DCCBuckLVVolt_V_ovrdflg KOPM_DCCBuckLVVolt_V_ovrdval /end REF_CHARACTERISTIC
 /begin REF_MEASUREMENT VOPM_DCCBuckLVVolt_V /end REF_MEASUREMENT
/end GROUP
/begin GROUP S297_Subsys_VOPM_MaxHVDCCurntAC_A "AppSwcOpm/Opm20ms/EptCAN_OUT_20ms/Msg_VCU_C_OprtCmd_EPT/Subsys_VOPM_MaxHVDCCurntAC_A"
 /begin REF_CHARACTERISTIC KOPM_MaxHVDCCurntACHi_A KOPM_MaxHVDCCurntACLo_A KOPM_MaxHVDCCurntAC_A_ovrdflg KOPM_MaxHVDCCurntAC_A_ovrdval /end REF_CHARACTERISTIC
 /begin REF_MEASUREMENT VOPM_MaxHVDCCurntAC_A /end REF_MEASUREMENT
/end GROUP
/begin GROUP S297_Subsys_VOPM_MaxHVDCVoltAC_V "AppSwcOpm/Opm20ms/EptCAN_OUT_20ms/Msg_VCU_C_OprtCmd_EPT/Subsys_VOPM_MaxHVDCVoltAC_V"
 /begin REF_CHARACTERISTIC KOPM_MaxHVDCVoltACHi_V KOPM_MaxHVDCVoltACLo_V KOPM_MaxHVDCVoltAC_V_ovrdflg KOPM_MaxHVDCVoltAC_V_ovrdval /end REF_CHARACTERISTIC
 /begin REF_MEASUREMENT VOPM_MaxHVDCVoltAC_V /end REF_MEASUREMENT
/end GROUP
/begin GROUP S297_Subsys_VOPM_OBCIntDchrgEna_flg "AppSwcOpm/Opm20ms/EptCAN_OUT_20ms/Msg_VCU_C_OprtCmd_EPT/Subsys_VOPM_OBCIntDchrgEna_flg"
 /begin REF_CHARACTERISTIC KOPM_OBCIntDchrgEna_flg_ovrdflg KOPM_OBCIntDchrgEna_flg_ovrdval /end REF_CHARACTERISTIC
 /begin REF_MEASUREMENT VOPM_OBCIntDchrgEna_flg /end REF_MEASUREMENT
/end GROUP
/begin GROUP S327_Subsys_VOPM_12VBatLowVolSta_enum "AppSwcOpm/Opm50ms/BacCAN_OUT_50ms/Msg_BCML_B_Package/Subsys_VOPM_12VBatLowVolSta_enum"
 /begin REF_CHARACTERISTIC KOPM_12VBatLowVolStaHi_enum KOPM_12VBatLowVolStaLo_enum KOPM_12VBatLowVolSta_enum_ovrdflg KOPM_12VBatLowVolSta_enum_ovrdval /end REF_CHARACTERISTIC
 /begin REF_MEASUREMENT VOPM_12VBatLowVolSta_enum /end REF_MEASUREMENT
/end GROUP
/begin GROUP S327_Subsys_VOPM_BCMBrkPedSta_flg "AppSwcOpm/Opm50ms/BacCAN_OUT_50ms/Msg_BCML_B_Package/Subsys_VOPM_BCMBrkPedSta_flg"
 /begin REF_CHARACTERISTIC KOPM_BCMBrkPedSta_flg_ovrdflg KOPM_BCMBrkPedSta_flg_ovrdval /end REF_CHARACTERISTIC
 /begin REF_MEASUREMENT VOPM_BCMBrkPedSta_flg /end REF_MEASUREMENT
/end GROUP
/begin GROUP S327_Subsys_VOPM_BCMCenLckSts_enum "AppSwcOpm/Opm50ms/BacCAN_OUT_50ms/Msg_BCML_B_Package/Subsys_VOPM_BCMCenLckSts_enum"
 /begin REF_CHARACTERISTIC KOPM_BCMCenLckStsHi_enum KOPM_BCMCenLckStsLo_enum KOPM_BCMCenLckSts_enum_ovrdflg KOPM_BCMCenLckSts_enum_ovrdval /end REF_CHARACTERISTIC
 /begin REF_MEASUREMENT VOPM_BCMCenLckSts_enum /end REF_MEASUREMENT
/end GROUP
/begin GROUP S327_Subsys_VOPM_BCMCenLckSwCtrlFb_enum "AppSwcOpm/Opm50ms/BacCAN_OUT_50ms/Msg_BCML_B_Package/Subsys_VOPM_BCMCenLckSwCtrlFb_enum"
 /begin REF_CHARACTERISTIC KOPM_BCMCenLckSwCtrlFbHi_enum KOPM_BCMCenLckSwCtrlFbLo_enum KOPM_BCMCenLckSwCtrlFb_enum_ovrdflg KOPM_BCMCenLckSwCtrlFb_enum_ovrdval /end REF_CHARACTERISTIC
 /begin REF_MEASUREMENT VOPM_BCMCenLckSwCtrlFb_enum /end REF_MEASUREMENT
/end GROUP
/begin GROUP S327_Subsys_VOPM_BCMDoorLckStaFL_flg "AppSwcOpm/Opm50ms/BacCAN_OUT_50ms/Msg_BCML_B_Package/Subsys_VOPM_BCMDoorLckStaFL_flg"
 /begin REF_CHARACTERISTIC KOPM_BCMDoorLckStaFL_flg_ovrdflg KOPM_BCMDoorLckStaFL_flg_ovrdval /end REF_CHARACTERISTIC
 /begin REF_MEASUREMENT VOPM_BCMDoorLckStaFL_flg /end REF_MEASUREMENT
/end GROUP
/begin GROUP S327_Subsys_VOPM_BCMSysPowerSts_enum "AppSwcOpm/Opm50ms/BacCAN_OUT_50ms/Msg_BCML_B_Package/Subsys_VOPM_BCMSysPowerSts_enum"
 /begin REF_CHARACTERISTIC KOPM_BCMSysPowerStsHi_enum KOPM_BCMSysPowerStsLo_enum KOPM_BCMSysPowerSts_enum_ovrdflg KOPM_BCMSysPowerSts_enum_ovrdval /end REF_CHARACTERISTIC
 /begin REF_MEASUREMENT VOPM_BCMSysPowerSts_enum /end REF_MEASUREMENT
/end GROUP
/begin GROUP S327_Subsys_VOPM_BCMSysPwrModeVld_flg "AppSwcOpm/Opm50ms/BacCAN_OUT_50ms/Msg_BCML_B_Package/Subsys_VOPM_BCMSysPwrModeVld_flg"
 /begin REF_CHARACTERISTIC KOPM_BCMSysPwrModeVld_flg_ovrdflg KOPM_BCMSysPwrModeVld_flg_ovrdval /end REF_CHARACTERISTIC
 /begin REF_MEASUREMENT VOPM_BCMSysPwrModeVld_flg /end REF_MEASUREMENT
/end GROUP
/begin GROUP S327_Subsys_VOPM_BCMSysPwrMode_enum "AppSwcOpm/Opm50ms/BacCAN_OUT_50ms/Msg_BCML_B_Package/Subsys_VOPM_BCMSysPwrMode_enum"
 /begin REF_CHARACTERISTIC KOPM_BCMSysPwrModeHi_enum KOPM_BCMSysPwrModeLo_enum KOPM_BCMSysPwrMode_enum_ovrdflg KOPM_BCMSysPwrMode_enum_ovrdval /end REF_CHARACTERISTIC
 /begin REF_MEASUREMENT VOPM_BCMSysPwrMode_enum /end REF_MEASUREMENT
/end GROUP
/begin GROUP S327_Subsys_VOPM_HDCStat_enum "AppSwcOpm/Opm50ms/BacCAN_OUT_50ms/Msg_BCML_B_Package/Subsys_VOPM_HDCStat_enum"
 /begin REF_CHARACTERISTIC KOPM_HDCStatHi_enum KOPM_HDCStatLo_enum KOPM_HDCStat_enum_ovrdflg KOPM_HDCStat_enum_ovrdval /end REF_CHARACTERISTIC
 /begin REF_MEASUREMENT VOPM_HDCStat_enum /end REF_MEASUREMENT
/end GROUP
/begin GROUP S327_Subsys_VOPM_LimpHomeSta_flg "AppSwcOpm/Opm50ms/BacCAN_OUT_50ms/Msg_BCML_B_Package/Subsys_VOPM_LimpHomeSta_flg" /begin REF_CHARACTERISTIC KOPM_LimpHomeSta_flg_ovrdflg KOPM_LimpHomeSta_flg_ovrdval /end REF_CHARACTERISTIC /begin REF_MEASUREMENT VOPM_LimpHomeSta_flg /end REF_MEASUREMENT /end GROUP
/begin GROUP S327_Subsys_VOPM_PCUFailSta_flg "AppSwcOpm/Opm50ms/BacCAN_OUT_50ms/Msg_BCML_B_Package/Subsys_VOPM_PCUFailSta_flg" /begin REF_CHARACTERISTIC KOPM_PCUFailSta_flg_ovrdflg KOPM_PCUFailSta_flg_ovrdval /end REF_CHARACTERISTIC /begin REF_MEASUREMENT VOPM_PCUFailSta_flg /end REF_MEASUREMENT /end GROUP
/begin GROUP S327_Subsys_VOPM_PTActlOprtMode_enum "AppSwcOpm/Opm50ms/BacCAN_OUT_50ms/Msg_BCML_B_Package/Subsys_VOPM_PTActlOprtMode_enum"
 /begin REF_CHARACTERISTIC KOPM_PTActlOprtModeHi_enum KOPM_PTActlOprtModeLo_enum KOPM_PTActlOprtMode_enum_ovrdflg KOPM_PTActlOprtMode_enum_ovrdval /end REF_CHARACTERISTIC
 /begin REF_MEASUREMENT VOPM_PTActlOprtMode_enum /end REF_MEASUREMENT
/end GROUP
/begin GROUP S327_Subsys_VOPM_PrstlsStaFb_enum "AppSwcOpm/Opm50ms/BacCAN_OUT_50ms/Msg_BCML_B_Package/Subsys_VOPM_PrstlsStaFb_enum"
 /begin REF_CHARACTERISTIC KOPM_PrstlsStaFbHi_enum KOPM_PrstlsStaFbLo_enum KOPM_PrstlsStaFb_enum_ovrdflg KOPM_PrstlsStaFb_enum_ovrdval /end REF_CHARACTERISTIC
 /begin REF_MEASUREMENT VOPM_PrstlsStaFb_enum /end REF_MEASUREMENT
/end GROUP
/begin GROUP S327_Subsys_VOPM_PwrRecupIntnsty_enum "AppSwcOpm/Opm50ms/BacCAN_OUT_50ms/Msg_BCML_B_Package/Subsys_VOPM_PwrRecupIntnsty_enum"
 /begin REF_CHARACTERISTIC KOPM_PwrRecupIntnstyHi_enum KOPM_PwrRecupIntnstyLo_enum KOPM_PwrRecupIntnsty_enum_ovrdflg KOPM_PwrRecupIntnsty_enum_ovrdval /end REF_CHARACTERISTIC
 /begin REF_MEASUREMENT VOPM_PwrRecupIntnsty_enum /end REF_MEASUREMENT
/end GROUP
/begin GROUP S327_Subsys_VOPM_VehActDrvMod1_enum "AppSwcOpm/Opm50ms/BacCAN_OUT_50ms/Msg_BCML_B_Package/Subsys_VOPM_VehActDrvMod1_enum"
 /begin REF_CHARACTERISTIC KOPM_VehActDrvMod1Hi_enum KOPM_VehActDrvMod1Lo_enum KOPM_VehActDrvMod1_enum_ovrdflg KOPM_VehActDrvMod1_enum_ovrdval /end REF_CHARACTERISTIC
 /begin REF_MEASUREMENT VOPM_VehActDrvMod1_enum /end REF_MEASUREMENT
/end GROUP
/begin GROUP S327_Subsys_VOPM_VehActlGearPosVld_flg "AppSwcOpm/Opm50ms/BacCAN_OUT_50ms/Msg_BCML_B_Package/Subsys_VOPM_VehActlGearPosVld_flg"
 /begin REF_CHARACTERISTIC KOPM_VehActlGearPosVld_flg_ovrdflg KOPM_VehActlGearPosVld_flg_ovrdval /end REF_CHARACTERISTIC
 /begin REF_MEASUREMENT VOPM_VehActlGearPosVld_flg /end REF_MEASUREMENT
/end GROUP
/begin GROUP S327_Subsys_VOPM_VehActlGearPos_enum "AppSwcOpm/Opm50ms/BacCAN_OUT_50ms/Msg_BCML_B_Package/Subsys_VOPM_VehActlGearPos_enum"
 /begin REF_CHARACTERISTIC KOPM_VehActlGearPosHi_enum KOPM_VehActlGearPosLo_enum KOPM_VehActlGearPos_enum_ovrdflg KOPM_VehActlGearPos_enum_ovrdval /end REF_CHARACTERISTIC
 /begin REF_MEASUREMENT VOPM_VehActlGearPos_enum /end REF_MEASUREMENT
/end GROUP
/begin GROUP S328_Subsys_VOPM_BCMAjarStaHood_flg1 "AppSwcOpm/Opm50ms/BacCAN_OUT_50ms/Msg_BCM_B_Package_BAC/Subsys_VOPM_BCMAjarStaHood_flg1"
 /begin REF_CHARACTERISTIC KOPM_BCMAjarStaHood_flg_ovrdflg KOPM_BCMAjarStaHood_flg_ovrdval /end REF_CHARACTERISTIC
 /begin REF_MEASUREMENT VOPM_BCMAjarStaHood_flg /end REF_MEASUREMENT
/end GROUP
/begin GROUP S328_Subsys_VOPM_BCMAjarStaTrunk_flg1 "AppSwcOpm/Opm50ms/BacCAN_OUT_50ms/Msg_BCM_B_Package_BAC/Subsys_VOPM_BCMAjarStaTrunk_flg1"
 /begin REF_CHARACTERISTIC KOPM_BCMAjarStaTrunk_flg_ovrdflg KOPM_BCMAjarStaTrunk_flg_ovrdval /end REF_CHARACTERISTIC
 /begin REF_MEASUREMENT VOPM_BCMAjarStaTrunk_flg /end REF_MEASUREMENT
/end GROUP
/begin GROUP S328_Subsys_VOPM_BCMAjarStaVHoodVld_flg1 "AppSwcOpm/Opm50ms/BacCAN_OUT_50ms/Msg_BCM_B_Package_BAC/Subsys_VOPM_BCMAjarStaVHoodVld_flg1"
 /begin REF_CHARACTERISTIC KOPM_BCMAjarStaVHoodVld_flg_ovrdflg KOPM_BCMAjarStaVHoodVld_flg_ovrdval /end REF_CHARACTERISTIC
 /begin REF_MEASUREMENT VOPM_BCMAjarStaVHoodVld_flg /end REF_MEASUREMENT
/end GROUP
/begin GROUP S328_Subsys_VOPM_BCMAlrmHornReq_flg1 "AppSwcOpm/Opm50ms/BacCAN_OUT_50ms/Msg_BCM_B_Package_BAC/Subsys_VOPM_BCMAlrmHornReq_flg1"
 /begin REF_CHARACTERISTIC KOPM_BCMAlrmHornReq_flg_ovrdflg KOPM_BCMAlrmHornReq_flg_ovrdval /end REF_CHARACTERISTIC
 /begin REF_MEASUREMENT VOPM_BCMAlrmHornReq_flg /end REF_MEASUREMENT
/end GROUP
/begin GROUP S328_Subsys_VOPM_BCMAuthentKeyNr_enum1 "AppSwcOpm/Opm50ms/BacCAN_OUT_50ms/Msg_BCM_B_Package_BAC/Subsys_VOPM_BCMAuthentKeyNr_enum1"
 /begin REF_CHARACTERISTIC KOPM_BCMAuthentKeyNrHi_enum KOPM_BCMAuthentKeyNrLo_enum KOPM_BCMAuthentKeyNr_enum_ovrdflg KOPM_BCMAuthentKeyNr_enum_ovrdval /end REF_CHARACTERISTIC
 /begin REF_MEASUREMENT VOPM_BCMAuthentKeyNr_enum /end REF_MEASUREMENT
/end GROUP
/begin GROUP S328_Subsys_VOPM_BCMAutoLampStatus_flg1 "AppSwcOpm/Opm50ms/BacCAN_OUT_50ms/Msg_BCM_B_Package_BAC/Subsys_VOPM_BCMAutoLampStatus_flg1"
 /begin REF_CHARACTERISTIC KOPM_BCMAutoLampStatus_flg_ovrdflg KOPM_BCMAutoLampStatus_flg_ovrdval /end REF_CHARACTERISTIC
 /begin REF_MEASUREMENT VOPM_BCMAutoLampStatus_flg /end REF_MEASUREMENT
/end GROUP
/begin GROUP S328_Subsys_VOPM_BCMAvaluebleKeyInCar_flg1 "AppSwcOpm/Opm50ms/BacCAN_OUT_50ms/Msg_BCM_B_Package_BAC/Subsys_VOPM_BCMAvaluebleKeyInCar_flg1"
 /begin REF_CHARACTERISTIC KOPM_BCMAvaluebleKeyInCar_flg_ovrdflg KOPM_BCMAvaluebleKeyInCar_flg_ovrdval /end REF_CHARACTERISTIC
 /begin REF_MEASUREMENT VOPM_BCMAvaluebleKeyInCar_flg /end REF_MEASUREMENT
/end GROUP
/begin GROUP S328_Subsys_VOPM_BCMBackLadjvalFb_enum1 "AppSwcOpm/Opm50ms/BacCAN_OUT_50ms/Msg_BCM_B_Package_BAC/Subsys_VOPM_BCMBackLadjvalFb_enum1"
 /begin REF_CHARACTERISTIC KOPM_BCMBackLadjvalFbHi_enum KOPM_BCMBackLadjvalFbLo_enum KOPM_BCMBackLadjvalFb_enum_ovrdflg KOPM_BCMBackLadjvalFb_enum_ovrdval /end REF_CHARACTERISTIC
 /begin REF_MEASUREMENT VOPM_BCMBackLadjvalFb_enum /end REF_MEASUREMENT
/end GROUP
/begin GROUP S328_Subsys_VOPM_BCMBassHornReq_enum1 "AppSwcOpm/Opm50ms/BacCAN_OUT_50ms/Msg_BCM_B_Package_BAC/Subsys_VOPM_BCMBassHornReq_enum1"
 /begin REF_CHARACTERISTIC KOPM_BCMBassHornReqHi_enum KOPM_BCMBassHornReqLo_enum KOPM_BCMBassHornReq_enum_ovrdflg KOPM_BCMBassHornReq_enum_ovrdval /end REF_CHARACTERISTIC
 /begin REF_MEASUREMENT VOPM_BCMBassHornReq_enum /end REF_MEASUREMENT
/end GROUP
/begin GROUP S328_Subsys_VOPM_BCMBodyWarnSts_enum1 "AppSwcOpm/Opm50ms/BacCAN_OUT_50ms/Msg_BCM_B_Package_BAC/Subsys_VOPM_BCMBodyWarnSts_enum1"
 /begin REF_CHARACTERISTIC KOPM_BCMBodyWarnStsHi_enum KOPM_BCMBodyWarnStsLo_enum KOPM_BCMBodyWarnSts_enum_ovrdflg KOPM_BCMBodyWarnSts_enum_ovrdval /end REF_CHARACTERISTIC
 /begin REF_MEASUREMENT VOPM_BCMBodyWarnSts_enum /end REF_MEASUREMENT
/end GROUP
/begin GROUP S328_Subsys_VOPM_BCMBrakeLampSta_flg1 "AppSwcOpm/Opm50ms/BacCAN_OUT_50ms/Msg_BCM_B_Package_BAC/Subsys_VOPM_BCMBrakeLampSta_flg1"
 /begin REF_CHARACTERISTIC KOPM_BCMBrakeLampSta_flg_ovrdflg KOPM_BCMBrakeLampSta_flg_ovrdval /end REF_CHARACTERISTIC
 /begin REF_MEASUREMENT VOPM_BCMBrakeLampSta_flg /end REF_MEASUREMENT
/end GROUP
/begin GROUP S328_Subsys_VOPM_BCMChgWiprMtMdSwSetFb_enum1 "AppSwcOpm/Opm50ms/BacCAN_OUT_50ms/Msg_BCM_B_Package_BAC/Subsys_VOPM_BCMChgWiprMtMdSwSetFb_enum1"
 /begin REF_CHARACTERISTIC KOPM_BCMChgWiprMtMdSwSetFbHi_enum KOPM_BCMChgWiprMtMdSwSetFbLo_enum KOPM_BCMChgWiprMtMdSwSetFb_enum_ovrdflg KOPM_BCMChgWiprMtMdSwSetFb_enum_ovrdval /end REF_CHARACTERISTIC
 /begin REF_MEASUREMENT VOPM_BCMChgWiprMtMdSwSetFb_enum /end REF_MEASUREMENT
/end GROUP
/begin GROUP S328_Subsys_VOPM_BCMChrgLidLockReq_enum1 "AppSwcOpm/Opm50ms/BacCAN_OUT_50ms/Msg_BCM_B_Package_BAC/Subsys_VOPM_BCMChrgLidLockReq_enum1"
 /begin REF_CHARACTERISTIC KOPM_BCMChrgLidLockReqHi_enum KOPM_BCMChrgLidLockReqLo_enum KOPM_BCMChrgLidLockReq_enum_ovrdflg KOPM_BCMChrgLidLockReq_enum_ovrdval /end REF_CHARACTERISTIC
 /begin REF_MEASUREMENT VOPM_BCMChrgLidLockReq_enum /end REF_MEASUREMENT
/end GROUP
/begin GROUP S328_Subsys_VOPM_BCMDayRunLiSwSig_flg1 "AppSwcOpm/Opm50ms/BacCAN_OUT_50ms/Msg_BCM_B_Package_BAC/Subsys_VOPM_BCMDayRunLiSwSig_flg1"
 /begin REF_CHARACTERISTIC KOPM_BCMDayRunLiSwSig_flg_ovrdflg KOPM_BCMDayRunLiSwSig_flg_ovrdval /end REF_CHARACTERISTIC
 /begin REF_MEASUREMENT VOPM_BCMDayRunLiSwSig_flg /end REF_MEASUREMENT
/end GROUP
/begin GROUP S328_Subsys_VOPM_BCMDayRunLightSta_flg1 "AppSwcOpm/Opm50ms/BacCAN_OUT_50ms/Msg_BCM_B_Package_BAC/Subsys_VOPM_BCMDayRunLightSta_flg1"
 /begin REF_CHARACTERISTIC KOPM_BCMDayRunLightSta_flg_ovrdflg KOPM_BCMDayRunLightSta_flg_ovrdval /end REF_CHARACTERISTIC
 /begin REF_MEASUREMENT VOPM_BCMDayRunLightSta_flg /end REF_MEASUREMENT
/end GROUP
/begin GROUP S328_Subsys_VOPM_BCMDoorAjarStaFL_flg1 "AppSwcOpm/Opm50ms/BacCAN_OUT_50ms/Msg_BCM_B_Package_BAC/Subsys_VOPM_BCMDoorAjarStaFL_flg1"
 /begin REF_CHARACTERISTIC KOPM_BCMDoorAjarStaFL_flg_ovrdflg KOPM_BCMDoorAjarStaFL_flg_ovrdval /end REF_CHARACTERISTIC
 /begin REF_MEASUREMENT VOPM_BCMDoorAjarStaFL_flg /end REF_MEASUREMENT
/end GROUP
/begin GROUP S328_Subsys_VOPM_BCMDoorAjarStaFR_flg1 "AppSwcOpm/Opm50ms/BacCAN_OUT_50ms/Msg_BCM_B_Package_BAC/Subsys_VOPM_BCMDoorAjarStaFR_flg1"
 /begin REF_CHARACTERISTIC KOPM_BCMDoorAjarStaFR_flg_ovrdflg KOPM_BCMDoorAjarStaFR_flg_ovrdval /end REF_CHARACTERISTIC
 /begin REF_MEASUREMENT VOPM_BCMDoorAjarStaFR_flg /end REF_MEASUREMENT
/end GROUP
/begin GROUP S328_Subsys_VOPM_BCMDoorAjarStaRL_flg1 "AppSwcOpm/Opm50ms/BacCAN_OUT_50ms/Msg_BCM_B_Package_BAC/Subsys_VOPM_BCMDoorAjarStaRL_flg1"
 /begin REF_CHARACTERISTIC KOPM_BCMDoorAjarStaRL_flg_ovrdflg KOPM_BCMDoorAjarStaRL_flg_ovrdval /end REF_CHARACTERISTIC
 /begin REF_MEASUREMENT VOPM_BCMDoorAjarStaRL_flg /end REF_MEASUREMENT
/end GROUP
/begin GROUP S328_Subsys_VOPM_BCMDoorAjarStaRR_flg1 "AppSwcOpm/Opm50ms/BacCAN_OUT_50ms/Msg_BCM_B_Package_BAC/Subsys_VOPM_BCMDoorAjarStaRR_flg1"
 /begin REF_CHARACTERISTIC KOPM_BCMDoorAjarStaRR_flg_ovrdflg KOPM_BCMDoorAjarStaRR_flg_ovrdval /end REF_CHARACTERISTIC
 /begin REF_MEASUREMENT VOPM_BCMDoorAjarStaRR_flg /end REF_MEASUREMENT
/end GROUP
/begin GROUP S328_Subsys_VOPM_BCMDrvPEAuthentAcsd_enum1 "AppSwcOpm/Opm50ms/BacCAN_OUT_50ms/Msg_BCM_B_Package_BAC/Subsys_VOPM_BCMDrvPEAuthentAcsd_enum1"
 /begin REF_CHARACTERISTIC KOPM_BCMDrvPEAuthentAcsdHi_enum KOPM_BCMDrvPEAuthentAcsdLo_enum KOPM_BCMDrvPEAuthentAcsd_enum_ovrdflg KOPM_BCMDrvPEAuthentAcsd_enum_ovrdval /end REF_CHARACTERISTIC
 /begin REF_MEASUREMENT VOPM_BCMDrvPEAuthentAcsd_enum /end REF_MEASUREMENT
/end GROUP
/begin GROUP S328_Subsys_VOPM_BCMDrvSeatOccptSnsrSts_enum1 "AppSwcOpm/Opm50ms/BacCAN_OUT_50ms/Msg_BCM_B_Package_BAC/Subsys_VOPM_BCMDrvSeatOccptSnsrSts_enum1"
 /begin REF_CHARACTERISTIC KOPM_BCMDrvSeatOccptSnsrStsHi_enum KOPM_BCMDrvSeatOccptSnsrStsLo_enum KOPM_BCMDrvSeatOccptSnsrSts_enum_ovrdflg KOPM_BCMDrvSeatOccptSnsrSts_enum_ovrdval /end REF_CHARACTERISTIC
 /begin REF_MEASUREMENT VOPM_BCMDrvSeatOccptSnsrSts_enum /end REF_MEASUREMENT
/end GROUP
/begin GROUP S328_Subsys_VOPM_BCMDrvrWinSwSig_enum1 "AppSwcOpm/Opm50ms/BacCAN_OUT_50ms/Msg_BCM_B_Package_BAC/Subsys_VOPM_BCMDrvrWinSwSig_enum1"
 /begin REF_CHARACTERISTIC KOPM_BCMDrvrWinSwSigHi_enum KOPM_BCMDrvrWinSwSigLo_enum KOPM_BCMDrvrWinSwSig_enum_ovrdflg KOPM_BCMDrvrWinSwSig_enum_ovrdval /end REF_CHARACTERISTIC
 /begin REF_MEASUREMENT VOPM_BCMDrvrWinSwSig_enum /end REF_MEASUREMENT
/end GROUP
/begin GROUP S328_Subsys_VOPM_BCMFLWinSts_flg1 "AppSwcOpm/Opm50ms/BacCAN_OUT_50ms/Msg_BCM_B_Package_BAC/Subsys_VOPM_BCMFLWinSts_flg1" /begin REF_CHARACTERISTIC KOPM_BCMFLWinSts_flg_ovrdflg KOPM_BCMFLWinSts_flg_ovrdval /end REF_CHARACTERISTIC /begin REF_MEASUREMENT VOPM_BCMFLWinSts_flg /end REF_MEASUREMENT /end GROUP
/begin GROUP S328_Subsys_VOPM_BCMFLWinmotorSts_enum1 "AppSwcOpm/Opm50ms/BacCAN_OUT_50ms/Msg_BCM_B_Package_BAC/Subsys_VOPM_BCMFLWinmotorSts_enum1"
 /begin REF_CHARACTERISTIC KOPM_BCMFLWinmotorStsHi_enum KOPM_BCMFLWinmotorStsLo_enum KOPM_BCMFLWinmotorSts_enum_ovrdflg KOPM_BCMFLWinmotorSts_enum_ovrdval /end REF_CHARACTERISTIC
 /begin REF_MEASUREMENT VOPM_BCMFLWinmotorSts_enum /end REF_MEASUREMENT
/end GROUP
/begin GROUP S328_Subsys_VOPM_BCMFRPEAuthentAcsd_enum1 "AppSwcOpm/Opm50ms/BacCAN_OUT_50ms/Msg_BCM_B_Package_BAC/Subsys_VOPM_BCMFRPEAuthentAcsd_enum1"
 /begin REF_CHARACTERISTIC KOPM_BCMFRPEAuthentAcsdHi_enum KOPM_BCMFRPEAuthentAcsdLo_enum KOPM_BCMFRPEAuthentAcsd_enum_ovrdflg KOPM_BCMFRPEAuthentAcsd_enum_ovrdval /end REF_CHARACTERISTIC
 /begin REF_MEASUREMENT VOPM_BCMFRPEAuthentAcsd_enum /end REF_MEASUREMENT
/end GROUP
/begin GROUP S328_Subsys_VOPM_BCMFRWinSts_flg1 "AppSwcOpm/Opm50ms/BacCAN_OUT_50ms/Msg_BCM_B_Package_BAC/Subsys_VOPM_BCMFRWinSts_flg1" /begin REF_CHARACTERISTIC KOPM_BCMFRWinSts_flg_ovrdflg KOPM_BCMFRWinSts_flg_ovrdval /end REF_CHARACTERISTIC /begin REF_MEASUREMENT VOPM_BCMFRWinSts_flg /end REF_MEASUREMENT /end GROUP
/begin GROUP S328_Subsys_VOPM_BCMFRWinmotorSts_enum1 "AppSwcOpm/Opm50ms/BacCAN_OUT_50ms/Msg_BCM_B_Package_BAC/Subsys_VOPM_BCMFRWinmotorSts_enum1"
 /begin REF_CHARACTERISTIC KOPM_BCMFRWinmotorStsHi_enum KOPM_BCMFRWinmotorStsLo_enum KOPM_BCMFRWinmotorSts_enum_ovrdflg KOPM_BCMFRWinmotorSts_enum_ovrdval /end REF_CHARACTERISTIC
 /begin REF_MEASUREMENT VOPM_BCMFRWinmotorSts_enum /end REF_MEASUREMENT
/end GROUP
/begin GROUP S328_Subsys_VOPM_BCMFlwrMeHmCtrlFb_enum1 "AppSwcOpm/Opm50ms/BacCAN_OUT_50ms/Msg_BCM_B_Package_BAC/Subsys_VOPM_BCMFlwrMeHmCtrlFb_enum1"
 /begin REF_CHARACTERISTIC KOPM_BCMFlwrMeHmCtrlFbHi_enum KOPM_BCMFlwrMeHmCtrlFbLo_enum KOPM_BCMFlwrMeHmCtrlFb_enum_ovrdflg KOPM_BCMFlwrMeHmCtrlFb_enum_ovrdval /end REF_CHARACTERISTIC
 /begin REF_MEASUREMENT VOPM_BCMFlwrMeHmCtrlFb_enum /end REF_MEASUREMENT
/end GROUP
/begin GROUP S328_Subsys_VOPM_BCMFogLampStaFront_flg1 "AppSwcOpm/Opm50ms/BacCAN_OUT_50ms/Msg_BCM_B_Package_BAC/Subsys_VOPM_BCMFogLampStaFront_flg1"
 /begin REF_CHARACTERISTIC KOPM_BCMFogLampStaFront_flg_ovrdflg KOPM_BCMFogLampStaFront_flg_ovrdval /end REF_CHARACTERISTIC
 /begin REF_MEASUREMENT VOPM_BCMFogLampStaFront_flg /end REF_MEASUREMENT
/end GROUP
/begin GROUP S328_Subsys_VOPM_BCMFogLampStaRear_flg1 "AppSwcOpm/Opm50ms/BacCAN_OUT_50ms/Msg_BCM_B_Package_BAC/Subsys_VOPM_BCMFogLampStaRear_flg1"
 /begin REF_CHARACTERISTIC KOPM_BCMFogLampStaRear_flg_ovrdflg KOPM_BCMFogLampStaRear_flg_ovrdval /end REF_CHARACTERISTIC
 /begin REF_MEASUREMENT VOPM_BCMFogLampStaRear_flg /end REF_MEASUREMENT
/end GROUP
/begin GROUP S328_Subsys_VOPM_BCMFrbdnKeyNr_enum1 "AppSwcOpm/Opm50ms/BacCAN_OUT_50ms/Msg_BCM_B_Package_BAC/Subsys_VOPM_BCMFrbdnKeyNr_enum1"
 /begin REF_CHARACTERISTIC KOPM_BCMFrbdnKeyNrHi_enum KOPM_BCMFrbdnKeyNrLo_enum KOPM_BCMFrbdnKeyNr_enum_ovrdflg KOPM_BCMFrbdnKeyNr_enum_ovrdval /end REF_CHARACTERISTIC
 /begin REF_MEASUREMENT VOPM_BCMFrbdnKeyNr_enum /end REF_MEASUREMENT
/end GROUP
/begin GROUP S328_Subsys_VOPM_BCMFrntFogLiSwSig_flg1 "AppSwcOpm/Opm50ms/BacCAN_OUT_50ms/Msg_BCM_B_Package_BAC/Subsys_VOPM_BCMFrntFogLiSwSig_flg1"
 /begin REF_CHARACTERISTIC KOPM_BCMFrntFogLiSwSig_flg_ovrdflg KOPM_BCMFrntFogLiSwSig_flg_ovrdval /end REF_CHARACTERISTIC
 /begin REF_MEASUREMENT VOPM_BCMFrntFogLiSwSig_flg /end REF_MEASUREMENT
/end GROUP
/begin GROUP S328_Subsys_VOPM_BCMFrntLeDoorHndlSwt_enum1 "AppSwcOpm/Opm50ms/BacCAN_OUT_50ms/Msg_BCM_B_Package_BAC/Subsys_VOPM_BCMFrntLeDoorHndlSwt_enum1"
 /begin REF_CHARACTERISTIC KOPM_BCMFrntLeDoorHndlSwtHi_enum KOPM_BCMFrntLeDoorHndlSwtLo_enum KOPM_BCMFrntLeDoorHndlSwt_enum_ovrdflg KOPM_BCMFrntLeDoorHndlSwt_enum_ovrdval /end REF_CHARACTERISTIC
 /begin REF_MEASUREMENT VOPM_BCMFrntLeDoorHndlSwt_enum /end REF_MEASUREMENT
/end GROUP
/begin GROUP S328_Subsys_VOPM_BCMFrntRiDoorHndlSwt_enum1 "AppSwcOpm/Opm50ms/BacCAN_OUT_50ms/Msg_BCM_B_Package_BAC/Subsys_VOPM_BCMFrntRiDoorHndlSwt_enum1"
 /begin REF_CHARACTERISTIC KOPM_BCMFrntRiDoorHndlSwtHi_enum KOPM_BCMFrntRiDoorHndlSwtLo_enum KOPM_BCMFrntRiDoorHndlSwt_enum_ovrdflg KOPM_BCMFrntRiDoorHndlSwt_enum_ovrdval /end REF_CHARACTERISTIC
 /begin REF_MEASUREMENT VOPM_BCMFrntRiDoorHndlSwt_enum /end REF_MEASUREMENT
/end GROUP
/begin GROUP S328_Subsys_VOPM_BCMFrntWiprMotSts_enum "AppSwcOpm/Opm50ms/BacCAN_OUT_50ms/Msg_BCM_B_Package_BAC/Subsys_VOPM_BCMFrntWiprMotSts_enum"
 /begin REF_CHARACTERISTIC KOPM_BCMFrntWiprMotStsHi_enum KOPM_BCMFrntWiprMotStsLo_enum KOPM_BCMFrntWiprMotSts_enum_ovrdflg KOPM_BCMFrntWiprMotSts_enum_ovrdval /end REF_CHARACTERISTIC
 /begin REF_MEASUREMENT VOPM_BCMFrntWiprMotSts_enum /end REF_MEASUREMENT
/end GROUP
/begin GROUP S328_Subsys_VOPM_BCMFrntWshrSwSig_flg1 "AppSwcOpm/Opm50ms/BacCAN_OUT_50ms/Msg_BCM_B_Package_BAC/Subsys_VOPM_BCMFrntWshrSwSig_flg1"
 /begin REF_CHARACTERISTIC KOPM_BCMFrntWshrSwSig_flg_ovrdflg KOPM_BCMFrntWshrSwSig_flg_ovrdval /end REF_CHARACTERISTIC
 /begin REF_MEASUREMENT VOPM_BCMFrntWshrSwSig_flg /end REF_MEASUREMENT
/end GROUP
/begin GROUP S328_Subsys_VOPM_BCMFrontWashSts_flg1 "AppSwcOpm/Opm50ms/BacCAN_OUT_50ms/Msg_BCM_B_Package_BAC/Subsys_VOPM_BCMFrontWashSts_flg1"
 /begin REF_CHARACTERISTIC KOPM_BCMFrontWashSts_flg_ovrdflg KOPM_BCMFrontWashSts_flg_ovrdval /end REF_CHARACTERISTIC
 /begin REF_MEASUREMENT VOPM_BCMFrontWashSts_flg /end REF_MEASUREMENT
/end GROUP
/begin GROUP S328_Subsys_VOPM_BCMHazardLampSts_flg1 "AppSwcOpm/Opm50ms/BacCAN_OUT_50ms/Msg_BCM_B_Package_BAC/Subsys_VOPM_BCMHazardLampSts_flg1"
 /begin REF_CHARACTERISTIC KOPM_BCMHazardLampSts_flg_ovrdflg KOPM_BCMHazardLampSts_flg_ovrdval /end REF_CHARACTERISTIC
 /begin REF_MEASUREMENT VOPM_BCMHazardLampSts_flg /end REF_MEASUREMENT
/end GROUP
/begin GROUP S328_Subsys_VOPM_BCMHiBeamSwSig_enum1 "AppSwcOpm/Opm50ms/BacCAN_OUT_50ms/Msg_BCM_B_Package_BAC/Subsys_VOPM_BCMHiBeamSwSig_enum1"
 /begin REF_CHARACTERISTIC KOPM_BCMHiBeamSwSigHi_enum KOPM_BCMHiBeamSwSigLo_enum KOPM_BCMHiBeamSwSig_enum_ovrdflg KOPM_BCMHiBeamSwSig_enum_ovrdval /end REF_CHARACTERISTIC
 /begin REF_MEASUREMENT VOPM_BCMHiBeamSwSig_enum /end REF_MEASUREMENT
/end GROUP
/begin GROUP S328_Subsys_VOPM_BCMHighBeamSta_flg1 "AppSwcOpm/Opm50ms/BacCAN_OUT_50ms/Msg_BCM_B_Package_BAC/Subsys_VOPM_BCMHighBeamSta_flg1"
 /begin REF_CHARACTERISTIC KOPM_BCMHighBeamSta_flg_ovrdflg KOPM_BCMHighBeamSta_flg_ovrdval /end REF_CHARACTERISTIC
 /begin REF_MEASUREMENT VOPM_BCMHighBeamSta_flg /end REF_MEASUREMENT
/end GROUP
/begin GROUP S328_Subsys_VOPM_BCMHvyRainInd_flg1 "AppSwcOpm/Opm50ms/BacCAN_OUT_50ms/Msg_BCM_B_Package_BAC/Subsys_VOPM_BCMHvyRainInd_flg1"
 /begin REF_CHARACTERISTIC KOPM_BCMHvyRainInd_flg_ovrdflg KOPM_BCMHvyRainInd_flg_ovrdval /end REF_CHARACTERISTIC
 /begin REF_MEASUREMENT VOPM_BCMHvyRainInd_flg /end REF_MEASUREMENT
/end GROUP
/begin GROUP S328_Subsys_VOPM_BCMHzrdWrngLghtSwSig_flg1 "AppSwcOpm/Opm50ms/BacCAN_OUT_50ms/Msg_BCM_B_Package_BAC/Subsys_VOPM_BCMHzrdWrngLghtSwSig_flg1"
 /begin REF_CHARACTERISTIC KOPM_BCMHzrdWrngLghtSwSig_flg_ovrdflg KOPM_BCMHzrdWrngLghtSwSig_flg_ovrdval /end REF_CHARACTERISTIC
 /begin REF_MEASUREMENT VOPM_BCMHzrdWrngLghtSwSig_flg /end REF_MEASUREMENT
/end GROUP
/begin GROUP S328_Subsys_VOPM_BCMIllmndEntryStsFb_flg1 "AppSwcOpm/Opm50ms/BacCAN_OUT_50ms/Msg_BCM_B_Package_BAC/Subsys_VOPM_BCMIllmndEntryStsFb_flg1"
 /begin REF_CHARACTERISTIC KOPM_BCMIllmndEntryStsFb_flg_ovrdflg KOPM_BCMIllmndEntryStsFb_flg_ovrdval /end REF_CHARACTERISTIC
 /begin REF_MEASUREMENT VOPM_BCMIllmndEntryStsFb_flg /end REF_MEASUREMENT
/end GROUP
/begin GROUP S328_Subsys_VOPM_BCMIllmndLampReq_flg1 "AppSwcOpm/Opm50ms/BacCAN_OUT_50ms/Msg_BCM_B_Package_BAC/Subsys_VOPM_BCMIllmndLampReq_flg1"
 /begin REF_CHARACTERISTIC KOPM_BCMIllmndLampReq_flg_ovrdflg KOPM_BCMIllmndLampReq_flg_ovrdval /end REF_CHARACTERISTIC
 /begin REF_MEASUREMENT VOPM_BCMIllmndLampReq_flg /end REF_MEASUREMENT
/end GROUP
/begin GROUP S328_Subsys_VOPM_BCMIllmndLockReq_enum1 "AppSwcOpm/Opm50ms/BacCAN_OUT_50ms/Msg_BCM_B_Package_BAC/Subsys_VOPM_BCMIllmndLockReq_enum1"
 /begin REF_CHARACTERISTIC KOPM_BCMIllmndLockReqHi_enum KOPM_BCMIllmndLockReqLo_enum KOPM_BCMIllmndLockReq_enum_ovrdflg KOPM_BCMIllmndLockReq_enum_ovrdval /end REF_CHARACTERISTIC
 /begin REF_MEASUREMENT VOPM_BCMIllmndLockReq_enum /end REF_MEASUREMENT
/end GROUP
/begin GROUP S328_Subsys_VOPM_BCMIllmndSts_enum1 "AppSwcOpm/Opm50ms/BacCAN_OUT_50ms/Msg_BCM_B_Package_BAC/Subsys_VOPM_BCMIllmndSts_enum1"
 /begin REF_CHARACTERISTIC KOPM_BCMIllmndStsHi_enum KOPM_BCMIllmndStsLo_enum KOPM_BCMIllmndSts_enum_ovrdflg KOPM_BCMIllmndSts_enum_ovrdval /end REF_CHARACTERISTIC
 /begin REF_MEASUREMENT VOPM_BCMIllmndSts_enum /end REF_MEASUREMENT
/end GROUP
/begin GROUP S328_Subsys_VOPM_BCMIndcnKeyClsr_flg1 "AppSwcOpm/Opm50ms/BacCAN_OUT_50ms/Msg_BCM_B_Package_BAC/Subsys_VOPM_BCMIndcnKeyClsr_flg1"
 /begin REF_CHARACTERISTIC KOPM_BCMIndcnKeyClsr_flg_ovrdflg KOPM_BCMIndcnKeyClsr_flg_ovrdval /end REF_CHARACTERISTIC
 /begin REF_MEASUREMENT VOPM_BCMIndcnKeyClsr_flg /end REF_MEASUREMENT
/end GROUP
/begin GROUP S328_Subsys_VOPM_BCMIndcnShfttoNeut_flg1 "AppSwcOpm/Opm50ms/BacCAN_OUT_50ms/Msg_BCM_B_Package_BAC/Subsys_VOPM_BCMIndcnShfttoNeut_flg1"
 /begin REF_CHARACTERISTIC KOPM_BCMIndcnShfttoNeut_flg_ovrdflg KOPM_BCMIndcnShfttoNeut_flg_ovrdval /end REF_CHARACTERISTIC
 /begin REF_MEASUREMENT VOPM_BCMIndcnShfttoNeut_flg /end REF_MEASUREMENT
/end GROUP
/begin GROUP S328_Subsys_VOPM_BCMKeyBattLvlSts_flg1 "AppSwcOpm/Opm50ms/BacCAN_OUT_50ms/Msg_BCM_B_Package_BAC/Subsys_VOPM_BCMKeyBattLvlSts_flg1"
 /begin REF_CHARACTERISTIC KOPM_BCMKeyBattLvlSts_flg_ovrdflg KOPM_BCMKeyBattLvlSts_flg_ovrdval /end REF_CHARACTERISTIC
 /begin REF_MEASUREMENT VOPM_BCMKeyBattLvlSts_flg /end REF_MEASUREMENT
/end GROUP
/begin GROUP S328_Subsys_VOPM_BCMKeyBattLvl_pct1 "AppSwcOpm/Opm50ms/BacCAN_OUT_50ms/Msg_BCM_B_Package_BAC/Subsys_VOPM_BCMKeyBattLvl_pct1"
 /begin REF_CHARACTERISTIC KOPM_BCMKeyBattLvlHi_pct KOPM_BCMKeyBattLvlLo_pct KOPM_BCMKeyBattLvl_pct_ovrdflg KOPM_BCMKeyBattLvl_pct_ovrdval /end REF_CHARACTERISTIC
 /begin REF_MEASUREMENT VOPM_BCMKeyBattLvl_pct /end REF_MEASUREMENT
/end GROUP
/begin GROUP S328_Subsys_VOPM_BCMKeyFrbdn_flg1 "AppSwcOpm/Opm50ms/BacCAN_OUT_50ms/Msg_BCM_B_Package_BAC/Subsys_VOPM_BCMKeyFrbdn_flg1" /begin REF_CHARACTERISTIC KOPM_BCMKeyFrbdn_flg_ovrdflg KOPM_BCMKeyFrbdn_flg_ovrdval /end REF_CHARACTERISTIC /begin REF_MEASUREMENT VOPM_BCMKeyFrbdn_flg /end REF_MEASUREMENT /end GROUP
/begin GROUP S328_Subsys_VOPM_BCMKeyIDFb_enum1 "AppSwcOpm/Opm50ms/BacCAN_OUT_50ms/Msg_BCM_B_Package_BAC/Subsys_VOPM_BCMKeyIDFb_enum1"
 /begin REF_CHARACTERISTIC KOPM_BCMKeyIDFbHi_enum KOPM_BCMKeyIDFbLo_enum KOPM_BCMKeyIDFb_enum_ovrdflg KOPM_BCMKeyIDFb_enum_ovrdval /end REF_CHARACTERISTIC
 /begin REF_MEASUREMENT VOPM_BCMKeyIDFb_enum /end REF_MEASUREMENT
/end GROUP
/begin GROUP S328_Subsys_VOPM_BCMKeyInCarSta_flg1 "AppSwcOpm/Opm50ms/BacCAN_OUT_50ms/Msg_BCM_B_Package_BAC/Subsys_VOPM_BCMKeyInCarSta_flg1"
 /begin REF_CHARACTERISTIC KOPM_BCMKeyInCarSta_flg_ovrdflg KOPM_BCMKeyInCarSta_flg_ovrdval /end REF_CHARACTERISTIC
 /begin REF_MEASUREMENT VOPM_BCMKeyInCarSta_flg /end REF_MEASUREMENT
/end GROUP
/begin GROUP S328_Subsys_VOPM_BCMKeyLoBattLvlWarn_flg1 "AppSwcOpm/Opm50ms/BacCAN_OUT_50ms/Msg_BCM_B_Package_BAC/Subsys_VOPM_BCMKeyLoBattLvlWarn_flg1"
 /begin REF_CHARACTERISTIC KOPM_BCMKeyLoBattLvlWarn_flg_ovrdflg KOPM_BCMKeyLoBattLvlWarn_flg_ovrdval /end REF_CHARACTERISTIC
 /begin REF_MEASUREMENT VOPM_BCMKeyLoBattLvlWarn_flg /end REF_MEASUREMENT
/end GROUP
/begin GROUP S328_Subsys_VOPM_BCMKeyLocn_mm1 "AppSwcOpm/Opm50ms/BacCAN_OUT_50ms/Msg_BCM_B_Package_BAC/Subsys_VOPM_BCMKeyLocn_mm1"
 /begin REF_CHARACTERISTIC KOPM_BCMKeyLocnHi_mm KOPM_BCMKeyLocnLo_mm KOPM_BCMKeyLocn_mm_ovrdflg KOPM_BCMKeyLocn_mm_ovrdval /end REF_CHARACTERISTIC
 /begin REF_MEASUREMENT VOPM_BCMKeyLocn_mm /end REF_MEASUREMENT
/end GROUP
/begin GROUP S328_Subsys_VOPM_BCMKeySta_enum1 "AppSwcOpm/Opm50ms/BacCAN_OUT_50ms/Msg_BCM_B_Package_BAC/Subsys_VOPM_BCMKeySta_enum1"
 /begin REF_CHARACTERISTIC KOPM_BCMKeyStaHi_enum KOPM_BCMKeyStaLo_enum KOPM_BCMKeySta_enum_ovrdflg KOPM_BCMKeySta_enum_ovrdval /end REF_CHARACTERISTIC
 /begin REF_MEASUREMENT VOPM_BCMKeySta_enum /end REF_MEASUREMENT
/end GROUP
/begin GROUP S328_Subsys_VOPM_BCMLckHornOnStFb_flg1 "AppSwcOpm/Opm50ms/BacCAN_OUT_50ms/Msg_BCM_B_Package_BAC/Subsys_VOPM_BCMLckHornOnStFb_flg1"
 /begin REF_CHARACTERISTIC KOPM_BCMLckHornOnStFb_flg_ovrdflg KOPM_BCMLckHornOnStFb_flg_ovrdval /end REF_CHARACTERISTIC
 /begin REF_MEASUREMENT VOPM_BCMLckHornOnStFb_flg /end REF_MEASUREMENT
/end GROUP
/begin GROUP S328_Subsys_VOPM_BCMLeTrnLiFltFb_enum "AppSwcOpm/Opm50ms/BacCAN_OUT_50ms/Msg_BCM_B_Package_BAC/Subsys_VOPM_BCMLeTrnLiFltFb_enum"
 /begin REF_CHARACTERISTIC KOPM_BCMLeTrnLiFltFbHi_enum KOPM_BCMLeTrnLiFltFbLo_enum KOPM_BCMLeTrnLiFltFb_enum_ovrdflg KOPM_BCMLeTrnLiFltFb_enum_ovrdval /end REF_CHARACTERISTIC
 /begin REF_MEASUREMENT VOPM_BCMLeTrnLiFltFb_enum /end REF_MEASUREMENT
/end GROUP
/begin GROUP S328_Subsys_VOPM_BCMLghtSwSig_enum1 "AppSwcOpm/Opm50ms/BacCAN_OUT_50ms/Msg_BCM_B_Package_BAC/Subsys_VOPM_BCMLghtSwSig_enum1"
 /begin REF_CHARACTERISTIC KOPM_BCMLghtSwSigHi_enum KOPM_BCMLghtSwSigLo_enum KOPM_BCMLghtSwSig_enum_ovrdflg KOPM_BCMLghtSwSig_enum_ovrdval /end REF_CHARACTERISTIC
 /begin REF_MEASUREMENT VOPM_BCMLghtSwSig_enum /end REF_MEASUREMENT
/end GROUP
/begin GROUP S328_Subsys_VOPM_BCMLightIntensity_enum1 "AppSwcOpm/Opm50ms/BacCAN_OUT_50ms/Msg_BCM_B_Package_BAC/Subsys_VOPM_BCMLightIntensity_enum1"
 /begin REF_CHARACTERISTIC KOPM_BCMLightIntensityHi_enum KOPM_BCMLightIntensityLo_enum KOPM_BCMLightIntensity_enum_ovrdflg KOPM_BCMLightIntensity_enum_ovrdval /end REF_CHARACTERISTIC
 /begin REF_MEASUREMENT VOPM_BCMLightIntensity_enum /end REF_MEASUREMENT
/end GROUP
/begin GROUP S328_Subsys_VOPM_BCMLogoActvFlg_enum "AppSwcOpm/Opm50ms/BacCAN_OUT_50ms/Msg_BCM_B_Package_BAC/Subsys_VOPM_BCMLogoActvFlg_enum"
 /begin REF_CHARACTERISTIC KOPM_BCMLogoActvFlgHi_enum KOPM_BCMLogoActvFlgLo_enum KOPM_BCMLogoActvFlg_enum_ovrdflg KOPM_BCMLogoActvFlg_enum_ovrdval /end REF_CHARACTERISTIC
 /begin REF_MEASUREMENT VOPM_BCMLogoActvFlg_enum /end REF_MEASUREMENT
/end GROUP
/begin GROUP S328_Subsys_VOPM_BCMLowBeamSta_flg1 "AppSwcOpm/Opm50ms/BacCAN_OUT_50ms/Msg_BCM_B_Package_BAC/Subsys_VOPM_BCMLowBeamSta_flg1"
 /begin REF_CHARACTERISTIC KOPM_BCMLowBeamSta_flg_ovrdflg KOPM_BCMLowBeamSta_flg_ovrdval /end REF_CHARACTERISTIC
 /begin REF_MEASUREMENT VOPM_BCMLowBeamSta_flg /end REF_MEASUREMENT
/end GROUP
/begin GROUP S328_Subsys_VOPM_BCMMaiDrvrSeatSts_enum1 "AppSwcOpm/Opm50ms/BacCAN_OUT_50ms/Msg_BCM_B_Package_BAC/Subsys_VOPM_BCMMaiDrvrSeatSts_enum1"
 /begin REF_CHARACTERISTIC KOPM_BCMMaiDrvrSeatStsHi_enum KOPM_BCMMaiDrvrSeatStsLo_enum KOPM_BCMMaiDrvrSeatSts_enum_ovrdflg KOPM_BCMMaiDrvrSeatSts_enum_ovrdval /end REF_CHARACTERISTIC
 /begin REF_MEASUREMENT VOPM_BCMMaiDrvrSeatSts_enum /end REF_MEASUREMENT
/end GROUP
/begin GROUP S328_Subsys_VOPM_BCMMaiDrvrSeatTemp_C1 "AppSwcOpm/Opm50ms/BacCAN_OUT_50ms/Msg_BCM_B_Package_BAC/Subsys_VOPM_BCMMaiDrvrSeatTemp_C1"
 /begin REF_CHARACTERISTIC KOPM_BCMMaiDrvrSeatTempHi_C KOPM_BCMMaiDrvrSeatTempLo_C KOPM_BCMMaiDrvrSeatTemp_C_ovrdflg KOPM_BCMMaiDrvrSeatTemp_C_ovrdval /end REF_CHARACTERISTIC
 /begin REF_MEASUREMENT VOPM_BCMMaiDrvrSeatTemp_C /end REF_MEASUREMENT
/end GROUP
/begin GROUP S328_Subsys_VOPM_BCMOvrspdCntrlLckSetFb_flg1 "AppSwcOpm/Opm50ms/BacCAN_OUT_50ms/Msg_BCM_B_Package_BAC/Subsys_VOPM_BCMOvrspdCntrlLckSetFb_flg1"
 /begin REF_CHARACTERISTIC KOPM_BCMOvrspdCntrlLckSetFb_flg_ovrdflg KOPM_BCMOvrspdCntrlLckSetFb_flg_ovrdval /end REF_CHARACTERISTIC
 /begin REF_MEASUREMENT VOPM_BCMOvrspdCntrlLckSetFb_flg /end REF_MEASUREMENT
/end GROUP
/begin GROUP S328_Subsys_VOPM_BCMPSAuthentRes_enum1 "AppSwcOpm/Opm50ms/BacCAN_OUT_50ms/Msg_BCM_B_Package_BAC/Subsys_VOPM_BCMPSAuthentRes_enum1"
 /begin REF_CHARACTERISTIC KOPM_BCMPSAuthentResHi_enum KOPM_BCMPSAuthentResLo_enum KOPM_BCMPSAuthentRes_enum_ovrdflg KOPM_BCMPSAuthentRes_enum_ovrdval /end REF_CHARACTERISTIC
 /begin REF_MEASUREMENT VOPM_BCMPSAuthentRes_enum /end REF_MEASUREMENT
/end GROUP
/begin GROUP S328_Subsys_VOPM_BCMPSReq_flg1 "AppSwcOpm/Opm50ms/BacCAN_OUT_50ms/Msg_BCM_B_Package_BAC/Subsys_VOPM_BCMPSReq_flg1" /begin REF_CHARACTERISTIC KOPM_BCMPSReq_flg_ovrdflg KOPM_BCMPSReq_flg_ovrdval /end REF_CHARACTERISTIC /begin REF_MEASUREMENT VOPM_BCMPSReq_flg /end REF_MEASUREMENT /end GROUP
/begin GROUP S328_Subsys_VOPM_BCMParkAutoUnlckSetFb_flg1 "AppSwcOpm/Opm50ms/BacCAN_OUT_50ms/Msg_BCM_B_Package_BAC/Subsys_VOPM_BCMParkAutoUnlckSetFb_flg1"
 /begin REF_CHARACTERISTIC KOPM_BCMParkAutoUnlckSetFb_flg_ovrdflg KOPM_BCMParkAutoUnlckSetFb_flg_ovrdval /end REF_CHARACTERISTIC
 /begin REF_MEASUREMENT VOPM_BCMParkAutoUnlckSetFb_flg /end REF_MEASUREMENT
/end GROUP
/begin GROUP S328_Subsys_VOPM_BCMPassWinSwSig_enum1 "AppSwcOpm/Opm50ms/BacCAN_OUT_50ms/Msg_BCM_B_Package_BAC/Subsys_VOPM_BCMPassWinSwSig_enum1"
 /begin REF_CHARACTERISTIC KOPM_BCMPassWinSwSigHi_enum KOPM_BCMPassWinSwSigLo_enum KOPM_BCMPassWinSwSig_enum_ovrdflg KOPM_BCMPassWinSwSig_enum_ovrdval /end REF_CHARACTERISTIC
 /begin REF_MEASUREMENT VOPM_BCMPassWinSwSig_enum /end REF_MEASUREMENT
/end GROUP
/begin GROUP S328_Subsys_VOPM_BCMPaswdwInit_flg1 "AppSwcOpm/Opm50ms/BacCAN_OUT_50ms/Msg_BCM_B_Package_BAC/Subsys_VOPM_BCMPaswdwInit_flg1"
 /begin REF_CHARACTERISTIC KOPM_BCMPaswdwInit_flg_ovrdflg KOPM_BCMPaswdwInit_flg_ovrdval /end REF_CHARACTERISTIC
 /begin REF_MEASUREMENT VOPM_BCMPaswdwInit_flg /end REF_MEASUREMENT
/end GROUP
/begin GROUP S328_Subsys_VOPM_BCMPosLampSta_flg1 "AppSwcOpm/Opm50ms/BacCAN_OUT_50ms/Msg_BCM_B_Package_BAC/Subsys_VOPM_BCMPosLampSta_flg1"
 /begin REF_CHARACTERISTIC KOPM_BCMPosLampSta_flg_ovrdflg KOPM_BCMPosLampSta_flg_ovrdval /end REF_CHARACTERISTIC
 /begin REF_MEASUREMENT VOPM_BCMPosLampSta_flg /end REF_MEASUREMENT
/end GROUP
/begin GROUP S328_Subsys_VOPM_BCMRFInitSta_flg "AppSwcOpm/Opm50ms/BacCAN_OUT_50ms/Msg_BCM_B_Package_BAC/Subsys_VOPM_BCMRFInitSta_flg"
 /begin REF_CHARACTERISTIC KOPM_BCMRFInitSta_flg_ovrdflg KOPM_BCMRFInitSta_flg_ovrdval /end REF_CHARACTERISTIC
 /begin REF_MEASUREMENT VOPM_BCMRFInitSta_flg /end REF_MEASUREMENT
/end GROUP
/begin GROUP S328_Subsys_VOPM_BCMRKEReq_enum1 "AppSwcOpm/Opm50ms/BacCAN_OUT_50ms/Msg_BCM_B_Package_BAC/Subsys_VOPM_BCMRKEReq_enum1"
 /begin REF_CHARACTERISTIC KOPM_BCMRKEReqHi_enum KOPM_BCMRKEReqLo_enum KOPM_BCMRKEReq_enum_ovrdflg KOPM_BCMRKEReq_enum_ovrdval /end REF_CHARACTERISTIC
 /begin REF_MEASUREMENT VOPM_BCMRKEReq_enum /end REF_MEASUREMENT
/end GROUP
/begin GROUP S328_Subsys_VOPM_BCMReverseLampSta_flg1 "AppSwcOpm/Opm50ms/BacCAN_OUT_50ms/Msg_BCM_B_Package_BAC/Subsys_VOPM_BCMReverseLampSta_flg1"
 /begin REF_CHARACTERISTIC KOPM_BCMReverseLampSta_flg_ovrdflg KOPM_BCMReverseLampSta_flg_ovrdval /end REF_CHARACTERISTIC
 /begin REF_MEASUREMENT VOPM_BCMReverseLampSta_flg /end REF_MEASUREMENT
/end GROUP
/begin GROUP S328_Subsys_VOPM_BCMRiTrnLiFltFb_enum "AppSwcOpm/Opm50ms/BacCAN_OUT_50ms/Msg_BCM_B_Package_BAC/Subsys_VOPM_BCMRiTrnLiFltFb_enum"
 /begin REF_CHARACTERISTIC KOPM_BCMRiTrnLiFltFbHi_enum KOPM_BCMRiTrnLiFltFbLo_enum KOPM_BCMRiTrnLiFltFb_enum_ovrdflg KOPM_BCMRiTrnLiFltFb_enum_ovrdval /end REF_CHARACTERISTIC
 /begin REF_MEASUREMENT VOPM_BCMRiTrnLiFltFb_enum /end REF_MEASUREMENT
/end GROUP
/begin GROUP S328_Subsys_VOPM_BCMRrFogLiSwSig_flg1 "AppSwcOpm/Opm50ms/BacCAN_OUT_50ms/Msg_BCM_B_Package_BAC/Subsys_VOPM_BCMRrFogLiSwSig_flg1"
 /begin REF_CHARACTERISTIC KOPM_BCMRrFogLiSwSig_flg_ovrdflg KOPM_BCMRrFogLiSwSig_flg_ovrdval /end REF_CHARACTERISTIC
 /begin REF_MEASUREMENT VOPM_BCMRrFogLiSwSig_flg /end REF_MEASUREMENT
/end GROUP
/begin GROUP S328_Subsys_VOPM_BCMRrMirrHeatSts_flg1 "AppSwcOpm/Opm50ms/BacCAN_OUT_50ms/Msg_BCM_B_Package_BAC/Subsys_VOPM_BCMRrMirrHeatSts_flg1"
 /begin REF_CHARACTERISTIC KOPM_BCMRrMirrHeatSts_flg_ovrdflg KOPM_BCMRrMirrHeatSts_flg_ovrdval /end REF_CHARACTERISTIC
 /begin REF_MEASUREMENT VOPM_BCMRrMirrHeatSts_flg /end REF_MEASUREMENT
/end GROUP
/begin GROUP S328_Subsys_VOPM_BCMStartReq_enum1 "AppSwcOpm/Opm50ms/BacCAN_OUT_50ms/Msg_BCM_B_Package_BAC/Subsys_VOPM_BCMStartReq_enum1"
 /begin REF_CHARACTERISTIC KOPM_BCMStartReqHi_enum KOPM_BCMStartReqLo_enum KOPM_BCMStartReq_enum_ovrdflg KOPM_BCMStartReq_enum_ovrdval /end REF_CHARACTERISTIC
 /begin REF_MEASUREMENT VOPM_BCMStartReq_enum /end REF_MEASUREMENT
/end GROUP
/begin GROUP S328_Subsys_VOPM_BCMSteerWhlHeatSts_flg1 "AppSwcOpm/Opm50ms/BacCAN_OUT_50ms/Msg_BCM_B_Package_BAC/Subsys_VOPM_BCMSteerWhlHeatSts_flg1"
 /begin REF_CHARACTERISTIC KOPM_BCMSteerWhlHeatStsHi_flg KOPM_BCMSteerWhlHeatStsLo_flg KOPM_BCMSteerWhlHeatSts_flg_ovrdflg KOPM_BCMSteerWhlHeatSts_flg_ovrdval /end REF_CHARACTERISTIC
 /begin REF_MEASUREMENT VOPM_BCMSteerWhlHeatSts_flg /end REF_MEASUREMENT
/end GROUP
/begin GROUP S328_Subsys_VOPM_BCMSteerWhlTemp_C1 "AppSwcOpm/Opm50ms/BacCAN_OUT_50ms/Msg_BCM_B_Package_BAC/Subsys_VOPM_BCMSteerWhlTemp_C1"
 /begin REF_CHARACTERISTIC KOPM_BCMSteerWhlTempHi_C KOPM_BCMSteerWhlTempLo_C KOPM_BCMSteerWhlTemp_C_ovrdflg KOPM_BCMSteerWhlTemp_C_ovrdval /end REF_CHARACTERISTIC
 /begin REF_MEASUREMENT VOPM_BCMSteerWhlTemp_C /end REF_MEASUREMENT
/end GROUP
/begin GROUP S328_Subsys_VOPM_BCMTPMSRstSts_enum1 "AppSwcOpm/Opm50ms/BacCAN_OUT_50ms/Msg_BCM_B_Package_BAC/Subsys_VOPM_BCMTPMSRstSts_enum1"
 /begin REF_CHARACTERISTIC KOPM_BCMTPMSRstStsHi_enum KOPM_BCMTPMSRstStsLo_enum KOPM_BCMTPMSRstSts_enum_ovrdflg KOPM_BCMTPMSRstSts_enum_ovrdval /end REF_CHARACTERISTIC
 /begin REF_MEASUREMENT VOPM_BCMTPMSRstSts_enum /end REF_MEASUREMENT
/end GROUP
/begin GROUP S328_Subsys_VOPM_BCMTrnkLckSta_flg1 "AppSwcOpm/Opm50ms/BacCAN_OUT_50ms/Msg_BCM_B_Package_BAC/Subsys_VOPM_BCMTrnkLckSta_flg1"
 /begin REF_CHARACTERISTIC KOPM_BCMTrnkLckSta_flg_ovrdflg KOPM_BCMTrnkLckSta_flg_ovrdval /end REF_CHARACTERISTIC
 /begin REF_MEASUREMENT VOPM_BCMTrnkLckSta_flg /end REF_MEASUREMENT
/end GROUP
/begin GROUP S328_Subsys_VOPM_BCMTrnkLckSwCtrlFb_flg1 "AppSwcOpm/Opm50ms/BacCAN_OUT_50ms/Msg_BCM_B_Package_BAC/Subsys_VOPM_BCMTrnkLckSwCtrlFb_flg1"
 /begin REF_CHARACTERISTIC KOPM_BCMTrnkLckSwCtrlFb_flg_ovrdflg KOPM_BCMTrnkLckSwCtrlFb_flg_ovrdval /end REF_CHARACTERISTIC
 /begin REF_MEASUREMENT VOPM_BCMTrnkLckSwCtrlFb_flg /end REF_MEASUREMENT
/end GROUP
/begin GROUP S328_Subsys_VOPM_BCMTrnngLiSwSig_enum1 "AppSwcOpm/Opm50ms/BacCAN_OUT_50ms/Msg_BCM_B_Package_BAC/Subsys_VOPM_BCMTrnngLiSwSig_enum1"
 /begin REF_CHARACTERISTIC KOPM_BCMTrnngLiSwSigHi_enum KOPM_BCMTrnngLiSwSigLo_enum KOPM_BCMTrnngLiSwSig_enum_ovrdflg KOPM_BCMTrnngLiSwSig_enum_ovrdval /end REF_CHARACTERISTIC
 /begin REF_MEASUREMENT VOPM_BCMTrnngLiSwSig_enum /end REF_MEASUREMENT
/end GROUP
/begin GROUP S328_Subsys_VOPM_BCMTrunkSwtSig_flg1 "AppSwcOpm/Opm50ms/BacCAN_OUT_50ms/Msg_BCM_B_Package_BAC/Subsys_VOPM_BCMTrunkSwtSig_flg1"
 /begin REF_CHARACTERISTIC KOPM_BCMTrunkSwtSig_flg_ovrdflg KOPM_BCMTrunkSwtSig_flg_ovrdval /end REF_CHARACTERISTIC
 /begin REF_MEASUREMENT VOPM_BCMTrunkSwtSig_flg /end REF_MEASUREMENT
/end GROUP
/begin GROUP S328_Subsys_VOPM_BCMTurnLampStaLeft_flg1 "AppSwcOpm/Opm50ms/BacCAN_OUT_50ms/Msg_BCM_B_Package_BAC/Subsys_VOPM_BCMTurnLampStaLeft_flg1"
 /begin REF_CHARACTERISTIC KOPM_BCMTurnLampStaLeft_flg_ovrdflg KOPM_BCMTurnLampStaLeft_flg_ovrdval /end REF_CHARACTERISTIC
 /begin REF_MEASUREMENT VOPM_BCMTurnLampStaLeft_flg /end REF_MEASUREMENT
/end GROUP
/begin GROUP S328_Subsys_VOPM_BCMTurnLampStaRight_flg1 "AppSwcOpm/Opm50ms/BacCAN_OUT_50ms/Msg_BCM_B_Package_BAC/Subsys_VOPM_BCMTurnLampStaRight_flg1"
 /begin REF_CHARACTERISTIC KOPM_BCMTurnLampStaRight_flg_ovrdflg KOPM_BCMTurnLampStaRight_flg_ovrdval /end REF_CHARACTERISTIC
 /begin REF_MEASUREMENT VOPM_BCMTurnLampStaRight_flg /end REF_MEASUREMENT
/end GROUP
/begin GROUP S328_Subsys_VOPM_BCMTurnLiSts_enum1 "AppSwcOpm/Opm50ms/BacCAN_OUT_50ms/Msg_BCM_B_Package_BAC/Subsys_VOPM_BCMTurnLiSts_enum1"
 /begin REF_CHARACTERISTIC KOPM_BCMTurnLiStsHi_enum KOPM_BCMTurnLiStsLo_enum KOPM_BCMTurnLiSts_enum_ovrdflg KOPM_BCMTurnLiSts_enum_ovrdval /end REF_CHARACTERISTIC
 /begin REF_MEASUREMENT VOPM_BCMTurnLiSts_enum /end REF_MEASUREMENT
/end GROUP
/begin GROUP S328_Subsys_VOPM_BCMVehSeek_flg "AppSwcOpm/Opm50ms/BacCAN_OUT_50ms/Msg_BCM_B_Package_BAC/Subsys_VOPM_BCMVehSeek_flg" /begin REF_CHARACTERISTIC KOPM_BCMVehSeek_flg_ovrdflg KOPM_BCMVehSeek_flg_ovrdval /end REF_CHARACTERISTIC /begin REF_MEASUREMENT VOPM_BCMVehSeek_flg /end REF_MEASUREMENT /end GROUP
/begin GROUP S328_Subsys_VOPM_BCMWarnKeyOutRmndr_flg1 "AppSwcOpm/Opm50ms/BacCAN_OUT_50ms/Msg_BCM_B_Package_BAC/Subsys_VOPM_BCMWarnKeyOutRmndr_flg1"
 /begin REF_CHARACTERISTIC KOPM_BCMWarnKeyOutRmndr_flg_ovrdflg KOPM_BCMWarnKeyOutRmndr_flg_ovrdval /end REF_CHARACTERISTIC
 /begin REF_MEASUREMENT VOPM_BCMWarnKeyOutRmndr_flg /end REF_MEASUREMENT
/end GROUP
/begin GROUP S328_Subsys_VOPM_BCMWarnNoKeyFound_flg1 "AppSwcOpm/Opm50ms/BacCAN_OUT_50ms/Msg_BCM_B_Package_BAC/Subsys_VOPM_BCMWarnNoKeyFound_flg1"
 /begin REF_CHARACTERISTIC KOPM_BCMWarnNoKeyFound_flg_ovrdflg KOPM_BCMWarnNoKeyFound_flg_ovrdval /end REF_CHARACTERISTIC
 /begin REF_MEASUREMENT VOPM_BCMWarnNoKeyFound_flg /end REF_MEASUREMENT
/end GROUP
/begin GROUP S328_Subsys_VOPM_BCMWashLiquidLvlWarn_flg1 "AppSwcOpm/Opm50ms/BacCAN_OUT_50ms/Msg_BCM_B_Package_BAC/Subsys_VOPM_BCMWashLiquidLvlWarn_flg1"
 /begin REF_CHARACTERISTIC KOPM_BCMWashLiquidLvlWarn_flg_ovrdflg KOPM_BCMWashLiquidLvlWarn_flg_ovrdval /end REF_CHARACTERISTIC
 /begin REF_MEASUREMENT VOPM_BCMWashLiquidLvlWarn_flg /end REF_MEASUREMENT
/end GROUP
/begin GROUP S328_Subsys_VOPM_BCMWinLockSig_flg1 "AppSwcOpm/Opm50ms/BacCAN_OUT_50ms/Msg_BCM_B_Package_BAC/Subsys_VOPM_BCMWinLockSig_flg1"
 /begin REF_CHARACTERISTIC KOPM_BCMWinLockSig_flg_ovrdflg KOPM_BCMWinLockSig_flg_ovrdval /end REF_CHARACTERISTIC
 /begin REF_MEASUREMENT VOPM_BCMWinLockSig_flg /end REF_MEASUREMENT
/end GROUP
/begin GROUP S328_Subsys_VOPM_BCMWinLockSts_flg1 "AppSwcOpm/Opm50ms/BacCAN_OUT_50ms/Msg_BCM_B_Package_BAC/Subsys_VOPM_BCMWinLockSts_flg1"
 /begin REF_CHARACTERISTIC KOPM_BCMWinLockSts_flg_ovrdflg KOPM_BCMWinLockSts_flg_ovrdval /end REF_CHARACTERISTIC
 /begin REF_MEASUREMENT VOPM_BCMWinLockSts_flg /end REF_MEASUREMENT
/end GROUP
/begin GROUP S328_Subsys_VOPM_BCMWiperCtrlFront_enum1 "AppSwcOpm/Opm50ms/BacCAN_OUT_50ms/Msg_BCM_B_Package_BAC/Subsys_VOPM_BCMWiperCtrlFront_enum1"
 /begin REF_CHARACTERISTIC KOPM_BCMWiperCtrlFrontHi_enum KOPM_BCMWiperCtrlFrontLo_enum KOPM_BCMWiperCtrlFront_enum_ovrdflg KOPM_BCMWiperCtrlFront_enum_ovrdval /end REF_CHARACTERISTIC
 /begin REF_MEASUREMENT VOPM_BCMWiperCtrlFront_enum /end REF_MEASUREMENT
/end GROUP
/begin GROUP S328_Subsys_VOPM_BCMWiperSwSig_enum1 "AppSwcOpm/Opm50ms/BacCAN_OUT_50ms/Msg_BCM_B_Package_BAC/Subsys_VOPM_BCMWiperSwSig_enum1"
 /begin REF_CHARACTERISTIC KOPM_BCMWiperSwSigHi_enum KOPM_BCMWiperSwSigLo_enum KOPM_BCMWiperSwSig_enum_ovrdflg KOPM_BCMWiperSwSig_enum_ovrdval /end REF_CHARACTERISTIC
 /begin REF_MEASUREMENT VOPM_BCMWiperSwSig_enum /end REF_MEASUREMENT
/end GROUP
/begin GROUP S328_Subsys_VOPM_BCMWiprIntlGrSwtSig_enum1 "AppSwcOpm/Opm50ms/BacCAN_OUT_50ms/Msg_BCM_B_Package_BAC/Subsys_VOPM_BCMWiprIntlGrSwtSig_enum1"
 /begin REF_CHARACTERISTIC KOPM_BCMWiprIntlGrSwtSigHi_enum KOPM_BCMWiprIntlGrSwtSigLo_enum KOPM_BCMWiprIntlGrSwtSig_enum_ovrdflg KOPM_BCMWiprIntlGrSwtSig_enum_ovrdval /end REF_CHARACTERISTIC
 /begin REF_MEASUREMENT VOPM_BCMWiprIntlGrSwtSig_enum /end REF_MEASUREMENT
/end GROUP
/begin GROUP S328_Subsys_VOPM_BCMWiprIntlTimeSetFb_enum1 "AppSwcOpm/Opm50ms/BacCAN_OUT_50ms/Msg_BCM_B_Package_BAC/Subsys_VOPM_BCMWiprIntlTimeSetFb_enum1"
 /begin REF_CHARACTERISTIC KOPM_BCMWiprIntlTimeSetFbHi_enum KOPM_BCMWiprIntlTimeSetFbLo_enum KOPM_BCMWiprIntlTimeSetFb_enum_ovrdflg KOPM_BCMWiprIntlTimeSetFb_enum_ovrdval /end REF_CHARACTERISTIC
 /begin REF_MEASUREMENT VOPM_BCMWiprIntlTimeSetFb_enum /end REF_MEASUREMENT
/end GROUP
/begin GROUP S328_Subsys_VOPM_TMPSAbnmPrsrWarn_flg1 "AppSwcOpm/Opm50ms/BacCAN_OUT_50ms/Msg_BCM_B_Package_BAC/Subsys_VOPM_TMPSAbnmPrsrWarn_flg1"
 /begin REF_CHARACTERISTIC KOPM_TMPSAbnmPrsrWarn_flg_ovrdflg KOPM_TMPSAbnmPrsrWarn_flg_ovrdval /end REF_CHARACTERISTIC
 /begin REF_MEASUREMENT VOPM_TMPSAbnmPrsrWarn_flg /end REF_MEASUREMENT
/end GROUP
/begin GROUP S328_Subsys_VOPM_TPMSPressureStaFL_enum1 "AppSwcOpm/Opm50ms/BacCAN_OUT_50ms/Msg_BCM_B_Package_BAC/Subsys_VOPM_TPMSPressureStaFL_enum1"
 /begin REF_CHARACTERISTIC KOPM_TPMSPressureStaFLHi_enum KOPM_TPMSPressureStaFLLo_enum KOPM_TPMSPressureStaFL_enum_ovrdflg KOPM_TPMSPressureStaFL_enum_ovrdval /end REF_CHARACTERISTIC
 /begin REF_MEASUREMENT VOPM_TPMSPressureStaFL_enum /end REF_MEASUREMENT
/end GROUP
/begin GROUP S328_Subsys_VOPM_TPMSPressureStaFR_enum1 "AppSwcOpm/Opm50ms/BacCAN_OUT_50ms/Msg_BCM_B_Package_BAC/Subsys_VOPM_TPMSPressureStaFR_enum1"
 /begin REF_CHARACTERISTIC KOPM_TPMSPressureStaFRHi_enum KOPM_TPMSPressureStaFRLo_enum KOPM_TPMSPressureStaFR_enum_ovrdflg KOPM_TPMSPressureStaFR_enum_ovrdval /end REF_CHARACTERISTIC
 /begin REF_MEASUREMENT VOPM_TPMSPressureStaFR_enum /end REF_MEASUREMENT
/end GROUP
/begin GROUP S328_Subsys_VOPM_TPMSPressureStaRL_enum1 "AppSwcOpm/Opm50ms/BacCAN_OUT_50ms/Msg_BCM_B_Package_BAC/Subsys_VOPM_TPMSPressureStaRL_enum1"
 /begin REF_CHARACTERISTIC KOPM_TPMSPressureStaRLHi_enum KOPM_TPMSPressureStaRLLo_enum KOPM_TPMSPressureStaRL_enum_ovrdflg KOPM_TPMSPressureStaRL_enum_ovrdval /end REF_CHARACTERISTIC
 /begin REF_MEASUREMENT VOPM_TPMSPressureStaRL_enum /end REF_MEASUREMENT
/end GROUP
/begin GROUP S328_Subsys_VOPM_TPMSPressureStaRR_enum1 "AppSwcOpm/Opm50ms/BacCAN_OUT_50ms/Msg_BCM_B_Package_BAC/Subsys_VOPM_TPMSPressureStaRR_enum1"
 /begin REF_CHARACTERISTIC KOPM_TPMSPressureStaRRHi_enum KOPM_TPMSPressureStaRRLo_enum KOPM_TPMSPressureStaRR_enum_ovrdflg KOPM_TPMSPressureStaRR_enum_ovrdval /end REF_CHARACTERISTIC
 /begin REF_MEASUREMENT VOPM_TPMSPressureStaRR_enum /end REF_MEASUREMENT
/end GROUP
/end MODULE
/end PROJECT
