/begin MOD_COMMON "Mod Common Comment Here" BYTE_ORDER MSB_LAST /end MOD_COMMON
/begin RECORD_LAYOUT Scalar_BOOLEAN FNC_VALUES 1 UBYTE COLUMN_DIR DIRECT /end RECORD_LAYOUT
/begin RECORD_LAYOUT Scalar_UBYTE FNC_VALUES 1 UBYTE COLUMN_DIR DIRECT /end RECORD_LAYOUT
/begin RECORD_LAYOUT Scalar_UWORD FNC_VALUES 1 UWORD COLUMN_DIR DIRECT /end RECORD_LAYOUT
/begin RECORD_LAYOUT Scalar_FLOAT32_IEEE FNC_VALUES 1 FLOAT32_IEEE COLUMN_DIR DIRECT /end RECORD_LAYOUT
/begin RECORD_LAYOUT Lookup1D_UBYTE FNC_VALUES 1 UBYTE COLUMN_DIR DIRECT /end RECORD_LAYOUT
/begin RECORD_LAYOUT Lookup1D_X_UBYTE AXIS_PTS_X 1 UBYTE INDEX_INCR DIRECT /end RECORD_LAYOUT
/begin RECORD_LAYOUT Lookup1D_X_UWORD AXIS_PTS_X 1 UWORD INDEX_INCR DIRECT /end RECORD_LAYOUT
/begin RECORD_LAYOUT Lookup1D_X_ULONG AXIS_PTS_X 1 ULONG INDEX_INCR DIRECT /end RECORD_LAYOUT
/begin RECORD_LAYOUT Lookup1D_SLONG FNC_VALUES 1 SLONG COLUMN_DIR DIRECT /end RECORD_LAYOUT
/begin RECORD_LAYOUT Lookup1D_X_LONG AXIS_PTS_X 1 SLONG INDEX_INCR DIRECT /end RECORD_LAYOUT
/begin RECORD_LAYOUT Lookup1D_FLOAT32_IEEE FNC_VALUES 1 FLOAT32_IEEE COLUMN_DIR DIRECT /end RECORD_LAYOUT
/begin RECORD_LAYOUT Lookup1D_X_FLOAT32_IEEE AXIS_PTS_X 1 FLOAT32_IEEE INDEX_INCR DIRECT /end RECORD_LAYOUT
/begin RECORD_LAYOUT Lookup1D_FLOAT64_IEEE FNC_VALUES 1 FLOAT64_IEEE COLUMN_DIR DIRECT /end RECORD_LAYOUT
/begin RECORD_LAYOUT Lookup1D_X_FLOAT64_IEEE AXIS_PTS_X 1 FLOAT64_IEEE INDEX_INCR DIRECT /end RECORD_LAYOUT
/begin RECORD_LAYOUT Lookup2D_BOOLEAN FNC_VALUES 1 UBYTE COLUMN_DIR DIRECT /end RECORD_LAYOUT
/begin RECORD_LAYOUT Lookup2D_X_BOOLEAN AXIS_PTS_X 1 UBYTE INDEX_INCR DIRECT /end RECORD_LAYOUT
/begin RECORD_LAYOUT Lookup2D_X_UBYTE AXIS_PTS_X 1 UBYTE INDEX_INCR DIRECT /end RECORD_LAYOUT
/begin RECORD_LAYOUT Lookup2D_BYTE FNC_VALUES 1 SBYTE COLUMN_DIR DIRECT /end RECORD_LAYOUT
/begin RECORD_LAYOUT Lookup2D_UWORD FNC_VALUES 1 UWORD COLUMN_DIR DIRECT /end RECORD_LAYOUT
/begin RECORD_LAYOUT Lookup2D_X_UWORD AXIS_PTS_X 1 UWORD INDEX_INCR DIRECT /end RECORD_LAYOUT
/begin RECORD_LAYOUT Lookup2D_FLOAT32_IEEE FNC_VALUES 1 FLOAT32_IEEE COLUMN_DIR DIRECT /end RECORD_LAYOUT
/begin RECORD_LAYOUT Lookup2D_X_FLOAT32_IEEE AXIS_PTS_X 1 FLOAT32_IEEE INDEX_INCR DIRECT /end RECORD_LAYOUT
/begin CHARACTERISTIC cal_CabinTempDuctUpStepCor_CUR "" CURVE 0x0000 /* @ECU_Address@cal_CabinTempDuctUpStepCor_CUR@ */ Lookup1D_FLOAT32_IEEE 0 ME11_CM_single_C -40.0 80.0
 /begin AXIS_DESCR COM_AXIS NO_INPUT_QUANTITY ME11_CM_single_C 10 -40.0 80.0 AXIS_PTS_REF cal_CabinTempDuctUpStepCor_1X /end AXIS_DESCR
/end CHARACTERISTIC
/begin AXIS_PTS cal_CabinTempDuctUpStepCor_1X "" 0x0000 /* @ECU_Address@cal_CabinTempDuctUpStepCor_1X@ */ NO_INPUT_QUANTITY Lookup1D_X_FLOAT32_IEEE 0 ME11_CM_single_C 10 -40.0 80.0 /end AXIS_PTS
/begin CHARACTERISTIC cal_SetPtcDesTempMax_MAP "" MAP 0x0000 /* @ECU_Address@cal_SetPtcDesTempMax_MAP@ */ Lookup2D_FLOAT32_IEEE 0 ME11_CM_single_C 0.0 100.0
 /begin AXIS_DESCR COM_AXIS NO_INPUT_QUANTITY ME11_CM_uint8_percent_ 10 0.0 100.0 AXIS_PTS_REF cal_SetPtcDesTempMax_2Y /end AXIS_DESCR
 /begin AXIS_DESCR COM_AXIS ACSen_sEnvTempCor ME11_CM_single_C 10 -40.0 100.0 AXIS_PTS_REF cal_SetPtcDesTempMax_2X /end AXIS_DESCR
/end CHARACTERISTIC
/begin AXIS_PTS cal_SetPtcDesTempMax_2X "" 0x0000 /* @ECU_Address@cal_SetPtcDesTempMax_2X@ */ ACSen_sEnvTempCor Lookup2D_X_FLOAT32_IEEE 0 ME11_CM_single_C 10 -40.0 100.0 /end AXIS_PTS
/begin AXIS_PTS cal_SetPtcDesTempMax_2Y "" 0x0000 /* @ECU_Address@cal_SetPtcDesTempMax_2Y@ */ NO_INPUT_QUANTITY Lookup2D_X_UBYTE 0 ME11_CM_uint8_percent_ 10 0.0 100.0 /end AXIS_PTS
/begin CHARACTERISTIC cal_AccmSpdLimByHiPressDownSide_CUR "" CURVE 0x0000 /* @ECU_Address@cal_AccmSpdLimByHiPressDownSide_CUR@ */ Lookup1D_FLOAT32_IEEE 0 ME11_CM_single_rpm 0.0 8000.0
 /begin AXIS_DESCR COM_AXIS NO_INPUT_QUANTITY ME11_CM_uint8_L 12 0.0 20.0 AXIS_PTS_REF cal_AccmSpdLimByHiPressDownSide_1X /end AXIS_DESCR
/end CHARACTERISTIC
/begin AXIS_PTS cal_AccmSpdLimByHiPressDownSide_1X "" 0x0000 /* @ECU_Address@cal_AccmSpdLimByHiPressDownSide_1X@ */ NO_INPUT_QUANTITY Lookup1D_X_UBYTE 0 ME11_CM_uint8_L 12 0.0 20.0 /end AXIS_PTS
/begin CHARACTERISTIC cal_AccmSpdLimByHiPressLevelCalcu_CUR "" CURVE 0x0000 /* @ECU_Address@cal_AccmSpdLimByHiPressLevelCalcu_CUR@ */ Lookup1D_UBYTE 0 ME11_CM_uint8_L 0.0 20.0
 /begin AXIS_DESCR COM_AXIS ACSen_sHiPressFilter ME11_CM_single_mpa 12 0.0 10.0 AXIS_PTS_REF cal_AccmSpdLimByHiPressLevelCalcu_1X /end AXIS_DESCR
/end CHARACTERISTIC
/begin AXIS_PTS cal_AccmSpdLimByHiPressLevelCalcu_1X "" 0x0000 /* @ECU_Address@cal_AccmSpdLimByHiPressLevelCalcu_1X@ */ ACSen_sHiPressFilter Lookup1D_X_FLOAT32_IEEE 0 ME11_CM_single_mpa 12 0.0 10.0 /end AXIS_PTS
/begin CHARACTERISTIC cal_AccmSpdLimByHiPressUpSide_CUR "" CURVE 0x0000 /* @ECU_Address@cal_AccmSpdLimByHiPressUpSide_CUR@ */ Lookup1D_FLOAT32_IEEE 0 ME11_CM_single_rpm 0.0 8000.0
 /begin AXIS_DESCR COM_AXIS NO_INPUT_QUANTITY ME11_CM_uint8_L 12 0.0 20.0 AXIS_PTS_REF cal_AccmSpdLimByHiPressUpSide_1X /end AXIS_DESCR
/end CHARACTERISTIC
/begin AXIS_PTS cal_AccmSpdLimByHiPressUpSide_1X "" 0x0000 /* @ECU_Address@cal_AccmSpdLimByHiPressUpSide_1X@ */ NO_INPUT_QUANTITY Lookup1D_X_UBYTE 0 ME11_CM_uint8_L 12 0.0 20.0 /end AXIS_PTS
/begin CHARACTERISTIC cal_AccmSpdLimByLoPressDownSide_CUR "" CURVE 0x0000 /* @ECU_Address@cal_AccmSpdLimByLoPressDownSide_CUR@ */ Lookup1D_FLOAT32_IEEE 0 ME11_CM_single_rpm 0.0 8000.0
 /begin AXIS_DESCR COM_AXIS NO_INPUT_QUANTITY ME11_CM_uint8_L 12 0.0 20.0 AXIS_PTS_REF cal_AccmSpdLimByLoPressDownSide_1X /end AXIS_DESCR
/end CHARACTERISTIC
/begin AXIS_PTS cal_AccmSpdLimByLoPressDownSide_1X "" 0x0000 /* @ECU_Address@cal_AccmSpdLimByLoPressDownSide_1X@ */ NO_INPUT_QUANTITY Lookup1D_X_UBYTE 0 ME11_CM_uint8_L 12 0.0 20.0 /end AXIS_PTS
/begin CHARACTERISTIC cal_AccmSpdLimByLoPressLevelCalcu_CUR "" CURVE 0x0000 /* @ECU_Address@cal_AccmSpdLimByLoPressLevelCalcu_CUR@ */ Lookup1D_UBYTE 0 ME11_CM_uint8_L 0.0 20.0
 /begin AXIS_DESCR COM_AXIS ACSen_sLoPressFilter ME11_CM_single_mpa 12 0.0 10.0 AXIS_PTS_REF cal_AccmSpdLimByLoPressLevelCalcu_1X /end AXIS_DESCR
/end CHARACTERISTIC
/begin AXIS_PTS cal_AccmSpdLimByLoPressLevelCalcu_1X "" 0x0000 /* @ECU_Address@cal_AccmSpdLimByLoPressLevelCalcu_1X@ */ ACSen_sLoPressFilter Lookup1D_X_FLOAT32_IEEE 0 ME11_CM_single_mpa 12 0.0 10.0 /end AXIS_PTS
/begin CHARACTERISTIC cal_AccmSpdLimByLoPressUpSide_CUR "" CURVE 0x0000 /* @ECU_Address@cal_AccmSpdLimByLoPressUpSide_CUR@ */ Lookup1D_FLOAT32_IEEE 0 ME11_CM_single_rpm 0.0 8000.0
 /begin AXIS_DESCR COM_AXIS NO_INPUT_QUANTITY ME11_CM_uint8_L 12 0.0 20.0 AXIS_PTS_REF cal_AccmSpdLimByLoPressUpSide_1X /end AXIS_DESCR
/end CHARACTERISTIC
/begin AXIS_PTS cal_AccmSpdLimByLoPressUpSide_1X "" 0x0000 /* @ECU_Address@cal_AccmSpdLimByLoPressUpSide_1X@ */ NO_INPUT_QUANTITY Lookup1D_X_UBYTE 0 ME11_CM_uint8_L 12 0.0 20.0 /end AXIS_PTS
/begin CHARACTERISTIC cal_COMPATNoiseSpdLmtHVS_CUR "" CURVE 0x0000 /* @ECU_Address@cal_COMPATNoiseSpdLmtHVS_CUR@ */ Lookup1D_FLOAT32_IEEE 0 ME11_CM_single_rpm 0.0 8000.0
 /begin AXIS_DESCR COM_AXIS ACSen_sEnvTempCor ME11_CM_single_C 8 -40.0 150.0 AXIS_PTS_REF cal_COMPATNoiseSpdLmtHVS_1X /end AXIS_DESCR
/end CHARACTERISTIC
/begin AXIS_PTS cal_COMPATNoiseSpdLmtHVS_1X "" 0x0000 /* @ECU_Address@cal_COMPATNoiseSpdLmtHVS_1X@ */ ACSen_sEnvTempCor Lookup1D_X_FLOAT32_IEEE 0 ME11_CM_single_C 8 -40.0 150.0 /end AXIS_PTS
/begin CHARACTERISTIC cal_COMPATNoiseSpdLmt_MAP "" MAP 0x0000 /* @ECU_Address@cal_COMPATNoiseSpdLmt_MAP@ */ Lookup2D_FLOAT32_IEEE 0 ME11_CM_single_rpm 0.0 8000.0
 /begin AXIS_DESCR COM_AXIS NO_INPUT_QUANTITY ME11_CM_uint8_percent_ 10 0.0 100.0 AXIS_PTS_REF cal_COMPATNoiseSpdLmt_2Y /end AXIS_DESCR
 /begin AXIS_DESCR COM_AXIS ACTCtl_sACCMPIVal ME11_CM_single_rpm 10 0.0 8000.0 AXIS_PTS_REF cal_COMPATNoiseSpdLmt_2X /end AXIS_DESCR
/end CHARACTERISTIC
/begin AXIS_PTS cal_COMPATNoiseSpdLmt_2X "" 0x0000 /* @ECU_Address@cal_COMPATNoiseSpdLmt_2X@ */ ACTCtl_sACCMPIVal Lookup2D_X_FLOAT32_IEEE 0 ME11_CM_single_rpm 10 0.0 8000.0 /end AXIS_PTS
/begin AXIS_PTS cal_COMPATNoiseSpdLmt_2Y "" 0x0000 /* @ECU_Address@cal_COMPATNoiseSpdLmt_2Y@ */ NO_INPUT_QUANTITY Lookup2D_X_UBYTE 0 ME11_CM_uint8_percent_ 10 0.0 100.0 /end AXIS_PTS
/begin CHARACTERISTIC cal_PCULimBTMAccmSpdDes_CUR "" CURVE 0x0000 /* @ECU_Address@cal_PCULimBTMAccmSpdDes_CUR@ */ Lookup1D_FLOAT32_IEEE 0 ME11_CM_single_rpm 0.0 8000.0
 /begin AXIS_DESCR COM_AXIS ACSen_sMotTempFilter ME11_CM_single_C 8 -40.0 100.0 AXIS_PTS_REF cal_PCULimBTMAccmSpdDes_1X /end AXIS_DESCR
/end CHARACTERISTIC
/begin AXIS_PTS cal_PCULimBTMAccmSpdDes_1X "" 0x0000 /* @ECU_Address@cal_PCULimBTMAccmSpdDes_1X@ */ ACSen_sMotTempFilter Lookup1D_X_FLOAT32_IEEE 0 ME11_CM_single_C 8 -40.0 100.0 /end AXIS_PTS
/begin CHARACTERISTIC cal_PCULimBTMAndCabinAccmSpdDes_CUR "" CURVE 0x0000 /* @ECU_Address@cal_PCULimBTMAndCabinAccmSpdDes_CUR@ */ Lookup1D_FLOAT32_IEEE 0 ME11_CM_single_rpm 0.0 8000.0
 /begin AXIS_DESCR COM_AXIS ACSen_sMotTempFilter ME11_CM_single_C 8 -40.0 100.0 AXIS_PTS_REF cal_PCULimBTMAndCabinAccmSpdDes_1X /end AXIS_DESCR
/end CHARACTERISTIC
/begin AXIS_PTS cal_PCULimBTMAndCabinAccmSpdDes_1X "" 0x0000 /* @ECU_Address@cal_PCULimBTMAndCabinAccmSpdDes_1X@ */ ACSen_sMotTempFilter Lookup1D_X_FLOAT32_IEEE 0 ME11_CM_single_C 8 -40.0 100.0 /end AXIS_PTS
/begin CHARACTERISTIC cal_PCULimCabinAccmSpdDes_CUR "" CURVE 0x0000 /* @ECU_Address@cal_PCULimCabinAccmSpdDes_CUR@ */ Lookup1D_FLOAT32_IEEE 0 ME11_CM_single_rpm 0.0 8000.0
 /begin AXIS_DESCR COM_AXIS ACSen_sMotTempFilter ME11_CM_single_C 8 -40.0 100.0 AXIS_PTS_REF cal_PCULimCabinAccmSpdDes_1X /end AXIS_DESCR
/end CHARACTERISTIC
/begin AXIS_PTS cal_PCULimCabinAccmSpdDes_1X "" 0x0000 /* @ECU_Address@cal_PCULimCabinAccmSpdDes_1X@ */ ACSen_sMotTempFilter Lookup1D_X_FLOAT32_IEEE 0 ME11_CM_single_C 8 -40.0 100.0 /end AXIS_PTS
/begin CHARACTERISTIC cal_COMPEnvSpdLmt1_CUR "" CURVE 0x0000 /* @ECU_Address@cal_COMPEnvSpdLmt1_CUR@ */ Lookup1D_FLOAT32_IEEE 0 ME11_CM_single_rpm 0.0 8000.0
 /begin AXIS_DESCR COM_AXIS ACSen_sEnvTempCor ME11_CM_single_C 2 -40.0 150.0 AXIS_PTS_REF cal_COMPEnvSpdLmt1_1X /end AXIS_DESCR
/end CHARACTERISTIC
/begin AXIS_PTS cal_COMPEnvSpdLmt1_1X "" 0x0000 /* @ECU_Address@cal_COMPEnvSpdLmt1_1X@ */ ACSen_sEnvTempCor Lookup1D_X_FLOAT32_IEEE 0 ME11_CM_single_C 2 -40.0 150.0 /end AXIS_PTS
/begin CHARACTERISTIC cal_COMPEnvSpdLmt2_CUR "" CURVE 0x0000 /* @ECU_Address@cal_COMPEnvSpdLmt2_CUR@ */ Lookup1D_FLOAT32_IEEE 0 ME11_CM_single_rpm 0.0 8000.0
 /begin AXIS_DESCR COM_AXIS ACSen_sEnvTempCor ME11_CM_single_C 2 -40.0 150.0 AXIS_PTS_REF cal_COMPEnvSpdLmt2_1X /end AXIS_DESCR
/end CHARACTERISTIC
/begin AXIS_PTS cal_COMPEnvSpdLmt2_1X "" 0x0000 /* @ECU_Address@cal_COMPEnvSpdLmt2_1X@ */ ACSen_sEnvTempCor Lookup1D_X_FLOAT32_IEEE 0 ME11_CM_single_C 2 -40.0 150.0 /end AXIS_PTS
/begin CHARACTERISTIC cal_COMPEnvSpdLmt3_CUR "" CURVE 0x0000 /* @ECU_Address@cal_COMPEnvSpdLmt3_CUR@ */ Lookup1D_FLOAT32_IEEE 0 ME11_CM_single_rpm 0.0 8000.0
 /begin AXIS_DESCR COM_AXIS ACSen_sEnvTempCor ME11_CM_single_C 2 -40.0 150.0 AXIS_PTS_REF cal_COMPEnvSpdLmt3_1X /end AXIS_DESCR
/end CHARACTERISTIC
/begin AXIS_PTS cal_COMPEnvSpdLmt3_1X "" 0x0000 /* @ECU_Address@cal_COMPEnvSpdLmt3_1X@ */ ACSen_sEnvTempCor Lookup1D_X_FLOAT32_IEEE 0 ME11_CM_single_C 2 -40.0 150.0 /end AXIS_PTS
/begin CHARACTERISTIC cal_COMPFanLevelLmt_CUR "" CURVE 0x0000 /* @ECU_Address@cal_COMPFanLevelLmt_CUR@ */ Lookup1D_FLOAT32_IEEE 0 ME11_CM_single_rpm 0.0 8000.0
 /begin AXIS_DESCR COM_AXIS AC_FanLeVel ME11_CM_uint8_null 9 0.0 10.0 AXIS_PTS_REF cal_COMPFanLevelLmt_1X /end AXIS_DESCR
/end CHARACTERISTIC
/begin AXIS_PTS cal_COMPFanLevelLmt_1X "" 0x0000 /* @ECU_Address@cal_COMPFanLevelLmt_1X@ */ AC_FanLeVel Lookup1D_X_UBYTE 0 ME11_CM_uint8_null 9 0.0 10.0 /end AXIS_PTS
/begin CHARACTERISTIC cal_ACCMCtrlA1FF_CUR "" CURVE 0x0000 /* @ECU_Address@cal_ACCMCtrlA1FF_CUR@ */ Lookup1D_FLOAT32_IEEE 0 ME11_CM_single_rpm 0.0 8000.0
 /begin AXIS_DESCR COM_AXIS ACSen_sEnvTempCor ME11_CM_single_C 6 -40.0 100.0 AXIS_PTS_REF cal_ACCMCtrlA1FF_1X /end AXIS_DESCR
/end CHARACTERISTIC
/begin AXIS_PTS cal_ACCMCtrlA1FF_1X "" 0x0000 /* @ECU_Address@cal_ACCMCtrlA1FF_1X@ */ ACSen_sEnvTempCor Lookup1D_X_FLOAT32_IEEE 0 ME11_CM_single_C 6 -40.0 100.0 /end AXIS_PTS
/begin CHARACTERISTIC cal_ACCMCtrlA2FF_MAP "" MAP 0x0000 /* @ECU_Address@cal_ACCMCtrlA2FF_MAP@ */ Lookup2D_FLOAT32_IEEE 0 ME11_CM_single_rpm 0.0 8000.0
 /begin AXIS_DESCR COM_AXIS NO_INPUT_QUANTITY ME11_CM_single_C 5 -40.0 100.0 AXIS_PTS_REF cal_ACCMCtrlA2FF_2Y /end AXIS_DESCR
 /begin AXIS_DESCR COM_AXIS ACSen_sEnvTempCor ME11_CM_single_C 6 -40.0 100.0 AXIS_PTS_REF cal_ACCMCtrlA2FF_2X /end AXIS_DESCR
/end CHARACTERISTIC
/begin AXIS_PTS cal_ACCMCtrlA2FF_2X "" 0x0000 /* @ECU_Address@cal_ACCMCtrlA2FF_2X@ */ ACSen_sEnvTempCor Lookup2D_X_FLOAT32_IEEE 0 ME11_CM_single_C 6 -40.0 100.0 /end AXIS_PTS
/begin AXIS_PTS cal_ACCMCtrlA2FF_2Y "" 0x0000 /* @ECU_Address@cal_ACCMCtrlA2FF_2Y@ */ NO_INPUT_QUANTITY Lookup2D_X_FLOAT32_IEEE 0 ME11_CM_single_C 5 -40.0 100.0 /end AXIS_PTS
/begin CHARACTERISTIC cal_ACCMCtrlAKi_CUR "" CURVE 0x0000 /* @ECU_Address@cal_ACCMCtrlAKi_CUR@ */ Lookup1D_FLOAT32_IEEE 0 ME11_CM_single_null 0.0 100.0
 /begin AXIS_DESCR COM_AXIS ACTCtl_tCtrlADiff ME11_CM_single_C 8 -100.0 100.0 AXIS_PTS_REF cal_ACCMCtrlAKi_1X /end AXIS_DESCR
/end CHARACTERISTIC
/begin AXIS_PTS cal_ACCMCtrlAKi_1X "" 0x0000 /* @ECU_Address@cal_ACCMCtrlAKi_1X@ */ ACTCtl_tCtrlADiff Lookup1D_X_FLOAT32_IEEE 0 ME11_CM_single_C 8 -100.0 100.0 /end AXIS_PTS
/begin CHARACTERISTIC cal_ACCMCtrlAKp_CUR "" CURVE 0x0000 /* @ECU_Address@cal_ACCMCtrlAKp_CUR@ */ Lookup1D_FLOAT32_IEEE 0 ME11_CM_single_null 0.0 100.0
 /begin AXIS_DESCR COM_AXIS ACTCtl_tCtrlADiff ME11_CM_single_C 8 -100.0 100.0 AXIS_PTS_REF cal_ACCMCtrlAKp_1X /end AXIS_DESCR
/end CHARACTERISTIC
/begin AXIS_PTS cal_ACCMCtrlAKp_1X "" 0x0000 /* @ECU_Address@cal_ACCMCtrlAKp_1X@ */ ACTCtl_tCtrlADiff Lookup1D_X_FLOAT32_IEEE 0 ME11_CM_single_C 8 -100.0 100.0 /end AXIS_PTS
/begin CHARACTERISTIC cal_PTCAuxHeatPwrLmt_MAP "" MAP 0x0000 /* @ECU_Address@cal_PTCAuxHeatPwrLmt_MAP@ */ Lookup2D_FLOAT32_IEEE 0 ME11_CM_single_kw 0.0 10.0
 /begin AXIS_DESCR COM_AXIS HMICtl_sLeftSetPoint ME11_CM_single_C 6 -40.0 40.0 AXIS_PTS_REF cal_PTCAuxHeatPwrLmt_2X /end AXIS_DESCR
 /begin AXIS_DESCR COM_AXIS ACTCtl_tCtrlADiff ME11_CM_single_C 6 -40.0 30.0 AXIS_PTS_REF cal_PTCAuxHeatPwrLmt_2Y /end AXIS_DESCR
/end CHARACTERISTIC
/begin AXIS_PTS cal_PTCAuxHeatPwrLmt_2Y "" 0x0000 /* @ECU_Address@cal_PTCAuxHeatPwrLmt_2Y@ */ ACTCtl_tCtrlADiff Lookup2D_X_FLOAT32_IEEE 0 ME11_CM_single_C 6 -40.0 30.0 /end AXIS_PTS
/begin AXIS_PTS cal_PTCAuxHeatPwrLmt_2X "" 0x0000 /* @ECU_Address@cal_PTCAuxHeatPwrLmt_2X@ */ HMICtl_sLeftSetPoint Lookup2D_X_FLOAT32_IEEE 0 ME11_CM_single_C 6 -40.0 40.0 /end AXIS_PTS
/begin CHARACTERISTIC cal_PTCOnReqPower_CUR "" CURVE 0x0000 /* @ECU_Address@cal_PTCOnReqPower_CUR@ */ Lookup1D_FLOAT32_IEEE 0 ME11_CM_single_kw 0.0 10.0
 /begin AXIS_DESCR COM_AXIS ACCtl_tSetPointPTC ME11_CM_single_C 6 0.0 100.0 AXIS_PTS_REF cal_PTCOnReqPower_1X /end AXIS_DESCR
/end CHARACTERISTIC
/begin AXIS_PTS cal_PTCOnReqPower_1X "" 0x0000 /* @ECU_Address@cal_PTCOnReqPower_1X@ */ ACCtl_tSetPointPTC Lookup1D_X_FLOAT32_IEEE 0 ME11_CM_single_C 6 0.0 100.0 /end AXIS_PTS
/begin CHARACTERISTIC cal_ACCMCtrlBFF_CUR "" CURVE 0x0000 /* @ECU_Address@cal_ACCMCtrlBFF_CUR@ */ Lookup1D_FLOAT32_IEEE 0 ME11_CM_single_rpm 0.0 8000.0
 /begin AXIS_DESCR COM_AXIS BMS_HVBatCellTempMin ME11_CM_single_C 6 -40.0 100.0 AXIS_PTS_REF cal_ACCMCtrlBFF_1X /end AXIS_DESCR
/end CHARACTERISTIC
/begin AXIS_PTS cal_ACCMCtrlBFF_1X "" 0x0000 /* @ECU_Address@cal_ACCMCtrlBFF_1X@ */ BMS_HVBatCellTempMin Lookup1D_X_FLOAT32_IEEE 0 ME11_CM_single_C 6 -40.0 100.0 /end AXIS_PTS
/begin CHARACTERISTIC cal_ACCMCtrlBKi_CUR "" CURVE 0x0000 /* @ECU_Address@cal_ACCMCtrlBKi_CUR@ */ Lookup1D_FLOAT32_IEEE 0 ME11_CM_single_null 0.0 100.0
 /begin AXIS_DESCR COM_AXIS ACTCtl_tCtrlBDiff ME11_CM_single_C 8 -40.0 100.0 AXIS_PTS_REF cal_ACCMCtrlBKi_1X /end AXIS_DESCR
/end CHARACTERISTIC
/begin AXIS_PTS cal_ACCMCtrlBKi_1X "" 0x0000 /* @ECU_Address@cal_ACCMCtrlBKi_1X@ */ ACTCtl_tCtrlBDiff Lookup1D_X_FLOAT32_IEEE 0 ME11_CM_single_C 8 -40.0 100.0 /end AXIS_PTS
/begin CHARACTERISTIC cal_ACCMCtrlBKp_CUR "" CURVE 0x0000 /* @ECU_Address@cal_ACCMCtrlBKp_CUR@ */ Lookup1D_FLOAT32_IEEE 0 ME11_CM_single_null 0.0 100.0
 /begin AXIS_DESCR COM_AXIS ACTCtl_tCtrlBDiff ME11_CM_single_C 8 -40.0 100.0 AXIS_PTS_REF cal_ACCMCtrlBKp_1X /end AXIS_DESCR
/end CHARACTERISTIC
/begin AXIS_PTS cal_ACCMCtrlBKp_1X "" 0x0000 /* @ECU_Address@cal_ACCMCtrlBKp_1X@ */ ACTCtl_tCtrlBDiff Lookup1D_X_FLOAT32_IEEE 0 ME11_CM_single_C 8 -40.0 100.0 /end AXIS_PTS
/begin CHARACTERISTIC cal_ACCMCtrlC1FF_CUR "" CURVE 0x0000 /* @ECU_Address@cal_ACCMCtrlC1FF_CUR@ */ Lookup1D_FLOAT32_IEEE 0 ME11_CM_single_rpm 0.0 8000.0
 /begin AXIS_DESCR COM_AXIS ACSen_sEnvTempCor ME11_CM_single_C 5 -40.0 100.0 AXIS_PTS_REF cal_ACCMCtrlC1FF_1X /end AXIS_DESCR
/end CHARACTERISTIC
/begin AXIS_PTS cal_ACCMCtrlC1FF_1X "" 0x0000 /* @ECU_Address@cal_ACCMCtrlC1FF_1X@ */ ACSen_sEnvTempCor Lookup1D_X_FLOAT32_IEEE 0 ME11_CM_single_C 5 -40.0 100.0 /end AXIS_PTS
/begin CHARACTERISTIC cal_ACCMCtrlC2FF_CUR "" CURVE 0x0000 /* @ECU_Address@cal_ACCMCtrlC2FF_CUR@ */ Lookup1D_FLOAT32_IEEE 0 ME11_CM_single_rpm 0.0 8000.0
 /begin AXIS_DESCR COM_AXIS NO_INPUT_QUANTITY ME11_CM_single_C 4 -40.0 100.0 AXIS_PTS_REF cal_ACCMCtrlC2FF_1X /end AXIS_DESCR
/end CHARACTERISTIC
/begin AXIS_PTS cal_ACCMCtrlC2FF_1X "" 0x0000 /* @ECU_Address@cal_ACCMCtrlC2FF_1X@ */ NO_INPUT_QUANTITY Lookup1D_X_FLOAT32_IEEE 0 ME11_CM_single_C 4 -40.0 100.0 /end AXIS_PTS
/begin CHARACTERISTIC cal_ACCMCtrlCKi_CUR "" CURVE 0x0000 /* @ECU_Address@cal_ACCMCtrlCKi_CUR@ */ Lookup1D_FLOAT32_IEEE 0 ME11_CM_single_null 0.0 100.0
 /begin AXIS_DESCR COM_AXIS ACTCtl_tCtrlCDiff ME11_CM_single_C 8 -100.0 100.0 AXIS_PTS_REF cal_ACCMCtrlCKi_1X /end AXIS_DESCR
/end CHARACTERISTIC
/begin AXIS_PTS cal_ACCMCtrlCKi_1X "" 0x0000 /* @ECU_Address@cal_ACCMCtrlCKi_1X@ */ ACTCtl_tCtrlCDiff Lookup1D_X_FLOAT32_IEEE 0 ME11_CM_single_C 8 -100.0 100.0 /end AXIS_PTS
/begin CHARACTERISTIC cal_ACCMCtrlCKp_CUR "" CURVE 0x0000 /* @ECU_Address@cal_ACCMCtrlCKp_CUR@ */ Lookup1D_FLOAT32_IEEE 0 ME11_CM_single_null 0.0 100.0
 /begin AXIS_DESCR COM_AXIS ACTCtl_tCtrlCDiff ME11_CM_single_C 8 -100.0 100.0 AXIS_PTS_REF cal_ACCMCtrlCKp_1X /end AXIS_DESCR
/end CHARACTERISTIC
/begin AXIS_PTS cal_ACCMCtrlCKp_1X "" 0x0000 /* @ECU_Address@cal_ACCMCtrlCKp_1X@ */ ACTCtl_tCtrlCDiff Lookup1D_X_FLOAT32_IEEE 0 ME11_CM_single_C 8 -100.0 100.0 /end AXIS_PTS
/begin CHARACTERISTIC cal_ACCMCtrlD1FF_CUR "" CURVE 0x0000 /* @ECU_Address@cal_ACCMCtrlD1FF_CUR@ */ Lookup1D_FLOAT32_IEEE 0 ME11_CM_single_rpm 0.0 8000.0
 /begin AXIS_DESCR COM_AXIS ACSen_sEnvTempCor ME11_CM_single_C 3 -40.0 100.0 AXIS_PTS_REF cal_ACCMCtrlD1FF_1X /end AXIS_DESCR
/end CHARACTERISTIC
/begin AXIS_PTS cal_ACCMCtrlD1FF_1X "" 0x0000 /* @ECU_Address@cal_ACCMCtrlD1FF_1X@ */ ACSen_sEnvTempCor Lookup1D_X_FLOAT32_IEEE 0 ME11_CM_single_C 3 -40.0 100.0 /end AXIS_PTS
/begin CHARACTERISTIC cal_ACCMCtrlD2FF_CUR "" CURVE 0x0000 /* @ECU_Address@cal_ACCMCtrlD2FF_CUR@ */ Lookup1D_FLOAT32_IEEE 0 ME11_CM_single_rpm 0.0 8000.0
 /begin AXIS_DESCR COM_AXIS NO_INPUT_QUANTITY ME11_CM_single_C 4 -40.0 100.0 AXIS_PTS_REF cal_ACCMCtrlD2FF_1X /end AXIS_DESCR
/end CHARACTERISTIC
/begin AXIS_PTS cal_ACCMCtrlD2FF_1X "" 0x0000 /* @ECU_Address@cal_ACCMCtrlD2FF_1X@ */ NO_INPUT_QUANTITY Lookup1D_X_FLOAT32_IEEE 0 ME11_CM_single_C 4 -40.0 100.0 /end AXIS_PTS
/begin CHARACTERISTIC cal_ACCMCtrlDKi_CUR "" CURVE 0x0000 /* @ECU_Address@cal_ACCMCtrlDKi_CUR@ */ Lookup1D_FLOAT32_IEEE 0 ME11_CM_single_null 0.0 100.0
 /begin AXIS_DESCR COM_AXIS NO_INPUT_QUANTITY ME11_CM_single_C 8 -40.0 100.0 AXIS_PTS_REF cal_ACCMCtrlDKi_1X /end AXIS_DESCR
/end CHARACTERISTIC
/begin AXIS_PTS cal_ACCMCtrlDKi_1X "" 0x0000 /* @ECU_Address@cal_ACCMCtrlDKi_1X@ */ NO_INPUT_QUANTITY Lookup1D_X_FLOAT32_IEEE 0 ME11_CM_single_C 8 -40.0 100.0 /end AXIS_PTS
/begin CHARACTERISTIC cal_ACCMCtrlDKp_CUR "" CURVE 0x0000 /* @ECU_Address@cal_ACCMCtrlDKp_CUR@ */ Lookup1D_FLOAT32_IEEE 0 ME11_CM_single_null 0.0 100.0
 /begin AXIS_DESCR COM_AXIS NO_INPUT_QUANTITY ME11_CM_single_C 8 -40.0 100.0 AXIS_PTS_REF cal_ACCMCtrlDKp_1X /end AXIS_DESCR
/end CHARACTERISTIC
/begin AXIS_PTS cal_ACCMCtrlDKp_1X "" 0x0000 /* @ECU_Address@cal_ACCMCtrlDKp_1X@ */ NO_INPUT_QUANTITY Lookup1D_X_FLOAT32_IEEE 0 ME11_CM_single_C 8 -40.0 100.0 /end AXIS_PTS
/begin CHARACTERISTIC cal_ACCMCtrlDPIMax_CUR "" CURVE 0x0000 /* @ECU_Address@cal_ACCMCtrlDPIMax_CUR@ */ Lookup1D_FLOAT32_IEEE 0 ME11_CM_single_rpm 0.0 10000.0
 /begin AXIS_DESCR COM_AXIS ACSen_sEnvTempCor ME11_CM_single_C 5 -40.0 80.0 AXIS_PTS_REF cal_ACCMCtrlDPIMax_1X /end AXIS_DESCR
/end CHARACTERISTIC
/begin AXIS_PTS cal_ACCMCtrlDPIMax_1X "" 0x0000 /* @ECU_Address@cal_ACCMCtrlDPIMax_1X@ */ ACSen_sEnvTempCor Lookup1D_X_FLOAT32_IEEE 0 ME11_CM_single_C 5 -40.0 80.0 /end AXIS_PTS
/begin CHARACTERISTIC cal_ACCMCtrlDTrg_CUR "" CURVE 0x0000 /* @ECU_Address@cal_ACCMCtrlDTrg_CUR@ */ Lookup1D_FLOAT32_IEEE 0 ME11_CM_single_C -2.0 20.0
 /begin AXIS_DESCR COM_AXIS ACSen_sEnvTempCor ME11_CM_single_C 7 -30.0 100.0 AXIS_PTS_REF cal_ACCMCtrlDTrg_1X /end AXIS_DESCR
/end CHARACTERISTIC
/begin AXIS_PTS cal_ACCMCtrlDTrg_1X "" 0x0000 /* @ECU_Address@cal_ACCMCtrlDTrg_1X@ */ ACSen_sEnvTempCor Lookup1D_X_FLOAT32_IEEE 0 ME11_CM_single_C 7 -30.0 100.0 /end AXIS_PTS
/begin CHARACTERISTIC cal_ACCMCtrlE1FF_CUR "" CURVE 0x0000 /* @ECU_Address@cal_ACCMCtrlE1FF_CUR@ */ Lookup1D_FLOAT32_IEEE 0 ME11_CM_single_rpm 0.0 8000.0
 /begin AXIS_DESCR COM_AXIS ACSen_sEnvTempCor ME11_CM_single_C 7 -40.0 100.0 AXIS_PTS_REF cal_ACCMCtrlE1FF_1X /end AXIS_DESCR
/end CHARACTERISTIC
/begin AXIS_PTS cal_ACCMCtrlE1FF_1X "" 0x0000 /* @ECU_Address@cal_ACCMCtrlE1FF_1X@ */ ACSen_sEnvTempCor Lookup1D_X_FLOAT32_IEEE 0 ME11_CM_single_C 7 -40.0 100.0 /end AXIS_PTS
/begin CHARACTERISTIC cal_ACCMCtrlE2FF_CUR "" CURVE 0x0000 /* @ECU_Address@cal_ACCMCtrlE2FF_CUR@ */ Lookup1D_FLOAT32_IEEE 0 ME11_CM_single_rpm 0.0 8000.0
 /begin AXIS_DESCR COM_AXIS NO_INPUT_QUANTITY ME11_CM_single_C 4 -40.0 100.0 AXIS_PTS_REF cal_ACCMCtrlE2FF_1X /end AXIS_DESCR
/end CHARACTERISTIC
/begin AXIS_PTS cal_ACCMCtrlE2FF_1X "" 0x0000 /* @ECU_Address@cal_ACCMCtrlE2FF_1X@ */ NO_INPUT_QUANTITY Lookup1D_X_FLOAT32_IEEE 0 ME11_CM_single_C 4 -40.0 100.0 /end AXIS_PTS
/begin CHARACTERISTIC cal_ACCMCtrlEKi_CUR "" CURVE 0x0000 /* @ECU_Address@cal_ACCMCtrlEKi_CUR@ */ Lookup1D_FLOAT32_IEEE 0 ME11_CM_single_null 0.0 100.0
 /begin AXIS_DESCR COM_AXIS NO_INPUT_QUANTITY ME11_CM_single_C 8 -100.0 100.0 AXIS_PTS_REF cal_ACCMCtrlEKi_1X /end AXIS_DESCR
/end CHARACTERISTIC
/begin AXIS_PTS cal_ACCMCtrlEKi_1X "" 0x0000 /* @ECU_Address@cal_ACCMCtrlEKi_1X@ */ NO_INPUT_QUANTITY Lookup1D_X_FLOAT32_IEEE 0 ME11_CM_single_C 8 -100.0 100.0 /end AXIS_PTS
/begin CHARACTERISTIC cal_ACCMCtrlEKp_CUR "" CURVE 0x0000 /* @ECU_Address@cal_ACCMCtrlEKp_CUR@ */ Lookup1D_FLOAT32_IEEE 0 ME11_CM_single_null 0.0 100.0
 /begin AXIS_DESCR COM_AXIS NO_INPUT_QUANTITY ME11_CM_single_C 8 -100.0 100.0 AXIS_PTS_REF cal_ACCMCtrlEKp_1X /end AXIS_DESCR
/end CHARACTERISTIC
/begin AXIS_PTS cal_ACCMCtrlEKp_1X "" 0x0000 /* @ECU_Address@cal_ACCMCtrlEKp_1X@ */ NO_INPUT_QUANTITY Lookup1D_X_FLOAT32_IEEE 0 ME11_CM_single_C 8 -100.0 100.0 /end AXIS_PTS
/begin CHARACTERISTIC cal_ACCMCtrlF1FF_CUR "" CURVE 0x0000 /* @ECU_Address@cal_ACCMCtrlF1FF_CUR@ */ Lookup1D_FLOAT32_IEEE 0 ME11_CM_single_rpm 0.0 8000.0
 /begin AXIS_DESCR COM_AXIS ACSen_sEnvTempCor ME11_CM_single_C 5 -40.0 100.0 AXIS_PTS_REF cal_ACCMCtrlF1FF_1X /end AXIS_DESCR
/end CHARACTERISTIC
/begin AXIS_PTS cal_ACCMCtrlF1FF_1X "" 0x0000 /* @ECU_Address@cal_ACCMCtrlF1FF_1X@ */ ACSen_sEnvTempCor Lookup1D_X_FLOAT32_IEEE 0 ME11_CM_single_C 5 -40.0 100.0 /end AXIS_PTS
/begin CHARACTERISTIC cal_ACCMCtrlF2FF_CUR "" CURVE 0x0000 /* @ECU_Address@cal_ACCMCtrlF2FF_CUR@ */ Lookup1D_FLOAT32_IEEE 0 ME11_CM_single_rpm 0.0 8000.0
 /begin AXIS_DESCR COM_AXIS NO_INPUT_QUANTITY ME11_CM_single_C 5 -40.0 100.0 AXIS_PTS_REF cal_ACCMCtrlF2FF_1X /end AXIS_DESCR
/end CHARACTERISTIC
/begin AXIS_PTS cal_ACCMCtrlF2FF_1X "" 0x0000 /* @ECU_Address@cal_ACCMCtrlF2FF_1X@ */ NO_INPUT_QUANTITY Lookup1D_X_FLOAT32_IEEE 0 ME11_CM_single_C 5 -40.0 100.0 /end AXIS_PTS
/begin CHARACTERISTIC cal_ACCMCtrlFKi_CUR "" CURVE 0x0000 /* @ECU_Address@cal_ACCMCtrlFKi_CUR@ */ Lookup1D_FLOAT32_IEEE 0 ME11_CM_single_null 0.0 100.0
 /begin AXIS_DESCR COM_AXIS NO_INPUT_QUANTITY ME11_CM_single_C 8 -100.0 100.0 AXIS_PTS_REF cal_ACCMCtrlFKi_1X /end AXIS_DESCR
/end CHARACTERISTIC
/begin AXIS_PTS cal_ACCMCtrlFKi_1X "" 0x0000 /* @ECU_Address@cal_ACCMCtrlFKi_1X@ */ NO_INPUT_QUANTITY Lookup1D_X_FLOAT32_IEEE 0 ME11_CM_single_C 8 -100.0 100.0 /end AXIS_PTS
/begin CHARACTERISTIC cal_ACCMCtrlFKp_CUR "" CURVE 0x0000 /* @ECU_Address@cal_ACCMCtrlFKp_CUR@ */ Lookup1D_FLOAT32_IEEE 0 ME11_CM_single_null 0.0 100.0
 /begin AXIS_DESCR COM_AXIS NO_INPUT_QUANTITY ME11_CM_single_C 8 -100.0 100.0 AXIS_PTS_REF cal_ACCMCtrlFKp_1X /end AXIS_DESCR
/end CHARACTERISTIC
/begin AXIS_PTS cal_ACCMCtrlFKp_1X "" 0x0000 /* @ECU_Address@cal_ACCMCtrlFKp_1X@ */ NO_INPUT_QUANTITY Lookup1D_X_FLOAT32_IEEE 0 ME11_CM_single_C 8 -100.0 100.0 /end AXIS_PTS
/begin CHARACTERISTIC cal_ACCMCtrlFPIMax_CUR "" CURVE 0x0000 /* @ECU_Address@cal_ACCMCtrlFPIMax_CUR@ */ Lookup1D_FLOAT32_IEEE 0 ME11_CM_single_rpm 0.0 10000.0
 /begin AXIS_DESCR COM_AXIS ACSen_sEnvTempCor ME11_CM_single_C 5 -40.0 80.0 AXIS_PTS_REF cal_ACCMCtrlFPIMax_1X /end AXIS_DESCR
/end CHARACTERISTIC
/begin AXIS_PTS cal_ACCMCtrlFPIMax_1X "" 0x0000 /* @ECU_Address@cal_ACCMCtrlFPIMax_1X@ */ ACSen_sEnvTempCor Lookup1D_X_FLOAT32_IEEE 0 ME11_CM_single_C 5 -40.0 80.0 /end AXIS_PTS
/begin CHARACTERISTIC cal_CtrlFPTCAuxHeatPwrLmt_MAP "" MAP 0x0000 /* @ECU_Address@cal_CtrlFPTCAuxHeatPwrLmt_MAP@ */ Lookup2D_FLOAT32_IEEE 0 ME11_CM_single_kw 0.0 10.0
 /begin AXIS_DESCR COM_AXIS HMICtl_sLeftSetPoint ME11_CM_single_C 6 0.0 40.0 AXIS_PTS_REF cal_CtrlFPTCAuxHeatPwrLmt_2X /end AXIS_DESCR
 /begin AXIS_DESCR COM_AXIS NO_INPUT_QUANTITY ME11_CM_single_C 6 0.0 30.0 AXIS_PTS_REF cal_CtrlFPTCAuxHeatPwrLmt_2Y /end AXIS_DESCR
/end CHARACTERISTIC
/begin AXIS_PTS cal_CtrlFPTCAuxHeatPwrLmt_2Y "" 0x0000 /* @ECU_Address@cal_CtrlFPTCAuxHeatPwrLmt_2Y@ */ NO_INPUT_QUANTITY Lookup2D_X_FLOAT32_IEEE 0 ME11_CM_single_C 6 0.0 30.0 /end AXIS_PTS
/begin AXIS_PTS cal_CtrlFPTCAuxHeatPwrLmt_2X "" 0x0000 /* @ECU_Address@cal_CtrlFPTCAuxHeatPwrLmt_2X@ */ HMICtl_sLeftSetPoint Lookup2D_X_FLOAT32_IEEE 0 ME11_CM_single_C 6 0.0 40.0 /end AXIS_PTS
/begin CHARACTERISTIC cal_CtrlFPTCOnReqPower_CUR "" CURVE 0x0000 /* @ECU_Address@cal_CtrlFPTCOnReqPower_CUR@ */ Lookup1D_FLOAT32_IEEE 0 ME11_CM_single_kw 0.0 10.0
 /begin AXIS_DESCR COM_AXIS ACCtl_tSetPointPTC ME11_CM_single_C 6 0.0 100.0 AXIS_PTS_REF cal_CtrlFPTCOnReqPower_1X /end AXIS_DESCR
/end CHARACTERISTIC
/begin AXIS_PTS cal_CtrlFPTCOnReqPower_1X "" 0x0000 /* @ECU_Address@cal_CtrlFPTCOnReqPower_1X@ */ ACCtl_tSetPointPTC Lookup1D_X_FLOAT32_IEEE 0 ME11_CM_single_C 6 0.0 100.0 /end AXIS_PTS
/begin CHARACTERISTIC cal_ACCMCtrlH1FF_CUR "" CURVE 0x0000 /* @ECU_Address@cal_ACCMCtrlH1FF_CUR@ */ Lookup1D_FLOAT32_IEEE 0 ME11_CM_single_rpm 0.0 8000.0
 /begin AXIS_DESCR COM_AXIS ACSen_sEnvTempCor ME11_CM_single_C 5 -40.0 100.0 AXIS_PTS_REF cal_ACCMCtrlH1FF_1X /end AXIS_DESCR
/end CHARACTERISTIC
/begin AXIS_PTS cal_ACCMCtrlH1FF_1X "" 0x0000 /* @ECU_Address@cal_ACCMCtrlH1FF_1X@ */ ACSen_sEnvTempCor Lookup1D_X_FLOAT32_IEEE 0 ME11_CM_single_C 5 -40.0 100.0 /end AXIS_PTS
/begin CHARACTERISTIC cal_ACCMCtrlH2FF_CUR "" CURVE 0x0000 /* @ECU_Address@cal_ACCMCtrlH2FF_CUR@ */ Lookup1D_FLOAT32_IEEE 0 ME11_CM_single_rpm 0.0 8000.0
 /begin AXIS_DESCR COM_AXIS NO_INPUT_QUANTITY ME11_CM_single_C 4 -40.0 100.0 AXIS_PTS_REF cal_ACCMCtrlH2FF_1X /end AXIS_DESCR
/end CHARACTERISTIC
/begin AXIS_PTS cal_ACCMCtrlH2FF_1X "" 0x0000 /* @ECU_Address@cal_ACCMCtrlH2FF_1X@ */ NO_INPUT_QUANTITY Lookup1D_X_FLOAT32_IEEE 0 ME11_CM_single_C 4 -40.0 100.0 /end AXIS_PTS
/begin CHARACTERISTIC cal_ACCMCtrlHKi_CUR "" CURVE 0x0000 /* @ECU_Address@cal_ACCMCtrlHKi_CUR@ */ Lookup1D_FLOAT32_IEEE 0 ME11_CM_single_null 0.0 100.0
 /begin AXIS_DESCR COM_AXIS NO_INPUT_QUANTITY ME11_CM_single_C 8 -100.0 100.0 AXIS_PTS_REF cal_ACCMCtrlHKi_1X /end AXIS_DESCR
/end CHARACTERISTIC
/begin AXIS_PTS cal_ACCMCtrlHKi_1X "" 0x0000 /* @ECU_Address@cal_ACCMCtrlHKi_1X@ */ NO_INPUT_QUANTITY Lookup1D_X_FLOAT32_IEEE 0 ME11_CM_single_C 8 -100.0 100.0 /end AXIS_PTS
/begin CHARACTERISTIC cal_ACCMCtrlHKp_CUR "" CURVE 0x0000 /* @ECU_Address@cal_ACCMCtrlHKp_CUR@ */ Lookup1D_FLOAT32_IEEE 0 ME11_CM_single_null 0.0 100.0
 /begin AXIS_DESCR COM_AXIS NO_INPUT_QUANTITY ME11_CM_single_C 8 -100.0 100.0 AXIS_PTS_REF cal_ACCMCtrlHKp_1X /end AXIS_DESCR
/end CHARACTERISTIC
/begin AXIS_PTS cal_ACCMCtrlHKp_1X "" 0x0000 /* @ECU_Address@cal_ACCMCtrlHKp_1X@ */ NO_INPUT_QUANTITY Lookup1D_X_FLOAT32_IEEE 0 ME11_CM_single_C 8 -100.0 100.0 /end AXIS_PTS
/begin CHARACTERISTIC cal_ACFanMaxSpdCellTempLim_CUR "" CURVE 0x0000 /* @ECU_Address@cal_ACFanMaxSpdCellTempLim_CUR@ */ Lookup1D_UBYTE 0 ME11_CM_uint8_percent_ 0.0 100.0
 /begin AXIS_DESCR COM_AXIS BMS_HVBatCellTempMax ME11_CM_single_C 5 -40.0 100.0 AXIS_PTS_REF cal_ACFanMaxSpdCellTempLim_1X /end AXIS_DESCR
/end CHARACTERISTIC
/begin AXIS_PTS cal_ACFanMaxSpdCellTempLim_1X "" 0x0000 /* @ECU_Address@cal_ACFanMaxSpdCellTempLim_1X@ */ BMS_HVBatCellTempMax Lookup1D_X_FLOAT32_IEEE 0 ME11_CM_single_C 5 -40.0 100.0 /end AXIS_PTS
/begin CHARACTERISTIC cal_ACFanMaxSpdDvtLim_CUR "" CURVE 0x0000 /* @ECU_Address@cal_ACFanMaxSpdDvtLim_CUR@ */ Lookup1D_UBYTE 0 ME11_CM_uint8_percent_ 0.0 100.0
 /begin AXIS_DESCR COM_AXIS AC_DVT2PTCErr ME11_CM_single_C 5 -40.0 80.0 AXIS_PTS_REF cal_ACFanMaxSpdDvtLim_1X /end AXIS_DESCR
/end CHARACTERISTIC
/begin AXIS_PTS cal_ACFanMaxSpdDvtLim_1X "" 0x0000 /* @ECU_Address@cal_ACFanMaxSpdDvtLim_1X@ */ AC_DVT2PTCErr Lookup1D_X_FLOAT32_IEEE 0 ME11_CM_single_C 5 -40.0 80.0 /end AXIS_PTS
/begin CHARACTERISTIC cal_ACPTCPwrPreSetByEnv_MAP "" MAP 0x0000 /* @ECU_Address@cal_ACPTCPwrPreSetByEnv_MAP@ */ Lookup2D_UWORD 0 ME11_CM_uint16_w 0.0 10000.0
 /begin AXIS_DESCR COM_AXIS ACSen_sEnvTempCor ME11_CM_single_C 10 -40.0 80.0 AXIS_PTS_REF cal_ACPTCPwrPreSetByEnv_2Y /end AXIS_DESCR
 /begin AXIS_DESCR COM_AXIS ACCtl_tSetPointPTC ME11_CM_single_C 10 -40.0 80.0 AXIS_PTS_REF cal_ACPTCPwrPreSetByEnv_2X /end AXIS_DESCR
/end CHARACTERISTIC
/begin AXIS_PTS cal_ACPTCPwrPreSetByEnv_2X "" 0x0000 /* @ECU_Address@cal_ACPTCPwrPreSetByEnv_2X@ */ ACCtl_tSetPointPTC Lookup2D_X_FLOAT32_IEEE 0 ME11_CM_single_C 10 -40.0 80.0 /end AXIS_PTS
/begin AXIS_PTS cal_ACPTCPwrPreSetByEnv_2Y "" 0x0000 /* @ECU_Address@cal_ACPTCPwrPreSetByEnv_2Y@ */ ACSen_sEnvTempCor Lookup2D_X_FLOAT32_IEEE 0 ME11_CM_single_C 10 -40.0 80.0 /end AXIS_PTS
/begin CHARACTERISTIC cal_ACInletEnvPrtSetCool_CUR "" CURVE 0x0000 /* @ECU_Address@cal_ACInletEnvPrtSetCool_CUR@ */ Lookup1D_UBYTE 0 ME11_CM_uint8_percent_ 0.0 100.0
 /begin AXIS_DESCR COM_AXIS ACSen_sEnvTempCor ME11_CM_single_C 5 -40.0 100.0 AXIS_PTS_REF cal_ACInletEnvPrtSetCool_1X /end AXIS_DESCR
/end CHARACTERISTIC
/begin AXIS_PTS cal_ACInletEnvPrtSetCool_1X "" 0x0000 /* @ECU_Address@cal_ACInletEnvPrtSetCool_1X@ */ ACSen_sEnvTempCor Lookup1D_X_FLOAT32_IEEE 0 ME11_CM_single_C 5 -40.0 100.0 /end AXIS_PTS
/begin CHARACTERISTIC cal_ACInletEnvPrtSetHeat_CUR "" CURVE 0x0000 /* @ECU_Address@cal_ACInletEnvPrtSetHeat_CUR@ */ Lookup1D_UBYTE 0 ME11_CM_uint8_percent_ 0.0 100.0
 /begin AXIS_DESCR COM_AXIS ACSen_sEnvTempCor ME11_CM_single_C 5 -40.0 100.0 AXIS_PTS_REF cal_ACInletEnvPrtSetHeat_1X /end AXIS_DESCR
/end CHARACTERISTIC
/begin AXIS_PTS cal_ACInletEnvPrtSetHeat_1X "" 0x0000 /* @ECU_Address@cal_ACInletEnvPrtSetHeat_1X@ */ ACSen_sEnvTempCor Lookup1D_X_FLOAT32_IEEE 0 ME11_CM_single_C 5 -40.0 100.0 /end AXIS_PTS
/begin CHARACTERISTIC cal_ACDrDVTSolarCor_MAP "" MAP 0x0000 /* @ECU_Address@cal_ACDrDVTSolarCor_MAP@ */ Lookup2D_FLOAT32_IEEE 0 ME11_CM_single_C -40.0 80.0
 /begin AXIS_DESCR COM_AXIS ACSen_sEnvTempCor ME11_CM_single_C 15 -40.0 80.0 AXIS_PTS_REF cal_ACDrDVTSolarCor_2Y /end AXIS_DESCR
 /begin AXIS_DESCR COM_AXIS GlbDa_LeftSolar ME11_CM_uint16_w_per_m_2 15 0.0 1300.0 AXIS_PTS_REF cal_ACDrDVTSolarCor_2X /end AXIS_DESCR
/end CHARACTERISTIC
/begin AXIS_PTS cal_ACDrDVTSolarCor_2X "" 0x0000 /* @ECU_Address@cal_ACDrDVTSolarCor_2X@ */ GlbDa_LeftSolar Lookup2D_X_UWORD 0 ME11_CM_uint16_w_per_m_2 15 0.0 1300.0 /end AXIS_PTS
/begin AXIS_PTS cal_ACDrDVTSolarCor_2Y "" 0x0000 /* @ECU_Address@cal_ACDrDVTSolarCor_2Y@ */ ACSen_sEnvTempCor Lookup2D_X_FLOAT32_IEEE 0 ME11_CM_single_C 15 -40.0 80.0 /end AXIS_PTS
/begin CHARACTERISTIC cal_ACPsDVTSetCorByEnv_MAP "" MAP 0x0000 /* @ECU_Address@cal_ACPsDVTSetCorByEnv_MAP@ */ Lookup2D_FLOAT32_IEEE 0 ME11_CM_single_C -40.0 100.0
 /begin AXIS_DESCR COM_AXIS ACSen_sEnvTempCor ME11_CM_single_C 14 -40.0 80.0 AXIS_PTS_REF cal_ACPsDVTSetCorByEnv_2Y /end AXIS_DESCR
 /begin AXIS_DESCR COM_AXIS AC_Ps2DrSetTempDvt ME11_CM_single_C 14 -40.0 100.0 AXIS_PTS_REF cal_ACPsDVTSetCorByEnv_2X /end AXIS_DESCR
/end CHARACTERISTIC
/begin AXIS_PTS cal_ACPsDVTSetCorByEnv_2X "" 0x0000 /* @ECU_Address@cal_ACPsDVTSetCorByEnv_2X@ */ AC_Ps2DrSetTempDvt Lookup2D_X_FLOAT32_IEEE 0 ME11_CM_single_C 14 -40.0 100.0 /end AXIS_PTS
/begin AXIS_PTS cal_ACPsDVTSetCorByEnv_2Y "" 0x0000 /* @ECU_Address@cal_ACPsDVTSetCorByEnv_2Y@ */ ACSen_sEnvTempCor Lookup2D_X_FLOAT32_IEEE 0 ME11_CM_single_C 14 -40.0 80.0 /end AXIS_PTS
/begin CHARACTERISTIC cal_ACPsDVTSolarCor_MAP "" MAP 0x0000 /* @ECU_Address@cal_ACPsDVTSolarCor_MAP@ */ Lookup2D_FLOAT32_IEEE 0 ME11_CM_single_C -40.0 100.0
 /begin AXIS_DESCR COM_AXIS ACSen_sEnvTempCor ME11_CM_single_C 15 -40.0 80.0 AXIS_PTS_REF cal_ACPsDVTSolarCor_2Y /end AXIS_DESCR
 /begin AXIS_DESCR COM_AXIS GlbDa_RightSolar ME11_CM_uint16_w_per_m_2 15 0.0 1300.0 AXIS_PTS_REF cal_ACPsDVTSolarCor_2X /end AXIS_DESCR
/end CHARACTERISTIC
/begin AXIS_PTS cal_ACPsDVTSolarCor_2X "" 0x0000 /* @ECU_Address@cal_ACPsDVTSolarCor_2X@ */ GlbDa_RightSolar Lookup2D_X_UWORD 0 ME11_CM_uint16_w_per_m_2 15 0.0 1300.0 /end AXIS_PTS
/begin AXIS_PTS cal_ACPsDVTSolarCor_2Y "" 0x0000 /* @ECU_Address@cal_ACPsDVTSolarCor_2Y@ */ ACSen_sEnvTempCor Lookup2D_X_FLOAT32_IEEE 0 ME11_CM_single_C 15 -40.0 80.0 /end AXIS_PTS
/begin CHARACTERISTIC cal_DrEvaDesValPIDLL_MAP "" MAP 0x0000 /* @ECU_Address@cal_DrEvaDesValPIDLL_MAP@ */ Lookup2D_FLOAT32_IEEE 0 ME11_CM_single_C -1.0 30.0
 /begin AXIS_DESCR COM_AXIS HMICtl_sLeftSetPoint ME11_CM_single_C 7 0.0 32.0 AXIS_PTS_REF cal_DrEvaDesValPIDLL_2Y /end AXIS_DESCR
 /begin AXIS_DESCR COM_AXIS NO_INPUT_QUANTITY ME11_CM_uint8_null 4 0.0 10.0 AXIS_PTS_REF cal_DrEvaDesValPIDLL_2X /end AXIS_DESCR
/end CHARACTERISTIC
/begin AXIS_PTS cal_DrEvaDesValPIDLL_2X "" 0x0000 /* @ECU_Address@cal_DrEvaDesValPIDLL_2X@ */ NO_INPUT_QUANTITY Lookup2D_X_UBYTE 0 ME11_CM_uint8_null 4 0.0 10.0 /end AXIS_PTS
/begin AXIS_PTS cal_DrEvaDesValPIDLL_2Y "" 0x0000 /* @ECU_Address@cal_DrEvaDesValPIDLL_2Y@ */ HMICtl_sLeftSetPoint Lookup2D_X_FLOAT32_IEEE 0 ME11_CM_single_C 7 0.0 32.0 /end AXIS_PTS
/begin CHARACTERISTIC cal_PsEvaDesValPIDLL_MAP "" MAP 0x0000 /* @ECU_Address@cal_PsEvaDesValPIDLL_MAP@ */ Lookup2D_FLOAT32_IEEE 0 ME11_CM_single_C -1.0 30.0
 /begin AXIS_DESCR COM_AXIS HMICtl_sLeftSetPoint ME11_CM_single_C 7 0.0 32.0 AXIS_PTS_REF cal_PsEvaDesValPIDLL_2Y /end AXIS_DESCR
 /begin AXIS_DESCR COM_AXIS NO_INPUT_QUANTITY ME11_CM_uint8_null 4 0.0 10.0 AXIS_PTS_REF cal_PsEvaDesValPIDLL_2X /end AXIS_DESCR
/end CHARACTERISTIC
/begin AXIS_PTS cal_PsEvaDesValPIDLL_2X "" 0x0000 /* @ECU_Address@cal_PsEvaDesValPIDLL_2X@ */ NO_INPUT_QUANTITY Lookup2D_X_UBYTE 0 ME11_CM_uint8_null 4 0.0 10.0 /end AXIS_PTS
/begin AXIS_PTS cal_PsEvaDesValPIDLL_2Y "" 0x0000 /* @ECU_Address@cal_PsEvaDesValPIDLL_2Y@ */ HMICtl_sLeftSetPoint Lookup2D_X_FLOAT32_IEEE 0 ME11_CM_single_C 7 0.0 32.0 /end AXIS_PTS
/begin CHARACTERISTIC cal_EvapDesLoLimByEnv_CUR "" CURVE 0x0000 /* @ECU_Address@cal_EvapDesLoLimByEnv_CUR@ */ Lookup1D_FLOAT32_IEEE 0 ME11_CM_single_C -40.0 80.0
 /begin AXIS_DESCR COM_AXIS ACSen_sEnvTempCor ME11_CM_single_C 8 -40.0 80.0 AXIS_PTS_REF cal_EvapDesLoLimByEnv_1X /end AXIS_DESCR
/end CHARACTERISTIC
/begin AXIS_PTS cal_EvapDesLoLimByEnv_1X "" 0x0000 /* @ECU_Address@cal_EvapDesLoLimByEnv_1X@ */ ACSen_sEnvTempCor Lookup1D_X_FLOAT32_IEEE 0 ME11_CM_single_C 8 -40.0 80.0 /end AXIS_PTS
/begin CHARACTERISTIC cal_EvapDesLoLimBySolarCor_CUR "" CURVE 0x0000 /* @ECU_Address@cal_EvapDesLoLimBySolarCor_CUR@ */ Lookup1D_FLOAT32_IEEE 0 ME11_CM_single_C -40.0 80.0
 /begin AXIS_DESCR COM_AXIS GlbDa_Solar ME11_CM_uint16_w_per_m_2 2 0.0 1300.0 AXIS_PTS_REF cal_EvapDesLoLimBySolarCor_1X /end AXIS_DESCR
/end CHARACTERISTIC
/begin AXIS_PTS cal_EvapDesLoLimBySolarCor_1X "" 0x0000 /* @ECU_Address@cal_EvapDesLoLimBySolarCor_1X@ */ GlbDa_Solar Lookup1D_X_UWORD 0 ME11_CM_uint16_w_per_m_2 2 0.0 1300.0 /end AXIS_PTS
/begin CHARACTERISTIC cal_DrMixBacSetDefog_CUR "" CURVE 0x0000 /* @ECU_Address@cal_DrMixBacSetDefog_CUR@ */ Lookup1D_FLOAT32_IEEE 0 ME11_CM_single_percent_ -100.0 100.0
 /begin AXIS_DESCR COM_AXIS ACCtl_tDrDVT ME11_CM_single_C 8 -40.0 80.0 AXIS_PTS_REF cal_DrMixBacSetDefog_1X /end AXIS_DESCR
/end CHARACTERISTIC
/begin AXIS_PTS cal_DrMixBacSetDefog_1X "" 0x0000 /* @ECU_Address@cal_DrMixBacSetDefog_1X@ */ ACCtl_tDrDVT Lookup1D_X_FLOAT32_IEEE 0 ME11_CM_single_C 8 -40.0 80.0 /end AXIS_PTS
/begin CHARACTERISTIC cal_DrMixBacSetFaceHeater_CUR "" CURVE 0x0000 /* @ECU_Address@cal_DrMixBacSetFaceHeater_CUR@ */ Lookup1D_FLOAT32_IEEE 0 ME11_CM_single_percent_ -100.0 100.0
 /begin AXIS_DESCR COM_AXIS ACCtl_tDrDVT ME11_CM_single_C 8 -40.0 80.0 AXIS_PTS_REF cal_DrMixBacSetFaceHeater_1X /end AXIS_DESCR
/end CHARACTERISTIC
/begin AXIS_PTS cal_DrMixBacSetFaceHeater_1X "" 0x0000 /* @ECU_Address@cal_DrMixBacSetFaceHeater_1X@ */ ACCtl_tDrDVT Lookup1D_X_FLOAT32_IEEE 0 ME11_CM_single_C 8 -40.0 80.0 /end AXIS_PTS
/begin CHARACTERISTIC cal_DrMixBacSetFace_CUR "" CURVE 0x0000 /* @ECU_Address@cal_DrMixBacSetFace_CUR@ */ Lookup1D_FLOAT32_IEEE 0 ME11_CM_single_percent_ -100.0 100.0
 /begin AXIS_DESCR COM_AXIS ACCtl_tDrDVT ME11_CM_single_C 8 -40.0 80.0 AXIS_PTS_REF cal_DrMixBacSetFace_1X /end AXIS_DESCR
/end CHARACTERISTIC
/begin AXIS_PTS cal_DrMixBacSetFace_1X "" 0x0000 /* @ECU_Address@cal_DrMixBacSetFace_1X@ */ ACCtl_tDrDVT Lookup1D_X_FLOAT32_IEEE 0 ME11_CM_single_C 8 -40.0 80.0 /end AXIS_PTS
/begin CHARACTERISTIC cal_DrMixBacSetHeaterDeforst_CUR "" CURVE 0x0000 /* @ECU_Address@cal_DrMixBacSetHeaterDeforst_CUR@ */ Lookup1D_FLOAT32_IEEE 0 ME11_CM_single_percent_ -100.0 100.0
 /begin AXIS_DESCR COM_AXIS ACCtl_tDrDVT ME11_CM_single_C 8 -40.0 80.0 AXIS_PTS_REF cal_DrMixBacSetHeaterDeforst_1X /end AXIS_DESCR
/end CHARACTERISTIC
/begin AXIS_PTS cal_DrMixBacSetHeaterDeforst_1X "" 0x0000 /* @ECU_Address@cal_DrMixBacSetHeaterDeforst_1X@ */ ACCtl_tDrDVT Lookup1D_X_FLOAT32_IEEE 0 ME11_CM_single_C 8 -40.0 80.0 /end AXIS_PTS
/begin CHARACTERISTIC cal_DrMixBacSetHeater_CUR "" CURVE 0x0000 /* @ECU_Address@cal_DrMixBacSetHeater_CUR@ */ Lookup1D_FLOAT32_IEEE 0 ME11_CM_single_percent_ -100.0 100.0
 /begin AXIS_DESCR COM_AXIS ACCtl_tDrDVT ME11_CM_single_C 8 -40.0 80.0 AXIS_PTS_REF cal_DrMixBacSetHeater_1X /end AXIS_DESCR
/end CHARACTERISTIC
/begin AXIS_PTS cal_DrMixBacSetHeater_1X "" 0x0000 /* @ECU_Address@cal_DrMixBacSetHeater_1X@ */ ACCtl_tDrDVT Lookup1D_X_FLOAT32_IEEE 0 ME11_CM_single_C 8 -40.0 80.0 /end AXIS_PTS
/begin CHARACTERISTIC cal_MixDoorClsFF_CUR "" CURVE 0x0000 /* @ECU_Address@cal_MixDoorClsFF_CUR@ */ Lookup1D_FLOAT32_IEEE 0 ME11_CM_single_percent_ 0.0 100.0
 /begin AXIS_DESCR COM_AXIS NO_INPUT_QUANTITY ME11_CM_single_C 8 -40.0 100.0 AXIS_PTS_REF cal_MixDoorClsFF_1X /end AXIS_DESCR
/end CHARACTERISTIC
/begin AXIS_PTS cal_MixDoorClsFF_1X "" 0x0000 /* @ECU_Address@cal_MixDoorClsFF_1X@ */ NO_INPUT_QUANTITY Lookup1D_X_FLOAT32_IEEE 0 ME11_CM_single_C 8 -40.0 100.0 /end AXIS_PTS
/begin CHARACTERISTIC cal_MixDoorKi_CUR "" CURVE 0x0000 /* @ECU_Address@cal_MixDoorKi_CUR@ */ Lookup1D_FLOAT32_IEEE 0 ME11_CM_single_percent_ 0.0 100.0
 /begin AXIS_DESCR COM_AXIS NO_INPUT_QUANTITY ME11_CM_single_C 8 -40.0 100.0 AXIS_PTS_REF cal_MixDoorKi_1X /end AXIS_DESCR
/end CHARACTERISTIC
/begin AXIS_PTS cal_MixDoorKi_1X "" 0x0000 /* @ECU_Address@cal_MixDoorKi_1X@ */ NO_INPUT_QUANTITY Lookup1D_X_FLOAT32_IEEE 0 ME11_CM_single_C 8 -40.0 100.0 /end AXIS_PTS
/begin CHARACTERISTIC cal_MixDoorKp_CUR "" CURVE 0x0000 /* @ECU_Address@cal_MixDoorKp_CUR@ */ Lookup1D_FLOAT32_IEEE 0 ME11_CM_single_percent_ 0.0 100.0
 /begin AXIS_DESCR COM_AXIS NO_INPUT_QUANTITY ME11_CM_single_C 8 -40.0 100.0 AXIS_PTS_REF cal_MixDoorKp_1X /end AXIS_DESCR
/end CHARACTERISTIC
/begin AXIS_PTS cal_MixDoorKp_1X "" 0x0000 /* @ECU_Address@cal_MixDoorKp_1X@ */ NO_INPUT_QUANTITY Lookup1D_X_FLOAT32_IEEE 0 ME11_CM_single_C 8 -40.0 100.0 /end AXIS_PTS
/begin CHARACTERISTIC cal_PsMixBacSetAC_CUR "" CURVE 0x0000 /* @ECU_Address@cal_PsMixBacSetAC_CUR@ */ Lookup1D_FLOAT32_IEEE 0 ME11_CM_single_percent_ -100.0 100.0
 /begin AXIS_DESCR COM_AXIS ACCtl_tPsDVT ME11_CM_single_C 8 -40.0 80.0 AXIS_PTS_REF cal_PsMixBacSetAC_1X /end AXIS_DESCR
/end CHARACTERISTIC
/begin AXIS_PTS cal_PsMixBacSetAC_1X "" 0x0000 /* @ECU_Address@cal_PsMixBacSetAC_1X@ */ ACCtl_tPsDVT Lookup1D_X_FLOAT32_IEEE 0 ME11_CM_single_C 8 -40.0 80.0 /end AXIS_PTS
/begin CHARACTERISTIC cal_PsMixBacSetBi_CUR "" CURVE 0x0000 /* @ECU_Address@cal_PsMixBacSetBi_CUR@ */ Lookup1D_FLOAT32_IEEE 0 ME11_CM_single_percent_ -100.0 100.0
 /begin AXIS_DESCR COM_AXIS ACCtl_tPsDVT ME11_CM_single_C 8 -40.0 80.0 AXIS_PTS_REF cal_PsMixBacSetBi_1X /end AXIS_DESCR
/end CHARACTERISTIC
/begin AXIS_PTS cal_PsMixBacSetBi_1X "" 0x0000 /* @ECU_Address@cal_PsMixBacSetBi_1X@ */ ACCtl_tPsDVT Lookup1D_X_FLOAT32_IEEE 0 ME11_CM_single_C 8 -40.0 80.0 /end AXIS_PTS
/begin CHARACTERISTIC cal_PsMixBacSetDefog_CUR "" CURVE 0x0000 /* @ECU_Address@cal_PsMixBacSetDefog_CUR@ */ Lookup1D_FLOAT32_IEEE 0 ME11_CM_single_percent_ -100.0 100.0
 /begin AXIS_DESCR COM_AXIS ACCtl_tPsDVT ME11_CM_single_C 8 -40.0 80.0 AXIS_PTS_REF cal_PsMixBacSetDefog_1X /end AXIS_DESCR
/end CHARACTERISTIC
/begin AXIS_PTS cal_PsMixBacSetDefog_1X "" 0x0000 /* @ECU_Address@cal_PsMixBacSetDefog_1X@ */ ACCtl_tPsDVT Lookup1D_X_FLOAT32_IEEE 0 ME11_CM_single_C 8 -40.0 80.0 /end AXIS_PTS
/begin CHARACTERISTIC cal_PsMixBacSetFootDe_CUR "" CURVE 0x0000 /* @ECU_Address@cal_PsMixBacSetFootDe_CUR@ */ Lookup1D_FLOAT32_IEEE 0 ME11_CM_single_percent_ -100.0 100.0
 /begin AXIS_DESCR COM_AXIS ACCtl_tPsDVT ME11_CM_single_C 8 -40.0 80.0 AXIS_PTS_REF cal_PsMixBacSetFootDe_1X /end AXIS_DESCR
/end CHARACTERISTIC
/begin AXIS_PTS cal_PsMixBacSetFootDe_1X "" 0x0000 /* @ECU_Address@cal_PsMixBacSetFootDe_1X@ */ ACCtl_tPsDVT Lookup1D_X_FLOAT32_IEEE 0 ME11_CM_single_C 8 -40.0 80.0 /end AXIS_PTS
/begin CHARACTERISTIC cal_PsMixBacSetFoot_CUR "" CURVE 0x0000 /* @ECU_Address@cal_PsMixBacSetFoot_CUR@ */ Lookup1D_FLOAT32_IEEE 0 ME11_CM_single_percent_ -100.0 100.0
 /begin AXIS_DESCR COM_AXIS ACCtl_tPsDVT ME11_CM_single_C 8 -40.0 80.0 AXIS_PTS_REF cal_PsMixBacSetFoot_1X /end AXIS_DESCR
/end CHARACTERISTIC
/begin AXIS_PTS cal_PsMixBacSetFoot_1X "" 0x0000 /* @ECU_Address@cal_PsMixBacSetFoot_1X@ */ ACCtl_tPsDVT Lookup1D_X_FLOAT32_IEEE 0 ME11_CM_single_C 8 -40.0 80.0 /end AXIS_PTS
/begin CHARACTERISTIC cal_ACCMCtlDownlmt "" VALUE 0x0000 /* @ECU_Address@cal_ACCMCtlDownlmt@ */ Scalar_FLOAT32_IEEE 0 ME11_CM_single_rpm 0.0 10000.0 /end CHARACTERISTIC
/begin CHARACTERISTIC cal_ACCMCtlUplmt "" VALUE 0x0000 /* @ECU_Address@cal_ACCMCtlUplmt@ */ Scalar_FLOAT32_IEEE 0 ME11_CM_single_rpm 0.0 10000.0 /end CHARACTERISTIC
/begin CHARACTERISTIC cal_ACCMCtrlACct "" VALUE 0x0000 /* @ECU_Address@cal_ACCMCtrlACct@ */ Scalar_FLOAT32_IEEE 0 ME11_CM_single_null 0.0 10.0 /end CHARACTERISTIC
/begin CHARACTERISTIC cal_ACCMCtrlADeadzone "" VALUE 0x0000 /* @ECU_Address@cal_ACCMCtrlADeadzone@ */ Scalar_FLOAT32_IEEE 0 ME11_CM_single_C 0.0 5.0 /end CHARACTERISTIC
/begin CHARACTERISTIC cal_ACCMCtrlADlyTime "" VALUE 0x0000 /* @ECU_Address@cal_ACCMCtrlADlyTime@ */ Scalar_FLOAT32_IEEE 0 ME11_CM_single_s 0.0 100.0 /end CHARACTERISTIC
/begin CHARACTERISTIC cal_ACCMCtrlAPIMax "" VALUE 0x0000 /* @ECU_Address@cal_ACCMCtrlAPIMax@ */ Scalar_FLOAT32_IEEE 0 ME11_CM_single_rpm 0.0 8000.0 /end CHARACTERISTIC
/begin CHARACTERISTIC cal_ACCMCtrlAPIMin "" VALUE 0x0000 /* @ECU_Address@cal_ACCMCtrlAPIMin@ */ Scalar_FLOAT32_IEEE 0 ME11_CM_single_rpm 0.0 8000.0 /end CHARACTERISTIC
/begin CHARACTERISTIC cal_ACCMCtrlARunTime "" VALUE 0x0000 /* @ECU_Address@cal_ACCMCtrlARunTime@ */ Scalar_FLOAT32_IEEE 0 ME11_CM_single_s 0.0 100.0 /end CHARACTERISTIC
/begin CHARACTERISTIC cal_ACCMCtrlBDeadzone "" VALUE 0x0000 /* @ECU_Address@cal_ACCMCtrlBDeadzone@ */ Scalar_FLOAT32_IEEE 0 ME11_CM_single_C 0.0 10.0 /end CHARACTERISTIC
/begin CHARACTERISTIC cal_ACCMCtrlBDlyTime "" VALUE 0x0000 /* @ECU_Address@cal_ACCMCtrlBDlyTime@ */ Scalar_FLOAT32_IEEE 0 ME11_CM_single_s 0.0 100.0 /end CHARACTERISTIC
/begin CHARACTERISTIC cal_ACCMCtrlBPIMax "" VALUE 0x0000 /* @ECU_Address@cal_ACCMCtrlBPIMax@ */ Scalar_FLOAT32_IEEE 0 ME11_CM_single_rpm 0.0 8000.0 /end CHARACTERISTIC
/begin CHARACTERISTIC cal_ACCMCtrlBPIMin "" VALUE 0x0000 /* @ECU_Address@cal_ACCMCtrlBPIMin@ */ Scalar_FLOAT32_IEEE 0 ME11_CM_single_rpm 0.0 8000.0 /end CHARACTERISTIC
/begin CHARACTERISTIC cal_ACCMCtrlBRunTime "" VALUE 0x0000 /* @ECU_Address@cal_ACCMCtrlBRunTime@ */ Scalar_FLOAT32_IEEE 0 ME11_CM_single_s 0.0 100.0 /end CHARACTERISTIC
/begin CHARACTERISTIC cal_ACCMCtrlCDeadzone "" VALUE 0x0000 /* @ECU_Address@cal_ACCMCtrlCDeadzone@ */ Scalar_FLOAT32_IEEE 0 ME11_CM_single_C 0.0 5.0 /end CHARACTERISTIC
/begin CHARACTERISTIC cal_ACCMCtrlCDlyTime "" VALUE 0x0000 /* @ECU_Address@cal_ACCMCtrlCDlyTime@ */ Scalar_FLOAT32_IEEE 0 ME11_CM_single_s 0.0 100.0 /end CHARACTERISTIC
/begin CHARACTERISTIC cal_ACCMCtrlCPIMax "" VALUE 0x0000 /* @ECU_Address@cal_ACCMCtrlCPIMax@ */ Scalar_FLOAT32_IEEE 0 ME11_CM_single_rpm 0.0 8000.0 /end CHARACTERISTIC
/begin CHARACTERISTIC cal_ACCMCtrlCPIMin "" VALUE 0x0000 /* @ECU_Address@cal_ACCMCtrlCPIMin@ */ Scalar_FLOAT32_IEEE 0 ME11_CM_single_rpm 0.0 8000.0 /end CHARACTERISTIC
/begin CHARACTERISTIC cal_ACCMCtrlCRunTime "" VALUE 0x0000 /* @ECU_Address@cal_ACCMCtrlCRunTime@ */ Scalar_FLOAT32_IEEE 0 ME11_CM_single_s 0.0 100.0 /end CHARACTERISTIC
/begin CHARACTERISTIC cal_ACCMCtrlDDeadzone "" VALUE 0x0000 /* @ECU_Address@cal_ACCMCtrlDDeadzone@ */ Scalar_FLOAT32_IEEE 0 ME11_CM_single_C 0.0 5.0 /end CHARACTERISTIC
/begin CHARACTERISTIC cal_ACCMCtrlDDlyTime "" VALUE 0x0000 /* @ECU_Address@cal_ACCMCtrlDDlyTime@ */ Scalar_FLOAT32_IEEE 0 ME11_CM_single_s 0.0 100.0 /end CHARACTERISTIC
/begin CHARACTERISTIC cal_ACCMCtrlDPIMin "" VALUE 0x0000 /* @ECU_Address@cal_ACCMCtrlDPIMin@ */ Scalar_FLOAT32_IEEE 0 ME11_CM_single_rpm 0.0 8000.0 /end CHARACTERISTIC
/begin CHARACTERISTIC cal_ACCMCtrlDRunTime "" VALUE 0x0000 /* @ECU_Address@cal_ACCMCtrlDRunTime@ */ Scalar_FLOAT32_IEEE 0 ME11_CM_single_s 0.0 100.0 /end CHARACTERISTIC
/begin CHARACTERISTIC cal_ACCMCtrlEDeadzone "" VALUE 0x0000 /* @ECU_Address@cal_ACCMCtrlEDeadzone@ */ Scalar_FLOAT32_IEEE 0 ME11_CM_single_C 0.0 5.0 /end CHARACTERISTIC
/begin CHARACTERISTIC cal_ACCMCtrlEDlyTime "" VALUE 0x0000 /* @ECU_Address@cal_ACCMCtrlEDlyTime@ */ Scalar_FLOAT32_IEEE 0 ME11_CM_single_s 0.0 100.0 /end CHARACTERISTIC
/begin CHARACTERISTIC cal_ACCMCtrlEPIMax "" VALUE 0x0000 /* @ECU_Address@cal_ACCMCtrlEPIMax@ */ Scalar_FLOAT32_IEEE 0 ME11_CM_single_rpm 0.0 8000.0 /end CHARACTERISTIC
/begin CHARACTERISTIC cal_ACCMCtrlEPIMin "" VALUE 0x0000 /* @ECU_Address@cal_ACCMCtrlEPIMin@ */ Scalar_FLOAT32_IEEE 0 ME11_CM_single_rpm 0.0 8000.0 /end CHARACTERISTIC
/begin CHARACTERISTIC cal_ACCMCtrlERunTime "" VALUE 0x0000 /* @ECU_Address@cal_ACCMCtrlERunTime@ */ Scalar_FLOAT32_IEEE 0 ME11_CM_single_s 0.0 100.0 /end CHARACTERISTIC
/begin CHARACTERISTIC cal_ACCMCtrlETrgTemp "" VALUE 0x0000 /* @ECU_Address@cal_ACCMCtrlETrgTemp@ */ Scalar_FLOAT32_IEEE 0 ME11_CM_single_C -5.0 20.0 /end CHARACTERISTIC
/begin CHARACTERISTIC cal_ACCMCtrlFDeadzone "" VALUE 0x0000 /* @ECU_Address@cal_ACCMCtrlFDeadzone@ */ Scalar_FLOAT32_IEEE 0 ME11_CM_single_C 0.0 5.0 /end CHARACTERISTIC
/begin CHARACTERISTIC cal_ACCMCtrlFDlyTime "" VALUE 0x0000 /* @ECU_Address@cal_ACCMCtrlFDlyTime@ */ Scalar_FLOAT32_IEEE 0 ME11_CM_single_s 0.0 100.0 /end CHARACTERISTIC
/begin CHARACTERISTIC cal_ACCMCtrlFPIMin "" VALUE 0x0000 /* @ECU_Address@cal_ACCMCtrlFPIMin@ */ Scalar_FLOAT32_IEEE 0 ME11_CM_single_rpm 0.0 8000.0 /end CHARACTERISTIC
/begin CHARACTERISTIC cal_ACCMCtrlFRunTime "" VALUE 0x0000 /* @ECU_Address@cal_ACCMCtrlFRunTime@ */ Scalar_FLOAT32_IEEE 0 ME11_CM_single_s 0.0 100.0 /end CHARACTERISTIC
/begin CHARACTERISTIC cal_ACCMCtrlHCct "" VALUE 0x0000 /* @ECU_Address@cal_ACCMCtrlHCct@ */ Scalar_FLOAT32_IEEE 0 ME11_CM_single_null 0.0 100.0 /end CHARACTERISTIC
/begin CHARACTERISTIC cal_ACCMCtrlHDeadzone "" VALUE 0x0000 /* @ECU_Address@cal_ACCMCtrlHDeadzone@ */ Scalar_FLOAT32_IEEE 0 ME11_CM_single_C 0.0 5.0 /end CHARACTERISTIC
/begin CHARACTERISTIC cal_ACCMCtrlHDlyTime "" VALUE 0x0000 /* @ECU_Address@cal_ACCMCtrlHDlyTime@ */ Scalar_FLOAT32_IEEE 0 ME11_CM_single_s 0.0 100.0 /end CHARACTERISTIC
/begin CHARACTERISTIC cal_ACCMCtrlHPIMax "" VALUE 0x0000 /* @ECU_Address@cal_ACCMCtrlHPIMax@ */ Scalar_FLOAT32_IEEE 0 ME11_CM_single_rpm 0.0 8000.0 /end CHARACTERISTIC
/begin CHARACTERISTIC cal_ACCMCtrlHPIMin "" VALUE 0x0000 /* @ECU_Address@cal_ACCMCtrlHPIMin@ */ Scalar_FLOAT32_IEEE 0 ME11_CM_single_rpm 0.0 8000.0 /end CHARACTERISTIC
/begin CHARACTERISTIC cal_ACCMCtrlHRunTime "" VALUE 0x0000 /* @ECU_Address@cal_ACCMCtrlHRunTime@ */ Scalar_FLOAT32_IEEE 0 ME11_CM_single_s 0.0 100.0 /end CHARACTERISTIC
/begin CHARACTERISTIC cal_ACCMCtrlSpdData "" VALUE 0x0000 /* @ECU_Address@cal_ACCMCtrlSpdData@ */ Scalar_FLOAT32_IEEE 0 ME11_CM_single_rpm 0.0 10000.0 /end CHARACTERISTIC
/begin CHARACTERISTIC cal_AEXVClsEvapPrtTemp "" VALUE 0x0000 /* @ECU_Address@cal_AEXVClsEvapPrtTemp@ */ Scalar_FLOAT32_IEEE 0 ME11_CM_single_C -20.0 20.0 /end CHARACTERISTIC
/begin CHARACTERISTIC cal_AEXVClsValEvapPrt "" VALUE 0x0000 /* @ECU_Address@cal_AEXVClsValEvapPrt@ */ Scalar_FLOAT32_IEEE 0 ME11_CM_single_percent_ 0.0 10.0 /end CHARACTERISTIC
/begin CHARACTERISTIC cal_AEXVClsValRunTimeEvapPrt "" VALUE 0x0000 /* @ECU_Address@cal_AEXVClsValRunTimeEvapPrt@ */ Scalar_FLOAT32_IEEE 0 ME11_CM_single_s 0.0 100.0 /end CHARACTERISTIC
/begin CHARACTERISTIC cal_AEXVCtlKi "" VALUE 0x0000 /* @ECU_Address@cal_AEXVCtlKi@ */ Scalar_FLOAT32_IEEE 0 ME11_CM_single_null 0.0 10.0 /end CHARACTERISTIC
/begin CHARACTERISTIC cal_AEXVCtlKisumMax "" VALUE 0x0000 /* @ECU_Address@cal_AEXVCtlKisumMax@ */ Scalar_FLOAT32_IEEE 0 ME11_CM_single_percent_ 0.0 100.0 /end CHARACTERISTIC
/begin CHARACTERISTIC cal_AEXVCtlKisumMin "" VALUE 0x0000 /* @ECU_Address@cal_AEXVCtlKisumMin@ */ Scalar_FLOAT32_IEEE 0 ME11_CM_single_percent_ -100.0 100.0 /end CHARACTERISTIC
/begin CHARACTERISTIC cal_AEXVCtlKp "" VALUE 0x0000 /* @ECU_Address@cal_AEXVCtlKp@ */ Scalar_FLOAT32_IEEE 0 ME11_CM_single_null 0.0 10.0 /end CHARACTERISTIC
/begin CHARACTERISTIC cal_AEXVFltClsSpd "" VALUE 0x0000 /* @ECU_Address@cal_AEXVFltClsSpd@ */ Scalar_FLOAT32_IEEE 0 ME11_CM_single_percent_ 0.0 10.0 /end CHARACTERISTIC
/begin CHARACTERISTIC cal_AEXVHighPressProhOn "" VALUE 0x0000 /* @ECU_Address@cal_AEXVHighPressProhOn@ */ Scalar_FLOAT32_IEEE 0 ME11_CM_single_Mpa 0.0 10.0 /end CHARACTERISTIC
/begin CHARACTERISTIC cal_AEXVLowPressProhOn "" VALUE 0x0000 /* @ECU_Address@cal_AEXVLowPressProhOn@ */ Scalar_FLOAT32_IEEE 0 ME11_CM_single_Mpa 0.0 5.0 /end CHARACTERISTIC
/begin CHARACTERISTIC cal_AEXVOpenDelayTimeEvapNOPrt "" VALUE 0x0000 /* @ECU_Address@cal_AEXVOpenDelayTimeEvapNOPrt@ */ Scalar_FLOAT32_IEEE 0 ME11_CM_single_s 0.0 100.0 /end CHARACTERISTIC
/begin CHARACTERISTIC cal_AEXVOpenEvapNOPrtTemp "" VALUE 0x0000 /* @ECU_Address@cal_AEXVOpenEvapNOPrtTemp@ */ Scalar_FLOAT32_IEEE 0 ME11_CM_single_C 0.0 20.0 /end CHARACTERISTIC
/begin CHARACTERISTIC cal_AEXVOpenRunTimeEvapNOPrt "" VALUE 0x0000 /* @ECU_Address@cal_AEXVOpenRunTimeEvapNOPrt@ */ Scalar_FLOAT32_IEEE 0 ME11_CM_single_s 0.0 100.0 /end CHARACTERISTIC
/begin CHARACTERISTIC cal_AEXVOpenValEvapNOPrt "" VALUE 0x0000 /* @ECU_Address@cal_AEXVOpenValEvapNOPrt@ */ Scalar_FLOAT32_IEEE 0 ME11_CM_single_percent_ 0.0 10.0 /end CHARACTERISTIC
/begin CHARACTERISTIC cal_AEXVOpenValveSpd "" VALUE 0x0000 /* @ECU_Address@cal_AEXVOpenValveSpd@ */ Scalar_FLOAT32_IEEE 0 ME11_CM_single_percent_ 0.0 5.0 /end CHARACTERISTIC
/begin CHARACTERISTIC cal_AirInletRecInPCUTemp "" VALUE 0x0000 /* @ECU_Address@cal_AirInletRecInPCUTemp@ */ Scalar_FLOAT32_IEEE 0 ME11_CM_single_C -40.0 100.0 /end CHARACTERISTIC
/begin CHARACTERISTIC cal_AirInletRecOutPCUTemp "" VALUE 0x0000 /* @ECU_Address@cal_AirInletRecOutPCUTemp@ */ Scalar_FLOAT32_IEEE 0 ME11_CM_single_C -40.0 100.0 /end CHARACTERISTIC
/begin CHARACTERISTIC cal_BCVPosDiffDelayTime "" VALUE 0x0000 /* @ECU_Address@cal_BCVPosDiffDelayTime@ */ Scalar_FLOAT32_IEEE 0 ME11_CM_single_min 0.0 300.0 /end CHARACTERISTIC
/begin CHARACTERISTIC cal_BEXVCtlKi "" VALUE 0x0000 /* @ECU_Address@cal_BEXVCtlKi@ */ Scalar_FLOAT32_IEEE 0 ME11_CM_single_null 0.0 10.0 /end CHARACTERISTIC
/begin CHARACTERISTIC cal_BEXVCtlKisumMax "" VALUE 0x0000 /* @ECU_Address@cal_BEXVCtlKisumMax@ */ Scalar_FLOAT32_IEEE 0 ME11_CM_single_percent_ 0.0 100.0 /end CHARACTERISTIC
/begin CHARACTERISTIC cal_BEXVCtlKisumMin "" VALUE 0x0000 /* @ECU_Address@cal_BEXVCtlKisumMin@ */ Scalar_FLOAT32_IEEE 0 ME11_CM_single_percent_ -100.0 100.0 /end CHARACTERISTIC
/begin CHARACTERISTIC cal_BEXVCtlKp "" VALUE 0x0000 /* @ECU_Address@cal_BEXVCtlKp@ */ Scalar_FLOAT32_IEEE 0 ME11_CM_single_null 0.0 10.0 /end CHARACTERISTIC
/begin CHARACTERISTIC cal_BEXVHighPressProhOn "" VALUE 0x0000 /* @ECU_Address@cal_BEXVHighPressProhOn@ */ Scalar_FLOAT32_IEEE 0 ME11_CM_single_Mpa 0.0 10.0 /end CHARACTERISTIC
/begin CHARACTERISTIC cal_BEXVLowPressProhOn "" VALUE 0x0000 /* @ECU_Address@cal_BEXVLowPressProhOn@ */ Scalar_FLOAT32_IEEE 0 ME11_CM_single_Mpa 0.0 5.0 /end CHARACTERISTIC
/begin CHARACTERISTIC cal_BEXVOpenValveSpd "" VALUE 0x0000 /* @ECU_Address@cal_BEXVOpenValveSpd@ */ Scalar_FLOAT32_IEEE 0 ME11_CM_single_percent_ 0.0 5.0 /end CHARACTERISTIC
/begin CHARACTERISTIC cal_BMSInletTempHighOffMCV "" VALUE 0x0000 /* @ECU_Address@cal_BMSInletTempHighOffMCV@ */ Scalar_FLOAT32_IEEE 0 ME11_CM_single_C -40.0 100.0 /end CHARACTERISTIC
/begin CHARACTERISTIC cal_BMSInletTempLowOnMCV "" VALUE 0x0000 /* @ECU_Address@cal_BMSInletTempLowOnMCV@ */ Scalar_FLOAT32_IEEE 0 ME11_CM_single_C -40.0 100.0 /end CHARACTERISTIC
/begin CHARACTERISTIC cal_BatBalCellTemp1 "" VALUE 0x0000 /* @ECU_Address@cal_BatBalCellTemp1@ */ Scalar_FLOAT32_IEEE 0 ME11_CM_single_C -40.0 50.0 /end CHARACTERISTIC
/begin CHARACTERISTIC cal_BatBalCellTemp2 "" VALUE 0x0000 /* @ECU_Address@cal_BatBalCellTemp2@ */ Scalar_FLOAT32_IEEE 0 ME11_CM_single_C -40.0 50.0 /end CHARACTERISTIC
/begin CHARACTERISTIC cal_BatCoolInletTrgTemp "" VALUE 0x0000 /* @ECU_Address@cal_BatCoolInletTrgTemp@ */ Scalar_FLOAT32_IEEE 0 ME11_CM_single_C 10.0 30.0 /end CHARACTERISTIC
/begin CHARACTERISTIC cal_BatCoolTrgFilter "" VALUE 0x0000 /* @ECU_Address@cal_BatCoolTrgFilter@ */ Scalar_FLOAT32_IEEE 0 ME11_CM_single_C_per_0_1s 0.0 100.0 /end CHARACTERISTIC
/begin CHARACTERISTIC cal_COMPBatMaxSpdLmt "" VALUE 0x0000 /* @ECU_Address@cal_COMPBatMaxSpdLmt@ */ Scalar_FLOAT32_IEEE 0 ME11_CM_single_rpm 0.0 8000.0 /end CHARACTERISTIC
/begin CHARACTERISTIC cal_COMPCabinCoolMaxSpdLmt "" VALUE 0x0000 /* @ECU_Address@cal_COMPCabinCoolMaxSpdLmt@ */ Scalar_FLOAT32_IEEE 0 ME11_CM_single_rpm 0.0 8000.0 /end CHARACTERISTIC
/begin CHARACTERISTIC cal_COMPCoolLowSpd "" VALUE 0x0000 /* @ECU_Address@cal_COMPCoolLowSpd@ */ Scalar_FLOAT32_IEEE 0 ME11_CM_single_km_per_h 0.0 100.0 /end CHARACTERISTIC
/begin CHARACTERISTIC cal_COMPExhTDownSpd "" VALUE 0x0000 /* @ECU_Address@cal_COMPExhTDownSpd@ */ Scalar_FLOAT32_IEEE 0 ME11_CM_single_rpm 0.0 2000.0 /end CHARACTERISTIC
/begin CHARACTERISTIC cal_CabinMD2F2MaxEnvTemp "" VALUE 0x0000 /* @ECU_Address@cal_CabinMD2F2MaxEnvTemp@ */ Scalar_FLOAT32_IEEE 0 ME11_CM_single_C 10.0 38.0 /end CHARACTERISTIC
/begin CHARACTERISTIC cal_CondDepFilter "" VALUE 0x0000 /* @ECU_Address@cal_CondDepFilter@ */ Scalar_FLOAT32_IEEE 0 ME11_CM_single_per_ 0.0 1.0 /end CHARACTERISTIC
/begin CHARACTERISTIC cal_CoolStartCompensate "" VALUE 0x0000 /* @ECU_Address@cal_CoolStartCompensate@ */ Scalar_FLOAT32_IEEE 0 ME11_CM_single_per_ -3.4E+38 3.4E+38 /end CHARACTERISTIC
/begin CHARACTERISTIC cal_CtrlFPTCOffPowerVal "" VALUE 0x0000 /* @ECU_Address@cal_CtrlFPTCOffPowerVal@ */ Scalar_FLOAT32_IEEE 0 ME11_CM_single_kw 0.0 10.0 /end CHARACTERISTIC
/begin CHARACTERISTIC cal_DLTRIPUTempExitVal "" VALUE 0x0000 /* @ECU_Address@cal_DLTRIPUTempExitVal@ */ Scalar_FLOAT32_IEEE 0 ME11_CM_single_C 0.0 100.0 /end CHARACTERISTIC
/begin CHARACTERISTIC cal_DcutTPidDeadBand "" VALUE 0x0000 /* @ECU_Address@cal_DcutTPidDeadBand@ */ Scalar_FLOAT32_IEEE 0 ME11_CM_single_per_ -3.4E+38 3.4E+38 /end CHARACTERISTIC
/begin CHARACTERISTIC cal_DcutTempPidLL "" VALUE 0x0000 /* @ECU_Address@cal_DcutTempPidLL@ */ Scalar_FLOAT32_IEEE 0 ME11_CM_single_per_ -3.4E+38 3.4E+38 /end CHARACTERISTIC
/begin CHARACTERISTIC cal_DcutTempPidUL "" VALUE 0x0000 /* @ECU_Address@cal_DcutTempPidUL@ */ Scalar_FLOAT32_IEEE 0 ME11_CM_single_per_ -3.4E+38 3.4E+38 /end CHARACTERISTIC
/begin CHARACTERISTIC cal_DcutTempPid_IsumMax "" VALUE 0x0000 /* @ECU_Address@cal_DcutTempPid_IsumMax@ */ Scalar_FLOAT32_IEEE 0 ME11_CM_single_per_ -3.4E+38 3.4E+38 /end CHARACTERISTIC
/begin CHARACTERISTIC cal_DcutTempPid_IsumMin "" VALUE 0x0000 /* @ECU_Address@cal_DcutTempPid_IsumMin@ */ Scalar_FLOAT32_IEEE 0 ME11_CM_single_per_ -3.4E+38 3.4E+38 /end CHARACTERISTIC
/begin CHARACTERISTIC cal_DcutTempPid_Ki "" VALUE 0x0000 /* @ECU_Address@cal_DcutTempPid_Ki@ */ Scalar_FLOAT32_IEEE 0 ME11_CM_single_per_ -3.4E+38 3.4E+38 /end CHARACTERISTIC
/begin CHARACTERISTIC cal_DcutTempPid_KiNeg "" VALUE 0x0000 /* @ECU_Address@cal_DcutTempPid_KiNeg@ */ Scalar_FLOAT32_IEEE 0 ME11_CM_single_per_ -3.4E+38 3.4E+38 /end CHARACTERISTIC
/begin CHARACTERISTIC cal_DcutTempPid_KiPos "" VALUE 0x0000 /* @ECU_Address@cal_DcutTempPid_KiPos@ */ Scalar_FLOAT32_IEEE 0 ME11_CM_single_per_ -3.4E+38 3.4E+38 /end CHARACTERISTIC
/begin CHARACTERISTIC cal_DcutTempPid_Kp "" VALUE 0x0000 /* @ECU_Address@cal_DcutTempPid_Kp@ */ Scalar_FLOAT32_IEEE 0 ME11_CM_single_per_ -3.4E+38 3.4E+38 /end CHARACTERISTIC
/begin CHARACTERISTIC cal_DcutTempPid_KpNeg "" VALUE 0x0000 /* @ECU_Address@cal_DcutTempPid_KpNeg@ */ Scalar_FLOAT32_IEEE 0 ME11_CM_single_per_ -3.4E+38 3.4E+38 /end CHARACTERISTIC
/begin CHARACTERISTIC cal_DcutTempPid_KpPos "" VALUE 0x0000 /* @ECU_Address@cal_DcutTempPid_KpPos@ */ Scalar_FLOAT32_IEEE 0 ME11_CM_single_per_ -3.4E+38 3.4E+38 /end CHARACTERISTIC
/begin CHARACTERISTIC cal_DcutTempPid_pWinNeg "" VALUE 0x0000 /* @ECU_Address@cal_DcutTempPid_pWinNeg@ */ Scalar_FLOAT32_IEEE 0 ME11_CM_single_per_ -3.4E+38 3.4E+38 /end CHARACTERISTIC
/begin CHARACTERISTIC cal_DcutTempPid_pWinPos "" VALUE 0x0000 /* @ECU_Address@cal_DcutTempPid_pWinPos@ */ Scalar_FLOAT32_IEEE 0 ME11_CM_single_per_ -3.4E+38 3.4E+38 /end CHARACTERISTIC
/begin CHARACTERISTIC cal_DrDuctFaceFloorFaFactor "" VALUE 0x0000 /* @ECU_Address@cal_DrDuctFaceFloorFaFactor@ */ Scalar_FLOAT32_IEEE 0 ME11_CM_single_per_ -3.4E+38 3.4E+38 /end CHARACTERISTIC
/begin CHARACTERISTIC cal_DrDuctFaceFloorFoFactor "" VALUE 0x0000 /* @ECU_Address@cal_DrDuctFaceFloorFoFactor@ */ Scalar_FLOAT32_IEEE 0 ME11_CM_single_per_ -3.4E+38 3.4E+38 /end CHARACTERISTIC
/begin CHARACTERISTIC cal_DrDuctSenFailDeflt "" VALUE 0x0000 /* @ECU_Address@cal_DrDuctSenFailDeflt@ */ Scalar_FLOAT32_IEEE 0 ME11_CM_single_per_ -3.4E+38 3.4E+38 /end CHARACTERISTIC
/begin CHARACTERISTIC cal_DrErrOfEvaDVT2CoolMixOff "" VALUE 0x0000 /* @ECU_Address@cal_DrErrOfEvaDVT2CoolMixOff@ */ Scalar_FLOAT32_IEEE 0 ME11_CM_single_per_ -40.0 100.0 /end CHARACTERISTIC
/begin CHARACTERISTIC cal_DrErrOfEvaDVT2CoolMixOn "" VALUE 0x0000 /* @ECU_Address@cal_DrErrOfEvaDVT2CoolMixOn@ */ Scalar_FLOAT32_IEEE 0 ME11_CM_single_per_ -40.0 100.0 /end CHARACTERISTIC
/begin CHARACTERISTIC cal_DrErrOfPtcDVT2HeatMixOff "" VALUE 0x0000 /* @ECU_Address@cal_DrErrOfPtcDVT2HeatMixOff@ */ Scalar_FLOAT32_IEEE 0 ME11_CM_single_per_ -40.0 100.0 /end CHARACTERISTIC
/begin CHARACTERISTIC cal_DrErrOfPtcDVT2HeatMixOn "" VALUE 0x0000 /* @ECU_Address@cal_DrErrOfPtcDVT2HeatMixOn@ */ Scalar_FLOAT32_IEEE 0 ME11_CM_single_per_ -40.0 100.0 /end CHARACTERISTIC
/begin CHARACTERISTIC cal_DrMixDesValPIDIntegDeadBand "" VALUE 0x0000 /* @ECU_Address@cal_DrMixDesValPIDIntegDeadBand@ */ Scalar_FLOAT32_IEEE 0 ME11_CM_single_per_ -3.4E+38 3.4E+38 /end CHARACTERISTIC
/begin CHARACTERISTIC cal_DrMixDesValPID_IsumMax "" VALUE 0x0000 /* @ECU_Address@cal_DrMixDesValPID_IsumMax@ */ Scalar_FLOAT32_IEEE 0 ME11_CM_single_per_ -3.4E+38 3.4E+38 /end CHARACTERISTIC
/begin CHARACTERISTIC cal_DrMixDesValPID_IsumMin "" VALUE 0x0000 /* @ECU_Address@cal_DrMixDesValPID_IsumMin@ */ Scalar_FLOAT32_IEEE 0 ME11_CM_single_per_ -3.4E+38 3.4E+38 /end CHARACTERISTIC
/begin CHARACTERISTIC cal_DrMixDesValPID_Ki "" VALUE 0x0000 /* @ECU_Address@cal_DrMixDesValPID_Ki@ */ Scalar_FLOAT32_IEEE 0 ME11_CM_single_per_ -3.4E+38 3.4E+38 /end CHARACTERISTIC
/begin CHARACTERISTIC cal_DrMixDesValPID_KiNeg "" VALUE 0x0000 /* @ECU_Address@cal_DrMixDesValPID_KiNeg@ */ Scalar_FLOAT32_IEEE 0 ME11_CM_single_per_ -3.4E+38 3.4E+38 /end CHARACTERISTIC
/begin CHARACTERISTIC cal_DrMixDesValPID_KiPos "" VALUE 0x0000 /* @ECU_Address@cal_DrMixDesValPID_KiPos@ */ Scalar_FLOAT32_IEEE 0 ME11_CM_single_per_ -3.4E+38 3.4E+38 /end CHARACTERISTIC
/begin CHARACTERISTIC cal_DrMixDesValPID_Kp "" VALUE 0x0000 /* @ECU_Address@cal_DrMixDesValPID_Kp@ */ Scalar_FLOAT32_IEEE 0 ME11_CM_single_per_ -3.4E+38 3.4E+38 /end CHARACTERISTIC
/begin CHARACTERISTIC cal_DrMixDesValPID_KpNeg "" VALUE 0x0000 /* @ECU_Address@cal_DrMixDesValPID_KpNeg@ */ Scalar_FLOAT32_IEEE 0 ME11_CM_single_per_ -3.4E+38 3.4E+38 /end CHARACTERISTIC
/begin CHARACTERISTIC cal_DrMixDesValPID_KpPos "" VALUE 0x0000 /* @ECU_Address@cal_DrMixDesValPID_KpPos@ */ Scalar_FLOAT32_IEEE 0 ME11_CM_single_per_ -3.4E+38 3.4E+38 /end CHARACTERISTIC
/begin CHARACTERISTIC cal_DrMixDesValPID_pWinNeg "" VALUE 0x0000 /* @ECU_Address@cal_DrMixDesValPID_pWinNeg@ */ Scalar_FLOAT32_IEEE 0 ME11_CM_single_per_ -3.4E+38 3.4E+38 /end CHARACTERISTIC
/begin CHARACTERISTIC cal_DrMixDesValPID_pWinPos "" VALUE 0x0000 /* @ECU_Address@cal_DrMixDesValPID_pWinPos@ */ Scalar_FLOAT32_IEEE 0 ME11_CM_single_per_ -3.4E+38 3.4E+38 /end CHARACTERISTIC
/begin CHARACTERISTIC cal_DvtCoff "" VALUE 0x0000 /* @ECU_Address@cal_DvtCoff@ */ Scalar_FLOAT32_IEEE 0 ME11_CM_single_C 0.0 1.0 /end CHARACTERISTIC
/begin CHARACTERISTIC cal_DvtDesValPID_LL "" VALUE 0x0000 /* @ECU_Address@cal_DvtDesValPID_LL@ */ Scalar_FLOAT32_IEEE 0 ME11_CM_single_per_ -3.4E+38 3.4E+38 /end CHARACTERISTIC
/begin CHARACTERISTIC cal_DvtDesValPID_UL "" VALUE 0x0000 /* @ECU_Address@cal_DvtDesValPID_UL@ */ Scalar_FLOAT32_IEEE 0 ME11_CM_single_per_ -3.4E+38 3.4E+38 /end CHARACTERISTIC
/begin CHARACTERISTIC cal_EnvTempStep "" VALUE 0x0000 /* @ECU_Address@cal_EnvTempStep@ */ Scalar_FLOAT32_IEEE 0 ME11_CM_single_per_ -3.4E+38 3.4E+38 /end CHARACTERISTIC
/begin CHARACTERISTIC cal_ErrAmbTDvtForEvaLL "" VALUE 0x0000 /* @ECU_Address@cal_ErrAmbTDvtForEvaLL@ */ Scalar_FLOAT32_IEEE 0 ME11_CM_single_per_ -3.4E+38 3.4E+38 /end CHARACTERISTIC
/begin CHARACTERISTIC cal_ErrAmbTDvtForEvaUL "" VALUE 0x0000 /* @ECU_Address@cal_ErrAmbTDvtForEvaUL@ */ Scalar_FLOAT32_IEEE 0 ME11_CM_single_per_ -3.4E+38 3.4E+38 /end CHARACTERISTIC
/begin CHARACTERISTIC cal_ErrAmbTDvtForPtcLL "" VALUE 0x0000 /* @ECU_Address@cal_ErrAmbTDvtForPtcLL@ */ Scalar_FLOAT32_IEEE 0 ME11_CM_single_per_ -3.4E+38 3.4E+38 /end CHARACTERISTIC
/begin CHARACTERISTIC cal_ErrAmbTDvtForPtcUL "" VALUE 0x0000 /* @ECU_Address@cal_ErrAmbTDvtForPtcUL@ */ Scalar_FLOAT32_IEEE 0 ME11_CM_single_per_ -3.4E+38 3.4E+38 /end CHARACTERISTIC
/begin CHARACTERISTIC cal_EvaDesLLMax "" VALUE 0x0000 /* @ECU_Address@cal_EvaDesLLMax@ */ Scalar_FLOAT32_IEEE 0 ME11_CM_single_per_ -3.4E+38 3.4E+38 /end CHARACTERISTIC
/begin CHARACTERISTIC cal_EvaDesLLMin "" VALUE 0x0000 /* @ECU_Address@cal_EvaDesLLMin@ */ Scalar_FLOAT32_IEEE 0 ME11_CM_single_per_ -3.4E+38 3.4E+38 /end CHARACTERISTIC
/begin CHARACTERISTIC cal_ExhSuperHeatFilter "" VALUE 0x0000 /* @ECU_Address@cal_ExhSuperHeatFilter@ */ Scalar_FLOAT32_IEEE 0 ME11_CM_single_per_ 0.0 1.0 /end CHARACTERISTIC
/begin CHARACTERISTIC cal_HPAndLPDiffMaxVal "" VALUE 0x0000 /* @ECU_Address@cal_HPAndLPDiffMaxVal@ */ Scalar_FLOAT32_IEEE 0 ME11_CM_single_Mpa 0.0 1.0 /end CHARACTERISTIC
/begin CHARACTERISTIC cal_HPEXVCtlKi "" VALUE 0x0000 /* @ECU_Address@cal_HPEXVCtlKi@ */ Scalar_FLOAT32_IEEE 0 ME11_CM_single_null 0.0 10.0 /end CHARACTERISTIC
/begin CHARACTERISTIC cal_HPEXVCtlKiDeadzoneNeg "" VALUE 0x0000 /* @ECU_Address@cal_HPEXVCtlKiDeadzoneNeg@ */ Scalar_FLOAT32_IEEE 0 ME11_CM_single_C 0.0 10.0 /end CHARACTERISTIC
/begin CHARACTERISTIC cal_HPEXVCtlKiDeadzonePos "" VALUE 0x0000 /* @ECU_Address@cal_HPEXVCtlKiDeadzonePos@ */ Scalar_FLOAT32_IEEE 0 ME11_CM_single_C 0.0 10.0 /end CHARACTERISTIC
/begin CHARACTERISTIC cal_HPEXVCtlKisumMax "" VALUE 0x0000 /* @ECU_Address@cal_HPEXVCtlKisumMax@ */ Scalar_FLOAT32_IEEE 0 ME11_CM_single_percent_ 0.0 100.0 /end CHARACTERISTIC
/begin CHARACTERISTIC cal_HPEXVCtlKisumMin "" VALUE 0x0000 /* @ECU_Address@cal_HPEXVCtlKisumMin@ */ Scalar_FLOAT32_IEEE 0 ME11_CM_single_percent_ -100.0 100.0 /end CHARACTERISTIC
/begin CHARACTERISTIC cal_HPEXVCtlKp "" VALUE 0x0000 /* @ECU_Address@cal_HPEXVCtlKp@ */ Scalar_FLOAT32_IEEE 0 ME11_CM_single_null 0.0 10.0 /end CHARACTERISTIC
/begin CHARACTERISTIC cal_HPEXVCtlKpDeadzoneNeg "" VALUE 0x0000 /* @ECU_Address@cal_HPEXVCtlKpDeadzoneNeg@ */ Scalar_FLOAT32_IEEE 0 ME11_CM_single_C 0.0 10.0 /end CHARACTERISTIC
/begin CHARACTERISTIC cal_HPEXVCtlKpDeadzonePos "" VALUE 0x0000 /* @ECU_Address@cal_HPEXVCtlKpDeadzonePos@ */ Scalar_FLOAT32_IEEE 0 ME11_CM_single_C 0.0 10.0 /end CHARACTERISTIC
/begin CHARACTERISTIC cal_HPEXVlowPressLmtTrg "" VALUE 0x0000 /* @ECU_Address@cal_HPEXVlowPressLmtTrg@ */ Scalar_FLOAT32_IEEE 0 ME11_CM_single_C -40.0 100.0 /end CHARACTERISTIC
/begin CHARACTERISTIC cal_HPProVal1 "" VALUE 0x0000 /* @ECU_Address@cal_HPProVal1@ */ Scalar_FLOAT32_IEEE 0 ME11_CM_single_Mpa 0.0 5.0 /end CHARACTERISTIC
/begin CHARACTERISTIC cal_HPProVal1Relay "" VALUE 0x0000 /* @ECU_Address@cal_HPProVal1Relay@ */ Scalar_FLOAT32_IEEE 0 ME11_CM_single_Mpa 0.0 5.0 /end CHARACTERISTIC
/begin CHARACTERISTIC cal_HPProVal2 "" VALUE 0x0000 /* @ECU_Address@cal_HPProVal2@ */ Scalar_FLOAT32_IEEE 0 ME11_CM_single_Mpa 0.0 5.0 /end CHARACTERISTIC
/begin CHARACTERISTIC cal_HPProVal2Relay "" VALUE 0x0000 /* @ECU_Address@cal_HPProVal2Relay@ */ Scalar_FLOAT32_IEEE 0 ME11_CM_single_Mpa 0.0 5.0 /end CHARACTERISTIC
/begin CHARACTERISTIC cal_HPProVal3 "" VALUE 0x0000 /* @ECU_Address@cal_HPProVal3@ */ Scalar_FLOAT32_IEEE 0 ME11_CM_single_Mpa 0.0 5.0 /end CHARACTERISTIC
/begin CHARACTERISTIC cal_HPProVal3Relay "" VALUE 0x0000 /* @ECU_Address@cal_HPProVal3Relay@ */ Scalar_FLOAT32_IEEE 0 ME11_CM_single_Mpa 0.0 5.0 /end CHARACTERISTIC
/begin CHARACTERISTIC cal_HPProVal4 "" VALUE 0x0000 /* @ECU_Address@cal_HPProVal4@ */ Scalar_FLOAT32_IEEE 0 ME11_CM_single_Mpa 0.0 10.0 /end CHARACTERISTIC
/begin CHARACTERISTIC cal_HeatCOMPEnvTempLmtOff "" VALUE 0x0000 /* @ECU_Address@cal_HeatCOMPEnvTempLmtOff@ */ Scalar_FLOAT32_IEEE 0 ME11_CM_single_C -40.0 100.0 /end CHARACTERISTIC
/begin CHARACTERISTIC cal_HeatCOMPEnvTempLmtOn "" VALUE 0x0000 /* @ECU_Address@cal_HeatCOMPEnvTempLmtOn@ */ Scalar_FLOAT32_IEEE 0 ME11_CM_single_C -40.0 100.0 /end CHARACTERISTIC
/begin CHARACTERISTIC cal_LTRFanCtrl_1X "" VAL_BLK 0x0000 /* @ECU_Address@cal_LTRFanCtrl_1X@ */ Scalar_FLOAT32_IEEE 0 ME11_CM_single_C 0.0 100.0 NUMBER 2 /end CHARACTERISTIC
/begin CHARACTERISTIC cal_LTRIGBTMaxExitTempB "" VALUE 0x0000 /* @ECU_Address@cal_LTRIGBTMaxExitTempB@ */ Scalar_FLOAT32_IEEE 0 ME11_CM_single_C -40.0 80.0 /end CHARACTERISTIC
/begin CHARACTERISTIC cal_LTRIGBTTempMotPMPCtrl_1X "" VAL_BLK 0x0000 /* @ECU_Address@cal_LTRIGBTTempMotPMPCtrl_1X@ */ Scalar_FLOAT32_IEEE 0 ME11_CM_single_C 0.0 100.0 NUMBER 2 /end CHARACTERISTIC
/begin CHARACTERISTIC cal_LTRIPUTempFanCtrl_1X "" VAL_BLK 0x0000 /* @ECU_Address@cal_LTRIPUTempFanCtrl_1X@ */ Scalar_FLOAT32_IEEE 0 ME11_CM_single_C 0.0 100.0 NUMBER 2 /end CHARACTERISTIC
/begin CHARACTERISTIC cal_LTRIPUTempMotPMPCtrl_1X "" VAL_BLK 0x0000 /* @ECU_Address@cal_LTRIPUTempMotPMPCtrl_1X@ */ Scalar_FLOAT32_IEEE 0 ME11_CM_single_C 0.0 100.0 NUMBER 2 /end CHARACTERISTIC
/begin CHARACTERISTIC cal_LTRMotorInletMaxExitTempA "" VALUE 0x0000 /* @ECU_Address@cal_LTRMotorInletMaxExitTempA@ */ Scalar_FLOAT32_IEEE 0 ME11_CM_single_C -40.0 80.0 /end CHARACTERISTIC
/begin CHARACTERISTIC cal_LTRMotorTempMotPMPCtrl_1X "" VAL_BLK 0x0000 /* @ECU_Address@cal_LTRMotorTempMotPMPCtrl_1X@ */ Scalar_FLOAT32_IEEE 0 ME11_CM_single_C 0.0 100.0 NUMBER 2 /end CHARACTERISTIC
/begin CHARACTERISTIC cal_MBIGBTHighExitTempG "" VALUE 0x0000 /* @ECU_Address@cal_MBIGBTHighExitTempG@ */ Scalar_FLOAT32_IEEE 0 ME11_CM_single_C -40.0 80.0 /end CHARACTERISTIC
/begin CHARACTERISTIC cal_MBIPUDevHighExitTempI "" VALUE 0x0000 /* @ECU_Address@cal_MBIPUDevHighExitTempI@ */ Scalar_FLOAT32_IEEE 0 ME11_CM_single_C -40.0 80.0 /end CHARACTERISTIC
/begin CHARACTERISTIC cal_MBMotorInletHighExitTempH "" VALUE 0x0000 /* @ECU_Address@cal_MBMotorInletHighExitTempH@ */ Scalar_FLOAT32_IEEE 0 ME11_CM_single_C -40.0 80.0 /end CHARACTERISTIC
/begin CHARACTERISTIC cal_MCVPosDiffDelayTime "" VALUE 0x0000 /* @ECU_Address@cal_MCVPosDiffDelayTime@ */ Scalar_FLOAT32_IEEE 0 ME11_CM_single_min 0.0 300.0 /end CHARACTERISTIC
/begin CHARACTERISTIC cal_MotHeatBatMinTempDiff "" VALUE 0x0000 /* @ECU_Address@cal_MotHeatBatMinTempDiff@ */ Scalar_FLOAT32_IEEE 0 ME11_CM_single_C -10.0 10.0 /end CHARACTERISTIC
/begin CHARACTERISTIC cal_NmCOMPEnvTempLmtOff "" VALUE 0x0000 /* @ECU_Address@cal_NmCOMPEnvTempLmtOff@ */ Scalar_FLOAT32_IEEE 0 ME11_CM_single_C -40.0 100.0 /end CHARACTERISTIC
/begin CHARACTERISTIC cal_NmCOMPEnvTempLmtOn "" VALUE 0x0000 /* @ECU_Address@cal_NmCOMPEnvTempLmtOn@ */ Scalar_FLOAT32_IEEE 0 ME11_CM_single_C -40.0 100.0 /end CHARACTERISTIC
/begin CHARACTERISTIC cal_OpenCtrlCOMPDownlmt "" VALUE 0x0000 /* @ECU_Address@cal_OpenCtrlCOMPDownlmt@ */ Scalar_FLOAT32_IEEE 0 ME11_CM_single_rpm 0.0 3000.0 /end CHARACTERISTIC
/begin CHARACTERISTIC cal_OpenCtrlCOMPUplmt "" VALUE 0x0000 /* @ECU_Address@cal_OpenCtrlCOMPUplmt@ */ Scalar_FLOAT32_IEEE 0 ME11_CM_single_rpm 0.0 3000.0 /end CHARACTERISTIC
/begin CHARACTERISTIC cal_PTCOffPowerVal "" VALUE 0x0000 /* @ECU_Address@cal_PTCOffPowerVal@ */ Scalar_FLOAT32_IEEE 0 ME11_CM_single_kw 0.0 10.0 /end CHARACTERISTIC
/begin CHARACTERISTIC cal_PTCReqtPowerData "" VALUE 0x0000 /* @ECU_Address@cal_PTCReqtPowerData@ */ Scalar_FLOAT32_IEEE 0 ME11_CM_single_kw 0.0 10.0 /end CHARACTERISTIC
/begin CHARACTERISTIC cal_PTCTempRecircOff "" VALUE 0x0000 /* @ECU_Address@cal_PTCTempRecircOff@ */ Scalar_FLOAT32_IEEE 0 ME11_CM_single_per_ -3.4E+38 3.4E+38 /end CHARACTERISTIC
/begin CHARACTERISTIC cal_PTCTempRecircOn "" VALUE 0x0000 /* @ECU_Address@cal_PTCTempRecircOn@ */ Scalar_FLOAT32_IEEE 0 ME11_CM_single_per_ -3.4E+38 3.4E+38 /end CHARACTERISTIC
/begin CHARACTERISTIC cal_PressRateVal1 "" VALUE 0x0000 /* @ECU_Address@cal_PressRateVal1@ */ Scalar_FLOAT32_IEEE 0 ME11_CM_single_percent_ 0.0 30.0 /end CHARACTERISTIC
/begin CHARACTERISTIC cal_PressRateVal1Relay "" VALUE 0x0000 /* @ECU_Address@cal_PressRateVal1Relay@ */ Scalar_FLOAT32_IEEE 0 ME11_CM_single_percent_ 0.0 30.0 /end CHARACTERISTIC
/begin CHARACTERISTIC cal_PressRateVal2 "" VALUE 0x0000 /* @ECU_Address@cal_PressRateVal2@ */ Scalar_FLOAT32_IEEE 0 ME11_CM_single_percent_ 0.0 30.0 /end CHARACTERISTIC
/begin CHARACTERISTIC cal_PressRateVal2Relay "" VALUE 0x0000 /* @ECU_Address@cal_PressRateVal2Relay@ */ Scalar_FLOAT32_IEEE 0 ME11_CM_single_percent_ 0.0 30.0 /end CHARACTERISTIC
/begin CHARACTERISTIC cal_PressRateVal3 "" VALUE 0x0000 /* @ECU_Address@cal_PressRateVal3@ */ Scalar_FLOAT32_IEEE 0 ME11_CM_single_percent_ 0.0 30.0 /end CHARACTERISTIC
/begin CHARACTERISTIC cal_PressRateVal3Relay "" VALUE 0x0000 /* @ECU_Address@cal_PressRateVal3Relay@ */ Scalar_FLOAT32_IEEE 0 ME11_CM_single_percent_ 0.0 30.0 /end CHARACTERISTIC
/begin CHARACTERISTIC cal_PsDuctFaceFloorFaFactor "" VALUE 0x0000 /* @ECU_Address@cal_PsDuctFaceFloorFaFactor@ */ Scalar_FLOAT32_IEEE 0 ME11_CM_single_per_ -3.4E+38 3.4E+38 /end CHARACTERISTIC
/begin CHARACTERISTIC cal_PsDuctFaceFloorFoFactor "" VALUE 0x0000 /* @ECU_Address@cal_PsDuctFaceFloorFoFactor@ */ Scalar_FLOAT32_IEEE 0 ME11_CM_single_per_ -3.4E+38 3.4E+38 /end CHARACTERISTIC
/begin CHARACTERISTIC cal_PsDuctSensorFailDeflt "" VALUE 0x0000 /* @ECU_Address@cal_PsDuctSensorFailDeflt@ */ Scalar_FLOAT32_IEEE 0 ME11_CM_single_per_ -3.4E+38 3.4E+38 /end CHARACTERISTIC
/begin CHARACTERISTIC cal_PsErrOfEvaDVT2CoolMixOff "" VALUE 0x0000 /* @ECU_Address@cal_PsErrOfEvaDVT2CoolMixOff@ */ Scalar_FLOAT32_IEEE 0 ME11_CM_single_per_ -40.0 100.0 /end CHARACTERISTIC
/begin CHARACTERISTIC cal_PsErrOfEvaDVT2CoolMixOn "" VALUE 0x0000 /* @ECU_Address@cal_PsErrOfEvaDVT2CoolMixOn@ */ Scalar_FLOAT32_IEEE 0 ME11_CM_single_per_ -40.0 100.0 /end CHARACTERISTIC
/begin CHARACTERISTIC cal_PsErrOfPtcDVT2HeatMixOff "" VALUE 0x0000 /* @ECU_Address@cal_PsErrOfPtcDVT2HeatMixOff@ */ Scalar_FLOAT32_IEEE 0 ME11_CM_single_per_ -40.0 100.0 /end CHARACTERISTIC
/begin CHARACTERISTIC cal_PsErrOfPtcDVT2HeatMixOn "" VALUE 0x0000 /* @ECU_Address@cal_PsErrOfPtcDVT2HeatMixOn@ */ Scalar_FLOAT32_IEEE 0 ME11_CM_single_per_ -40.0 100.0 /end CHARACTERISTIC
/begin CHARACTERISTIC cal_PsMixDesValPIDIntegDeadBand "" VALUE 0x0000 /* @ECU_Address@cal_PsMixDesValPIDIntegDeadBand@ */ Scalar_FLOAT32_IEEE 0 ME11_CM_single_per_ -3.4E+38 3.4E+38 /end CHARACTERISTIC
/begin CHARACTERISTIC cal_PsMixDesValPID_IsumMax "" VALUE 0x0000 /* @ECU_Address@cal_PsMixDesValPID_IsumMax@ */ Scalar_FLOAT32_IEEE 0 ME11_CM_single_per_ -3.4E+38 3.4E+38 /end CHARACTERISTIC
/begin CHARACTERISTIC cal_PsMixDesValPID_IsumMin "" VALUE 0x0000 /* @ECU_Address@cal_PsMixDesValPID_IsumMin@ */ Scalar_FLOAT32_IEEE 0 ME11_CM_single_per_ -3.4E+38 3.4E+38 /end CHARACTERISTIC
/begin CHARACTERISTIC cal_PsMixDesValPID_Ki "" VALUE 0x0000 /* @ECU_Address@cal_PsMixDesValPID_Ki@ */ Scalar_FLOAT32_IEEE 0 ME11_CM_single_per_ -3.4E+38 3.4E+38 /end CHARACTERISTIC
/begin CHARACTERISTIC cal_PsMixDesValPID_KiNeg "" VALUE 0x0000 /* @ECU_Address@cal_PsMixDesValPID_KiNeg@ */ Scalar_FLOAT32_IEEE 0 ME11_CM_single_per_ -3.4E+38 3.4E+38 /end CHARACTERISTIC
/begin CHARACTERISTIC cal_PsMixDesValPID_KiPos "" VALUE 0x0000 /* @ECU_Address@cal_PsMixDesValPID_KiPos@ */ Scalar_FLOAT32_IEEE 0 ME11_CM_single_per_ -3.4E+38 3.4E+38 /end CHARACTERISTIC
/begin CHARACTERISTIC cal_PsMixDesValPID_Kp "" VALUE 0x0000 /* @ECU_Address@cal_PsMixDesValPID_Kp@ */ Scalar_FLOAT32_IEEE 0 ME11_CM_single_per_ -3.4E+38 3.4E+38 /end CHARACTERISTIC
/begin CHARACTERISTIC cal_PsMixDesValPID_KpNeg "" VALUE 0x0000 /* @ECU_Address@cal_PsMixDesValPID_KpNeg@ */ Scalar_FLOAT32_IEEE 0 ME11_CM_single_per_ -3.4E+38 3.4E+38 /end CHARACTERISTIC
/begin CHARACTERISTIC cal_PsMixDesValPID_KpPos "" VALUE 0x0000 /* @ECU_Address@cal_PsMixDesValPID_KpPos@ */ Scalar_FLOAT32_IEEE 0 ME11_CM_single_per_ -3.4E+38 3.4E+38 /end CHARACTERISTIC
/begin CHARACTERISTIC cal_PsMixDesValPID_pWinNeg "" VALUE 0x0000 /* @ECU_Address@cal_PsMixDesValPID_pWinNeg@ */ Scalar_FLOAT32_IEEE 0 ME11_CM_single_per_ -3.4E+38 3.4E+38 /end CHARACTERISTIC
/begin CHARACTERISTIC cal_PsMixDesValPID_pWinPos "" VALUE 0x0000 /* @ECU_Address@cal_PsMixDesValPID_pWinPos@ */ Scalar_FLOAT32_IEEE 0 ME11_CM_single_per_ -3.4E+38 3.4E+38 /end CHARACTERISTIC
/begin CHARACTERISTIC cal_PtcPwrDesValPIDDeadBandNeg "" VALUE 0x0000 /* @ECU_Address@cal_PtcPwrDesValPIDDeadBandNeg@ */ Scalar_FLOAT32_IEEE 0 ME11_CM_single_per_ -3.4E+38 3.4E+38 /end CHARACTERISTIC
/begin CHARACTERISTIC cal_PtcPwrDesValPIDDeadBandPos "" VALUE 0x0000 /* @ECU_Address@cal_PtcPwrDesValPIDDeadBandPos@ */ Scalar_FLOAT32_IEEE 0 ME11_CM_single_per_ -3.4E+38 3.4E+38 /end CHARACTERISTIC
/begin CHARACTERISTIC cal_PtcPwrDesValPID_IsumMax "" VALUE 0x0000 /* @ECU_Address@cal_PtcPwrDesValPID_IsumMax@ */ Scalar_FLOAT32_IEEE 0 ME11_CM_single_per_ -3.4E+38 3.4E+38 /end CHARACTERISTIC
/begin CHARACTERISTIC cal_PtcPwrDesValPID_IsumMin "" VALUE 0x0000 /* @ECU_Address@cal_PtcPwrDesValPID_IsumMin@ */ Scalar_FLOAT32_IEEE 0 ME11_CM_single_per_ -3.4E+38 3.4E+38 /end CHARACTERISTIC
/begin CHARACTERISTIC cal_PtcPwrDesValPID_Ki "" VALUE 0x0000 /* @ECU_Address@cal_PtcPwrDesValPID_Ki@ */ Scalar_FLOAT32_IEEE 0 ME11_CM_single_per_ -3.4E+38 3.4E+38 /end CHARACTERISTIC
/begin CHARACTERISTIC cal_PtcPwrDesValPID_KiNeg "" VALUE 0x0000 /* @ECU_Address@cal_PtcPwrDesValPID_KiNeg@ */ Scalar_FLOAT32_IEEE 0 ME11_CM_single_per_ -3.4E+38 3.4E+38 /end CHARACTERISTIC
/begin CHARACTERISTIC cal_PtcPwrDesValPID_KiPos "" VALUE 0x0000 /* @ECU_Address@cal_PtcPwrDesValPID_KiPos@ */ Scalar_FLOAT32_IEEE 0 ME11_CM_single_per_ -3.4E+38 3.4E+38 /end CHARACTERISTIC
/begin CHARACTERISTIC cal_PtcPwrDesValPID_Kp "" VALUE 0x0000 /* @ECU_Address@cal_PtcPwrDesValPID_Kp@ */ Scalar_FLOAT32_IEEE 0 ME11_CM_single_per_ -3.4E+38 3.4E+38 /end CHARACTERISTIC
/begin CHARACTERISTIC cal_PtcPwrDesValPID_KpNeg "" VALUE 0x0000 /* @ECU_Address@cal_PtcPwrDesValPID_KpNeg@ */ Scalar_FLOAT32_IEEE 0 ME11_CM_single_per_ -3.4E+38 3.4E+38 /end CHARACTERISTIC
/begin CHARACTERISTIC cal_PtcPwrDesValPID_KpPos "" VALUE 0x0000 /* @ECU_Address@cal_PtcPwrDesValPID_KpPos@ */ Scalar_FLOAT32_IEEE 0 ME11_CM_single_per_ -3.4E+38 3.4E+38 /end CHARACTERISTIC
/begin CHARACTERISTIC cal_PtcPwrDesValPID_pWinNeg "" VALUE 0x0000 /* @ECU_Address@cal_PtcPwrDesValPID_pWinNeg@ */ Scalar_FLOAT32_IEEE 0 ME11_CM_single_per_ -3.4E+38 3.4E+38 /end CHARACTERISTIC
/begin CHARACTERISTIC cal_PtcPwrDesValPID_pWinPos "" VALUE 0x0000 /* @ECU_Address@cal_PtcPwrDesValPID_pWinPos@ */ Scalar_FLOAT32_IEEE 0 ME11_CM_single_per_ -3.4E+38 3.4E+38 /end CHARACTERISTIC
/begin CHARACTERISTIC cal_REC_DVTFresh "" VALUE 0x0000 /* @ECU_Address@cal_REC_DVTFresh@ */ Scalar_FLOAT32_IEEE 0 ME11_CM_single_per_ -3.4E+38 3.4E+38 /end CHARACTERISTIC
/begin CHARACTERISTIC cal_REC_DVTRecirc "" VALUE 0x0000 /* @ECU_Address@cal_REC_DVTRecirc@ */ Scalar_FLOAT32_IEEE 0 ME11_CM_single_per_ -3.4E+38 3.4E+38 /end CHARACTERISTIC
/begin CHARACTERISTIC cal_SensorTempDownFlg "" VALUE 0x0000 /* @ECU_Address@cal_SensorTempDownFlg@ */ Scalar_FLOAT32_IEEE 0 ME11_CM_single_mv 0.0 5000.0 /end CHARACTERISTIC
/begin CHARACTERISTIC cal_SensorTempUpFlt "" VALUE 0x0000 /* @ECU_Address@cal_SensorTempUpFlt@ */ Scalar_FLOAT32_IEEE 0 ME11_CM_single_mv 0.0 5000.0 /end CHARACTERISTIC
/begin CHARACTERISTIC cal_SetPtcDesCoff "" VALUE 0x0000 /* @ECU_Address@cal_SetPtcDesCoff@ */ Scalar_FLOAT32_IEEE 0 ME11_CM_single_C 0.0 1.0 /end CHARACTERISTIC
/begin CHARACTERISTIC cal_SetPtcDesTempMin "" VALUE 0x0000 /* @ECU_Address@cal_SetPtcDesTempMin@ */ Scalar_FLOAT32_IEEE 0 ME11_CM_single_C 0.0 100.0 /end CHARACTERISTIC
/begin CHARACTERISTIC cal_SuperHeatFilter "" VALUE 0x0000 /* @ECU_Address@cal_SuperHeatFilter@ */ Scalar_FLOAT32_IEEE 0 ME11_CM_single_per_ 0.0 1.0 /end CHARACTERISTIC
/begin CHARACTERISTIC cal_TevapLoStepMin "" VALUE 0x0000 /* @ECU_Address@cal_TevapLoStepMin@ */ Scalar_FLOAT32_IEEE 0 ME11_CM_single_per_ -3.4E+38 3.4E+38 /end CHARACTERISTIC
/begin CHARACTERISTIC cal_TevapUpStepMin "" VALUE 0x0000 /* @ECU_Address@cal_TevapUpStepMin@ */ Scalar_FLOAT32_IEEE 0 ME11_CM_single_per_ -3.4E+38 3.4E+38 /end CHARACTERISTIC
/begin CHARACTERISTIC cal_U_DVTFFSolarFilterRate "" VALUE 0x0000 /* @ECU_Address@cal_U_DVTFFSolarFilterRate@ */ Scalar_FLOAT32_IEEE 0 ME11_CM_single_per_ -3.4E+38 3.4E+38 /end CHARACTERISTIC
/begin CHARACTERISTIC cal_VehHeatSOCOff "" VALUE 0x0000 /* @ECU_Address@cal_VehHeatSOCOff@ */ Scalar_FLOAT32_IEEE 0 ME11_CM_single_percent_ 0.0 10.0 /end CHARACTERISTIC
/begin CHARACTERISTIC cal_VehHeatSOCOn "" VALUE 0x0000 /* @ECU_Address@cal_VehHeatSOCOn@ */ Scalar_FLOAT32_IEEE 0 ME11_CM_single_percent_ 0.0 10.0 /end CHARACTERISTIC
/begin CHARACTERISTIC cal_tBatBalExitACChrgMinCellTemp "" VALUE 0x0000 /* @ECU_Address@cal_tBatBalExitACChrgMinCellTemp@ */ Scalar_FLOAT32_IEEE 0 ME11_CM_single_C 0.0 10.0 /end CHARACTERISTIC
/begin CHARACTERISTIC cal_tBatBalExitBal1ToBatDiff "" VALUE 0x0000 /* @ECU_Address@cal_tBatBalExitBal1ToBatDiff@ */ Scalar_FLOAT32_IEEE 0 ME11_CM_single_C -5.0 5.0 /end CHARACTERISTIC
/begin CHARACTERISTIC cal_tBatBalExitBatToBal2Diff "" VALUE 0x0000 /* @ECU_Address@cal_tBatBalExitBatToBal2Diff@ */ Scalar_FLOAT32_IEEE 0 ME11_CM_single_C -5.0 5.0 /end CHARACTERISTIC
/begin CHARACTERISTIC cal_tBatBalExitDCChrgMinCellTemp "" VALUE 0x0000 /* @ECU_Address@cal_tBatBalExitDCChrgMinCellTemp@ */ Scalar_FLOAT32_IEEE 0 ME11_CM_single_C -40.0 50.0 /end CHARACTERISTIC
/begin CHARACTERISTIC cal_tBatBalExitMaxToMinCellDiff "" VALUE 0x0000 /* @ECU_Address@cal_tBatBalExitMaxToMinCellDiff@ */ Scalar_FLOAT32_IEEE 0 ME11_CM_single_C 0.0 10.0 /end CHARACTERISTIC
/begin CHARACTERISTIC cal_tBatBalONACChrgMinCellTemp "" VALUE 0x0000 /* @ECU_Address@cal_tBatBalONACChrgMinCellTemp@ */ Scalar_FLOAT32_IEEE 0 ME11_CM_single_C 0.0 30.0 /end CHARACTERISTIC
/begin CHARACTERISTIC cal_tBatHeatExitMaxToMinCellDiff "" VALUE 0x0000 /* @ECU_Address@cal_tBatHeatExitMaxToMinCellDiff@ */ Scalar_FLOAT32_IEEE 0 ME11_CM_single_C -40.0 40.0 /end CHARACTERISTIC
/begin CHARACTERISTIC cal_tLTROffIPUTemp "" VALUE 0x0000 /* @ECU_Address@cal_tLTROffIPUTemp@ */ Scalar_FLOAT32_IEEE 0 ME11_CM_single_C 35.0 80.0 /end CHARACTERISTIC
/begin CHARACTERISTIC cal_tLTROnIPUTemp "" VALUE 0x0000 /* @ECU_Address@cal_tLTROnIPUTemp@ */ Scalar_FLOAT32_IEEE 0 ME11_CM_single_C 40.0 80.0 /end CHARACTERISTIC
/begin CHARACTERISTIC cal_tLTROnMotTemp "" VALUE 0x0000 /* @ECU_Address@cal_tLTROnMotTemp@ */ Scalar_FLOAT32_IEEE 0 ME11_CM_single_C 40.0 80.0 /end CHARACTERISTIC
/begin CHARACTERISTIC cal_tMotHeatBatACChrgMinCellTempLow "" VALUE 0x0000 /* @ECU_Address@cal_tMotHeatBatACChrgMinCellTempLow@ */ Scalar_FLOAT32_IEEE 0 ME11_CM_single_C -20.0 20.0 /end CHARACTERISTIC
/begin CHARACTERISTIC cal_tMotHeatBatMinCellTempLow "" VALUE 0x0000 /* @ECU_Address@cal_tMotHeatBatMinCellTempLow@ */ Scalar_FLOAT32_IEEE 0 ME11_CM_single_C -20.0 20.0 /end CHARACTERISTIC
/begin CHARACTERISTIC cal_tMotHeatExitMinCellToBal1Diff "" VALUE 0x0000 /* @ECU_Address@cal_tMotHeatExitMinCellToBal1Diff@ */ Scalar_FLOAT32_IEEE 0 ME11_CM_single_C 0.0 10.0 /end CHARACTERISTIC
/begin CHARACTERISTIC cal_tMotHeatExitMinCellToMotTempDiff "" VALUE 0x0000 /* @ECU_Address@cal_tMotHeatExitMinCellToMotTempDiff@ */ Scalar_FLOAT32_IEEE 0 ME11_CM_single_C 0.0 10.0 /end CHARACTERISTIC
/begin CHARACTERISTIC cal_tMotHeatOnMotToMinCellDiff "" VALUE 0x0000 /* @ECU_Address@cal_tMotHeatOnMotToMinCellDiff@ */ Scalar_FLOAT32_IEEE 0 ME11_CM_single_C 0.0 10.0 /end CHARACTERISTIC
/begin CHARACTERISTIC cal_tMotStorExitMaxCellTemp "" VALUE 0x0000 /* @ECU_Address@cal_tMotStorExitMaxCellTemp@ */ Scalar_FLOAT32_IEEE 0 ME11_CM_single_C 20.0 40.0 /end CHARACTERISTIC
/begin CHARACTERISTIC cal_tMotStorExitMotToMinCellDiff "" VALUE 0x0000 /* @ECU_Address@cal_tMotStorExitMotToMinCellDiff@ */ Scalar_FLOAT32_IEEE 0 ME11_CM_single_C -10.0 10.0 /end CHARACTERISTIC
/begin CHARACTERISTIC cal_tMotStorMinCellTempLow "" VALUE 0x0000 /* @ECU_Address@cal_tMotStorMinCellTempLow@ */ Scalar_FLOAT32_IEEE 0 ME11_CM_single_C 0.0 20.0 /end CHARACTERISTIC
/begin CHARACTERISTIC cal_tMotStorOnMotToMinCellDiff "" VALUE 0x0000 /* @ECU_Address@cal_tMotStorOnMotToMinCellDiff@ */ Scalar_FLOAT32_IEEE 0 ME11_CM_single_C 0.0 10.0 /end CHARACTERISTIC
/begin CHARACTERISTIC cal_FalseTime2EnvTamb "" VALUE 0x0000 /* @ECU_Address@cal_FalseTime2EnvTamb@ */ Scalar_UWORD 0 ME11_CM_uint16_per_ 0 65535 /end CHARACTERISTIC
/begin CHARACTERISTIC cal_PtcPwrDesValPID_LL "" VALUE 0x0000 /* @ECU_Address@cal_PtcPwrDesValPID_LL@ */ Scalar_UWORD 0 ME11_CM_uint16_per_ 0 65535 /end CHARACTERISTIC
/begin CHARACTERISTIC cal_PtcPwrDesValPID_UL "" VALUE 0x0000 /* @ECU_Address@cal_PtcPwrDesValPID_UL@ */ Scalar_UWORD 0 ME11_CM_uint16_per_ 0 65535 /end CHARACTERISTIC
/begin CHARACTERISTIC cal_RiseTime2EnvTamb "" VALUE 0x0000 /* @ECU_Address@cal_RiseTime2EnvTamb@ */ Scalar_UWORD 0 ME11_CM_uint16_per_ 0 65535 /end CHARACTERISTIC
/begin CHARACTERISTIC cal_TevapLoTime "" VALUE 0x0000 /* @ECU_Address@cal_TevapLoTime@ */ Scalar_UWORD 0 ME11_CM_uint16_per_ 0 65535 /end CHARACTERISTIC
/begin CHARACTERISTIC cal_TevapUpTime "" VALUE 0x0000 /* @ECU_Address@cal_TevapUpTime@ */ Scalar_UWORD 0 ME11_CM_uint16_s 0.0 100.0 /end CHARACTERISTIC
/begin CHARACTERISTIC cal_tiAQSFresh2RecircDelay "" VALUE 0x0000 /* @ECU_Address@cal_tiAQSFresh2RecircDelay@ */ Scalar_UWORD 0 ME11_CM_uint16_per_ 0 65535 /end CHARACTERISTIC
/begin CHARACTERISTIC cal_tiAQSRecirc2FreshDelay "" VALUE 0x0000 /* @ECU_Address@cal_tiAQSRecirc2FreshDelay@ */ Scalar_UWORD 0 ME11_CM_uint16_per_ 0 65535 /end CHARACTERISTIC
/begin CHARACTERISTIC cal_tiCO2Fresh2RecircMax "" VALUE 0x0000 /* @ECU_Address@cal_tiCO2Fresh2RecircMax@ */ Scalar_UWORD 0 ME11_CM_uint16_per_ 0 65535 /end CHARACTERISTIC
/begin CHARACTERISTIC cal_tiCO2Recirc2FreshMax "" VALUE 0x0000 /* @ECU_Address@cal_tiCO2Recirc2FreshMax@ */ Scalar_UWORD 0 ME11_CM_uint16_per_ 0 65535 /end CHARACTERISTIC
/begin CHARACTERISTIC cal_BatModeData "" VALUE 0x0000 /* @ECU_Address@cal_BatModeData@ */ Scalar_UBYTE 0 ME11_CM_BatModes_null 0 6 /end CHARACTERISTIC
/begin CHARACTERISTIC cal_CabinModeData "" VALUE 0x0000 /* @ECU_Address@cal_CabinModeData@ */ Scalar_UBYTE 0 ME11_CM_CabinMode_null 0 7 /end CHARACTERISTIC
/begin CHARACTERISTIC cal_ACCMCtrlSpdDataEnb "" VALUE 0x0000 /* @ECU_Address@cal_ACCMCtrlSpdDataEnb@ */ Scalar_BOOLEAN 0 ME11_CM_boolean_flg 0.0 1.0 /end CHARACTERISTIC
/begin CHARACTERISTIC cal_ACCMEnbData "" VALUE 0x0000 /* @ECU_Address@cal_ACCMEnbData@ */ Scalar_BOOLEAN 0 ME11_CM_boolean_rpm 0.0 1.0 /end CHARACTERISTIC
/begin CHARACTERISTIC cal_ACCMEnbDataEnb "" VALUE 0x0000 /* @ECU_Address@cal_ACCMEnbDataEnb@ */ Scalar_BOOLEAN 0 ME11_CM_boolean_flg 0.0 1.0 /end CHARACTERISTIC
/begin CHARACTERISTIC cal_AcPMPFaultFlgData "" VALUE 0x0000 /* @ECU_Address@cal_AcPMPFaultFlgData@ */ Scalar_BOOLEAN 0 ME11_CM_boolean_flg 0.0 1.0 /end CHARACTERISTIC
/begin CHARACTERISTIC cal_AcPMPFaultFlgDataEnb "" VALUE 0x0000 /* @ECU_Address@cal_AcPMPFaultFlgDataEnb@ */ Scalar_BOOLEAN 0 ME11_CM_boolean_flg 0.0 1.0 /end CHARACTERISTIC
/begin CHARACTERISTIC cal_AcPMPSpdSetDataEnb "" VALUE 0x0000 /* @ECU_Address@cal_AcPMPSpdSetDataEnb@ */ Scalar_BOOLEAN 0 ME11_CM_boolean_flg 0.0 1.0 /end CHARACTERISTIC
/begin CHARACTERISTIC cal_BatCoolOverData "" VALUE 0x0000 /* @ECU_Address@cal_BatCoolOverData@ */ Scalar_BOOLEAN 0 ME11_CM_boolean_flg 0.0 1.0 /end CHARACTERISTIC
/begin CHARACTERISTIC cal_BatCoolOverEnb "" VALUE 0x0000 /* @ECU_Address@cal_BatCoolOverEnb@ */ Scalar_BOOLEAN 0 ME11_CM_boolean_flg 0.0 1.0 /end CHARACTERISTIC
/begin CHARACTERISTIC cal_BatHeatACCMEnb "" VALUE 0x0000 /* @ECU_Address@cal_BatHeatACCMEnb@ */ Scalar_BOOLEAN 0 ME11_CM_boolean_flg 0.0 1.0 /end CHARACTERISTIC
/begin CHARACTERISTIC cal_BatHeatOverData "" VALUE 0x0000 /* @ECU_Address@cal_BatHeatOverData@ */ Scalar_BOOLEAN 0 ME11_CM_boolean_flg 0.0 1.0 /end CHARACTERISTIC
/begin CHARACTERISTIC cal_BatHeatOverEnb "" VALUE 0x0000 /* @ECU_Address@cal_BatHeatOverEnb@ */ Scalar_BOOLEAN 0 ME11_CM_boolean_flg 0.0 1.0 /end CHARACTERISTIC
/begin CHARACTERISTIC cal_BatModeEnb "" VALUE 0x0000 /* @ECU_Address@cal_BatModeEnb@ */ Scalar_BOOLEAN 0 ME11_CM_boolean_flg 0.0 1.0 /end CHARACTERISTIC
/begin CHARACTERISTIC cal_BatModeTestCtrl "" VALUE 0x0000 /* @ECU_Address@cal_BatModeTestCtrl@ */ Scalar_BOOLEAN 0 ME11_CM_boolean_flg 0.0 1.0 /end CHARACTERISTIC
/begin CHARACTERISTIC cal_BatPMPFaultFlgData "" VALUE 0x0000 /* @ECU_Address@cal_BatPMPFaultFlgData@ */ Scalar_BOOLEAN 0 ME11_CM_boolean_flg 0.0 1.0 /end CHARACTERISTIC
/begin CHARACTERISTIC cal_BatPMPFaultFlgDataEnb "" VALUE 0x0000 /* @ECU_Address@cal_BatPMPFaultFlgDataEnb@ */ Scalar_BOOLEAN 0 ME11_CM_boolean_flg 0.0 1.0 /end CHARACTERISTIC
/begin CHARACTERISTIC cal_BatPMPSpdSetDataEnb "" VALUE 0x0000 /* @ECU_Address@cal_BatPMPSpdSetDataEnb@ */ Scalar_BOOLEAN 0 ME11_CM_boolean_flg 0.0 1.0 /end CHARACTERISTIC
/begin CHARACTERISTIC cal_CabinModeEnb "" VALUE 0x0000 /* @ECU_Address@cal_CabinModeEnb@ */ Scalar_BOOLEAN 0 ME11_CM_boolean_flg 0.0 1.0 /end CHARACTERISTIC
/begin CHARACTERISTIC cal_CabinSetPTCSwitch "" VALUE 0x0000 /* @ECU_Address@cal_CabinSetPTCSwitch@ */ Scalar_BOOLEAN 0 ME11_CM_boolean_per_ 0.0 1.0 /end CHARACTERISTIC
/begin CHARACTERISTIC cal_EvaDesLLSelect "" VALUE 0x0000 /* @ECU_Address@cal_EvaDesLLSelect@ */ Scalar_BOOLEAN 0 ME11_CM_boolean_per_ 0 1 /end CHARACTERISTIC
/begin CHARACTERISTIC cal_EvaEnable "" VALUE 0x0000 /* @ECU_Address@cal_EvaEnable@ */ Scalar_BOOLEAN 0 ME11_CM_boolean_per_ 0 1 /end CHARACTERISTIC
/begin CHARACTERISTIC cal_FixPIDSecletFlag "" VALUE 0x0000 /* @ECU_Address@cal_FixPIDSecletFlag@ */ Scalar_BOOLEAN 0 ME11_CM_boolean_per_ 0 1 /end CHARACTERISTIC
/begin CHARACTERISTIC cal_HPEXVStepLmtSw "" VALUE 0x0000 /* @ECU_Address@cal_HPEXVStepLmtSw@ */ Scalar_BOOLEAN 0 ME11_CM_boolean_flg 0.0 1.0 /end CHARACTERISTIC
/begin CHARACTERISTIC cal_MotPMPFaultFlgData "" VALUE 0x0000 /* @ECU_Address@cal_MotPMPFaultFlgData@ */ Scalar_BOOLEAN 0 ME11_CM_boolean_flg 0.0 1.0 /end CHARACTERISTIC
/begin CHARACTERISTIC cal_MotPMPFaultFlgDataEnb "" VALUE 0x0000 /* @ECU_Address@cal_MotPMPFaultFlgDataEnb@ */ Scalar_BOOLEAN 0 ME11_CM_boolean_flg 0.0 1.0 /end CHARACTERISTIC
/begin CHARACTERISTIC cal_MotPMPSpdSetDataEnb "" VALUE 0x0000 /* @ECU_Address@cal_MotPMPSpdSetDataEnb@ */ Scalar_BOOLEAN 0 ME11_CM_boolean_flg 0.0 1.0 /end CHARACTERISTIC
/begin CHARACTERISTIC cal_PTCEnableDataEnb "" VALUE 0x0000 /* @ECU_Address@cal_PTCEnableDataEnb@ */ Scalar_BOOLEAN 0 ME11_CM_boolean_flg 0.0 1.0 /end CHARACTERISTIC
/begin CHARACTERISTIC cal_PTCReqtPowerDataEnb "" VALUE 0x0000 /* @ECU_Address@cal_PTCReqtPowerDataEnb@ */ Scalar_BOOLEAN 0 ME11_CM_boolean_flg 0.0 1.0 /end CHARACTERISTIC
/begin CHARACTERISTIC cal_PtcEnable "" VALUE 0x0000 /* @ECU_Address@cal_PtcEnable@ */ Scalar_BOOLEAN 0 ME11_CM_boolean_per_ 0 1 /end CHARACTERISTIC
/begin CHARACTERISTIC cal_bACAutoData "" VALUE 0x0000 /* @ECU_Address@cal_bACAutoData@ */ Scalar_BOOLEAN 0 ME11_CM_boolean_flg 0.0 1.0 /end CHARACTERISTIC
/begin CHARACTERISTIC cal_bACAutoEnb "" VALUE 0x0000 /* @ECU_Address@cal_bACAutoEnb@ */ Scalar_BOOLEAN 0 ME11_CM_boolean_flg 0.0 1.0 /end CHARACTERISTIC
/begin CHARACTERISTIC cal_bACDefrostData "" VALUE 0x0000 /* @ECU_Address@cal_bACDefrostData@ */ Scalar_BOOLEAN 0 ME11_CM_boolean_flg 0.0 1.0 /end CHARACTERISTIC
/begin CHARACTERISTIC cal_bACDefrostEnb "" VALUE 0x0000 /* @ECU_Address@cal_bACDefrostEnb@ */ Scalar_BOOLEAN 0 ME11_CM_boolean_flg 0.0 1.0 /end CHARACTERISTIC
/begin CHARACTERISTIC cal_bACOnOffData "" VALUE 0x0000 /* @ECU_Address@cal_bACOnOffData@ */ Scalar_BOOLEAN 0 ME11_CM_boolean_flg 0.0 1.0 /end CHARACTERISTIC
/begin CHARACTERISTIC cal_bACOnOffEnb "" VALUE 0x0000 /* @ECU_Address@cal_bACOnOffEnb@ */ Scalar_BOOLEAN 0 ME11_CM_boolean_flg 0.0 1.0 /end CHARACTERISTIC
/begin CHARACTERISTIC cal_eACStsEnb "" VALUE 0x0000 /* @ECU_Address@cal_eACStsEnb@ */ Scalar_BOOLEAN 0 ME11_CM_boolean_flg 0.0 1.0 /end CHARACTERISTIC
/begin CHARACTERISTIC ACDefog "" VALUE 0x0000 /* @ECU_Address@ACDefog@ */ Scalar_UBYTE 0 ME11_CM_uint8_flg 0.0 64.0 /end CHARACTERISTIC
/begin CHARACTERISTIC AC_ColdStart "" VALUE 0x0000 /* @ECU_Address@AC_ColdStart@ */ Scalar_UBYTE 0 ME11_CM_uint8_per_ 0.0 64.0 /end CHARACTERISTIC
/begin CHARACTERISTIC AC_HotStart "" VALUE 0x0000 /* @ECU_Address@AC_HotStart@ */ Scalar_UBYTE 0 ME11_CM_uint8_per_ 0.0 64.0 /end CHARACTERISTIC
/begin CHARACTERISTIC AC_LittleColdStart "" VALUE 0x0000 /* @ECU_Address@AC_LittleColdStart@ */ Scalar_UBYTE 0 ME11_CM_uint8_per_ 0.0 64.0 /end CHARACTERISTIC
/begin CHARACTERISTIC DriveFRESH "" VALUE 0x0000 /* @ECU_Address@DriveFRESH@ */ Scalar_UBYTE 0 ME11_CM_uint8_null 0.0 100.0 /end CHARACTERISTIC
/begin CHARACTERISTIC RECIRC "" VALUE 0x0000 /* @ECU_Address@RECIRC@ */ Scalar_UBYTE 0 ME11_CM_uint8_null 0.0 100.0 /end CHARACTERISTIC
/begin CHARACTERISTIC cal_ACCtlRecLevelForACHotStart "" VALUE 0x0000 /* @ECU_Address@cal_ACCtlRecLevelForACHotStart@ */ Scalar_UBYTE 0 ME11_CM_uint8_per_ 0.0 15.0 /end CHARACTERISTIC
/begin CHARACTERISTIC cal_ACCtlRecLevelForAQS "" VALUE 0x0000 /* @ECU_Address@cal_ACCtlRecLevelForAQS@ */ Scalar_UBYTE 0 ME11_CM_uint8_per_ 0.0 15.0 /end CHARACTERISTIC
/begin CHARACTERISTIC cal_ACCtlRecLevelForForceChange "" VALUE 0x0000 /* @ECU_Address@cal_ACCtlRecLevelForForceChange@ */ Scalar_UBYTE 0 ME11_CM_uint8_per_ 0.0 15.0 /end CHARACTERISTIC
/begin CHARACTERISTIC cal_ACCtlRecLevelForForceDefog "" VALUE 0x0000 /* @ECU_Address@cal_ACCtlRecLevelForForceDefog@ */ Scalar_UBYTE 0 ME11_CM_uint8_per_ 0.0 15.0 /end CHARACTERISTIC
/begin CHARACTERISTIC cal_ACCtlRecLevelForManual "" VALUE 0x0000 /* @ECU_Address@cal_ACCtlRecLevelForManual@ */ Scalar_UBYTE 0 ME11_CM_uint8_per_ 0.0 15.0 /end CHARACTERISTIC
/begin CHARACTERISTIC cal_ACCtlRecLevelForNormalDefog "" VALUE 0x0000 /* @ECU_Address@cal_ACCtlRecLevelForNormalDefog@ */ Scalar_UBYTE 0 ME11_CM_uint8_per_ 0.0 15.0 /end CHARACTERISTIC
/begin CHARACTERISTIC cal_ACCtlRecLevelForPCUTemp "" VALUE 0x0000 /* @ECU_Address@cal_ACCtlRecLevelForPCUTemp@ */ Scalar_UBYTE 0 ME11_CM_uint8_per_ 0.0 15.0 /end CHARACTERISTIC
/begin CHARACTERISTIC cal_ACCtlRecLevelForPTCDvt "" VALUE 0x0000 /* @ECU_Address@cal_ACCtlRecLevelForPTCDvt@ */ Scalar_UBYTE 0 ME11_CM_uint8_per_ 0.0 15.0 /end CHARACTERISTIC
/begin CHARACTERISTIC cal_ACCtlRecLevelForQkChargeCooling "" VALUE 0x0000 /* @ECU_Address@cal_ACCtlRecLevelForQkChargeCooling@ */ Scalar_UBYTE 0 ME11_CM_uint8_per_ 0.0 15.0 /end CHARACTERISTIC
/begin CHARACTERISTIC cal_ACCtlRecLevelForRemoteAC "" VALUE 0x0000 /* @ECU_Address@cal_ACCtlRecLevelForRemoteAC@ */ Scalar_UBYTE 0 ME11_CM_uint8_per_ 0.0 15.0 /end CHARACTERISTIC
/begin CHARACTERISTIC cal_ACCtlRecLevelForSummer "" VALUE 0x0000 /* @ECU_Address@cal_ACCtlRecLevelForSummer@ */ Scalar_UBYTE 0 ME11_CM_uint8_per_ 0.0 15.0 /end CHARACTERISTIC
/begin CHARACTERISTIC cal_ACCtlRecLevelForTargetOutTemp "" VALUE 0x0000 /* @ECU_Address@cal_ACCtlRecLevelForTargetOutTemp@ */ Scalar_UBYTE 0 ME11_CM_uint8_per_ 0.0 15.0 /end CHARACTERISTIC
/begin CHARACTERISTIC cal_ACCtlRecLevelForTempLow "" VALUE 0x0000 /* @ECU_Address@cal_ACCtlRecLevelForTempLow@ */ Scalar_UBYTE 0 ME11_CM_uint8_per_ 0.0 15.0 /end CHARACTERISTIC
/begin CHARACTERISTIC cal_ACCtlRecLevelForVent "" VALUE 0x0000 /* @ECU_Address@cal_ACCtlRecLevelForVent@ */ Scalar_UBYTE 0 ME11_CM_uint8_per_ 0.0 15.0 /end CHARACTERISTIC
/begin CHARACTERISTIC cal_ACCtlRecLevelForWinter "" VALUE 0x0000 /* @ECU_Address@cal_ACCtlRecLevelForWinter@ */ Scalar_UBYTE 0 ME11_CM_uint8_per_ 0.0 15.0 /end CHARACTERISTIC
/begin CHARACTERISTIC cal_AQS2InRecThreVal "" VALUE 0x0000 /* @ECU_Address@cal_AQS2InRecThreVal@ */ Scalar_UBYTE 0 ME11_CM_uint8_per_ 0.0 255.0 /end CHARACTERISTIC
/begin CHARACTERISTIC cal_AQS2OutRecThreVal "" VALUE 0x0000 /* @ECU_Address@cal_AQS2OutRecThreVal@ */ Scalar_UBYTE 0 ME11_CM_uint8_per_ 0.0 255.0 /end CHARACTERISTIC
/begin CHARACTERISTIC cal_AcPMPSpdSetData "" VALUE 0x0000 /* @ECU_Address@cal_AcPMPSpdSetData@ */ Scalar_UBYTE 0 ME11_CM_uint8_percent_ 0.0 255.0 /end CHARACTERISTIC
/begin CHARACTERISTIC cal_BCVFltStsDelayTime "" VALUE 0x0000 /* @ECU_Address@cal_BCVFltStsDelayTime@ */ Scalar_UBYTE 0 ME11_CM_uint8_s 0.0 100.0 /end CHARACTERISTIC
/begin CHARACTERISTIC cal_BatPMPSpdSetData "" VALUE 0x0000 /* @ECU_Address@cal_BatPMPSpdSetData@ */ Scalar_UBYTE 0 ME11_CM_uint8_percent_ 0.0 255.0 /end CHARACTERISTIC
/begin CHARACTERISTIC cal_BlowerFanSpdLL "" VALUE 0x0000 /* @ECU_Address@cal_BlowerFanSpdLL@ */ Scalar_UBYTE 0 ME11_CM_uint8_per_ 0 255 /end CHARACTERISTIC
/begin CHARACTERISTIC cal_BlowerFanSpdVentUL "" VALUE 0x0000 /* @ECU_Address@cal_BlowerFanSpdVentUL@ */ Scalar_UBYTE 0 ME11_CM_uint8_per_ 0 255 /end CHARACTERISTIC
/begin CHARACTERISTIC cal_C3WVExhPosVal "" VALUE 0x0000 /* @ECU_Address@cal_C3WVExhPosVal@ */ Scalar_UBYTE 0 ME11_CM_uint8_percent_ 0.0 100.0 /end CHARACTERISTIC
/begin CHARACTERISTIC cal_C5WVExhPosVal "" VALUE 0x0000 /* @ECU_Address@cal_C5WVExhPosVal@ */ Scalar_UBYTE 0 ME11_CM_uint8_percent_ 0.0 100.0 /end CHARACTERISTIC
/begin CHARACTERISTIC cal_CO2RecircRatio "" VALUE 0x0000 /* @ECU_Address@cal_CO2RecircRatio@ */ Scalar_UBYTE 0 ME11_CM_uint8_per_ 0 255 /end CHARACTERISTIC
/begin CHARACTERISTIC cal_CabinTCorSelect "" VALUE 0x0000 /* @ECU_Address@cal_CabinTCorSelect@ */ Scalar_UBYTE 0 ME11_CM_uint8_per_ 0 255 /end CHARACTERISTIC
/begin CHARACTERISTIC cal_DrMixDesValPIDLL "" VALUE 0x0000 /* @ECU_Address@cal_DrMixDesValPIDLL@ */ Scalar_UBYTE 0 ME11_CM_uint8_per_ 0 255 /end CHARACTERISTIC
/begin CHARACTERISTIC cal_DrMixDesValPIDUL "" VALUE 0x0000 /* @ECU_Address@cal_DrMixDesValPIDUL@ */ Scalar_UBYTE 0 ME11_CM_uint8_per_ 0 255 /end CHARACTERISTIC
/begin CHARACTERISTIC cal_FANSpdHotStartLL "" VALUE 0x0000 /* @ECU_Address@cal_FANSpdHotStartLL@ */ Scalar_UBYTE 0 ME11_CM_uint8_per_ 0 255 /end CHARACTERISTIC
/begin CHARACTERISTIC cal_FANSpdHotStartUL "" VALUE 0x0000 /* @ECU_Address@cal_FANSpdHotStartUL@ */ Scalar_UBYTE 0 ME11_CM_uint8_per_ 0 255 /end CHARACTERISTIC
/begin CHARACTERISTIC cal_FANSpdModeShiftMax "" VALUE 0x0000 /* @ECU_Address@cal_FANSpdModeShiftMax@ */ Scalar_UBYTE 0 ME11_CM_uint8_per_ 0 255 /end CHARACTERISTIC
/begin CHARACTERISTIC cal_LTRFanCtrl_1Y "" VAL_BLK 0x0000 /* @ECU_Address@cal_LTRFanCtrl_1Y@ */ Scalar_UBYTE 0 ME11_CM_uint8_rpm 0.0 100.0 NUMBER 3 /end CHARACTERISTIC
/begin CHARACTERISTIC cal_LTRIGBTTempMotPMPCtrl_1Y "" VAL_BLK 0x0000 /* @ECU_Address@cal_LTRIGBTTempMotPMPCtrl_1Y@ */ Scalar_UBYTE 0 ME11_CM_uint8_percent_ 0.0 100.0 NUMBER 3 /end CHARACTERISTIC
/begin CHARACTERISTIC cal_LTRIPUTempFanCtrl_1Y "" VAL_BLK 0x0000 /* @ECU_Address@cal_LTRIPUTempFanCtrl_1Y@ */ Scalar_UBYTE 0 ME11_CM_uint8_rpm 0.0 100.0 NUMBER 3 /end CHARACTERISTIC
/begin CHARACTERISTIC cal_LTRIPUTempMotPMPCtrl_1Y "" VAL_BLK 0x0000 /* @ECU_Address@cal_LTRIPUTempMotPMPCtrl_1Y@ */ Scalar_UBYTE 0 ME11_CM_uint8_percent_ 0.0 100.0 NUMBER 3 /end CHARACTERISTIC
/begin CHARACTERISTIC cal_LTRMotorTempMotPMPCtrl_1Y "" VAL_BLK 0x0000 /* @ECU_Address@cal_LTRMotorTempMotPMPCtrl_1Y@ */ Scalar_UBYTE 0 ME11_CM_uint8_percent_ 0.0 100.0 NUMBER 3 /end CHARACTERISTIC
/begin CHARACTERISTIC cal_MCVFltStsDelayTime "" VALUE 0x0000 /* @ECU_Address@cal_MCVFltStsDelayTime@ */ Scalar_UBYTE 0 ME11_CM_uint8_s 0.0 100.0 /end CHARACTERISTIC
/begin CHARACTERISTIC cal_MixDoor2CabinHeatingEn_OFF "" VALUE 0x0000 /* @ECU_Address@cal_MixDoor2CabinHeatingEn_OFF@ */ Scalar_UBYTE 0 ME11_CM_uint8_percent_ 0.0 100.0 /end CHARACTERISTIC
/begin CHARACTERISTIC cal_MixDoor2CabinHeatingEn_ON "" VALUE 0x0000 /* @ECU_Address@cal_MixDoor2CabinHeatingEn_ON@ */ Scalar_UBYTE 0 ME11_CM_uint8_percent_ 0.0 100.0 /end CHARACTERISTIC
/begin CHARACTERISTIC cal_MotPMPSpdSetData "" VALUE 0x0000 /* @ECU_Address@cal_MotPMPSpdSetData@ */ Scalar_UBYTE 0 ME11_CM_uint8_percent_ 0.0 255.0 /end CHARACTERISTIC
/begin CHARACTERISTIC cal_PTCEnableData "" VALUE 0x0000 /* @ECU_Address@cal_PTCEnableData@ */ Scalar_UBYTE 0 ME11_CM_uint8_flg 0.0 3.0 /end CHARACTERISTIC
/begin CHARACTERISTIC cal_PsMixDesValPIDLL "" VALUE 0x0000 /* @ECU_Address@cal_PsMixDesValPIDLL@ */ Scalar_UBYTE 0 ME11_CM_uint8_per_ 0 255 /end CHARACTERISTIC
/begin CHARACTERISTIC cal_PsMixDesValPIDUL "" VALUE 0x0000 /* @ECU_Address@cal_PsMixDesValPIDUL@ */ Scalar_UBYTE 0 ME11_CM_uint8_per_ 0 255 /end CHARACTERISTIC
/begin CHARACTERISTIC cal_eACStsData "" VALUE 0x0000 /* @ECU_Address@cal_eACStsData@ */ Scalar_UBYTE 0 ME11_CM_uint8_flg 0.0 10.0 /end CHARACTERISTIC
/begin MEASUREMENT ACSen_sEnvTempFilter "" FLOAT32_IEEE ME11_CM_single_C 0 0 -3.4E+38 3.4E+38 ECU_ADDRESS 0x0000 /* @ECU_Address@ACSen_sEnvTempFilter@ */ /end MEASUREMENT
/begin MEASUREMENT ACCtl_tLeftDuct "" FLOAT32_IEEE ME11_CM_single_null 0 0 -3.4E+38 3.4E+38 ECU_ADDRESS 0x0000 /* @ECU_Address@ACCtl_tLeftDuct@ */ /end MEASUREMENT
/begin MEASUREMENT GlbDa_tCabinInvent "" FLOAT32_IEEE ME11_CM_single_null 0 0 -3.4E+38 3.4E+38 ECU_ADDRESS 0x0000 /* @ECU_Address@GlbDa_tCabinInvent@ */ /end MEASUREMENT
/begin MEASUREMENT ACCtl_tDrDVTSolarCor "" FLOAT32_IEEE ME11_CM_single_null 0 0 -3.4E+38 3.4E+38 ECU_ADDRESS 0x0000 /* @ECU_Address@ACCtl_tDrDVTSolarCor@ */ /end MEASUREMENT
/begin MEASUREMENT ACCtl_tDrDVT "" FLOAT32_IEEE ME11_CM_single_null 0 0 -3.4E+38 3.4E+38 ECU_ADDRESS 0x0000 /* @ECU_Address@ACCtl_tDrDVT@ */ /end MEASUREMENT
/begin MEASUREMENT AC_Ps2DrSetTempDvt "" FLOAT32_IEEE ME11_CM_single_null 0 0 -3.4E+38 3.4E+38 ECU_ADDRESS 0x0000 /* @ECU_Address@AC_Ps2DrSetTempDvt@ */ /end MEASUREMENT
/begin MEASUREMENT ACCtl_tPsDVTCabinCor "" FLOAT32_IEEE ME11_CM_single_null 0 0 -3.4E+38 3.4E+38 ECU_ADDRESS 0x0000 /* @ECU_Address@ACCtl_tPsDVTCabinCor@ */ /end MEASUREMENT
/begin MEASUREMENT ACCtl_tPsDVTSolarCor "" FLOAT32_IEEE ME11_CM_single_null 0 0 -3.4E+38 3.4E+38 ECU_ADDRESS 0x0000 /* @ECU_Address@ACCtl_tPsDVTSolarCor@ */ /end MEASUREMENT
/begin MEASUREMENT ACCtl_tPsDVT "" FLOAT32_IEEE ME11_CM_single_null 0 0 -3.4E+38 3.4E+38 ECU_ADDRESS 0x0000 /* @ECU_Address@ACCtl_tPsDVT@ */ /end MEASUREMENT
/begin MEASUREMENT ACCtl_tRightDuct "" FLOAT32_IEEE ME11_CM_single_null 0 0 -3.4E+38 3.4E+38 ECU_ADDRESS 0x0000 /* @ECU_Address@ACCtl_tRightDuct@ */ /end MEASUREMENT
/begin MEASUREMENT Eva_CoolingCond1 "" FLOAT32_IEEE ME11_CM_single_null 0 0 -3.4E+38 3.4E+38 ECU_ADDRESS 0x0000 /* @ECU_Address@Eva_CoolingCond1@ */ /end MEASUREMENT
/begin MEASUREMENT Eva_CoolingCond2 "" FLOAT32_IEEE ME11_CM_single_null 0 0 -3.4E+38 3.4E+38 ECU_ADDRESS 0x0000 /* @ECU_Address@Eva_CoolingCond2@ */ /end MEASUREMENT
/begin MEASUREMENT Eva_CloseCond1 "" FLOAT32_IEEE ME11_CM_single_null 0 0 -3.4E+38 3.4E+38 ECU_ADDRESS 0x0000 /* @ECU_Address@Eva_CloseCond1@ */ /end MEASUREMENT
/begin MEASUREMENT Eva_CooledCond1 "" FLOAT32_IEEE ME11_CM_single_null 0 0 -3.4E+38 3.4E+38 ECU_ADDRESS 0x0000 /* @ECU_Address@Eva_CooledCond1@ */ /end MEASUREMENT
/begin MEASUREMENT ACCtl_tDrEvapDes "" FLOAT32_IEEE ME11_CM_single_null 0 0 -3.4E+38 3.4E+38 ECU_ADDRESS 0x0000 /* @ECU_Address@ACCtl_tDrEvapDes@ */ /end MEASUREMENT
/begin MEASUREMENT ACCtl_tPsEvapDes "" FLOAT32_IEEE ME11_CM_single_null 0 0 -3.4E+38 3.4E+38 ECU_ADDRESS 0x0000 /* @ECU_Address@ACCtl_tPsEvapDes@ */ /end MEASUREMENT
/begin MEASUREMENT ACCtl_tSetPointEvap "" FLOAT32_IEEE ME11_CM_single_null 0 0 -3.4E+38 3.4E+38 ECU_ADDRESS 0x0000 /* @ECU_Address@ACCtl_tSetPointEvap@ */ /end MEASUREMENT
/begin MEASUREMENT ACPTC_HeatingCond1 "" FLOAT32_IEEE ME11_CM_single_null 0 0 -3.4E+38 3.4E+38 ECU_ADDRESS 0x0000 /* @ECU_Address@ACPTC_HeatingCond1@ */ /end MEASUREMENT
/begin MEASUREMENT ACPTC_HeatingCond2 "" FLOAT32_IEEE ME11_CM_single_null 0 0 -3.4E+38 3.4E+38 ECU_ADDRESS 0x0000 /* @ECU_Address@ACPTC_HeatingCond2@ */ /end MEASUREMENT
/begin MEASUREMENT ACPtc_CloseCond1 "" FLOAT32_IEEE ME11_CM_single_null 0 0 -3.4E+38 3.4E+38 ECU_ADDRESS 0x0000 /* @ECU_Address@ACPtc_CloseCond1@ */ /end MEASUREMENT
/begin MEASUREMENT ACPTC_HeatedCond1 "" FLOAT32_IEEE ME11_CM_single_null 0 0 -3.4E+38 3.4E+38 ECU_ADDRESS 0x0000 /* @ECU_Address@ACPTC_HeatedCond1@ */ /end MEASUREMENT
/begin MEASUREMENT ACCCtl_sSetPtcDesTempMax "" FLOAT32_IEEE ME11_CM_single_C 0 0 -3.4E+38 3.4E+38 ECU_ADDRESS 0x0000 /* @ECU_Address@ACCCtl_sSetPtcDesTempMax@ */ /end MEASUREMENT
/begin MEASUREMENT ACCtl_tSetPointPTC "" FLOAT32_IEEE ME11_CM_single_null 0 0 -3.4E+38 3.4E+38 ECU_ADDRESS 0x0000 /* @ECU_Address@ACCtl_tSetPointPTC@ */ /end MEASUREMENT
/begin MEASUREMENT AC_DVT2PTCErr "" FLOAT32_IEEE ME11_CM_single_null 0 0 -3.4E+38 3.4E+38 ECU_ADDRESS 0x0000 /* @ECU_Address@AC_DVT2PTCErr@ */ /end MEASUREMENT
/begin MEASUREMENT ThCo_rSetLeftMixDoor "" FLOAT32_IEEE ME11_CM_single_null 0 0 -3.4E+38 3.4E+38 ECU_ADDRESS 0x0000 /* @ECU_Address@ThCo_rSetLeftMixDoor@ */ /end MEASUREMENT
/begin MEASUREMENT ThCo_rSetRightMixDoor "" FLOAT32_IEEE ME11_CM_single_null 0 0 -3.4E+38 3.4E+38 ECU_ADDRESS 0x0000 /* @ECU_Address@ThCo_rSetRightMixDoor@ */ /end MEASUREMENT
/begin MEASUREMENT ACSen_sPressRateVal "" FLOAT32_IEEE ME11_CM_single_percent_ 0 0 -3.4E+38 3.4E+38 ECU_ADDRESS 0x0000 /* @ECU_Address@ACSen_sPressRateVal@ */ /end MEASUREMENT
/begin MEASUREMENT ACTCtl_sCOMPCtrlAClsFF "" FLOAT32_IEEE ME11_CM_single_rpm 0 0 -3.4E+38 3.4E+38 ECU_ADDRESS 0x0000 /* @ECU_Address@ACTCtl_sCOMPCtrlAClsFF@ */ /end MEASUREMENT
/begin MEASUREMENT ACTCtl_tCtrlADiff "" FLOAT32_IEEE ME11_CM_single_C 0 0 -3.4E+38 3.4E+38 ECU_ADDRESS 0x0000 /* @ECU_Address@ACTCtl_tCtrlADiff@ */ /end MEASUREMENT
/begin MEASUREMENT ACTCtl_tCtrlBDiff "" FLOAT32_IEEE ME11_CM_single_C 0 0 -3.4E+38 3.4E+38 ECU_ADDRESS 0x0000 /* @ECU_Address@ACTCtl_tCtrlBDiff@ */ /end MEASUREMENT
/begin MEASUREMENT ACTCtl_tCtrlCDiff "" FLOAT32_IEEE ME11_CM_single_C 0 0 -3.4E+38 3.4E+38 ECU_ADDRESS 0x0000 /* @ECU_Address@ACTCtl_tCtrlCDiff@ */ /end MEASUREMENT
/begin MEASUREMENT ACTCtl_sDCoolBatTempDiff "" FLOAT32_IEEE ME11_CM_single_C 0 0 -3.4E+38 3.4E+38 ECU_ADDRESS 0x0000 /* @ECU_Address@ACTCtl_sDCoolBatTempDiff@ */ /end MEASUREMENT
/begin MEASUREMENT ACTCtl_sDCoolCabinTempDiff "" FLOAT32_IEEE ME11_CM_single_C 0 0 -3.4E+38 3.4E+38 ECU_ADDRESS 0x0000 /* @ECU_Address@ACTCtl_sDCoolCabinTempDiff@ */ /end MEASUREMENT
/begin MEASUREMENT ACTCtl_sACCMI_Cor "" FLOAT32_IEEE ME11_CM_single_rpm 0 0 -3.4E+38 3.4E+38 ECU_ADDRESS 0x0000 /* @ECU_Address@ACTCtl_sACCMI_Cor@ */ /end MEASUREMENT
/begin MEASUREMENT ACTCtl_sACCMI_Sum "" FLOAT32_IEEE ME11_CM_single_rpm 0 0 -3.4E+38 3.4E+38 ECU_ADDRESS 0x0000 /* @ECU_Address@ACTCtl_sACCMI_Sum@ */ /end MEASUREMENT
/begin MEASUREMENT ACTCtl_sACCMP_Cor "" FLOAT32_IEEE ME11_CM_single_rpm 0 0 -3.4E+38 3.4E+38 ECU_ADDRESS 0x0000 /* @ECU_Address@ACTCtl_sACCMP_Cor@ */ /end MEASUREMENT
/begin MEASUREMENT ACTCtl_sACCMPIVal "" FLOAT32_IEEE ME11_CM_single_rpm 0 0 -3.4E+38 3.4E+38 ECU_ADDRESS 0x0000 /* @ECU_Address@ACTCtl_sACCMPIVal@ */ /end MEASUREMENT
/begin MEASUREMENT ACTCtl_sCOMPATNoiseLmtHVSSpd "" FLOAT32_IEEE ME11_CM_single_rpm 0 0 -3.4E+38 3.4E+38 ECU_ADDRESS 0x0000 /* @ECU_Address@ACTCtl_sCOMPATNoiseLmtHVSSpd@ */ /end MEASUREMENT
/begin MEASUREMENT ACTCtl_sCOMPATNoiseBlwAndAccmSpd "" FLOAT32_IEEE ME11_CM_single_rpm 0 0 -3.4E+38 3.4E+38 ECU_ADDRESS 0x0000 /* @ECU_Address@ACTCtl_sCOMPATNoiseBlwAndAccmSpd@ */ /end MEASUREMENT
/begin MEASUREMENT ACTCtl_sCOMPCoolLmtSpd "" FLOAT32_IEEE ME11_CM_single_rpm 0 0 -3.4E+38 3.4E+38 ECU_ADDRESS 0x0000 /* @ECU_Address@ACTCtl_sCOMPCoolLmtSpd@ */ /end MEASUREMENT
/begin MEASUREMENT ACTCtl_sCOMPHPLmtSpd "" FLOAT32_IEEE ME11_CM_single_rpm 0 0 -3.4E+38 3.4E+38 ECU_ADDRESS 0x0000 /* @ECU_Address@ACTCtl_sCOMPHPLmtSpd@ */ /end MEASUREMENT
/begin MEASUREMENT ACTCtl_sCOMPLPLmtSpd "" FLOAT32_IEEE ME11_CM_single_rpm 0 0 -3.4E+38 3.4E+38 ECU_ADDRESS 0x0000 /* @ECU_Address@ACTCtl_sCOMPLPLmtSpd@ */ /end MEASUREMENT
/begin MEASUREMENT ACTCtl_sCOMPPCULimSpd "" FLOAT32_IEEE ME11_CM_single_rpm 0 0 -3.4E+38 3.4E+38 ECU_ADDRESS 0x0000 /* @ECU_Address@ACTCtl_sCOMPPCULimSpd@ */ /end MEASUREMENT
/begin MEASUREMENT ACTCtl_sCOMPATNoiseLmtSpd "" FLOAT32_IEEE ME11_CM_single_rpm 0 0 -3.4E+38 3.4E+38 ECU_ADDRESS 0x0000 /* @ECU_Address@ACTCtl_sCOMPATNoiseLmtSpd@ */ /end MEASUREMENT
/begin MEASUREMENT ACTCtl_sCOMPEnvLmtSpd "" FLOAT32_IEEE ME11_CM_single_rpm 0 0 -3.4E+38 3.4E+38 ECU_ADDRESS 0x0000 /* @ECU_Address@ACTCtl_sCOMPEnvLmtSpd@ */ /end MEASUREMENT
/begin MEASUREMENT ACTCtl_sCOMPFanlevelLmtSpd "" FLOAT32_IEEE ME11_CM_single_rpm 0 0 -3.4E+38 3.4E+38 ECU_ADDRESS 0x0000 /* @ECU_Address@ACTCtl_sCOMPFanlevelLmtSpd@ */ /end MEASUREMENT
/begin MEASUREMENT ACTCtl_sCOMPDownSpd "" FLOAT32_IEEE ME11_CM_single_null 0 0 -3.4E+38 3.4E+38 ECU_ADDRESS 0x0000 /* @ECU_Address@ACTCtl_sCOMPDownSpd@ */ /end MEASUREMENT
/begin MEASUREMENT ACTCtl_sPTCAuxHeatPwr "" FLOAT32_IEEE ME11_CM_single_kw 0 0 -3.4E+38 3.4E+38 ECU_ADDRESS 0x0000 /* @ECU_Address@ACTCtl_sPTCAuxHeatPwr@ */ /end MEASUREMENT
/begin MEASUREMENT ACTCtl_sCtrlFPTCAuxHeatPwr "" FLOAT32_IEEE ME11_CM_single_kw 0 0 -3.4E+38 3.4E+38 ECU_ADDRESS 0x0000 /* @ECU_Address@ACTCtl_sCtrlFPTCAuxHeatPwr@ */ /end MEASUREMENT
/begin MEASUREMENT SOMCtl_sBatHeatT1 "" FLOAT32_IEEE ME11_CM_single_C 0 0 -3.4E+38 3.4E+38 ECU_ADDRESS 0x0000 /* @ECU_Address@SOMCtl_sBatHeatT1@ */ /end MEASUREMENT
/begin MEASUREMENT SOMCtl_sBatHeatT2 "" FLOAT32_IEEE ME11_CM_single_C 0 0 -3.4E+38 3.4E+38 ECU_ADDRESS 0x0000 /* @ECU_Address@SOMCtl_sBatHeatT2@ */ /end MEASUREMENT
/begin MEASUREMENT ACTCtl_sCoolCondDepAvg "" FLOAT32_IEEE ME11_CM_single_C 0 0 -3.4E+38 3.4E+38 ECU_ADDRESS 0x0000 /* @ECU_Address@ACTCtl_sCoolCondDepAvg@ */ /end MEASUREMENT
/begin MEASUREMENT ACTCtl_sEvapSuperHeatAvg "" FLOAT32_IEEE ME11_CM_single_C 0 0 -3.4E+38 3.4E+38 ECU_ADDRESS 0x0000 /* @ECU_Address@ACTCtl_sEvapSuperHeatAvg@ */ /end MEASUREMENT
/begin MEASUREMENT ACTCtl_sAEXVDvt "" FLOAT32_IEEE ME11_CM_single_C 0 0 -3.4E+38 3.4E+38 ECU_ADDRESS 0x0000 /* @ECU_Address@ACTCtl_sAEXVDvt@ */ /end MEASUREMENT
/begin MEASUREMENT ACTCtl_sAEXVPos "" FLOAT32_IEEE ME11_CM_single_percent_ 0 0 -3.4E+38 3.4E+38 ECU_ADDRESS 0x0000 /* @ECU_Address@ACTCtl_sAEXVPos@ */ /end MEASUREMENT
/begin MEASUREMENT ACTCtl_sChiSuperHeatAvg "" FLOAT32_IEEE ME11_CM_single_C 0 0 -3.4E+38 3.4E+38 ECU_ADDRESS 0x0000 /* @ECU_Address@ACTCtl_sChiSuperHeatAvg@ */ /end MEASUREMENT
/begin MEASUREMENT ACTCtl_sBEXVDvt "" FLOAT32_IEEE ME11_CM_single_C 0 0 -3.4E+38 3.4E+38 ECU_ADDRESS 0x0000 /* @ECU_Address@ACTCtl_sBEXVDvt@ */ /end MEASUREMENT
/begin MEASUREMENT ACTCtl_sCondDepAvg "" FLOAT32_IEEE ME11_CM_single_C 0 0 -3.4E+38 3.4E+38 ECU_ADDRESS 0x0000 /* @ECU_Address@ACTCtl_sCondDepAvg@ */ /end MEASUREMENT
/begin MEASUREMENT ACTCtl_sHPEXVSetPoint "" FLOAT32_IEEE ME11_CM_single_null 0 0 -3.4E+38 3.4E+38 ECU_ADDRESS 0x0000 /* @ECU_Address@ACTCtl_sHPEXVSetPoint@ */ /end MEASUREMENT
/begin MEASUREMENT ACTCtl_sHPEXVDvt "" FLOAT32_IEEE ME11_CM_single_C 0 0 -3.4E+38 3.4E+38 ECU_ADDRESS 0x0000 /* @ECU_Address@ACTCtl_sHPEXVDvt@ */ /end MEASUREMENT
/begin MEASUREMENT ACTCtl_sHPEXVPos "" FLOAT32_IEEE ME11_CM_single_percent_ 0 0 -3.4E+38 3.4E+38 ECU_ADDRESS 0x0000 /* @ECU_Address@ACTCtl_sHPEXVPos@ */ /end MEASUREMENT
/begin MEASUREMENT ACTCtl_sExhSuperHeatAvg "" FLOAT32_IEEE ME11_CM_single_C 0 0 -3.4E+38 3.4E+38 ECU_ADDRESS 0x0000 /* @ECU_Address@ACTCtl_sExhSuperHeatAvg@ */ /end MEASUREMENT
/begin MEASUREMENT ACTCtl_sSuperHeatAvg "" FLOAT32_IEEE ME11_CM_single_C 0 0 -3.4E+38 3.4E+38 ECU_ADDRESS 0x0000 /* @ECU_Address@ACTCtl_sSuperHeatAvg@ */ /end MEASUREMENT
/begin MEASUREMENT ACTCtl_sPTCReqPower "" FLOAT32_IEEE ME11_CM_single_kw 0 0 -3.4E+38 3.4E+38 ECU_ADDRESS 0x0000 /* @ECU_Address@ACTCtl_sPTCReqPower@ */ /end MEASUREMENT
/begin MEASUREMENT ACTCtl_sHPEXVCtrlFF "" FLOAT32_IEEE ME11_CM_single_percent_ 0 0 -3.4E+38 3.4E+38 ECU_ADDRESS 0x0000 /* @ECU_Address@ACTCtl_sHPEXVCtrlFF@ */ /end MEASUREMENT
/begin MEASUREMENT ACTCtl_sBEXVCtrlFF "" FLOAT32_IEEE ME11_CM_single_C 0 0 -3.4E+38 3.4E+38 ECU_ADDRESS 0x0000 /* @ECU_Address@ACTCtl_sBEXVCtrlFF@ */ /end MEASUREMENT
/begin MEASUREMENT ACTCtl_sAEXVCtrlFF "" FLOAT32_IEEE ME11_CM_single_C 0 0 -3.4E+38 3.4E+38 ECU_ADDRESS 0x0000 /* @ECU_Address@ACTCtl_sAEXVCtrlFF@ */ /end MEASUREMENT
/begin MEASUREMENT ACCtl_rPsBlowerModeSet "" FLOAT32_IEEE ME11_CM_single_null 0 0 -3.4E+38 3.4E+38 ECU_ADDRESS 0x0000 /* @ECU_Address@ACCtl_rPsBlowerModeSet@ */ /end MEASUREMENT
/begin MEASUREMENT ACCtl_sMixDoorClsFF "" FLOAT32_IEEE ME11_CM_single_percent_ 0 0 -3.4E+38 3.4E+38 ECU_ADDRESS 0x0000 /* @ECU_Address@ACCtl_sMixDoorClsFF@ */ /end MEASUREMENT
/begin MEASUREMENT GlbDa_LeftSolar "" UWORD ME11_CM_uint16_null 0 0 0 65535 ECU_ADDRESS 0x0000 /* @ECU_Address@GlbDa_LeftSolar@ */ /end MEASUREMENT
/begin MEASUREMENT GlbDa_RightSolar "" UWORD ME11_CM_uint16_null 0 0 0 65535 ECU_ADDRESS 0x0000 /* @ECU_Address@GlbDa_RightSolar@ */ /end MEASUREMENT
/begin MEASUREMENT GlbDa_Solar "" UWORD ME11_CM_uint16_null 0 0 0 65535 ECU_ADDRESS 0x0000 /* @ECU_Address@GlbDa_Solar@ */ /end MEASUREMENT
/begin MEASUREMENT SOMCtl_eMotorHeatBatOffFlg "" UWORD ME11_CM_uint16_flg 0 0 0 65535 ECU_ADDRESS 0x0000 /* @ECU_Address@SOMCtl_eMotorHeatBatOffFlg@ */ /end MEASUREMENT
/begin MEASUREMENT SOMCtl_eBatBalEntBFlg "" UBYTE ME11_CM_uint8_flg 0 0 0 255 ECU_ADDRESS 0x0000 /* @ECU_Address@SOMCtl_eBatBalEntBFlg@ */ /end MEASUREMENT
/begin MEASUREMENT SOMCtl_eBatLTROnFlg "" UBYTE ME11_CM_uint8_flg 0 0 0 255 ECU_ADDRESS 0x0000 /* @ECU_Address@SOMCtl_eBatLTROnFlg@ */ /end MEASUREMENT
/begin MEASUREMENT SOMCtl_eMotLTRAndBatBalOffFlg "" UBYTE ME11_CM_uint8_flg 0 0 0 255 ECU_ADDRESS 0x0000 /* @ECU_Address@SOMCtl_eMotLTRAndBatBalOffFlg@ */ /end MEASUREMENT
/begin MEASUREMENT SOMCtl_eMotLTRAndBatBalOn1Flg "" UBYTE ME11_CM_uint8_flg 0 0 0 255 ECU_ADDRESS 0x0000 /* @ECU_Address@SOMCtl_eMotLTRAndBatBalOn1Flg@ */ /end MEASUREMENT
/begin MEASUREMENT SOMCtl_eMotLTRAndBatBalOn2Flg "" UBYTE ME11_CM_uint8_flg 0 0 0 255 ECU_ADDRESS 0x0000 /* @ECU_Address@SOMCtl_eMotLTRAndBatBalOn2Flg@ */ /end MEASUREMENT
/begin MEASUREMENT SOMCtl_eNmlBatLTROnFlg "" UBYTE ME11_CM_uint8_flg 0 0 0 255 ECU_ADDRESS 0x0000 /* @ECU_Address@SOMCtl_eNmlBatLTROnFlg@ */ /end MEASUREMENT
/begin MEASUREMENT ACCtl_IntakeRatio "" UBYTE ME11_CM_uint8_null 0 0 0 255 ECU_ADDRESS 0x0000 /* @ECU_Address@ACCtl_IntakeRatio@ */ /end MEASUREMENT
/begin MEASUREMENT AC_BlowerFanSpeedMax "" UBYTE ME11_CM_uint8_null 0 0 0 255 ECU_ADDRESS 0x0000 /* @ECU_Address@AC_BlowerFanSpeedMax@ */ /end MEASUREMENT
/begin MEASUREMENT AC_BlowerFanSpeedMin "" UBYTE ME11_CM_uint8_null 0 0 0 255 ECU_ADDRESS 0x0000 /* @ECU_Address@AC_BlowerFanSpeedMin@ */ /end MEASUREMENT
/begin MEASUREMENT ACTCtl_eAcPMPSpdPerc "" UBYTE ME11_CM_uint8_percent_ 0 0 0 255 ECU_ADDRESS 0x0000 /* @ECU_Address@ACTCtl_eAcPMPSpdPerc@ */ /end MEASUREMENT
/begin MEASUREMENT ACTCtl_eCOMPJudgeFlg "" UBYTE ME11_CM_uint8_flg 0 0 0 255 ECU_ADDRESS 0x0000 /* @ECU_Address@ACTCtl_eCOMPJudgeFlg@ */ /end MEASUREMENT
/begin MEASUREMENT ACTCtl_bCOMPIFreeFlag "" UBYTE ME11_CM_uint8_flg 0 0 0 255 ECU_ADDRESS 0x0000 /* @ECU_Address@ACTCtl_bCOMPIFreeFlag@ */ /end MEASUREMENT
/begin MEASUREMENT ACTCtl_sPTCEnable "" UBYTE ME11_CM_uint8_flg 0 0 0 255 ECU_ADDRESS 0x0000 /* @ECU_Address@ACTCtl_sPTCEnable@ */ /end MEASUREMENT
/begin MEASUREMENT SOMCtl_eMotorHeatBatFlg "" UBYTE ME11_CM_uint8_flg 0 0 0 255 ECU_ADDRESS 0x0000 /* @ECU_Address@SOMCtl_eMotorHeatBatFlg@ */ /end MEASUREMENT
/begin MEASUREMENT SOMCtl_eMotorHeatBat2Flg "" UBYTE ME11_CM_uint8_flg 0 0 0 255 ECU_ADDRESS 0x0000 /* @ECU_Address@SOMCtl_eMotorHeatBat2Flg@ */ /end MEASUREMENT
/begin MEASUREMENT HMICtl_eACSts "" UBYTE ME11_CM_uint8_null 0 0 0 255 ECU_ADDRESS 0x0000 /* @ECU_Address@HMICtl_eACSts@ */ /end MEASUREMENT
/begin MEASUREMENT ACTCtl_eEvapProSts "" UBYTE ME11_CM_uint8_null 0 0 0 255 ECU_ADDRESS 0x0000 /* @ECU_Address@ACTCtl_eEvapProSts@ */ /end MEASUREMENT
/begin MEASUREMENT ACCtl_rPsBasicMixDoor "" UBYTE ME11_CM_uint8_null 0 0 0 255 ECU_ADDRESS 0x0000 /* @ECU_Address@ACCtl_rPsBasicMixDoor@ */ /end MEASUREMENT
/begin MEASUREMENT ACCtl_rPsMixDoorDes "" UBYTE ME11_CM_uint8_null 0 0 0 255 ECU_ADDRESS 0x0000 /* @ECU_Address@ACCtl_rPsMixDoorDes@ */ /end MEASUREMENT
/begin MEASUREMENT ACCtl_rDrBasicMixDoor "" UBYTE ME11_CM_uint8_null 0 0 0 255 ECU_ADDRESS 0x0000 /* @ECU_Address@ACCtl_rDrBasicMixDoor@ */ /end MEASUREMENT
/begin MEASUREMENT ACCtl_rDrMixDoorDes "" UBYTE ME11_CM_uint8_null 0 0 0 255 ECU_ADDRESS 0x0000 /* @ECU_Address@ACCtl_rDrMixDoorDes@ */ /end MEASUREMENT
/begin MEASUREMENT ACCtl_stRecForceChangeEna "" UBYTE ME11_CM_boolean_null 0 0 0 1 ECU_ADDRESS 0x0000 /* @ECU_Address@ACCtl_stRecForceChangeEna@ */ /end MEASUREMENT
/begin MEASUREMENT ACCtl_stRecNormalDefogEna "" UBYTE ME11_CM_boolean_null 0 0 0 1 ECU_ADDRESS 0x0000 /* @ECU_Address@ACCtl_stRecNormalDefogEna@ */ /end MEASUREMENT
/begin MEASUREMENT ACCtl_stRecTargetOutTempEna "" UBYTE ME11_CM_boolean_null 0 0 0 1 ECU_ADDRESS 0x0000 /* @ECU_Address@ACCtl_stRecTargetOutTempEna@ */ /end MEASUREMENT
/begin MEASUREMENT ACCtl_stRecVentEna "" UBYTE ME11_CM_boolean_null 0 0 0 1 ECU_ADDRESS 0x0000 /* @ECU_Address@ACCtl_stRecVentEna@ */ /end MEASUREMENT
/begin MEASUREMENT ACCtl_stRecWinterCondEna "" UBYTE ME11_CM_boolean_null 0 0 0 1 ECU_ADDRESS 0x0000 /* @ECU_Address@ACCtl_stRecWinterCondEna@ */ /end MEASUREMENT
/begin MEASUREMENT ACCtl_stRecSummerCondEna "" UBYTE ME11_CM_boolean_null 0 0 0 1 ECU_ADDRESS 0x0000 /* @ECU_Address@ACCtl_stRecSummerCondEna@ */ /end MEASUREMENT
/begin MEASUREMENT ACCtl_stRecPTCDvtEna "" UBYTE ME11_CM_boolean_flg 0 0 0 1 ECU_ADDRESS 0x0000 /* @ECU_Address@ACCtl_stRecPTCDvtEna@ */ /end MEASUREMENT
/begin MEASUREMENT ACCtl_stRecACHotStartEna "" UBYTE ME11_CM_boolean_null 0 0 0 1 ECU_ADDRESS 0x0000 /* @ECU_Address@ACCtl_stRecACHotStartEna@ */ /end MEASUREMENT
/begin MEASUREMENT ACCtl_stRecForceDefogEna "" UBYTE ME11_CM_boolean_null 0 0 0 1 ECU_ADDRESS 0x0000 /* @ECU_Address@ACCtl_stRecForceDefogEna@ */ /end MEASUREMENT
/begin MEASUREMENT ACCtl_stRecManualEna "" UBYTE ME11_CM_boolean_null 0 0 0 1 ECU_ADDRESS 0x0000 /* @ECU_Address@ACCtl_stRecManualEna@ */ /end MEASUREMENT
/begin MEASUREMENT ACCtl_stRecRemoteACEna "" UBYTE ME11_CM_boolean_null 0 0 0 1 ECU_ADDRESS 0x0000 /* @ECU_Address@ACCtl_stRecRemoteACEna@ */ /end MEASUREMENT
/begin MEASUREMENT ACTCtl_bAEXVFaultFlg "" UBYTE ME11_CM_boolean_flg 0 0 0 1 ECU_ADDRESS 0x0000 /* @ECU_Address@ACTCtl_bAEXVFaultFlg@ */ /end MEASUREMENT
/begin MEASUREMENT ACTCtl_bBEXVFaultFlg "" UBYTE ME11_CM_boolean_flg 0 0 0 1 ECU_ADDRESS 0x0000 /* @ECU_Address@ACTCtl_bBEXVFaultFlg@ */ /end MEASUREMENT
/begin MEASUREMENT ACTCtl_bHPEXVFaultFlg "" UBYTE ME11_CM_boolean_flg 0 0 0 1 ECU_ADDRESS 0x0000 /* @ECU_Address@ACTCtl_bHPEXVFaultFlg@ */ /end MEASUREMENT
/begin MEASUREMENT ACTCtl_bBatPMPFaultFlg "" UBYTE ME11_CM_boolean_flg 0 0 0 1 ECU_ADDRESS 0x0000 /* @ECU_Address@ACTCtl_bBatPMPFaultFlg@ */ /end MEASUREMENT
/begin MEASUREMENT SOMCtl_bBatCoolFlg "" UBYTE ME11_CM_boolean_flg 0 0 0 1 ECU_ADDRESS 0x0000 /* @ECU_Address@SOMCtl_bBatCoolFlg@ */ /end MEASUREMENT
/begin MEASUREMENT ACTCtl_bMotPMPFaultFlg "" UBYTE ME11_CM_boolean_flg 0 0 0 1 ECU_ADDRESS 0x0000 /* @ECU_Address@ACTCtl_bMotPMPFaultFlg@ */ /end MEASUREMENT
/begin MEASUREMENT SOMCtl_bBatBalEntBFlg "" UBYTE ME11_CM_boolean_flg 0 0 0 1 ECU_ADDRESS 0x0000 /* @ECU_Address@SOMCtl_bBatBalEntBFlg@ */ /end MEASUREMENT
/begin MEASUREMENT SOMCtl_bMotLTRAndBatBalOffFlg "" UBYTE ME11_CM_boolean_flg 0 0 0 1 ECU_ADDRESS 0x0000 /* @ECU_Address@SOMCtl_bMotLTRAndBatBalOffFlg@ */ /end MEASUREMENT
/begin MEASUREMENT SOMCtl_bMotLTRAndBatBalOn1Flg "" UBYTE ME11_CM_boolean_flg 0 0 0 1 ECU_ADDRESS 0x0000 /* @ECU_Address@SOMCtl_bMotLTRAndBatBalOn1Flg@ */ /end MEASUREMENT
/begin MEASUREMENT SOMCtl_bMotLTRAndBatBalOn2Flg "" UBYTE ME11_CM_boolean_flg 0 0 0 1 ECU_ADDRESS 0x0000 /* @ECU_Address@SOMCtl_bMotLTRAndBatBalOn2Flg@ */ /end MEASUREMENT
/begin MEASUREMENT SOMCtl_bDBatLTROffFlg "" UBYTE ME11_CM_boolean_flg 0 0 0 1 ECU_ADDRESS 0x0000 /* @ECU_Address@SOMCtl_bDBatLTROffFlg@ */ /end MEASUREMENT
/begin MEASUREMENT ACTCtl_bAcPMPFaultFlg "" UBYTE ME11_CM_boolean_flg 0 0 0 1 ECU_ADDRESS 0x0000 /* @ECU_Address@ACTCtl_bAcPMPFaultFlg@ */ /end MEASUREMENT
/begin MEASUREMENT SOMCtl_bBatHeatFlg "" UBYTE ME11_CM_boolean_flg 0 0 0 1 ECU_ADDRESS 0x0000 /* @ECU_Address@SOMCtl_bBatHeatFlg@ */ /end MEASUREMENT
/begin MEASUREMENT SOMCtl_bBatTSExitFlg "" UBYTE ME11_CM_boolean_flg 0 0 0 1 ECU_ADDRESS 0x0000 /* @ECU_Address@SOMCtl_bBatTSExitFlg@ */ /end MEASUREMENT
/begin MEASUREMENT SOMCtl_bMotorHeatBatOffFlg "" UBYTE ME11_CM_boolean_flg 0 0 0 1 ECU_ADDRESS 0x0000 /* @ECU_Address@SOMCtl_bMotorHeatBatOffFlg@ */ /end MEASUREMENT
/begin MEASUREMENT SOMCtl_bNmlBatLTROnFlg "" UBYTE ME11_CM_boolean_flg 0 0 0 1 ECU_ADDRESS 0x0000 /* @ECU_Address@SOMCtl_bNmlBatLTROnFlg@ */ /end MEASUREMENT
/begin MEASUREMENT SOMCtl_bDCBatLTROnFlg "" UBYTE ME11_CM_boolean_flg 0 0 0 1 ECU_ADDRESS 0x0000 /* @ECU_Address@SOMCtl_bDCBatLTROnFlg@ */ /end MEASUREMENT
/begin MEASUREMENT SOMCtrl_bBatLTRDelayFlg "" UBYTE ME11_CM_boolean_flg 0 0 0 1 ECU_ADDRESS 0x0000 /* @ECU_Address@SOMCtrl_bBatLTRDelayFlg@ */ /end MEASUREMENT
/begin MEASUREMENT SOMCtl_bBatLTROffFlg "" UBYTE ME11_CM_boolean_flg 0 0 0 1 ECU_ADDRESS 0x0000 /* @ECU_Address@SOMCtl_bBatLTROffFlg@ */ /end MEASUREMENT
/begin MEASUREMENT SOMCtl_bBatHeatB31tB1Flg "" UBYTE ME11_CM_boolean_flg 0 0 0 1 ECU_ADDRESS 0x0000 /* @ECU_Address@SOMCtl_bBatHeatB31tB1Flg@ */ /end MEASUREMENT
/begin MEASUREMENT ACCtl_stRecQkChargeCoolingEna "" UBYTE ME11_CM_boolean_null 0 0 0 1 ECU_ADDRESS 0x0000 /* @ECU_Address@ACCtl_stRecQkChargeCoolingEna@ */ /end MEASUREMENT
/begin MEASUREMENT ACCtl_stRecPCUTempEna "" UBYTE ME11_CM_boolean_null 0 0 0 1 ECU_ADDRESS 0x0000 /* @ECU_Address@ACCtl_stRecPCUTempEna@ */ /end MEASUREMENT
/begin MEASUREMENT ACCtl_stCabinHeatingEn "" UBYTE ME11_CM_boolean_null 0 0 0 1 ECU_ADDRESS 0x0000 /* @ECU_Address@ACCtl_stCabinHeatingEn@ */ /end MEASUREMENT
/begin MEASUREMENT ACCtl_stRecOut "" UBYTE ME11_CM_boolean_null 0 0 0 1 ECU_ADDRESS 0x0000 /* @ECU_Address@ACCtl_stRecOut@ */ /end MEASUREMENT
/begin MEASUREMENT ACTCrl_bEnvCOMPLmt "" UBYTE ME11_CM_boolean_flg 0 0 0 1 ECU_ADDRESS 0x0000 /* @ECU_Address@ACTCrl_bEnvCOMPLmt@ */ /end MEASUREMENT
/begin MEASUREMENT ACTCtl_bOCOLmtFlg "" UBYTE ME11_CM_boolean_flg 0 0 0 1 ECU_ADDRESS 0x0000 /* @ECU_Address@ACTCtl_bOCOLmtFlg@ */ /end MEASUREMENT
/begin MEASUREMENT ACTCtl_bPressProtectFlg "" UBYTE ME11_CM_boolean_flg 0 0 0 1 ECU_ADDRESS 0x0000 /* @ECU_Address@ACTCtl_bPressProtectFlg@ */ /end MEASUREMENT
/begin MEASUREMENT ACTCtl_bPressRateFlg "" UBYTE ME11_CM_boolean_flg 0 0 0 1 ECU_ADDRESS 0x0000 /* @ECU_Address@ACTCtl_bPressRateFlg@ */ /end MEASUREMENT
/begin MEASUREMENT ACTCtl_bCOMPRealFault "" UBYTE ME11_CM_boolean_flg 0 0 0 1 ECU_ADDRESS 0x0000 /* @ECU_Address@ACTCtl_bCOMPRealFault@ */ /end MEASUREMENT
/begin MEASUREMENT ACTCtl_bACCMCtlEnb "" UBYTE ME11_CM_boolean_flg 0 0 0 1 ECU_ADDRESS 0x0000 /* @ECU_Address@ACTCtl_bACCMCtlEnb@ */ /end MEASUREMENT
/begin MEASUREMENT ACTCtl_bCOMPFaultClc "" UBYTE ME11_CM_boolean_flg 0 0 0 1 ECU_ADDRESS 0x0000 /* @ECU_Address@ACTCtl_bCOMPFaultClc@ */ /end MEASUREMENT
/begin MEASUREMENT ACTCtl_bMCVlearnFlg "" UBYTE ME11_CM_boolean_flg 0 0 0 1 ECU_ADDRESS 0x0000 /* @ECU_Address@ACTCtl_bMCVlearnFlg@ */ /end MEASUREMENT
/begin MEASUREMENT ACTCtl_bBCVlearnFlg "" UBYTE ME11_CM_boolean_flg 0 0 0 1 ECU_ADDRESS 0x0000 /* @ECU_Address@ACTCtl_bBCVlearnFlg@ */ /end MEASUREMENT
/begin MEASUREMENT ACTCtl_bAEXVInitFinishFlg "" UBYTE ME11_CM_boolean_flg 0 0 0 1 ECU_ADDRESS 0x0000 /* @ECU_Address@ACTCtl_bAEXVInitFinishFlg@ */ /end MEASUREMENT
/begin MEASUREMENT ACTCtl_bAEXVDvtFlg "" UBYTE ME11_CM_boolean_flg 0 0 0 1 ECU_ADDRESS 0x0000 /* @ECU_Address@ACTCtl_bAEXVDvtFlg@ */ /end MEASUREMENT
/begin MEASUREMENT ACTCtl_bBEXVInitFinishFlg "" UBYTE ME11_CM_boolean_flg 0 0 0 1 ECU_ADDRESS 0x0000 /* @ECU_Address@ACTCtl_bBEXVInitFinishFlg@ */ /end MEASUREMENT
/begin MEASUREMENT ACTCtl_bBEXVDvtFlg "" UBYTE ME11_CM_boolean_flg 0 0 0 1 ECU_ADDRESS 0x0000 /* @ECU_Address@ACTCtl_bBEXVDvtFlg@ */ /end MEASUREMENT
/begin MEASUREMENT ACTCtl_bHPEXVDvtFlg "" UBYTE ME11_CM_boolean_flg 0 0 0 1 ECU_ADDRESS 0x0000 /* @ECU_Address@ACTCtl_bHPEXVDvtFlg@ */ /end MEASUREMENT
/begin MEASUREMENT ACTCtl_bHPEXVInitFinishFlg "" UBYTE ME11_CM_boolean_flg 0 0 0 1 ECU_ADDRESS 0x0000 /* @ECU_Address@ACTCtl_bHPEXVInitFinishFlg@ */ /end MEASUREMENT
/begin MEASUREMENT SOMCtl_bCalTempBatHeatFlg "" UBYTE ME11_CM_boolean_flg 0 0 0 1 ECU_ADDRESS 0x0000 /* @ECU_Address@SOMCtl_bCalTempBatHeatFlg@ */ /end MEASUREMENT
/begin MEASUREMENT SOMCtl_bBatHStrFlg "" UBYTE ME11_CM_boolean_flg 0 0 0 1 ECU_ADDRESS 0x0000 /* @ECU_Address@SOMCtl_bBatHStrFlg@ */ /end MEASUREMENT
/begin MEASUREMENT HMICtl_bACDefrost "" UBYTE ME11_CM_boolean_flg 0 0 0 1 ECU_ADDRESS 0x0000 /* @ECU_Address@HMICtl_bACDefrost@ */ /end MEASUREMENT
/begin MEASUREMENT HMICtl_bACAuto "" UBYTE ME11_CM_boolean_flg 0 0 0 1 ECU_ADDRESS 0x0000 /* @ECU_Address@HMICtl_bACAuto@ */ /end MEASUREMENT
/begin MEASUREMENT HMICtl_bACOnOff "" UBYTE ME11_CM_boolean_flg 0 0 0 1 ECU_ADDRESS 0x0000 /* @ECU_Address@HMICtl_bACOnOff@ */ /end MEASUREMENT
/begin MEASUREMENT ACTCtl_bCOMPEnbDelay "" UBYTE ME11_CM_boolean_flg 0 0 0 1 ECU_ADDRESS 0x0000 /* @ECU_Address@ACTCtl_bCOMPEnbDelay@ */ /end MEASUREMENT
/begin MEASUREMENT ACCtl_stACPTCHeated "" UBYTE ME11_CM_boolean_null 0 0 0 1 ECU_ADDRESS 0x0000 /* @ECU_Address@ACCtl_stACPTCHeated@ */ /end MEASUREMENT
/begin MEASUREMENT ACCtl_stEvaCooledFlag "" UBYTE ME11_CM_boolean_null 0 0 0 1 ECU_ADDRESS 0x0000 /* @ECU_Address@ACCtl_stEvaCooledFlag@ */ /end MEASUREMENT
/begin MEASUREMENT ACCtl_stRecAQSEna "" UBYTE ME11_CM_boolean_null 0 0 0 1 ECU_ADDRESS 0x0000 /* @ECU_Address@ACCtl_stRecAQSEna@ */ /end MEASUREMENT
/begin MEASUREMENT SOMCtl_eCabinMode "" UBYTE ME11_CM_CabinMode_null 0 0 0 7 ECU_ADDRESS 0x0000 /* @ECU_Address@SOMCtl_eCabinMode@ */ /end MEASUREMENT
/begin MEASUREMENT SOMCtl_eBatMode "" UBYTE ME11_CM_BatModes_null 0 0 0 6 ECU_ADDRESS 0x0000 /* @ECU_Address@SOMCtl_eBatMode@ */ /end MEASUREMENT
/begin MEASUREMENT ACCtl_pwrHeatingFeed "" UWORD ME11_CM_uint16_null 0 0 0 65535 ECU_ADDRESS 0x0000 /* @ECU_Address@ACCtl_pwrHeatingFeed@ */ /end MEASUREMENT
/begin COMPU_METHOD ME11_CM_uint8_null "Q = V" RAT_FUNC "%3.0" "null" COEFFS 0 1 0 0 0 1 /end COMPU_METHOD
/begin COMPU_METHOD ME11_CM_single_C "Q = V" RAT_FUNC "%8.6" "C" COEFFS 0 1 0 0 0 1 /end COMPU_METHOD
/begin COMPU_METHOD ME11_CM_single_Mpa "Q = V" RAT_FUNC "%8.6" "Mpa" COEFFS 0 1 0 0 0 1 /end COMPU_METHOD
/begin COMPU_METHOD ME11_CM_single_mv "Q = V" RAT_FUNC "%8.6" "mv" COEFFS 0 1 0 0 0 1 /end COMPU_METHOD
/begin COMPU_METHOD ME11_CM_single_percent_ "Q = V" RAT_FUNC "%8.6" "%" COEFFS 0 1 0 0 0 1 /end COMPU_METHOD
/begin COMPU_METHOD ME11_CM_uint8_percent_ "Q = V" RAT_FUNC "%3.0" "%" COEFFS 0 1 0 0 0 1 /end COMPU_METHOD
/begin COMPU_METHOD ME11_CM_uint16_w_per_m_2 "Q = V" RAT_FUNC "%5.0" "w/m^2" COEFFS 0 1 0 0 0 1 /end COMPU_METHOD
/begin COMPU_METHOD ME11_CM_single_km_per_h "Q = V" RAT_FUNC "%8.6" "km/h" COEFFS 0 1 0 0 0 1 /end COMPU_METHOD
/begin COMPU_METHOD ME11_CM_single_kw "Q = V" RAT_FUNC "%8.6" "kw" COEFFS 0 1 0 0 0 1 /end COMPU_METHOD
/begin COMPU_METHOD ME11_CM_single_rpm "Q = V" RAT_FUNC "%8.6" "rpm" COEFFS 0 1 0 0 0 1 /end COMPU_METHOD
/begin COMPU_METHOD ME11_CM_uint8_L "Q = V" RAT_FUNC "%3.0" "L" COEFFS 0 1 0 0 0 1 /end COMPU_METHOD
/begin COMPU_METHOD ME11_CM_single_mpa "Q = V" RAT_FUNC "%8.6" "mpa" COEFFS 0 1 0 0 0 1 /end COMPU_METHOD
/begin COMPU_METHOD ME11_CM_single_null "Q = V" RAT_FUNC "%8.6" "null" COEFFS 0 1 0 0 0 1 /end COMPU_METHOD
/begin COMPU_METHOD ME11_CM_uint16_w "Q = V" RAT_FUNC "%5.0" "w" COEFFS 0 1 0 0 0 1 /end COMPU_METHOD
/begin COMPU_METHOD ME11_CM_single_s "Q = V" RAT_FUNC "%8.6" "s" COEFFS 0 1 0 0 0 1 /end COMPU_METHOD
/begin COMPU_METHOD ME11_CM_single_min "Q = V" RAT_FUNC "%8.6" "min" COEFFS 0 1 0 0 0 1 /end COMPU_METHOD
/begin COMPU_METHOD ME11_CM_single_C_per_0_1s "Q = V" RAT_FUNC "%8.6" "C/0.1s" COEFFS 0 1 0 0 0 1 /end COMPU_METHOD
/begin COMPU_METHOD ME11_CM_single_per_ "Q = V" RAT_FUNC "%8.6" "/" COEFFS 0 1 0 0 0 1 /end COMPU_METHOD
/begin COMPU_METHOD ME11_CM_uint16_s "Q = V" RAT_FUNC "%5.0" "s" COEFFS 0 1 0 0 0 1 /end COMPU_METHOD
/begin COMPU_METHOD ME11_CM_uint16_per_ "Q = V" RAT_FUNC "%5.0" "/" COEFFS 0 1 0 0 0 1 /end COMPU_METHOD
/begin COMPU_METHOD ME11_CM_BatModes_null "Enumerated data type: BatModes" TAB_VERB "%0.6" "null" COMPU_TAB_REF VTAB_FOR_ME11_CM_BatModes_null /end COMPU_METHOD
/begin COMPU_VTAB VTAB_FOR_ME11_CM_BatModes_null "Enumerated data type: BatModes" TAB_VERB 7 0 "Off" 1 "Cool" 2 "ThermalHeat" 3 "MotorHeatBat" 4 "Balance" 5 "BatLTR" 6 "BatHeat" /end COMPU_VTAB
/begin COMPU_METHOD ME11_CM_CabinMode_null "Enumerated data type: CabinMode" TAB_VERB "%0.6" "null" COMPU_TAB_REF VTAB_FOR_ME11_CM_CabinMode_null /end COMPU_METHOD
/begin COMPU_VTAB VTAB_FOR_ME11_CM_CabinMode_null "Enumerated data type: CabinMode" TAB_VERB 7 0 "CabinMode_MD_Off" 1 "CabinMode_MD1_CLM" 2 "CabinMode_MD2_DHMD1" 3 "CabinMode_MD3_DHMD2" 4 "CabinMode_MD4_HP" 6 "CabinMode_VENT" 7 "CabinMode_STANDBY" /end COMPU_VTAB
/begin COMPU_METHOD ME11_CM_boolean_flg "Q = V" RAT_FUNC "%1.0" "flg" COEFFS 0 1 0 0 0 1 /end COMPU_METHOD
/begin COMPU_METHOD ME11_CM_boolean_rpm "Q = V" RAT_FUNC "%1.0" "rpm" COEFFS 0 1 0 0 0 1 /end COMPU_METHOD
/begin COMPU_METHOD ME11_CM_boolean_per_ "Q = V" RAT_FUNC "%1.0" "/" COEFFS 0 1 0 0 0 1 /end COMPU_METHOD
/begin COMPU_METHOD ME11_CM_boolean_null "Q = V" RAT_FUNC "%1.0" "null" COEFFS 0 1 0 0 0 1 /end COMPU_METHOD
/begin COMPU_METHOD ME11_CM_uint8_flg "Q = V" RAT_FUNC "%3.0" "flg" COEFFS 0 1 0 0 0 1 /end COMPU_METHOD
/begin COMPU_METHOD ME11_CM_uint8_per_ "Q = V" RAT_FUNC "%3.0" "/" COEFFS 0 1 0 0 0 1 /end COMPU_METHOD
/begin COMPU_METHOD ME11_CM_uint8_s "Q = V" RAT_FUNC "%3.0" "s" COEFFS 0 1 0 0 0 1 /end COMPU_METHOD
/begin COMPU_METHOD ME11_CM_uint8_rpm "Q = V" RAT_FUNC "%3.0" "rpm" COEFFS 0 1 0 0 0 1 /end COMPU_METHOD
/begin COMPU_METHOD ME11_CM_uint16_null "Q = V" RAT_FUNC "%5.0" "null" COEFFS 0 1 0 0 0 1 /end COMPU_METHOD
/begin COMPU_METHOD ME11_CM_uint16_flg "Q = V" RAT_FUNC "%5.0" "flg" COEFFS 0 1 0 0 0 1 /end COMPU_METHOD
/begin GROUP S35_RecircModeEnaCalcu "ME11/ME11_TMS/ACC/AutoAc/AutoACFun/RecircModeEnaCalcu"
 /begin SUB_GROUP S43_ACCtlRecForForceDefog1 S43_ACCtlRecForSummerOrWinterOrNormalDefog1 S43_ACCtlRecForVent1 S43_Mannual S43_RecACHotStart S43_RecAQS S43_RecForceChange S43_RecForceDefog S43_RecNormalDefog S43_RecPCUTemp S43_RecPTCDvt S43_RecQkChargeCooling S43_RecRemoteForce S43_RecSummerCond S43_RecTargetOutTemp S43_RecVent S43_RecWinterCond /end SUB_GROUP
 /begin REF_CHARACTERISTIC cal_ACCtlRecLevelForACHotStart cal_ACCtlRecLevelForAQS cal_ACCtlRecLevelForForceChange cal_ACCtlRecLevelForForceDefog cal_ACCtlRecLevelForManual cal_ACCtlRecLevelForNormalDefog cal_ACCtlRecLevelForPCUTemp cal_ACCtlRecLevelForPTCDvt cal_ACCtlRecLevelForQkChargeCooling cal_ACCtlRecLevelForRemoteAC cal_ACCtlRecLevelForSummer cal_ACCtlRecLevelForTargetOutTemp cal_ACCtlRecLevelForTempLow cal_ACCtlRecLevelForVent cal_ACCtlRecLevelForWinter cal_CO2RecircRatio /end REF_CHARACTERISTIC
/end GROUP
/begin GROUP S35_RecircModeOut "ME11/ME11_TMS/ACC/AutoAc/AutoACFun/RecircModeOut" /begin SUB_GROUP S44_ACCtlRecForForceDefog S44_Subsystem13 /end SUB_GROUP /begin REF_MEASUREMENT ACCtl_IntakeRatio ACCtl_stRecOut /end REF_MEASUREMENT /end GROUP
/begin GROUP S37_DesiredVentTempCal_FIX "ME11/ME11_TMS/ACC/AutoAc/EvaporatorAndPTCAimTempCal_FIX/DesiredVentTempCal_FIX"
 /begin SUB_GROUP S171_CalFrontVentDesireTemp S171_CalLeftVentDesireTemp S171_CalRightVentDesireTemp S171_DVTWeightCal /end SUB_GROUP
/end GROUP
/begin GROUP S37_DuctActualTemperature "ME11/ME11_TMS/ACC/AutoAc/EvaporatorAndPTCAimTempCal_FIX/DuctActualTemperature"
 /begin SUB_GROUP S172_CalDrDuctActualTemperature S172_CalPsDuctActualTemperature S172_LeftMixDoorPI S172_PIDEnabLeCheck_ S172_RightMixDoorPI /end SUB_GROUP
 /begin REF_CHARACTERISTIC cal_DrDuctSenFailDeflt cal_PsDuctSensorFailDeflt /end REF_CHARACTERISTIC
 /begin REF_MEASUREMENT ACCtl_tLeftDuct ACCtl_tRightDuct /end REF_MEASUREMENT
/end GROUP
/begin GROUP S37_InventedCabin "ME11/ME11_TMS/ACC/AutoAc/EvaporatorAndPTCAimTempCal_FIX/InventedCabin" /begin REF_CHARACTERISTIC cal_CabinTCorSelect cal_CabinTempDuctUpStepCor_CUR /end REF_CHARACTERISTIC /begin REF_MEASUREMENT GlbDa_tCabinInvent /end REF_MEASUREMENT /end GROUP
/begin GROUP S37_TargetEvaporatorTempGov "ME11/ME11_TMS/ACC/AutoAc/EvaporatorAndPTCAimTempCal_FIX/TargetEvaporatorTempGov"
 /begin SUB_GROUP S175_CalAirCondDrEvapAimTemp S175_CalAirCondPsEvapAimTemp S175_EvapTargetLowest /end SUB_GROUP
 /begin REF_CHARACTERISTIC cal_ErrAmbTDvtForEvaLL cal_ErrAmbTDvtForEvaUL cal_EvaDesLLMax cal_TevapLoStepMin cal_TevapLoTime /end REF_CHARACTERISTIC
 /begin REF_MEASUREMENT ACCtl_stEvaCooledFlag ACCtl_tSetPointEvap Eva_CloseCond1 Eva_CooledCond1 Eva_CoolingCond1 Eva_CoolingCond2 /end REF_MEASUREMENT
/end GROUP
/begin GROUP S37_TargetPTCTempGov "ME11/ME11_TMS/ACC/AutoAc/EvaporatorAndPTCAimTempCal_FIX/TargetPTCTempGov" /begin SUB_GROUP S176_CalPTCAimTemp_LeftDes S176_CalPTCAimTemp_RightDes /end SUB_GROUP
 /begin REF_CHARACTERISTIC cal_CabinSetPTCSwitch cal_ErrAmbTDvtForPtcLL cal_ErrAmbTDvtForPtcUL cal_SetPtcDesCoff cal_SetPtcDesTempMax_MAP cal_SetPtcDesTempMin cal_TevapUpStepMin cal_TevapUpTime /end REF_CHARACTERISTIC
 /begin REF_MEASUREMENT ACCCtl_sSetPtcDesTempMax ACCtl_stACPTCHeated ACCtl_tSetPointPTC ACPTC_HeatedCond1 ACPTC_HeatingCond1 ACPTC_HeatingCond2 ACPtc_CloseCond1 /end REF_MEASUREMENT
/end GROUP
/begin GROUP S38_CalDrMixDoorDesRatio "ME11/ME11_TMS/ACC/AutoAc/MixDoorOpenCloseDesCal/CalDrMixDoorDesRatio"
 /begin SUB_GROUP S383_CalAirCondMixVlvLeftTrgTemp S383_CalDrMixDoorDesRatio_FIXPID /end SUB_GROUP
 /begin REF_CHARACTERISTIC cal_EvaEnable cal_FixPIDSecletFlag cal_PtcEnable /end REF_CHARACTERISTIC
/end GROUP
/begin GROUP S38_CalPsMixDoorDesRatio "ME11/ME11_TMS/ACC/AutoAc/MixDoorOpenCloseDesCal/CalPsMixDoorDesRatio"
 /begin SUB_GROUP S384_CalAirCondMixVlvRightTrgTemp S384_CalPsMixDoorDesRatio /end SUB_GROUP
 /begin REF_CHARACTERISTIC cal_EvaEnable cal_FixPIDSecletFlag cal_PtcEnable /end REF_CHARACTERISTIC
/end GROUP
/begin GROUP S38_CoTS_rSetMixDoor "ME11/ME11_TMS/ACC/AutoAc/MixDoorOpenCloseDesCal/CoTS_rSetMixDoor" /begin REF_CHARACTERISTIC ACDefog /end REF_CHARACTERISTIC /begin REF_MEASUREMENT ThCo_rSetLeftMixDoor ThCo_rSetRightMixDoor /end REF_MEASUREMENT /end GROUP
/begin GROUP S444_ModeOnOrOff "ME11/ME11_TMS/Actuator/COMP/ACCMEnble/ModeOnOrOff" /begin SUB_GROUP S456_ModeJudge /end SUB_GROUP /end GROUP
/begin GROUP S444_Override "ME11/ME11_TMS/Actuator/COMP/ACCMEnble/Override" /begin REF_CHARACTERISTIC cal_ACCMEnbData cal_ACCMEnbDataEnb /end REF_CHARACTERISTIC /begin REF_MEASUREMENT ACTCtl_bACCMCtlEnb /end REF_MEASUREMENT /end GROUP
/begin GROUP S445_IWin_Controller "ME11/ME11_TMS/Actuator/COMP/ACCMPICtrl/IWin_Controller" /begin SUB_GROUP S478_ISum /end SUB_GROUP /begin REF_MEASUREMENT ACTCtl_sACCMI_Sum /end REF_MEASUREMENT /end GROUP
/begin GROUP S445_PI_Controller "ME11/ME11_TMS/Actuator/COMP/ACCMPICtrl/PI_Controller" /begin REF_MEASUREMENT ACTCtl_bCOMPIFreeFlag ACTCtl_sACCMPIVal /end REF_MEASUREMENT /end GROUP
/begin GROUP S445_pWin_Controller "ME11/ME11_TMS/Actuator/COMP/ACCMPICtrl/pWin_Controller" /begin REF_MEASUREMENT ACTCtl_sACCMP_Cor /end REF_MEASUREMENT /end GROUP
/begin GROUP S446_ACCMFault "ME11/ME11_TMS/Actuator/COMP/COMPFaultHandling/ACCMFault" /begin REF_MEASUREMENT ACTCtl_bCOMPFaultClc ACTCtl_bCOMPRealFault /end REF_MEASUREMENT /end GROUP
/begin GROUP S446_EnvLmt "ME11/ME11_TMS/Actuator/COMP/COMPFaultHandling/EnvLmt"
 /begin REF_CHARACTERISTIC cal_HeatCOMPEnvTempLmtOff cal_HeatCOMPEnvTempLmtOn cal_NmCOMPEnvTempLmtOff cal_NmCOMPEnvTempLmtOn /end REF_CHARACTERISTIC
 /begin REF_MEASUREMENT ACTCrl_bEnvCOMPLmt /end REF_MEASUREMENT
/end GROUP
/begin GROUP S446_OCOLmt "ME11/ME11_TMS/Actuator/COMP/COMPFaultHandling/OCOLmt" /begin REF_CHARACTERISTIC cal_HPAndLPDiffMaxVal /end REF_CHARACTERISTIC /begin REF_MEASUREMENT ACTCtl_bCOMPEnbDelay ACTCtl_bOCOLmtFlg /end REF_MEASUREMENT /end GROUP
/begin GROUP S446_PressRateProtect "ME11/ME11_TMS/Actuator/COMP/COMPFaultHandling/PressRateProtect"
 /begin SUB_GROUP S502_Flg1Cal S502_Flg1Cal1 S502_Flg1Cal2 S502_Flg2Cal S502_Flg2Cal1 S502_Flg3Cal S502_Flg3Cal1 S502_FlgCal S502_Other /end SUB_GROUP
 /begin REF_MEASUREMENT ACSen_sPressRateVal ACTCtl_bPressProtectFlg ACTCtl_bPressRateFlg /end REF_MEASUREMENT
/end GROUP
/begin GROUP S447_COMP_AT_Noise_Lmt "ME11/ME11_TMS/Actuator/COMP/COMPLimitSpeed/COMP_AT_Noise_Lmt"
 /begin REF_CHARACTERISTIC cal_AccmSpdLimByHiPressDownSide_CUR cal_AccmSpdLimByHiPressLevelCalcu_CUR cal_AccmSpdLimByHiPressUpSide_CUR cal_AccmSpdLimByLoPressDownSide_CUR cal_AccmSpdLimByLoPressLevelCalcu_CUR cal_AccmSpdLimByLoPressUpSide_CUR cal_COMPATNoiseSpdLmtHVS_CUR cal_COMPATNoiseSpdLmt_MAP cal_COMPCoolLowSpd cal_PCULimBTMAccmSpdDes_CUR cal_PCULimBTMAndCabinAccmSpdDes_CUR cal_PCULimCabinAccmSpdDes_CUR /end REF_CHARACTERISTIC
 /begin REF_MEASUREMENT ACTCtl_sCOMPATNoiseBlwAndAccmSpd ACTCtl_sCOMPATNoiseLmtHVSSpd ACTCtl_sCOMPATNoiseLmtSpd ACTCtl_sCOMPCoolLmtSpd ACTCtl_sCOMPHPLmtSpd ACTCtl_sCOMPLPLmtSpd ACTCtl_sCOMPPCULimSpd /end REF_MEASUREMENT
/end GROUP
/begin GROUP S447_COMP_Cool_Speed_Lmt "ME11/ME11_TMS/Actuator/COMP/COMPLimitSpeed/COMP_Cool_Speed_Lmt"
 /begin REF_CHARACTERISTIC cal_COMPBatMaxSpdLmt cal_COMPCabinCoolMaxSpdLmt cal_COMPEnvSpdLmt1_CUR cal_COMPEnvSpdLmt2_CUR cal_COMPEnvSpdLmt3_CUR cal_COMPFanLevelLmt_CUR /end REF_CHARACTERISTIC
 /begin REF_MEASUREMENT ACTCtl_sCOMPEnvLmtSpd ACTCtl_sCOMPFanlevelLmtSpd /end REF_MEASUREMENT
/end GROUP
/begin GROUP S448_OpenOrCloseFilter "ME11/ME11_TMS/Actuator/COMP/COMPSpeedLmt/OpenOrCloseFilter" /begin SUB_GROUP S565_Deal /end SUB_GROUP
 /begin REF_CHARACTERISTIC cal_ACCMCtlDownlmt cal_ACCMCtlUplmt cal_OpenCtrlCOMPDownlmt cal_OpenCtrlCOMPUplmt /end REF_CHARACTERISTIC
/end GROUP
/begin GROUP S448_Override "ME11/ME11_TMS/Actuator/COMP/COMPSpeedLmt/Override" /begin REF_CHARACTERISTIC cal_ACCMCtrlSpdData cal_ACCMCtrlSpdDataEnb /end REF_CHARACTERISTIC /end GROUP
/begin GROUP S448_Spd "ME11/ME11_TMS/Actuator/COMP/COMPSpeedLmt/Spd" /begin REF_CHARACTERISTIC cal_COMPExhTDownSpd /end REF_CHARACTERISTIC /begin REF_MEASUREMENT ACTCtl_sCOMPDownSpd /end REF_MEASUREMENT /end GROUP
/begin GROUP S451_ACCMCtrlA "ME11/ME11_TMS/Actuator/COMP/ParameterCal/ACCMCtrlA" /begin SUB_GROUP S580_Target_computation S580_relay /end SUB_GROUP
 /begin REF_CHARACTERISTIC cal_ACCMCtrlA1FF_CUR cal_ACCMCtrlA2FF_MAP cal_ACCMCtrlACct cal_ACCMCtrlADeadzone cal_ACCMCtrlADlyTime cal_ACCMCtrlAKi_CUR cal_ACCMCtrlAKp_CUR cal_ACCMCtrlAPIMax cal_ACCMCtrlAPIMin cal_ACCMCtrlARunTime cal_PTCAuxHeatPwrLmt_MAP cal_PTCOffPowerVal cal_PTCOnReqPower_CUR /end REF_CHARACTERISTIC
 /begin REF_MEASUREMENT ACTCtl_sCOMPCtrlAClsFF ACTCtl_sPTCAuxHeatPwr ACTCtl_tCtrlADiff /end REF_MEASUREMENT
/end GROUP
/begin GROUP S451_ACCMCtrlB "ME11/ME11_TMS/Actuator/COMP/ParameterCal/ACCMCtrlB"
 /begin REF_CHARACTERISTIC cal_ACCMCtrlBDeadzone cal_ACCMCtrlBDlyTime cal_ACCMCtrlBFF_CUR cal_ACCMCtrlBKi_CUR cal_ACCMCtrlBKp_CUR cal_ACCMCtrlBPIMax cal_ACCMCtrlBPIMin cal_ACCMCtrlBRunTime cal_BatCoolInletTrgTemp cal_BatCoolTrgFilter /end REF_CHARACTERISTIC
 /begin REF_MEASUREMENT ACTCtl_tCtrlBDiff /end REF_MEASUREMENT
/end GROUP
/begin GROUP S451_ACCMCtrlC "ME11/ME11_TMS/Actuator/COMP/ParameterCal/ACCMCtrlC"
 /begin REF_CHARACTERISTIC cal_ACCMCtrlACct cal_ACCMCtrlC1FF_CUR cal_ACCMCtrlC2FF_CUR cal_ACCMCtrlCDeadzone cal_ACCMCtrlCDlyTime cal_ACCMCtrlCKi_CUR cal_ACCMCtrlCKp_CUR cal_ACCMCtrlCPIMax cal_ACCMCtrlCPIMin cal_ACCMCtrlCRunTime /end REF_CHARACTERISTIC
 /begin REF_MEASUREMENT ACTCtl_tCtrlCDiff /end REF_MEASUREMENT
/end GROUP
/begin GROUP S451_ACCMCtrlD "ME11/ME11_TMS/Actuator/COMP/ParameterCal/ACCMCtrlD"
 /begin REF_CHARACTERISTIC cal_ACCMCtrlACct cal_ACCMCtrlD1FF_CUR cal_ACCMCtrlD2FF_CUR cal_ACCMCtrlDDeadzone cal_ACCMCtrlDDlyTime cal_ACCMCtrlDKi_CUR cal_ACCMCtrlDKp_CUR cal_ACCMCtrlDPIMax_CUR cal_ACCMCtrlDPIMin cal_ACCMCtrlDRunTime cal_ACCMCtrlDTrg_CUR /end REF_CHARACTERISTIC
/end GROUP
/begin GROUP S451_ACCMCtrlE "ME11/ME11_TMS/Actuator/COMP/ParameterCal/ACCMCtrlE"
 /begin REF_CHARACTERISTIC cal_ACCMCtrlACct cal_ACCMCtrlE1FF_CUR cal_ACCMCtrlE2FF_CUR cal_ACCMCtrlEDeadzone cal_ACCMCtrlEDlyTime cal_ACCMCtrlEKi_CUR cal_ACCMCtrlEKp_CUR cal_ACCMCtrlEPIMax cal_ACCMCtrlEPIMin cal_ACCMCtrlERunTime cal_ACCMCtrlETrgTemp cal_BatCoolTrgFilter /end REF_CHARACTERISTIC
/end GROUP
/begin GROUP S451_ACCMCtrlF "ME11/ME11_TMS/Actuator/COMP/ParameterCal/ACCMCtrlF" /begin SUB_GROUP S585_relay /end SUB_GROUP
 /begin REF_CHARACTERISTIC cal_ACCMCtrlACct cal_ACCMCtrlF1FF_CUR cal_ACCMCtrlF2FF_CUR cal_ACCMCtrlFDeadzone cal_ACCMCtrlFDlyTime cal_ACCMCtrlFKi_CUR cal_ACCMCtrlFKp_CUR cal_ACCMCtrlFPIMax_CUR cal_ACCMCtrlFPIMin cal_ACCMCtrlFRunTime cal_CtrlFPTCAuxHeatPwrLmt_MAP cal_CtrlFPTCOffPowerVal cal_CtrlFPTCOnReqPower_CUR /end REF_CHARACTERISTIC
 /begin REF_MEASUREMENT ACTCtl_sCtrlFPTCAuxHeatPwr /end REF_MEASUREMENT
/end GROUP
/begin GROUP S451_ACCMCtrlH "ME11/ME11_TMS/Actuator/COMP/ParameterCal/ACCMCtrlH"
 /begin REF_CHARACTERISTIC cal_ACCMCtrlH1FF_CUR cal_ACCMCtrlH2FF_CUR cal_ACCMCtrlHCct cal_ACCMCtrlHDeadzone cal_ACCMCtrlHDlyTime cal_ACCMCtrlHKi_CUR cal_ACCMCtrlHKp_CUR cal_ACCMCtrlHPIMax cal_ACCMCtrlHPIMin cal_ACCMCtrlHRunTime cal_BatCoolInletTrgTemp /end REF_CHARACTERISTIC
 /begin REF_MEASUREMENT ACTCtl_sDCoolBatTempDiff ACTCtl_sDCoolCabinTempDiff /end REF_MEASUREMENT
/end GROUP
/begin GROUP S635_MUL "ME11/ME11_TMS/Actuator/CWV/C3WV//MCV/MUL"
 /begin SUB_GROUP S639_FallInBetweenT1AndT2 S639_HeatTemp S639_MinTempLessThanT1 /end SUB_GROUP
 /begin REF_CHARACTERISTIC cal_BMSInletTempHighOffMCV cal_BMSInletTempLowOnMCV cal_C3WVExhPosVal /end REF_CHARACTERISTIC
/end GROUP
/begin GROUP S635_selflearning "ME11/ME11_TMS/Actuator/CWV/C3WV//MCV/selflearning" /begin SUB_GROUP S640_Override_C5WV /end SUB_GROUP /begin REF_CHARACTERISTIC cal_MCVFltStsDelayTime cal_MCVPosDiffDelayTime /end REF_CHARACTERISTIC /begin REF_MEASUREMENT ACTCtl_bMCVlearnFlg /end REF_MEASUREMENT /end GROUP
/begin GROUP S636_Position "ME11/ME11_TMS/Actuator/CWV/C5WV//BCV/Position" /begin REF_CHARACTERISTIC cal_BatModeTestCtrl cal_C5WVExhPosVal /end REF_CHARACTERISTIC /end GROUP
/begin GROUP S636_selflearning "ME11/ME11_TMS/Actuator/CWV/C5WV//BCV/selflearning" /begin SUB_GROUP S662_Override_C5WV /end SUB_GROUP /begin REF_CHARACTERISTIC cal_BCVFltStsDelayTime cal_BCVPosDiffDelayTime /end REF_CHARACTERISTIC /begin REF_MEASUREMENT ACTCtl_bBCVlearnFlg /end REF_MEASUREMENT /end GROUP
/begin GROUP S671_AEXVEnble "ME11/ME11_TMS/Actuator/EXV/AEXV/AEXVEnble" /begin SUB_GROUP S675_Override /end SUB_GROUP /begin REF_MEASUREMENT ACTCtl_sAEXVCtrlFF /end REF_MEASUREMENT /end GROUP
/begin GROUP S671_AEXVFault "ME11/ME11_TMS/Actuator/EXV/AEXV/AEXVFault" /begin REF_MEASUREMENT ACTCtl_bAEXVFaultFlg /end REF_MEASUREMENT /end GROUP
/begin GROUP S671_AEXVInit "ME11/ME11_TMS/Actuator/EXV/AEXV/AEXVInit" /begin SUB_GROUP S677_Override /end SUB_GROUP /begin REF_MEASUREMENT ACTCtl_bAEXVInitFinishFlg /end REF_MEASUREMENT /end GROUP
/begin GROUP S671_AEXVPICtrl "ME11/ME11_TMS/Actuator/EXV/AEXV/AEXVPICtrl"
 /begin SUB_GROUP S678_IWin_Controller S678_PI_Controller S678_pWin_Controller /end SUB_GROUP
 /begin REF_CHARACTERISTIC cal_AEXVCtlKi cal_AEXVCtlKisumMax cal_AEXVCtlKisumMin cal_AEXVCtlKp /end REF_CHARACTERISTIC
/end GROUP
/begin GROUP S671_AEXVPIParameter "ME11/ME11_TMS/Actuator/EXV/AEXV/AEXVPIParameter"
 /begin SUB_GROUP S679_AEXVCtrlB S679_AEXVCtrlC S679_AEXVCtrlD S679_AEXVCtrlDefault /end SUB_GROUP
/end GROUP
/begin GROUP S671_NegAndPosCheck_EXV "ME11/ME11_TMS/Actuator/EXV/AEXV/NegAndPosCheck_EXV" /begin REF_MEASUREMENT ACTCtl_bAEXVDvtFlg ACTCtl_sAEXVDvt /end REF_MEASUREMENT /end GROUP
/begin GROUP S671_pressureprotection "ME11/ME11_TMS/Actuator/EXV/AEXV/pressureprotection" /begin SUB_GROUP S681_OpenOrCloseAEXVPos S681_Override S681_StepLimit /end SUB_GROUP
 /begin REF_CHARACTERISTIC cal_AEXVClsEvapPrtTemp cal_AEXVClsValEvapPrt cal_AEXVClsValRunTimeEvapPrt cal_AEXVFltClsSpd cal_AEXVHighPressProhOn cal_AEXVLowPressProhOn cal_AEXVOpenDelayTimeEvapNOPrt cal_AEXVOpenEvapNOPrtTemp cal_AEXVOpenRunTimeEvapNOPrt cal_AEXVOpenValEvapNOPrt cal_AEXVOpenValveSpd /end REF_CHARACTERISTIC
 /begin REF_MEASUREMENT ACTCtl_eEvapProSts ACTCtl_sAEXVPos /end REF_MEASUREMENT
/end GROUP
/begin GROUP S672_BEXVFault "ME11/ME11_TMS/Actuator/EXV/BEXV/BEXVFault" /begin REF_MEASUREMENT ACTCtl_bBEXVFaultFlg /end REF_MEASUREMENT /end GROUP
/begin GROUP S672_BEXVInit "ME11/ME11_TMS/Actuator/EXV/BEXV/BEXVInit" /begin SUB_GROUP S747_Override /end SUB_GROUP /begin REF_MEASUREMENT ACTCtl_bBEXVInitFinishFlg /end REF_MEASUREMENT /end GROUP
/begin GROUP S672_BEXVPICtrl "ME11/ME11_TMS/Actuator/EXV/BEXV/BEXVPICtrl"
 /begin SUB_GROUP S748_IWin_Controller S748_PI_Controller S748_pWin_Controller /end SUB_GROUP
 /begin REF_CHARACTERISTIC cal_BEXVCtlKi cal_BEXVCtlKisumMax cal_BEXVCtlKisumMin cal_BEXVCtlKp /end REF_CHARACTERISTIC
/end GROUP
/begin GROUP S672_BEXVPIParameter "ME11/ME11_TMS/Actuator/EXV/BEXV/BEXVPIParameter" /begin SUB_GROUP S749_BEXVCtrlB S749_BEXVCtrlC /end SUB_GROUP /end GROUP
/begin GROUP S672_EXVEnble "ME11/ME11_TMS/Actuator/EXV/BEXV/EXVEnble" /begin SUB_GROUP S750_Override /end SUB_GROUP /begin REF_MEASUREMENT ACTCtl_sBEXVCtrlFF /end REF_MEASUREMENT /end GROUP
/begin GROUP S672_NegAndPosCheck_EXV "ME11/ME11_TMS/Actuator/EXV/BEXV/NegAndPosCheck_EXV" /begin REF_MEASUREMENT ACTCtl_bBEXVDvtFlg ACTCtl_sBEXVDvt /end REF_MEASUREMENT /end GROUP
/begin GROUP S672_pressure_protection "ME11/ME11_TMS/Actuator/EXV/BEXV/pressure-protection" /begin SUB_GROUP S752_Choose S752_OpenOrCloseControl /end SUB_GROUP
 /begin REF_CHARACTERISTIC cal_BEXVHighPressProhOn cal_BEXVLowPressProhOn cal_BEXVOpenValveSpd /end REF_CHARACTERISTIC
/end GROUP
/begin GROUP S673_Arbitration "ME11/ME11_TMS/Actuator/EXV/HPEXV/Arbitration" /begin SUB_GROUP S816_HPEXVLimit S816_Override S816_StepLimit /end SUB_GROUP /begin REF_CHARACTERISTIC cal_HPEXVStepLmtSw /end REF_CHARACTERISTIC /begin REF_MEASUREMENT ACTCtl_sHPEXVPos /end REF_MEASUREMENT /end GROUP
/begin GROUP S673_FFCal "ME11/ME11_TMS/Actuator/EXV/HPEXV/FFCal" /begin SUB_GROUP S817_Override /end SUB_GROUP /begin REF_MEASUREMENT ACTCtl_sHPEXVCtrlFF /end REF_MEASUREMENT /end GROUP
/begin GROUP S673_HPEXVFault "ME11/ME11_TMS/Actuator/EXV/HPEXV/HPEXVFault" /begin REF_MEASUREMENT ACTCtl_bHPEXVFaultFlg /end REF_MEASUREMENT /end GROUP
/begin GROUP S673_HPEXVPICtrl "ME11/ME11_TMS/Actuator/EXV/HPEXV/HPEXVPICtrl"
 /begin SUB_GROUP S819_IWin_Controller S819_PI_Controller S819_pWin_Controller /end SUB_GROUP
 /begin REF_CHARACTERISTIC cal_HPEXVCtlKi cal_HPEXVCtlKiDeadzoneNeg cal_HPEXVCtlKiDeadzonePos cal_HPEXVCtlKisumMax cal_HPEXVCtlKisumMin cal_HPEXVCtlKp cal_HPEXVCtlKpDeadzoneNeg cal_HPEXVCtlKpDeadzonePos /end REF_CHARACTERISTIC
/end GROUP
/begin GROUP S673_HPEXVParameterCal "ME11/ME11_TMS/Actuator/EXV/HPEXV/HPEXVParameterCal"
 /begin SUB_GROUP S820_HPEXVCtrlA S820_HPEXVCtrlC S820_HPEXVCtrlD S820_HPEXVCtrlE S820_PressLimit /end SUB_GROUP
 /begin REF_CHARACTERISTIC cal_HPEXVlowPressLmtTrg /end REF_CHARACTERISTIC
 /begin REF_MEASUREMENT ACTCtl_sHPEXVSetPoint /end REF_MEASUREMENT
/end GROUP
/begin GROUP S673_Init "ME11/ME11_TMS/Actuator/EXV/HPEXV/Init" /begin SUB_GROUP S821_Override /end SUB_GROUP /begin REF_MEASUREMENT ACTCtl_bHPEXVInitFinishFlg /end REF_MEASUREMENT /end GROUP
/begin GROUP S673_NegAndPosCheck_EXV "ME11/ME11_TMS/Actuator/EXV/HPEXV/NegAndPosCheck_EXV" /begin REF_MEASUREMENT ACTCtl_bHPEXVDvtFlg ACTCtl_sHPEXVDvt /end REF_MEASUREMENT /end GROUP
/begin GROUP S674_AvgCondDep "ME11/ME11_TMS/Actuator/EXV/SupercoolingOrSuperheat/AvgCondDep" /begin SUB_GROUP S893_Sensor_Filter /end SUB_GROUP /begin REF_CHARACTERISTIC cal_CondDepFilter /end REF_CHARACTERISTIC /begin REF_MEASUREMENT ACTCtl_sCondDepAvg /end REF_MEASUREMENT /end GROUP
/begin GROUP S674_AvgCondDep_Cool "ME11/ME11_TMS/Actuator/EXV/SupercoolingOrSuperheat/AvgCondDep_Cool" /begin SUB_GROUP S894_Sensor_Filter /end SUB_GROUP /begin REF_CHARACTERISTIC cal_SuperHeatFilter /end REF_CHARACTERISTIC /begin REF_MEASUREMENT ACTCtl_sCoolCondDepAvg /end REF_MEASUREMENT /end GROUP
/begin GROUP S674_EvapSuperHeat "ME11/ME11_TMS/Actuator/EXV/SupercoolingOrSuperheat/EvapSuperHeat" /begin SUB_GROUP S895_Sensor_Filter /end SUB_GROUP /begin REF_CHARACTERISTIC cal_SuperHeatFilter /end REF_CHARACTERISTIC /begin REF_MEASUREMENT ACTCtl_sEvapSuperHeatAvg /end REF_MEASUREMENT /end GROUP
/begin GROUP S674_EvapSuperHeat1 "ME11/ME11_TMS/Actuator/EXV/SupercoolingOrSuperheat/EvapSuperHeat1" /begin SUB_GROUP S896_Sensor_Filter /end SUB_GROUP /begin REF_CHARACTERISTIC cal_SuperHeatFilter /end REF_CHARACTERISTIC /begin REF_MEASUREMENT ACTCtl_sChiSuperHeatAvg /end REF_MEASUREMENT /end GROUP
/begin GROUP S674_ExhSuperHeat "ME11/ME11_TMS/Actuator/EXV/SupercoolingOrSuperheat/ExhSuperHeat" /begin SUB_GROUP S897_Sensor_Filter /end SUB_GROUP /begin REF_CHARACTERISTIC cal_ExhSuperHeatFilter /end REF_CHARACTERISTIC /begin REF_MEASUREMENT ACTCtl_sExhSuperHeatAvg /end REF_MEASUREMENT /end GROUP
/begin GROUP S674_SuperHeat "ME11/ME11_TMS/Actuator/EXV/SupercoolingOrSuperheat/SuperHeat" /begin SUB_GROUP S898_Sensor_Filter /end SUB_GROUP /begin REF_CHARACTERISTIC cal_SuperHeatFilter /end REF_CHARACTERISTIC /begin REF_MEASUREMENT ACTCtl_sSuperHeatAvg /end REF_MEASUREMENT /end GROUP
/begin GROUP S911_IPUTempJudge "ME11/ME11_TMS/Actuator/Fan/BatBalOrLTR/IPUTempJudge" /begin REF_CHARACTERISTIC cal_LTRIPUTempFanCtrl_1X cal_LTRIPUTempFanCtrl_1Y /end REF_CHARACTERISTIC /end GROUP
/begin GROUP S911_MotorTempJudge "ME11/ME11_TMS/Actuator/Fan/BatBalOrLTR/MotorTempJudge" /begin REF_CHARACTERISTIC cal_LTRFanCtrl_1X cal_LTRFanCtrl_1Y /end REF_CHARACTERISTIC /end GROUP
/begin GROUP S942_Override1 "ME11/ME11_TMS/Actuator/PTC/PTCEnable/Override1" /begin REF_CHARACTERISTIC cal_PTCEnableData cal_PTCEnableDataEnb /end REF_CHARACTERISTIC /begin REF_MEASUREMENT ACTCtl_sPTCEnable /end REF_MEASUREMENT /end GROUP
/begin GROUP S944_Override2 "ME11/ME11_TMS/Actuator/PTC/PTCRequestPwr/Override2" /begin REF_CHARACTERISTIC cal_PTCReqtPowerData cal_PTCReqtPowerDataEnb /end REF_CHARACTERISTIC /begin REF_MEASUREMENT ACTCtl_sPTCReqPower /end REF_MEASUREMENT /end GROUP
/begin GROUP S1019_Override_AcPmp "ME11/ME11_TMS/Actuator/PUMP/AcPMP/Override_AcPmp" /begin REF_CHARACTERISTIC cal_AcPMPSpdSetData cal_AcPMPSpdSetDataEnb /end REF_CHARACTERISTIC /begin REF_MEASUREMENT ACTCtl_eAcPMPSpdPerc /end REF_MEASUREMENT /end GROUP
/begin GROUP S1019_Override_AcPmpFault "ME11/ME11_TMS/Actuator/PUMP/AcPMP/Override_AcPmpFault" /begin REF_CHARACTERISTIC cal_AcPMPFaultFlgData cal_AcPMPFaultFlgDataEnb /end REF_CHARACTERISTIC /begin REF_MEASUREMENT ACTCtl_bAcPMPFaultFlg /end REF_MEASUREMENT /end GROUP
/begin GROUP S1020_Override_BatPmp "ME11/ME11_TMS/Actuator/PUMP/BatPMP/Override_BatPmp" /begin REF_CHARACTERISTIC cal_BatPMPSpdSetData cal_BatPMPSpdSetDataEnb /end REF_CHARACTERISTIC /end GROUP
/begin GROUP S1020_Override_BatPmp1 "ME11/ME11_TMS/Actuator/PUMP/BatPMP/Override_BatPmp1" /begin REF_CHARACTERISTIC cal_BatPMPFaultFlgData cal_BatPMPFaultFlgDataEnb /end REF_CHARACTERISTIC /begin REF_MEASUREMENT ACTCtl_bBatPMPFaultFlg /end REF_MEASUREMENT /end GROUP
/begin GROUP S1021_IGBTTempJudge "ME11/ME11_TMS/Actuator/PUMP/MotPMP/IGBTTempJudge" /begin REF_CHARACTERISTIC cal_LTRIGBTTempMotPMPCtrl_1X cal_LTRIGBTTempMotPMPCtrl_1Y /end REF_CHARACTERISTIC /end GROUP
/begin GROUP S1021_MotorTempJudge "ME11/ME11_TMS/Actuator/PUMP/MotPMP/MotorTempJudge"
 /begin REF_CHARACTERISTIC cal_LTRMotorTempMotPMPCtrl_1X cal_LTRMotorTempMotPMPCtrl_1Y /end REF_CHARACTERISTIC
/end GROUP
/begin GROUP S1021_Override_BatPmp1 "ME11/ME11_TMS/Actuator/PUMP/MotPMP/Override_BatPmp1" /begin REF_CHARACTERISTIC cal_MotPMPFaultFlgData cal_MotPMPFaultFlgDataEnb /end REF_CHARACTERISTIC /begin REF_MEASUREMENT ACTCtl_bMotPMPFaultFlg /end REF_MEASUREMENT /end GROUP
/begin GROUP S1021_Override_MotPmp "ME11/ME11_TMS/Actuator/PUMP/MotPMP/Override_MotPmp" /begin REF_CHARACTERISTIC cal_MotPMPSpdSetData cal_MotPMPSpdSetDataEnb /end REF_CHARACTERISTIC /end GROUP
/begin GROUP S1021_PCUTempJudge "ME11/ME11_TMS/Actuator/PUMP/MotPMP/PCUTempJudge" /begin REF_CHARACTERISTIC cal_LTRIPUTempMotPMPCtrl_1X cal_LTRIPUTempMotPMPCtrl_1Y /end REF_CHARACTERISTIC /end GROUP
/begin GROUP S1129_Override_bACAuto "ME11/ME11_TMS/HMI/Status/ACAuto/Override_bACAuto" /begin REF_CHARACTERISTIC cal_bACAutoData cal_bACAutoEnb /end REF_CHARACTERISTIC /begin REF_MEASUREMENT HMICtl_bACAuto /end REF_MEASUREMENT /end GROUP
/begin GROUP S1130_Override_bACDefrost "ME11/ME11_TMS/HMI/Status/ACDefrost/Override_bACDefrost" /begin REF_CHARACTERISTIC cal_bACDefrostData cal_bACDefrostEnb /end REF_CHARACTERISTIC /begin REF_MEASUREMENT HMICtl_bACDefrost /end REF_MEASUREMENT /end GROUP
/begin GROUP S1131_Override_bACOnOff "ME11/ME11_TMS/HMI/Status/ACOnOff/Override_bACOnOff" /begin REF_CHARACTERISTIC cal_bACOnOffData cal_bACOnOffEnb /end REF_CHARACTERISTIC /begin REF_MEASUREMENT HMICtl_bACOnOff /end REF_MEASUREMENT /end GROUP
/begin GROUP S1132_Override_eACSts "ME11/ME11_TMS/HMI/Status/ACSts/Override_eACSts" /begin REF_CHARACTERISTIC cal_eACStsData cal_eACStsEnb /end REF_CHARACTERISTIC /begin REF_MEASUREMENT HMICtl_eACSts /end REF_MEASUREMENT /end GROUP
/begin GROUP S1264_ACRunOffTimeCal "ME11/ME11_TMS/Power/RDCWorkMng/Stop_Manage/ACRunOffTimeCal" /begin SUB_GROUP S1266_Subsystem /end SUB_GROUP /end GROUP
/begin GROUP S1282_ACCharge "ME11/ME11_TMS/SOM/BattaryMode/Balance/ACCharge"
 /begin REF_CHARACTERISTIC cal_BatBalCellTemp2 cal_tBatBalONACChrgMinCellTemp cal_tBatHeatExitMaxToMinCellDiff /end REF_CHARACTERISTIC
/end GROUP
/begin GROUP S1282_Exit "ME11/ME11_TMS/SOM/BattaryMode/Balance/Exit"
 /begin REF_CHARACTERISTIC cal_BatBalCellTemp1 cal_BatBalCellTemp2 cal_VehHeatSOCOff cal_tBatBalExitACChrgMinCellTemp cal_tBatBalExitBal1ToBatDiff cal_tBatBalExitBatToBal2Diff cal_tBatBalExitDCChrgMinCellTemp cal_tBatBalExitMaxToMinCellDiff cal_tBatHeatExitMaxToMinCellDiff /end REF_CHARACTERISTIC
/end GROUP
/begin GROUP S1282_Ready "ME11/ME11_TMS/SOM/BattaryMode/Balance/Ready"
 /begin REF_CHARACTERISTIC cal_BatBalCellTemp1 cal_BatBalCellTemp2 cal_MotHeatBatMinTempDiff cal_VehHeatSOCOn cal_tBatHeatExitMaxToMinCellDiff /end REF_CHARACTERISTIC
/end GROUP
/begin GROUP S1282_thermal_storage_enter "ME11/ME11_TMS/SOM/BattaryMode/Balance/thermal_storage_enter" /begin SUB_GROUP S1301_A S1301_B /end SUB_GROUP /end GROUP
/begin GROUP S1282_thermal_storage_exit "ME11/ME11_TMS/SOM/BattaryMode/Balance/thermal_storage_exit"
 /begin SUB_GROUP S1302_B S1302_C S1302_D S1302_G S1302_H S1302_I S1302_J S1302_K S1302_M S1302_N S1302_P /end SUB_GROUP
 /begin REF_CHARACTERISTIC cal_tBatHeatExitMaxToMinCellDiff /end REF_CHARACTERISTIC
 /begin REF_MEASUREMENT SOMCtl_bBatTSExitFlg /end REF_MEASUREMENT
/end GROUP
/begin GROUP S1283_B1_B21 "ME11/ME11_TMS/SOM/BattaryMode/Cool/B1_B21"
 /begin SUB_GROUP S1356_ConditionABC S1356_ConditionE S1356_ConditionF S1356_Judge /end SUB_GROUP
/end GROUP
/begin GROUP S1283_B1_B22 "ME11/ME11_TMS/SOM/BattaryMode/Cool/B1_B22"
 /begin SUB_GROUP S1357_ConditionB S1357_ConditionD S1357_ConditionE S1357_Judge /end SUB_GROUP
/end GROUP
/begin GROUP S1283_B2_B1 "ME11/ME11_TMS/SOM/BattaryMode/Cool/B2_B1"
 /begin SUB_GROUP S1358_ConditionA S1358_ConditionD S1358_ConditionGHI S1358_Judge /end SUB_GROUP
/end GROUP
/begin GROUP S1283_Override_BatTrgTemp "ME11/ME11_TMS/SOM/BattaryMode/Cool/Override_BatTrgTemp" /begin REF_CHARACTERISTIC cal_BatCoolOverData cal_BatCoolOverEnb /end REF_CHARACTERISTIC /begin REF_MEASUREMENT SOMCtl_bBatCoolFlg /end REF_MEASUREMENT /end GROUP
/begin GROUP S1284_B1_B33 "ME11/ME11_TMS/SOM/BattaryMode/DLTR/B1_B33" /begin SUB_GROUP S1403_B S1403_B1C1 S1403_C S1403_D /end SUB_GROUP /begin REF_CHARACTERISTIC cal_VehHeatSOCOn cal_tLTROnIPUTemp cal_tLTROnMotTemp /end REF_CHARACTERISTIC
 /begin REF_MEASUREMENT SOMCtl_bDCBatLTROnFlg SOMCtl_bNmlBatLTROnFlg SOMCtl_eNmlBatLTROnFlg /end REF_MEASUREMENT
/end GROUP
/begin GROUP S1284_B33_B1 "ME11/ME11_TMS/SOM/BattaryMode/DLTR/B33_B1" /begin SUB_GROUP S1404_A S1404_B S1404_D /end SUB_GROUP /begin REF_CHARACTERISTIC cal_VehHeatSOCOff cal_tLTROffIPUTemp /end REF_CHARACTERISTIC /begin REF_MEASUREMENT SOMCtl_bBatLTROffFlg SOMCtrl_bBatLTRDelayFlg /end REF_MEASUREMENT /end GROUP
/begin GROUP S1285_Override_BatModed "ME11/ME11_TMS/SOM/BattaryMode/DisplaySet/Override_BatModed" /begin REF_CHARACTERISTIC cal_BatModeData cal_BatModeEnb /end REF_CHARACTERISTIC /begin REF_MEASUREMENT SOMCtl_eBatMode /end REF_MEASUREMENT /end GROUP
/begin GROUP S1286_B1_B41 "ME11/ME11_TMS/SOM/BattaryMode/Heat/B1_B41"
 /begin SUB_GROUP S1440_ConditionAorB S1440_ConditionCorD S1440_ConditionE S1440_ConditionF S1440_Judge /end SUB_GROUP
/end GROUP
/begin GROUP S1286_B1_B42 "ME11/ME11_TMS/SOM/BattaryMode/Heat/B1_B42"
 /begin SUB_GROUP S1441_ConditionB S1441_ConditionD S1441_ConditionE S1441_ConditionF S1441_Judge /end SUB_GROUP
/end GROUP
/begin GROUP S1286_B41_B1 "ME11/ME11_TMS/SOM/BattaryMode/Heat/B41_B1"
 /begin SUB_GROUP S1442_ConditionA S1442_ConditionB S1442_ConditionD S1442_ConditionHIJ S1442_Judge /end SUB_GROUP
/end GROUP
/begin GROUP S1286_Override_BatTrgTemp "ME11/ME11_TMS/SOM/BattaryMode/Heat/Override_BatTrgTemp" /begin REF_CHARACTERISTIC cal_BatHeatOverData cal_BatHeatOverEnb /end REF_CHARACTERISTIC /begin REF_MEASUREMENT SOMCtl_bBatHeatFlg /end REF_MEASUREMENT /end GROUP
/begin GROUP S1286_calTemp "ME11/ME11_TMS/SOM/BattaryMode/Heat/calTemp"
 /begin SUB_GROUP S1445_ACCharge S1445_DCCharge S1445_Discharge S1445_HeatTrgTemp /end SUB_GROUP
 /begin REF_MEASUREMENT SOMCtl_bCalTempBatHeatFlg SOMCtl_sBatHeatT1 SOMCtl_sBatHeatT2 /end REF_MEASUREMENT
/end GROUP
/begin GROUP S1288_Enter "ME11/ME11_TMS/SOM/BattaryMode/MotorAndBatLTR/Enter"
 /begin SUB_GROUP S1505_A1 S1505_B S1505_B1 S1505_B1C1 S1505_C S1505_C1 S1505_D /end SUB_GROUP
 /begin REF_CHARACTERISTIC cal_tLTROnIPUTemp cal_tLTROnMotTemp /end REF_CHARACTERISTIC
 /begin REF_MEASUREMENT SOMCtl_bMotLTRAndBatBalOn1Flg SOMCtl_bMotLTRAndBatBalOn2Flg SOMCtl_eMotLTRAndBatBalOn1Flg SOMCtl_eMotLTRAndBatBalOn2Flg /end REF_MEASUREMENT
/end GROUP
/begin GROUP S1288_Exit "ME11/ME11_TMS/SOM/BattaryMode/MotorAndBatLTR/Exit" /begin SUB_GROUP S1506_A S1506_BC S1506_D S1506_E /end SUB_GROUP /begin REF_CHARACTERISTIC cal_DLTRIPUTempExitVal /end REF_CHARACTERISTIC /begin REF_MEASUREMENT SOMCtl_bDBatLTROffFlg /end REF_MEASUREMENT /end GROUP
/begin GROUP S1289_B1_B30 "ME11/ME11_TMS/SOM/BattaryMode/MotorHeatBat/B1_B30"
 /begin REF_CHARACTERISTIC cal_BatBalCellTemp1 cal_VehHeatSOCOff cal_VehHeatSOCOn cal_tBatHeatExitMaxToMinCellDiff cal_tMotStorExitMaxCellTemp cal_tMotStorExitMotToMinCellDiff cal_tMotStorMinCellTempLow cal_tMotStorOnMotToMinCellDiff /end REF_CHARACTERISTIC
 /begin REF_MEASUREMENT SOMCtl_bBatHStrFlg /end REF_MEASUREMENT
/end GROUP
/begin GROUP S1289_B1_B31_AC "ME11/ME11_TMS/SOM/BattaryMode/MotorHeatBat/B1_B31_AC"
 /begin REF_CHARACTERISTIC cal_BatBalCellTemp1 cal_tBatHeatExitMaxToMinCellDiff cal_tMotHeatBatACChrgMinCellTempLow cal_tMotHeatOnMotToMinCellDiff /end REF_CHARACTERISTIC
/end GROUP
/begin GROUP S1289_B1_B31_PT "ME11/ME11_TMS/SOM/BattaryMode/MotorHeatBat/B1_B31_PT"
 /begin REF_CHARACTERISTIC cal_BatBalCellTemp1 cal_VehHeatSOCOn cal_tBatHeatExitMaxToMinCellDiff cal_tMotHeatBatMinCellTempLow cal_tMotHeatOnMotToMinCellDiff /end REF_CHARACTERISTIC
/end GROUP
/begin GROUP S1289_B31_B1 "ME11/ME11_TMS/SOM/BattaryMode/MotorHeatBat/B31_B1"
 /begin REF_CHARACTERISTIC cal_BatBalCellTemp1 cal_VehHeatSOCOff cal_tBatHeatExitMaxToMinCellDiff cal_tMotHeatExitMinCellToBal1Diff cal_tMotHeatExitMinCellToMotTempDiff cal_tMotStorExitMaxCellTemp /end REF_CHARACTERISTIC
 /begin REF_MEASUREMENT SOMCtl_bBatHeatB31tB1Flg /end REF_MEASUREMENT
/end GROUP
/begin GROUP S1290_Enter_AC "ME11/ME11_TMS/SOM/BattaryMode/MotorHeatBat_OTS/Enter_AC"
 /begin REF_CHARACTERISTIC cal_BatBalCellTemp1 cal_tBatHeatExitMaxToMinCellDiff cal_tMotHeatBatACChrgMinCellTempLow cal_tMotHeatOnMotToMinCellDiff /end REF_CHARACTERISTIC
 /begin REF_MEASUREMENT SOMCtl_eMotorHeatBat2Flg /end REF_MEASUREMENT
/end GROUP
/begin GROUP S1290_Enter_PT "ME11/ME11_TMS/SOM/BattaryMode/MotorHeatBat_OTS/Enter_PT"
 /begin REF_CHARACTERISTIC cal_BatBalCellTemp1 cal_tBatHeatExitMaxToMinCellDiff cal_tMotHeatBatMinCellTempLow cal_tMotHeatOnMotToMinCellDiff /end REF_CHARACTERISTIC
 /begin REF_MEASUREMENT SOMCtl_eMotorHeatBatFlg /end REF_MEASUREMENT
/end GROUP
/begin GROUP S1290_Exit "ME11/ME11_TMS/SOM/BattaryMode/MotorHeatBat_OTS/Exit"
 /begin REF_CHARACTERISTIC cal_BatBalCellTemp1 cal_MBIGBTHighExitTempG cal_MBIPUDevHighExitTempI cal_MBMotorInletHighExitTempH cal_tBatHeatExitMaxToMinCellDiff cal_tMotHeatExitMinCellToBal1Diff cal_tMotHeatExitMinCellToMotTempDiff cal_tMotStorExitMaxCellTemp /end REF_CHARACTERISTIC
 /begin REF_MEASUREMENT SOMCtl_bMotorHeatBatOffFlg SOMCtl_eMotorHeatBatOffFlg /end REF_MEASUREMENT
/end GROUP
/begin GROUP S1291_B33_B1 "ME11/ME11_TMS/SOM/BattaryMode/MotorLTRAndBatBalance/B33_B1" /begin SUB_GROUP S1600_C S1600_D S1600_E S1600_I /end SUB_GROUP
 /begin REF_CHARACTERISTIC cal_BatBalCellTemp2 cal_LTRIGBTMaxExitTempB cal_LTRMotorInletMaxExitTempA /end REF_CHARACTERISTIC
 /begin REF_MEASUREMENT SOMCtl_bMotLTRAndBatBalOffFlg SOMCtl_eMotLTRAndBatBalOffFlg /end REF_MEASUREMENT
/end GROUP
/begin GROUP S1291_Balance "ME11/ME11_TMS/SOM/BattaryMode/MotorLTRAndBatBalance/Balance" /begin SUB_GROUP S1601_A S1601_B S1601_C S1601_D /end SUB_GROUP /begin REF_CHARACTERISTIC cal_tBatHeatExitMaxToMinCellDiff /end REF_CHARACTERISTIC /begin REF_MEASUREMENT SOMCtl_bBatBalEntBFlg SOMCtl_eBatBalEntBFlg /end REF_MEASUREMENT /end GROUP
/begin GROUP S1291_LTR "ME11/ME11_TMS/SOM/BattaryMode/MotorLTRAndBatBalance/LTR" /begin SUB_GROUP S1604_D /end SUB_GROUP /begin REF_CHARACTERISTIC cal_tLTROnMotTemp /end REF_CHARACTERISTIC /begin REF_MEASUREMENT SOMCtl_eBatLTROnFlg /end REF_MEASUREMENT /end GROUP
/begin GROUP S1644_Enter "ME11/ME11_TMS/SOM/Cabin/MD2_DHMD1/Enter" /begin SUB_GROUP S1660_EnterCondition1 S1660_EnterCondition2 /end SUB_GROUP /end GROUP
/begin GROUP S1644_Exit "ME11/ME11_TMS/SOM/Cabin/MD2_DHMD1/Exit" /begin SUB_GROUP S1661_Condition1And2 S1661_Condition3 S1661_Contidion4 /end SUB_GROUP /end GROUP
/begin GROUP S1646_Enter "ME11/ME11_TMS/SOM/Cabin/MD3_DHMD2/Enter" /begin REF_CHARACTERISTIC cal_CabinMD2F2MaxEnvTemp /end REF_CHARACTERISTIC /end GROUP
/begin GROUP S1646_Exit "ME11/ME11_TMS/SOM/Cabin/MD3_DHMD2/Exit" /begin SUB_GROUP S1676_Condition1 S1676_Condition2 S1676_Contidion3 /end SUB_GROUP /end GROUP
/begin GROUP S1649_Override_CabinModed "ME11/ME11_TMS/SOM/Cabin/ModeDisplay/Override_CabinModed" /begin REF_CHARACTERISTIC cal_CabinModeData cal_CabinModeEnb /end REF_CHARACTERISTIC /begin REF_MEASUREMENT SOMCtl_eCabinMode /end REF_MEASUREMENT /end GROUP
/begin GROUP S1724_SenDiagnostic "ME11/ME11_TMS/Sensor/Cabin/Cabin/SenDiagnostic" /begin REF_CHARACTERISTIC cal_SensorTempDownFlg cal_SensorTempUpFlt /end REF_CHARACTERISTIC /end GROUP
/begin GROUP S1747_SenDiagnostic "ME11/ME11_TMS/Sensor/FaceDuct/Face/SenDiagnostic" /begin REF_CHARACTERISTIC cal_SensorTempDownFlg cal_SensorTempUpFlt /end REF_CHARACTERISTIC /end GROUP
/begin GROUP S1757_SenDiagnostic "ME11/ME11_TMS/Sensor/FootDuct/Foot/SenDiagnostic" /begin REF_CHARACTERISTIC cal_SensorTempDownFlg cal_SensorTempUpFlt /end REF_CHARACTERISTIC /end GROUP
/begin GROUP S1797_SenDiagnostic "ME11/ME11_TMS/Sensor/TempChiller/Chiller/SenDiagnostic" /begin REF_CHARACTERISTIC cal_SensorTempDownFlg cal_SensorTempUpFlt /end REF_CHARACTERISTIC /end GROUP
/begin GROUP S1808_SenDiagnostic "ME11/ME11_TMS/Sensor/TempEnvironment/Env/SenDiagnostic" /begin REF_CHARACTERISTIC cal_SensorTempDownFlg cal_SensorTempUpFlt /end REF_CHARACTERISTIC /end GROUP
/begin GROUP S1809_median "ME11/ME11_TMS/Sensor/TempEnvironment/EnvCal/median" /begin REF_MEASUREMENT ACSen_sEnvTempFilter /end REF_MEASUREMENT /end GROUP
/begin GROUP S1817_SenDiagnostic "ME11/ME11_TMS/Sensor/TempEvap/EVAP/SenDiagnostic" /begin REF_CHARACTERISTIC cal_SensorTempDownFlg cal_SensorTempUpFlt /end REF_CHARACTERISTIC /end GROUP
/begin GROUP S1827_SenDiagnostic "ME11/ME11_TMS/Sensor/TempEvapSurface/EvapSurface/SenDiagnostic" /begin REF_CHARACTERISTIC cal_SensorTempDownFlg cal_SensorTempUpFlt /end REF_CHARACTERISTIC /end GROUP
/begin GROUP S1836_SenDiagnostic "ME11/ME11_TMS/Sensor/TempMotor/motor/SenDiagnostic" /begin REF_CHARACTERISTIC cal_SensorTempDownFlg cal_SensorTempUpFlt /end REF_CHARACTERISTIC /end GROUP
/begin GROUP S1843_SenDiagnostic "ME11/ME11_TMS/Sensor/TempOHX/Env/SenDiagnostic" /begin REF_CHARACTERISTIC cal_SensorTempDownFlg cal_SensorTempUpFlt /end REF_CHARACTERISTIC /end GROUP
/begin GROUP S1852_SenDiagnostic "ME11/ME11_TMS/Sensor/WCCHiTemp/Env/SenDiagnostic" /begin REF_CHARACTERISTIC cal_SensorTempDownFlg cal_SensorTempUpFlt /end REF_CHARACTERISTIC /end GROUP
/begin GROUP S1868_SenDiagnostic "ME11/ME11_TMS/Sensor/tempACCMHi/ACCMHi/SenDiagnostic" /begin REF_CHARACTERISTIC cal_SensorTempDownFlg cal_SensorTempUpFlt /end REF_CHARACTERISTIC /end GROUP
/begin GROUP S39_BlowerFanSpeedCalEnable "ME11/ME11_TMS/ACC/AutoAc/AutoACFun/BlowerFanSpeed/BlowerFanSpeedCalEnable" /begin SUB_GROUP S46_ACFanLevelEnvCor S46_FanReqSpeedCal /end SUB_GROUP /end GROUP
/begin GROUP S39_FanMaxSpeedLimCal "ME11/ME11_TMS/ACC/AutoAc/AutoACFun/BlowerFanSpeed/FanMaxSpeedLimCal"
 /begin REF_CHARACTERISTIC AC_ColdStart AC_HotStart AC_LittleColdStart cal_ACFanMaxSpdCellTempLim_CUR cal_ACFanMaxSpdDvtLim_CUR cal_BlowerFanSpdVentUL cal_FANSpdHotStartUL cal_FANSpdModeShiftMax /end REF_CHARACTERISTIC
 /begin REF_MEASUREMENT AC_BlowerFanSpeedMax AC_DVT2PTCErr /end REF_MEASUREMENT
/end GROUP
/begin GROUP S39_FanMinSpeedLimCal "ME11/ME11_TMS/ACC/AutoAc/AutoACFun/BlowerFanSpeed/FanMinSpeedLimCal" /begin REF_CHARACTERISTIC AC_HotStart cal_BlowerFanSpdLL cal_FANSpdHotStartLL /end REF_CHARACTERISTIC /begin REF_MEASUREMENT AC_BlowerFanSpeedMin /end REF_MEASUREMENT /end GROUP
/begin GROUP S40_BlowerControlEnable "ME11/ME11_TMS/ACC/AutoAc/AutoACFun/BlowerMode/BlowerControlEnable" /begin SUB_GROUP S73_AutoMode /end SUB_GROUP /end GROUP
/begin GROUP S41_CabinAccmReqEnable "ME11/ME11_TMS/ACC/AutoAc/AutoACFun/Compressor_ACWorkModeCheck/CabinAccmReqEnable"
 /begin SUB_GROUP S81_Compressor_ACWorkModeCheck S81_Compressor_DefogWorkModeWithDefogCheck /end SUB_GROUP
/end GROUP
/begin GROUP S42_AC_PTCCalEnableState "ME11/ME11_TMS/ACC/AutoAc/AutoACFun/PTC_ACWorkModeCheck/AC_PTCCalEnableState" /begin SUB_GROUP S90_AC_PTCShutOffCond0 /end SUB_GROUP
 /begin REF_CHARACTERISTIC cal_MixDoor2CabinHeatingEn_OFF cal_MixDoor2CabinHeatingEn_ON /end REF_CHARACTERISTIC
 /begin REF_MEASUREMENT ACCtl_stCabinHeatingEn /end REF_MEASUREMENT
/end GROUP
/begin GROUP S42_PTC_PID "ME11/ME11_TMS/ACC/AutoAc/AutoACFun/PTC_ACWorkModeCheck/PTC_PID" /begin SUB_GROUP S91_IWin_Controller S91_NegAndPosCheck S91_pWin_Controller /end SUB_GROUP
 /begin REF_CHARACTERISTIC cal_ACPTCPwrPreSetByEnv_MAP cal_PtcPwrDesValPIDDeadBandNeg cal_PtcPwrDesValPIDDeadBandPos cal_PtcPwrDesValPID_IsumMax cal_PtcPwrDesValPID_IsumMin cal_PtcPwrDesValPID_Ki cal_PtcPwrDesValPID_KiNeg cal_PtcPwrDesValPID_KiPos cal_PtcPwrDesValPID_Kp cal_PtcPwrDesValPID_KpNeg cal_PtcPwrDesValPID_KpPos cal_PtcPwrDesValPID_LL cal_PtcPwrDesValPID_UL cal_PtcPwrDesValPID_pWinNeg cal_PtcPwrDesValPID_pWinPos /end REF_CHARACTERISTIC
 /begin REF_MEASUREMENT ACCtl_pwrHeatingFeed /end REF_MEASUREMENT
/end GROUP
/begin GROUP S43_ACCtlRecForForceDefog1 "ME11/ME11_TMS/ACC/AutoAc/AutoACFun/RecircModeEnaCalcu/ACCtlRecForForceDefog1" /begin REF_CHARACTERISTIC DriveFRESH RECIRC /end REF_CHARACTERISTIC /end GROUP
/begin GROUP S43_ACCtlRecForSummerOrWinterOrNormalDefog1 "ME11/ME11_TMS/ACC/AutoAc/AutoACFun/RecircModeEnaCalcu/ACCtlRecForSummerOrWinterOrNormalDefog1" /begin SUB_GROUP S119_DefogRiskLimIntakeRatio /end SUB_GROUP /end GROUP
/begin GROUP S43_ACCtlRecForVent1 "ME11/ME11_TMS/ACC/AutoAc/AutoACFun/RecircModeEnaCalcu/ACCtlRecForVent1" /begin REF_CHARACTERISTIC cal_ACInletEnvPrtSetCool_CUR cal_ACInletEnvPrtSetHeat_CUR /end REF_CHARACTERISTIC /end GROUP
/begin GROUP S43_Mannual "ME11/ME11_TMS/ACC/AutoAc/AutoACFun/RecircModeEnaCalcu/Mannual" /begin REF_MEASUREMENT ACCtl_stRecManualEna /end REF_MEASUREMENT /end GROUP
/begin GROUP S43_RecACHotStart "ME11/ME11_TMS/ACC/AutoAc/AutoACFun/RecircModeEnaCalcu/RecACHotStart" /begin REF_CHARACTERISTIC AC_HotStart /end REF_CHARACTERISTIC /begin REF_MEASUREMENT ACCtl_stRecACHotStartEna /end REF_MEASUREMENT /end GROUP
/begin GROUP S43_RecAQS "ME11/ME11_TMS/ACC/AutoAc/AutoACFun/RecircModeEnaCalcu/RecAQS"
 /begin REF_CHARACTERISTIC cal_AQS2InRecThreVal cal_AQS2OutRecThreVal cal_tiAQSFresh2RecircDelay cal_tiAQSRecirc2FreshDelay /end REF_CHARACTERISTIC
 /begin REF_MEASUREMENT ACCtl_stRecAQSEna /end REF_MEASUREMENT
/end GROUP
/begin GROUP S43_RecForceChange "ME11/ME11_TMS/ACC/AutoAc/AutoACFun/RecircModeEnaCalcu/RecForceChange"
 /begin REF_CHARACTERISTIC cal_ACCtlRecLevelForForceChange cal_tiCO2Fresh2RecircMax cal_tiCO2Recirc2FreshMax /end REF_CHARACTERISTIC
 /begin REF_MEASUREMENT ACCtl_stRecForceChangeEna /end REF_MEASUREMENT
/end GROUP
/begin GROUP S43_RecForceDefog "ME11/ME11_TMS/ACC/AutoAc/AutoACFun/RecircModeEnaCalcu/RecForceDefog" /begin REF_MEASUREMENT ACCtl_stRecForceDefogEna /end REF_MEASUREMENT /end GROUP
/begin GROUP S43_RecNormalDefog "ME11/ME11_TMS/ACC/AutoAc/AutoACFun/RecircModeEnaCalcu/RecNormalDefog" /begin REF_MEASUREMENT ACCtl_stRecNormalDefogEna /end REF_MEASUREMENT /end GROUP
/begin GROUP S43_RecPCUTemp "ME11/ME11_TMS/ACC/AutoAc/AutoACFun/RecircModeEnaCalcu/RecPCUTemp" /begin REF_CHARACTERISTIC cal_AirInletRecInPCUTemp cal_AirInletRecOutPCUTemp /end REF_CHARACTERISTIC /begin REF_MEASUREMENT ACCtl_stRecPCUTempEna /end REF_MEASUREMENT /end GROUP
/begin GROUP S43_RecPTCDvt "ME11/ME11_TMS/ACC/AutoAc/AutoACFun/RecircModeEnaCalcu/RecPTCDvt" /begin REF_CHARACTERISTIC cal_PTCTempRecircOff cal_PTCTempRecircOn /end REF_CHARACTERISTIC /begin REF_MEASUREMENT ACCtl_stRecPTCDvtEna /end REF_MEASUREMENT /end GROUP
/begin GROUP S43_RecQkChargeCooling "ME11/ME11_TMS/ACC/AutoAc/AutoACFun/RecircModeEnaCalcu/RecQkChargeCooling" /begin REF_MEASUREMENT ACCtl_stRecQkChargeCoolingEna /end REF_MEASUREMENT /end GROUP
/begin GROUP S43_RecRemoteForce "ME11/ME11_TMS/ACC/AutoAc/AutoACFun/RecircModeEnaCalcu/RecRemoteForce" /begin REF_MEASUREMENT ACCtl_stRecRemoteACEna /end REF_MEASUREMENT /end GROUP
/begin GROUP S43_RecSummerCond "ME11/ME11_TMS/ACC/AutoAc/AutoACFun/RecircModeEnaCalcu/RecSummerCond" /begin REF_MEASUREMENT ACCtl_stRecSummerCondEna /end REF_MEASUREMENT /end GROUP
/begin GROUP S43_RecTargetOutTemp "ME11/ME11_TMS/ACC/AutoAc/AutoACFun/RecircModeEnaCalcu/RecTargetOutTemp" /begin REF_CHARACTERISTIC cal_REC_DVTFresh cal_REC_DVTRecirc /end REF_CHARACTERISTIC /begin REF_MEASUREMENT ACCtl_stRecTargetOutTempEna /end REF_MEASUREMENT /end GROUP
/begin GROUP S43_RecVent "ME11/ME11_TMS/ACC/AutoAc/AutoACFun/RecircModeEnaCalcu/RecVent" /begin REF_MEASUREMENT ACCtl_stRecVentEna /end REF_MEASUREMENT /end GROUP
/begin GROUP S43_RecWinterCond "ME11/ME11_TMS/ACC/AutoAc/AutoACFun/RecircModeEnaCalcu/RecWinterCond" /begin REF_MEASUREMENT ACCtl_stRecWinterCondEna /end REF_MEASUREMENT /end GROUP
/begin GROUP S44_ACCtlRecForForceDefog "ME11/ME11_TMS/ACC/AutoAc/AutoACFun/RecircModeOut/ACCtlRecForForceDefog" /begin REF_CHARACTERISTIC DriveFRESH RECIRC /end REF_CHARACTERISTIC /end GROUP
/begin GROUP S44_Subsystem13 "ME11/ME11_TMS/ACC/AutoAc/AutoACFun/RecircModeOut/Subsystem13"
 /begin SUB_GROUP S154_Subsystem S154_Subsystem1 S154_Subsystem10 S154_Subsystem11 S154_Subsystem12 S154_Subsystem2 S154_Subsystem3 S154_Subsystem4 S154_Subsystem5 S154_Subsystem6 S154_Subsystem7 S154_Subsystem8 S154_Subsystem9 /end SUB_GROUP
/end GROUP
/begin GROUP S171_CalFrontVentDesireTemp "ME11/ME11_TMS/ACC/AutoAc/EvaporatorAndPTCAimTempCal_FIX/DesiredVentTempCal_FIX/CalFrontVentDesireTemp"
 /begin SUB_GROUP S177_FrontCabinAimTempBasCal S177_FrontCabinAimTempFeedfowardCorCal S177_TempRamp /end SUB_GROUP
 /begin REF_CHARACTERISTIC cal_EnvTempStep cal_FalseTime2EnvTamb cal_RiseTime2EnvTamb /end REF_CHARACTERISTIC
/end GROUP
/begin GROUP S171_CalLeftVentDesireTemp "ME11/ME11_TMS/ACC/AutoAc/EvaporatorAndPTCAimTempCal_FIX/DesiredVentTempCal_FIX/CalLeftVentDesireTemp"
 /begin REF_CHARACTERISTIC cal_ACDrDVTSolarCor_MAP cal_DvtDesValPID_LL cal_DvtDesValPID_UL cal_U_DVTFFSolarFilterRate /end REF_CHARACTERISTIC
 /begin REF_MEASUREMENT ACCtl_tDrDVT ACCtl_tDrDVTSolarCor GlbDa_LeftSolar /end REF_MEASUREMENT
/end GROUP
/begin GROUP S171_CalRightVentDesireTemp "ME11/ME11_TMS/ACC/AutoAc/EvaporatorAndPTCAimTempCal_FIX/DesiredVentTempCal_FIX/CalRightVentDesireTemp"
 /begin REF_CHARACTERISTIC cal_ACPsDVTSetCorByEnv_MAP cal_ACPsDVTSolarCor_MAP cal_DvtDesValPID_LL cal_DvtDesValPID_UL cal_U_DVTFFSolarFilterRate /end REF_CHARACTERISTIC
 /begin REF_MEASUREMENT ACCtl_tPsDVT ACCtl_tPsDVTCabinCor ACCtl_tPsDVTSolarCor AC_Ps2DrSetTempDvt GlbDa_RightSolar /end REF_MEASUREMENT
/end GROUP
/begin GROUP S171_DVTWeightCal "ME11/ME11_TMS/ACC/AutoAc/EvaporatorAndPTCAimTempCal_FIX/DesiredVentTempCal_FIX/DVTWeightCal" /begin REF_CHARACTERISTIC cal_DvtCoff /end REF_CHARACTERISTIC /end GROUP
/begin GROUP S172_CalDrDuctActualTemperature "ME11/ME11_TMS/ACC/AutoAc/EvaporatorAndPTCAimTempCal_FIX/DuctActualTemperature/CalDrDuctActualTemperature" /begin REF_CHARACTERISTIC cal_DrDuctFaceFloorFaFactor cal_DrDuctFaceFloorFoFactor /end REF_CHARACTERISTIC /end GROUP
/begin GROUP S172_CalPsDuctActualTemperature "ME11/ME11_TMS/ACC/AutoAc/EvaporatorAndPTCAimTempCal_FIX/DuctActualTemperature/CalPsDuctActualTemperature" /begin REF_CHARACTERISTIC cal_PsDuctFaceFloorFaFactor cal_PsDuctFaceFloorFoFactor /end REF_CHARACTERISTIC /end GROUP
/begin GROUP S172_LeftMixDoorPI "ME11/ME11_TMS/ACC/AutoAc/EvaporatorAndPTCAimTempCal_FIX/DuctActualTemperature/LeftMixDoorPI"
 /begin REF_CHARACTERISTIC cal_DcutTPidDeadBand cal_DcutTempPidLL cal_DcutTempPidUL cal_DcutTempPid_IsumMax cal_DcutTempPid_IsumMin cal_DcutTempPid_Ki cal_DcutTempPid_KiNeg cal_DcutTempPid_KiPos cal_DcutTempPid_Kp cal_DcutTempPid_KpNeg cal_DcutTempPid_KpPos cal_DcutTempPid_pWinNeg cal_DcutTempPid_pWinPos /end REF_CHARACTERISTIC
/end GROUP
/begin GROUP S172_RightMixDoorPI "ME11/ME11_TMS/ACC/AutoAc/EvaporatorAndPTCAimTempCal_FIX/DuctActualTemperature/RightMixDoorPI"
 /begin REF_CHARACTERISTIC cal_DcutTPidDeadBand cal_DcutTempPidLL cal_DcutTempPidUL cal_DcutTempPid_IsumMax cal_DcutTempPid_IsumMin cal_DcutTempPid_Ki cal_DcutTempPid_KiNeg cal_DcutTempPid_KiPos cal_DcutTempPid_Kp cal_DcutTempPid_KpNeg cal_DcutTempPid_KpPos cal_DcutTempPid_pWinNeg cal_DcutTempPid_pWinPos /end REF_CHARACTERISTIC
/end GROUP
/begin GROUP S175_CalAirCondDrEvapAimTemp "ME11/ME11_TMS/ACC/AutoAc/EvaporatorAndPTCAimTempCal_FIX/TargetEvaporatorTempGov/CalAirCondDrEvapAimTemp"
 /begin SUB_GROUP S272_CalAirCondEvapAimTemp_FIXPID S272_CalAirCondEvapDesTemp /end SUB_GROUP
 /begin REF_CHARACTERISTIC cal_DrEvaDesValPIDLL_MAP cal_EvaDesLLMax cal_EvaDesLLMin cal_FixPIDSecletFlag /end REF_CHARACTERISTIC
 /begin REF_MEASUREMENT ACCtl_tDrEvapDes /end REF_MEASUREMENT
/end GROUP
/begin GROUP S175_CalAirCondPsEvapAimTemp "ME11/ME11_TMS/ACC/AutoAc/EvaporatorAndPTCAimTempCal_FIX/TargetEvaporatorTempGov/CalAirCondPsEvapAimTemp"
 /begin SUB_GROUP S273_CalAirCondEvapAimTemp_RightDes S273_CalAirCondMixVlvRightTrgBasicTemp /end SUB_GROUP
 /begin REF_CHARACTERISTIC cal_EvaDesLLMax cal_EvaDesLLMin cal_FixPIDSecletFlag cal_PsEvaDesValPIDLL_MAP /end REF_CHARACTERISTIC
 /begin REF_MEASUREMENT ACCtl_tPsEvapDes /end REF_MEASUREMENT
/end GROUP
/begin GROUP S175_EvapTargetLowest "ME11/ME11_TMS/ACC/AutoAc/EvaporatorAndPTCAimTempCal_FIX/TargetEvaporatorTempGov/EvapTargetLowest"
 /begin REF_CHARACTERISTIC cal_CoolStartCompensate cal_EvaDesLLMax cal_EvaDesLLMin cal_EvaDesLLSelect cal_EvapDesLoLimByEnv_CUR cal_EvapDesLoLimBySolarCor_CUR /end REF_CHARACTERISTIC
 /begin REF_MEASUREMENT GlbDa_Solar /end REF_MEASUREMENT
/end GROUP
/begin GROUP S176_CalPTCAimTemp_LeftDes "ME11/ME11_TMS/ACC/AutoAc/EvaporatorAndPTCAimTempCal_FIX/TargetPTCTempGov/CalPTCAimTemp_LeftDes"
 /begin SUB_GROUP S332_CalAirCondMixVlvRightTrgBasicTemp S332_CalAirCondPTCAimTemp_FIXPID /end SUB_GROUP
 /begin REF_CHARACTERISTIC cal_FixPIDSecletFlag /end REF_CHARACTERISTIC
/end GROUP
/begin GROUP S176_CalPTCAimTemp_RightDes "ME11/ME11_TMS/ACC/AutoAc/EvaporatorAndPTCAimTempCal_FIX/TargetPTCTempGov/CalPTCAimTemp_RightDes"
 /begin SUB_GROUP S333_CalAirCondMixVlvRightTrgBasicTemp S333_CalAirCondPTCAimTemp_LeftDes /end SUB_GROUP
 /begin REF_CHARACTERISTIC cal_FixPIDSecletFlag /end REF_CHARACTERISTIC
/end GROUP
/begin GROUP S383_CalAirCondMixVlvLeftTrgTemp "ME11/ME11_TMS/ACC/AutoAc/MixDoorOpenCloseDesCal/CalDrMixDoorDesRatio/CalAirCondMixVlvLeftTrgTemp" /begin SUB_GROUP S386_CalFactorNominalTemp2ACPtcTemp /end SUB_GROUP
 /begin REF_CHARACTERISTIC cal_DrErrOfEvaDVT2CoolMixOff cal_DrErrOfEvaDVT2CoolMixOn cal_DrErrOfPtcDVT2HeatMixOff cal_DrErrOfPtcDVT2HeatMixOn cal_DrMixBacSetDefog_CUR cal_DrMixBacSetFaceHeater_CUR cal_DrMixBacSetFace_CUR cal_DrMixBacSetHeaterDeforst_CUR cal_DrMixBacSetHeater_CUR /end REF_CHARACTERISTIC
 /begin REF_MEASUREMENT ACCtl_rDrBasicMixDoor /end REF_MEASUREMENT
/end GROUP
/begin GROUP S383_CalDrMixDoorDesRatio_FIXPID "ME11/ME11_TMS/ACC/AutoAc/MixDoorOpenCloseDesCal/CalDrMixDoorDesRatio/CalDrMixDoorDesRatio_FIXPID" /begin SUB_GROUP S387_IWin_Controller S387_pWin_Controller /end SUB_GROUP
 /begin REF_CHARACTERISTIC cal_DrMixDesValPIDIntegDeadBand cal_DrMixDesValPIDLL cal_DrMixDesValPIDUL cal_DrMixDesValPID_IsumMax cal_DrMixDesValPID_IsumMin cal_DrMixDesValPID_Ki cal_DrMixDesValPID_KiNeg cal_DrMixDesValPID_KiPos cal_DrMixDesValPID_Kp cal_DrMixDesValPID_KpNeg cal_DrMixDesValPID_KpPos cal_DrMixDesValPID_pWinNeg cal_DrMixDesValPID_pWinPos cal_MixDoorClsFF_CUR cal_MixDoorKi_CUR cal_MixDoorKp_CUR /end REF_CHARACTERISTIC
 /begin REF_MEASUREMENT ACCtl_rDrMixDoorDes ACCtl_sMixDoorClsFF /end REF_MEASUREMENT
/end GROUP
/begin GROUP S384_CalAirCondMixVlvRightTrgTemp "ME11/ME11_TMS/ACC/AutoAc/MixDoorOpenCloseDesCal/CalPsMixDoorDesRatio/CalAirCondMixVlvRightTrgTemp" /begin SUB_GROUP S412_CalFactorNominalTemp2ACPtcTemp /end SUB_GROUP
 /begin REF_CHARACTERISTIC cal_PsErrOfEvaDVT2CoolMixOff cal_PsErrOfEvaDVT2CoolMixOn cal_PsErrOfPtcDVT2HeatMixOff cal_PsErrOfPtcDVT2HeatMixOn cal_PsMixBacSetAC_CUR cal_PsMixBacSetBi_CUR cal_PsMixBacSetDefog_CUR cal_PsMixBacSetFootDe_CUR cal_PsMixBacSetFoot_CUR /end REF_CHARACTERISTIC
 /begin REF_MEASUREMENT ACCtl_rPsBasicMixDoor ACCtl_rPsBlowerModeSet /end REF_MEASUREMENT
/end GROUP
/begin GROUP S384_CalPsMixDoorDesRatio "ME11/ME11_TMS/ACC/AutoAc/MixDoorOpenCloseDesCal/CalPsMixDoorDesRatio/CalPsMixDoorDesRatio" /begin SUB_GROUP S413_IWin_Controller S413_pWin_Controller /end SUB_GROUP
 /begin REF_CHARACTERISTIC cal_PsMixDesValPIDIntegDeadBand cal_PsMixDesValPIDLL cal_PsMixDesValPIDUL cal_PsMixDesValPID_IsumMax cal_PsMixDesValPID_IsumMin cal_PsMixDesValPID_Ki cal_PsMixDesValPID_KiNeg cal_PsMixDesValPID_KiPos cal_PsMixDesValPID_Kp cal_PsMixDesValPID_KpNeg cal_PsMixDesValPID_KpPos cal_PsMixDesValPID_pWinNeg cal_PsMixDesValPID_pWinPos /end REF_CHARACTERISTIC
 /begin REF_MEASUREMENT ACCtl_rPsMixDoorDes /end REF_MEASUREMENT
/end GROUP
/begin GROUP S456_ModeJudge "ME11/ME11_TMS/Actuator/COMP/ACCMEnble/ModeOnOrOff/ModeJudge" /begin REF_CHARACTERISTIC cal_BatHeatACCMEnb /end REF_CHARACTERISTIC /begin REF_MEASUREMENT ACTCtl_eCOMPJudgeFlg /end REF_MEASUREMENT /end GROUP
/begin GROUP S478_ISum "ME11/ME11_TMS/Actuator/COMP/ACCMPICtrl/IWin_Controller/ISum" /begin REF_MEASUREMENT ACTCtl_sACCMI_Cor /end REF_MEASUREMENT /end GROUP
/begin GROUP S502_Flg1Cal "ME11/ME11_TMS/Actuator/COMP/COMPFaultHandling/PressRateProtect/Flg1Cal" /begin REF_CHARACTERISTIC cal_HPProVal3 cal_HPProVal3Relay /end REF_CHARACTERISTIC /end GROUP
/begin GROUP S502_Flg1Cal1 "ME11/ME11_TMS/Actuator/COMP/COMPFaultHandling/PressRateProtect/Flg1Cal1" /begin REF_CHARACTERISTIC cal_PressRateVal3 cal_PressRateVal3Relay /end REF_CHARACTERISTIC /end GROUP
/begin GROUP S502_Flg1Cal2 "ME11/ME11_TMS/Actuator/COMP/COMPFaultHandling/PressRateProtect/Flg1Cal2" /begin REF_CHARACTERISTIC cal_HPProVal3 cal_HPProVal4 /end REF_CHARACTERISTIC /end GROUP
/begin GROUP S502_Flg2Cal "ME11/ME11_TMS/Actuator/COMP/COMPFaultHandling/PressRateProtect/Flg2Cal"
 /begin REF_CHARACTERISTIC cal_HPProVal2 cal_HPProVal2Relay cal_HPProVal3 cal_HPProVal3Relay /end REF_CHARACTERISTIC
/end GROUP
/begin GROUP S502_Flg2Cal1 "ME11/ME11_TMS/Actuator/COMP/COMPFaultHandling/PressRateProtect/Flg2Cal1"
 /begin REF_CHARACTERISTIC cal_PressRateVal2 cal_PressRateVal2Relay cal_PressRateVal3 cal_PressRateVal3Relay /end REF_CHARACTERISTIC
/end GROUP
/begin GROUP S502_Flg3Cal "ME11/ME11_TMS/Actuator/COMP/COMPFaultHandling/PressRateProtect/Flg3Cal"
 /begin REF_CHARACTERISTIC cal_HPProVal1 cal_HPProVal1Relay cal_HPProVal2 cal_HPProVal2Relay cal_HPProVal3 cal_HPProVal3Relay /end REF_CHARACTERISTIC
/end GROUP
/begin GROUP S502_Flg3Cal1 "ME11/ME11_TMS/Actuator/COMP/COMPFaultHandling/PressRateProtect/Flg3Cal1"
 /begin REF_CHARACTERISTIC cal_PressRateVal1 cal_PressRateVal1Relay cal_PressRateVal2 cal_PressRateVal2Relay cal_PressRateVal3 cal_PressRateVal3Relay /end REF_CHARACTERISTIC
/end GROUP
/begin GROUP S502_Other "ME11/ME11_TMS/Actuator/COMP/COMPFaultHandling/PressRateProtect/Other" /begin REF_CHARACTERISTIC cal_PressRateVal3 /end REF_CHARACTERISTIC /end GROUP
/begin GROUP S580_Target_computation "ME11/ME11_TMS/Actuator/COMP/ParameterCal/ACCMCtrlA/Target_computation" /begin REF_CHARACTERISTIC cal_BatHeatACCMEnb /end REF_CHARACTERISTIC /end GROUP
/begin GROUP S749_BEXVCtrlB "ME11/ME11_TMS/Actuator/EXV/BEXV/BEXVPIParameter/BEXVCtrlB" /begin REF_CHARACTERISTIC cal_BatCoolInletTrgTemp /end REF_CHARACTERISTIC /end GROUP
/begin GROUP S1301_A "ME11/ME11_TMS/SOM/BattaryMode/Balance/thermal_storage_enter/A" /begin REF_CHARACTERISTIC cal_BatBalCellTemp1 cal_tBatHeatExitMaxToMinCellDiff /end REF_CHARACTERISTIC /end GROUP
/begin GROUP S1301_B "ME11/ME11_TMS/SOM/BattaryMode/Balance/thermal_storage_enter/B" /begin REF_CHARACTERISTIC cal_tBatHeatExitMaxToMinCellDiff /end REF_CHARACTERISTIC /end GROUP
/begin GROUP S1302_B "ME11/ME11_TMS/SOM/BattaryMode/Balance/thermal_storage_exit/B" /begin REF_CHARACTERISTIC cal_BatBalCellTemp1 /end REF_CHARACTERISTIC /end GROUP
/begin GROUP S1356_ConditionF "ME11/ME11_TMS/SOM/BattaryMode/Cool/B1_B21/ConditionF" /begin REF_CHARACTERISTIC cal_tBatHeatExitMaxToMinCellDiff /end REF_CHARACTERISTIC /end GROUP
/begin GROUP S1357_ConditionE "ME11/ME11_TMS/SOM/BattaryMode/Cool/B1_B22/ConditionE" /begin REF_CHARACTERISTIC cal_tBatHeatExitMaxToMinCellDiff /end REF_CHARACTERISTIC /end GROUP
/begin GROUP S1358_ConditionA "ME11/ME11_TMS/SOM/BattaryMode/Cool/B2_B1/ConditionA" /begin REF_CHARACTERISTIC cal_tBatHeatExitMaxToMinCellDiff /end REF_CHARACTERISTIC /end GROUP
/begin GROUP S1403_B "ME11/ME11_TMS/SOM/BattaryMode/DLTR/B1_B33/B" /begin REF_CHARACTERISTIC cal_BatBalCellTemp2 /end REF_CHARACTERISTIC /end GROUP
/begin GROUP S1403_D "ME11/ME11_TMS/SOM/BattaryMode/DLTR/B1_B33/D" /begin REF_CHARACTERISTIC cal_tBatHeatExitMaxToMinCellDiff /end REF_CHARACTERISTIC /end GROUP
/begin GROUP S1404_A "ME11/ME11_TMS/SOM/BattaryMode/DLTR/B33_B1/A" /begin REF_CHARACTERISTIC cal_BatBalCellTemp2 /end REF_CHARACTERISTIC /end GROUP
/begin GROUP S1404_D "ME11/ME11_TMS/SOM/BattaryMode/DLTR/B33_B1/D" /begin REF_CHARACTERISTIC cal_tBatHeatExitMaxToMinCellDiff /end REF_CHARACTERISTIC /end GROUP
/begin GROUP S1440_ConditionE "ME11/ME11_TMS/SOM/BattaryMode/Heat/B1_B41/ConditionE" /begin REF_CHARACTERISTIC cal_tBatHeatExitMaxToMinCellDiff /end REF_CHARACTERISTIC /end GROUP
/begin GROUP S1441_ConditionD "ME11/ME11_TMS/SOM/BattaryMode/Heat/B1_B42/ConditionD" /begin REF_CHARACTERISTIC cal_VehHeatSOCOn /end REF_CHARACTERISTIC /end GROUP
/begin GROUP S1441_ConditionE "ME11/ME11_TMS/SOM/BattaryMode/Heat/B1_B42/ConditionE" /begin REF_CHARACTERISTIC cal_tBatHeatExitMaxToMinCellDiff /end REF_CHARACTERISTIC /end GROUP
/begin GROUP S1442_ConditionA "ME11/ME11_TMS/SOM/BattaryMode/Heat/B41_B1/ConditionA" /begin REF_CHARACTERISTIC cal_tBatHeatExitMaxToMinCellDiff /end REF_CHARACTERISTIC /end GROUP
/begin GROUP S1442_ConditionD "ME11/ME11_TMS/SOM/BattaryMode/Heat/B41_B1/ConditionD" /begin REF_CHARACTERISTIC cal_VehHeatSOCOff /end REF_CHARACTERISTIC /end GROUP
/begin GROUP S1505_B "ME11/ME11_TMS/SOM/BattaryMode/MotorAndBatLTR/Enter/B" /begin REF_CHARACTERISTIC cal_BatBalCellTemp2 /end REF_CHARACTERISTIC /end GROUP
/begin GROUP S1505_D "ME11/ME11_TMS/SOM/BattaryMode/MotorAndBatLTR/Enter/D" /begin REF_CHARACTERISTIC cal_tBatHeatExitMaxToMinCellDiff /end REF_CHARACTERISTIC /end GROUP
/begin GROUP S1506_A "ME11/ME11_TMS/SOM/BattaryMode/MotorAndBatLTR/Exit/A" /begin REF_CHARACTERISTIC cal_BatBalCellTemp2 /end REF_CHARACTERISTIC /end GROUP
/begin GROUP S1506_E "ME11/ME11_TMS/SOM/BattaryMode/MotorAndBatLTR/Exit/E" /begin REF_CHARACTERISTIC cal_tBatHeatExitMaxToMinCellDiff /end REF_CHARACTERISTIC /end GROUP
/begin GROUP S1601_A "ME11/ME11_TMS/SOM/BattaryMode/MotorLTRAndBatBalance/Balance/A" /begin REF_CHARACTERISTIC cal_BatBalCellTemp2 /end REF_CHARACTERISTIC /end GROUP
/begin GROUP S1601_B "ME11/ME11_TMS/SOM/BattaryMode/MotorLTRAndBatBalance/Balance/B" /begin REF_CHARACTERISTIC cal_BatBalCellTemp2 /end REF_CHARACTERISTIC /end GROUP
/begin GROUP S1601_C "ME11/ME11_TMS/SOM/BattaryMode/MotorLTRAndBatBalance/Balance/C" /begin REF_CHARACTERISTIC cal_BatBalCellTemp2 /end REF_CHARACTERISTIC /end GROUP
/begin GROUP S1601_D "ME11/ME11_TMS/SOM/BattaryMode/MotorLTRAndBatBalance/Balance/D" /begin REF_CHARACTERISTIC cal_BatBalCellTemp1 cal_BatBalCellTemp2 /end REF_CHARACTERISTIC /end GROUP
/begin GROUP S1604_D "ME11/ME11_TMS/SOM/BattaryMode/MotorLTRAndBatBalance/LTR/D" /begin REF_CHARACTERISTIC cal_BatBalCellTemp2 /end REF_CHARACTERISTIC /end GROUP
/begin GROUP S1660_EnterCondition1 "ME11/ME11_TMS/SOM/Cabin/MD2_DHMD1/Enter/EnterCondition1" /begin REF_CHARACTERISTIC cal_CabinMD2F2MaxEnvTemp /end REF_CHARACTERISTIC /end GROUP
/begin GROUP S1660_EnterCondition2 "ME11/ME11_TMS/SOM/Cabin/MD2_DHMD1/Enter/EnterCondition2" /begin REF_CHARACTERISTIC cal_CabinMD2F2MaxEnvTemp /end REF_CHARACTERISTIC /end GROUP
/begin GROUP S1661_Condition3 "ME11/ME11_TMS/SOM/Cabin/MD2_DHMD1/Exit/Condition3" /begin REF_CHARACTERISTIC cal_CabinMD2F2MaxEnvTemp /end REF_CHARACTERISTIC /end GROUP
/begin GROUP S1676_Condition2 "ME11/ME11_TMS/SOM/Cabin/MD3_DHMD2/Exit/Condition2" /begin REF_CHARACTERISTIC cal_CabinMD2F2MaxEnvTemp /end REF_CHARACTERISTIC /end GROUP
/begin GROUP S1676_Contidion3 "ME11/ME11_TMS/SOM/Cabin/MD3_DHMD2/Exit/Contidion3" /begin REF_CHARACTERISTIC cal_CabinMD2F2MaxEnvTemp /end REF_CHARACTERISTIC /end GROUP
/begin GROUP S154_Subsystem "ME11/ME11_TMS/ACC/AutoAc/AutoACFun/RecircModeOut/Subsystem13/Subsystem"
 /begin REF_CHARACTERISTIC cal_ACCtlRecLevelForNormalDefog cal_ACCtlRecLevelForSummer cal_ACCtlRecLevelForWinter /end REF_CHARACTERISTIC
/end GROUP
/begin GROUP S154_Subsystem1 "ME11/ME11_TMS/ACC/AutoAc/AutoACFun/RecircModeOut/Subsystem13/Subsystem1" /begin REF_CHARACTERISTIC cal_ACCtlRecLevelForPTCDvt /end REF_CHARACTERISTIC /end GROUP
/begin GROUP S154_Subsystem10 "ME11/ME11_TMS/ACC/AutoAc/AutoACFun/RecircModeOut/Subsystem13/Subsystem10" /begin REF_CHARACTERISTIC cal_ACCtlRecLevelForQkChargeCooling /end REF_CHARACTERISTIC /end GROUP
/begin GROUP S154_Subsystem11 "ME11/ME11_TMS/ACC/AutoAc/AutoACFun/RecircModeOut/Subsystem13/Subsystem11" /begin REF_CHARACTERISTIC cal_ACCtlRecLevelForForceChange /end REF_CHARACTERISTIC /end GROUP
/begin GROUP S154_Subsystem12 "ME11/ME11_TMS/ACC/AutoAc/AutoACFun/RecircModeOut/Subsystem13/Subsystem12" /begin REF_CHARACTERISTIC cal_ACCtlRecLevelForRemoteAC /end REF_CHARACTERISTIC /end GROUP
/begin GROUP S154_Subsystem2 "ME11/ME11_TMS/ACC/AutoAc/AutoACFun/RecircModeOut/Subsystem13/Subsystem2" /begin REF_CHARACTERISTIC cal_ACCtlRecLevelForACHotStart /end REF_CHARACTERISTIC /end GROUP
/begin GROUP S154_Subsystem3 "ME11/ME11_TMS/ACC/AutoAc/AutoACFun/RecircModeOut/Subsystem13/Subsystem3" /begin REF_CHARACTERISTIC cal_ACCtlRecLevelForTargetOutTemp /end REF_CHARACTERISTIC /end GROUP
/begin GROUP S154_Subsystem4 "ME11/ME11_TMS/ACC/AutoAc/AutoACFun/RecircModeOut/Subsystem13/Subsystem4" /begin REF_CHARACTERISTIC cal_ACCtlRecLevelForVent /end REF_CHARACTERISTIC /end GROUP
/begin GROUP S154_Subsystem5 "ME11/ME11_TMS/ACC/AutoAc/AutoACFun/RecircModeOut/Subsystem13/Subsystem5" /begin REF_CHARACTERISTIC cal_ACCtlRecLevelForTempLow /end REF_CHARACTERISTIC /end GROUP
/begin GROUP S154_Subsystem6 "ME11/ME11_TMS/ACC/AutoAc/AutoACFun/RecircModeOut/Subsystem13/Subsystem6" /begin REF_CHARACTERISTIC cal_ACCtlRecLevelForAQS /end REF_CHARACTERISTIC /end GROUP
/begin GROUP S154_Subsystem7 "ME11/ME11_TMS/ACC/AutoAc/AutoACFun/RecircModeOut/Subsystem13/Subsystem7" /begin REF_CHARACTERISTIC cal_ACCtlRecLevelForPCUTemp /end REF_CHARACTERISTIC /end GROUP
/begin GROUP S154_Subsystem8 "ME11/ME11_TMS/ACC/AutoAc/AutoACFun/RecircModeOut/Subsystem13/Subsystem8" /begin REF_CHARACTERISTIC cal_ACCtlRecLevelForForceDefog /end REF_CHARACTERISTIC /end GROUP
/begin GROUP S154_Subsystem9 "ME11/ME11_TMS/ACC/AutoAc/AutoACFun/RecircModeOut/Subsystem13/Subsystem9" /begin REF_CHARACTERISTIC cal_ACCtlRecLevelForManual /end REF_CHARACTERISTIC /end GROUP
/begin GROUP S177_FrontCabinAimTempBasCal "ME11/ME11_TMS/ACC/AutoAc/EvaporatorAndPTCAimTempCal_FIX/DesiredVentTempCal_FIX/CalFrontVentDesireTemp/FrontCabinAimTempBasCal" /begin REF_CHARACTERISTIC cal_FixPIDSecletFlag /end REF_CHARACTERISTIC /end GROUP
/begin GROUP S177_FrontCabinAimTempFeedfowardCorCal "ME11/ME11_TMS/ACC/AutoAc/EvaporatorAndPTCAimTempCal_FIX/DesiredVentTempCal_FIX/CalFrontVentDesireTemp/FrontCabinAimTempFeedfowardCorCal" /begin REF_CHARACTERISTIC cal_U_DVTFFSolarFilterRate /end REF_CHARACTERISTIC /end GROUP
/begin GROUP S1323_A "ME11/ME11_TMS/SOM/BattaryMode/Balance/thermal_storage_enter/B/A" /begin REF_CHARACTERISTIC cal_BatBalCellTemp2 /end REF_CHARACTERISTIC /end GROUP
/begin GROUP S1323_B "ME11/ME11_TMS/SOM/BattaryMode/Balance/thermal_storage_enter/B/B" /begin REF_CHARACTERISTIC cal_BatBalCellTemp2 /end REF_CHARACTERISTIC /end GROUP
/begin GROUP S1323_C "ME11/ME11_TMS/SOM/BattaryMode/Balance/thermal_storage_enter/B/C" /begin REF_CHARACTERISTIC cal_BatBalCellTemp2 /end REF_CHARACTERISTIC /end GROUP
/begin GROUP S1323_D "ME11/ME11_TMS/SOM/BattaryMode/Balance/thermal_storage_enter/B/D" /begin REF_CHARACTERISTIC cal_BatBalCellTemp1 cal_BatBalCellTemp2 /end REF_CHARACTERISTIC /end GROUP
/begin GROUP S181_PID_CalDVT_FIX "ME11/ME11_TMS/ACC/AutoAc/EvaporatorAndPTCAimTempCal_FIX/DesiredVentTempCal_FIX/CalFrontVentDesireTemp/FrontCabinAimTempBasCal/PID_CalDVT_FIX" /begin REF_CHARACTERISTIC cal_DvtDesValPID_LL /end REF_CHARACTERISTIC /end GROUP
