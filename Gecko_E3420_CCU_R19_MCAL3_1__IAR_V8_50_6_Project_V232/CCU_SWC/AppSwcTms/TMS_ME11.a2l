/begin MOD_COMMON "Mod Common Comment Here" BYTE_ORDER MSB_LAST /end MOD_COMMON
/begin RECORD_LAYOUT Scalar_BOOLEAN FNC_VALUES 1 UBYTE COLUMN_DIR DIRECT /end RECORD_LAYOUT
/begin RECORD_LAYOUT Scalar_UBYTE FNC_VALUES 1 UBYTE COLUMN_DIR DIRECT /end RECORD_LAYOUT
/begin RECORD_LAYOUT Scalar_BYTE FNC_VALUES 1 SBYTE COLUMN_DIR DIRECT /end RECORD_LAYOUT
/begin RECORD_LAYOUT Scalar_UWORD FNC_VALUES 1 UWORD COLUMN_DIR DIRECT /end RECORD_LAYOUT
/begin RECORD_LAYOUT Scalar_SWORD FNC_VALUES 1 SWORD COLUMN_DIR DIRECT /end RECORD_LAYOUT
/begin RECORD_LAYOUT Scalar_ULONG FNC_VALUES 1 ULONG COLUMN_DIR DIRECT /end RECORD_LAYOUT
/begin RECORD_LAYOUT Scalar_LONG FNC_VALUES 1 SLONG COLUMN_DIR DIRECT /end RECORD_LAYOUT
/begin RECORD_LAYOUT Scalar_FLOAT32_IEEE FNC_VALUES 1 FLOAT32_IEEE COLUMN_DIR DIRECT /end RECORD_LAYOUT
/begin RECORD_LAYOUT Scalar_FLOAT64_IEEE FNC_VALUES 1 FLOAT64_IEEE COLUMN_DIR DIRECT /end RECORD_LAYOUT
/begin RECORD_LAYOUT Lookup1D_BOOLEAN FNC_VALUES 1 UBYTE COLUMN_DIR DIRECT /end RECORD_LAYOUT
/begin RECORD_LAYOUT Lookup1D_X_BOOLEAN AXIS_PTS_X 1 UBYTE INDEX_INCR DIRECT /end RECORD_LAYOUT
/begin RECORD_LAYOUT Lookup1D_BYTE FNC_VALUES 1 SBYTE COLUMN_DIR DIRECT /end RECORD_LAYOUT
/begin RECORD_LAYOUT Lookup1D_X_BYTE AXIS_PTS_X 1 SBYTE INDEX_INCR DIRECT /end RECORD_LAYOUT
/begin RECORD_LAYOUT Lookup1D_UBYTE FNC_VALUES 1 UBYTE COLUMN_DIR DIRECT /end RECORD_LAYOUT
/begin RECORD_LAYOUT Lookup1D_X_UBYTE AXIS_PTS_X 1 UBYTE INDEX_INCR DIRECT /end RECORD_LAYOUT
/begin RECORD_LAYOUT Lookup1D_UWORD FNC_VALUES 1 UWORD COLUMN_DIR DIRECT /end RECORD_LAYOUT
/begin RECORD_LAYOUT Lookup1D_X_UWORD AXIS_PTS_X 1 UWORD INDEX_INCR DIRECT /end RECORD_LAYOUT
/begin RECORD_LAYOUT Lookup1D_WORD FNC_VALUES 1 SWORD COLUMN_DIR DIRECT /end RECORD_LAYOUT
/begin RECORD_LAYOUT Lookup1D_X_WORD AXIS_PTS_X 1 SWORD INDEX_INCR DIRECT /end RECORD_LAYOUT
/begin RECORD_LAYOUT Lookup1D_ULONG FNC_VALUES 1 ULONG COLUMN_DIR DIRECT /end RECORD_LAYOUT
/begin RECORD_LAYOUT Lookup1D_FLOAT32_IEEE FNC_VALUES 1 FLOAT32_IEEE COLUMN_DIR DIRECT /end RECORD_LAYOUT
/begin RECORD_LAYOUT Lookup1D_X_FLOAT32_IEEE AXIS_PTS_X 1 FLOAT32_IEEE INDEX_INCR DIRECT /end RECORD_LAYOUT
/begin RECORD_LAYOUT Lookup2D_UBYTE FNC_VALUES 1 UBYTE COLUMN_DIR DIRECT /end RECORD_LAYOUT
/begin RECORD_LAYOUT Lookup2D_X_FLOAT32_IEEE AXIS_PTS_X 1 FLOAT32_IEEE INDEX_INCR DIRECT /end RECORD_LAYOUT
/begin CHARACTERISTIC cal_ModeMotorTrgPos_CUR "" CURVE 0x0000 /* @ECU_Address@cal_ModeMotorTrgPos_CUR@ */ Lookup1D_FLOAT32_IEEE 0 ME11_CM_single_v 0.0 5.0
 /begin AXIS_DESCR COM_AXIS NO_INPUT_QUANTITY ME11_CM_uint8_null 5 0.0 8.0 AXIS_PTS_REF cal_ModeMotorTrgPos_1X /end AXIS_DESCR
/end CHARACTERISTIC
/begin AXIS_PTS cal_ModeMotorTrgPos_1X "" 0x0000 /* @ECU_Address@cal_ModeMotorTrgPos_1X@ */ NO_INPUT_QUANTITY Lookup1D_X_UBYTE 0 ME11_CM_uint8_null 5 0.0 8.0 /end AXIS_PTS
/begin CHARACTERISTIC cal_CabinVolAmend_CUR "" CURVE 0x0000 /* @ECU_Address@cal_CabinVolAmend_CUR@ */ Lookup1D_WORD 0 ME11_CM_int16_mv -1000.0 1000.0
 /begin AXIS_DESCR COM_AXIS SENCtl_uCabinVoltage ME11_CM_uint16_mv 2 0.0 5000.0 AXIS_PTS_REF cal_CabinVolAmend_1X /end AXIS_DESCR
/end CHARACTERISTIC
/begin AXIS_PTS cal_CabinVolAmend_1X "" 0x0000 /* @ECU_Address@cal_CabinVolAmend_1X@ */ SENCtl_uCabinVoltage Lookup1D_X_UWORD 0 ME11_CM_uint16_mv 2 0.0 5000.0 /end AXIS_PTS
/begin CHARACTERISTIC cal_TCabinRaw_CUR "" CURVE 0x0000 /* @ECU_Address@cal_TCabinRaw_CUR@ */ Lookup1D_FLOAT32_IEEE 0 ME11_CM_single_C -40.0 100.0
 /begin AXIS_DESCR COM_AXIS NO_INPUT_QUANTITY ME11_CM_single_Kohm 27 0.0 100.0 AXIS_PTS_REF cal_TCabinRaw_1X /end AXIS_DESCR
/end CHARACTERISTIC
/begin AXIS_PTS cal_TCabinRaw_1X "" 0x0000 /* @ECU_Address@cal_TCabinRaw_1X@ */ NO_INPUT_QUANTITY Lookup1D_X_FLOAT32_IEEE 0 ME11_CM_single_Kohm 27 0.0 100.0 /end AXIS_PTS
/begin CHARACTERISTIC cal_ColdPCUTempMinByEnv_CUR "" CURVE 0x0000 /* @ECU_Address@cal_ColdPCUTempMinByEnv_CUR@ */ Lookup1D_FLOAT32_IEEE 0 ME11_CM_single_C -40.0 100.0
 /begin AXIS_DESCR COM_AXIS NO_INPUT_QUANTITY ME11_CM_single_C 15 -40.0 100.0 AXIS_PTS_REF cal_ColdPCUTempMinByEnv_1X /end AXIS_DESCR
/end CHARACTERISTIC
/begin AXIS_PTS cal_ColdPCUTempMinByEnv_1X "" 0x0000 /* @ECU_Address@cal_ColdPCUTempMinByEnv_1X@ */ NO_INPUT_QUANTITY Lookup1D_X_FLOAT32_IEEE 0 ME11_CM_single_C 15 -40.0 100.0 /end AXIS_PTS
/begin CHARACTERISTIC cal_EnvTAme_CUR "" CURVE 0x0000 /* @ECU_Address@cal_EnvTAme_CUR@ */ Lookup1D_FLOAT32_IEEE 0 ME11_CM_single_C -10.0 10.0
 /begin AXIS_DESCR COM_AXIS NO_INPUT_QUANTITY ME11_CM_single_C 11 -40.0 100.0 AXIS_PTS_REF cal_EnvTAme_1X /end AXIS_DESCR
/end CHARACTERISTIC
/begin AXIS_PTS cal_EnvTAme_1X "" 0x0000 /* @ECU_Address@cal_EnvTAme_1X@ */ NO_INPUT_QUANTITY Lookup1D_X_FLOAT32_IEEE 0 ME11_CM_single_C 11 -40.0 100.0 /end AXIS_PTS
/begin CHARACTERISTIC cal_FaceDuctVolAmend_CUR "" CURVE 0x0000 /* @ECU_Address@cal_FaceDuctVolAmend_CUR@ */ Lookup1D_WORD 0 ME11_CM_int16_mv -1000.0 1000.0
 /begin AXIS_DESCR COM_AXIS SENCtl_uFaceDuctVal ME11_CM_uint16_mv 2 0.0 5000.0 AXIS_PTS_REF cal_FaceDuctVolAmend_1X /end AXIS_DESCR
/end CHARACTERISTIC
/begin AXIS_PTS cal_FaceDuctVolAmend_1X "" 0x0000 /* @ECU_Address@cal_FaceDuctVolAmend_1X@ */ SENCtl_uFaceDuctVal Lookup1D_X_UWORD 0 ME11_CM_uint16_mv 2 0.0 5000.0 /end AXIS_PTS
/begin CHARACTERISTIC cal_TDuctRaw_CUR "" CURVE 0x0000 /* @ECU_Address@cal_TDuctRaw_CUR@ */ Lookup1D_FLOAT32_IEEE 0 ME11_CM_single_C -40.0 100.0
 /begin AXIS_DESCR COM_AXIS NO_INPUT_QUANTITY ME11_CM_single_Kohm 26 0.0 100.0 AXIS_PTS_REF cal_TDuctRaw_1X /end AXIS_DESCR
/end CHARACTERISTIC
/begin AXIS_PTS cal_TDuctRaw_1X "" 0x0000 /* @ECU_Address@cal_TDuctRaw_1X@ */ NO_INPUT_QUANTITY Lookup1D_X_FLOAT32_IEEE 0 ME11_CM_single_Kohm 26 0.0 100.0 /end AXIS_PTS
/begin CHARACTERISTIC cal_FootDuctVolAmend_CUR "" CURVE 0x0000 /* @ECU_Address@cal_FootDuctVolAmend_CUR@ */ Lookup1D_WORD 0 ME11_CM_int16_mv -1000.0 1000.0
 /begin AXIS_DESCR COM_AXIS SENCtl_uFootDuctVal ME11_CM_uint16_mv 2 0.0 5000.0 AXIS_PTS_REF cal_FootDuctVolAmend_1X /end AXIS_DESCR
/end CHARACTERISTIC
/begin AXIS_PTS cal_FootDuctVolAmend_1X "" 0x0000 /* @ECU_Address@cal_FootDuctVolAmend_1X@ */ SENCtl_uFootDuctVal Lookup1D_X_UWORD 0 ME11_CM_uint16_mv 2 0.0 5000.0 /end AXIS_PTS
/begin CHARACTERISTIC cal_LoPressRaw_CUR "" CURVE 0x0000 /* @ECU_Address@cal_LoPressRaw_CUR@ */ Lookup1D_FLOAT32_IEEE 0 ME11_CM_single_Mpa 0.0 5.0
 /begin AXIS_DESCR COM_AXIS NO_INPUT_QUANTITY ME11_CM_single_mv 2 0.0 5000.0 AXIS_PTS_REF cal_LoPressRaw_1X /end AXIS_DESCR
/end CHARACTERISTIC
/begin AXIS_PTS cal_LoPressRaw_1X "" 0x0000 /* @ECU_Address@cal_LoPressRaw_1X@ */ NO_INPUT_QUANTITY Lookup1D_X_FLOAT32_IEEE 0 ME11_CM_single_mv 2 0.0 5000.0 /end AXIS_PTS
/begin CHARACTERISTIC cal_WCCLPVolAmend_CUR "" CURVE 0x0000 /* @ECU_Address@cal_WCCLPVolAmend_CUR@ */ Lookup1D_WORD 0 ME11_CM_int16_mv -1000.0 1000.0
 /begin AXIS_DESCR COM_AXIS SENCtl_uWCCLPVol ME11_CM_uint16_mv 2 0.0 5000.0 AXIS_PTS_REF cal_WCCLPVolAmend_1X /end AXIS_DESCR
/end CHARACTERISTIC
/begin AXIS_PTS cal_WCCLPVolAmend_1X "" 0x0000 /* @ECU_Address@cal_WCCLPVolAmend_1X@ */ SENCtl_uWCCLPVol Lookup1D_X_UWORD 0 ME11_CM_uint16_mv 2 0.0 5000.0 /end AXIS_PTS
/begin CHARACTERISTIC cal_MixDoorPerc_CUR "" CURVE 0x0000 /* @ECU_Address@cal_MixDoorPerc_CUR@ */ Lookup1D_FLOAT32_IEEE 0 ME11_CM_single_percent_ 0.0 100.0
 /begin AXIS_DESCR COM_AXIS NO_INPUT_QUANTITY ME11_CM_single_mv 2 0.0 5000.0 AXIS_PTS_REF cal_MixDoorV_1X /end AXIS_DESCR
/end CHARACTERISTIC
/begin AXIS_PTS cal_MixDoorV_1X "" 0x0000 /* @ECU_Address@cal_MixDoorV_1X@ */ NO_INPUT_QUANTITY Lookup1D_X_FLOAT32_IEEE 0 ME11_CM_single_mv 2 0.0 5000.0 /end AXIS_PTS
/begin CHARACTERISTIC cal_MixDoorVolAmend_CUR "" CURVE 0x0000 /* @ECU_Address@cal_MixDoorVolAmend_CUR@ */ Lookup1D_WORD 0 ME11_CM_int16_mv -1000.0 1000.0
 /begin AXIS_DESCR COM_AXIS SENCtl_uMixDoorVol ME11_CM_uint16_mv 2 0.0 5000.0 AXIS_PTS_REF cal_MixDoorVolAmend_1X /end AXIS_DESCR
/end CHARACTERISTIC
/begin AXIS_PTS cal_MixDoorVolAmend_1X "" 0x0000 /* @ECU_Address@cal_MixDoorVolAmend_1X@ */ SENCtl_uMixDoorVol Lookup1D_X_UWORD 0 ME11_CM_uint16_mv 2 0.0 5000.0 /end AXIS_PTS
/begin CHARACTERISTIC cal_ModeDoorVolAmend_CUR "" CURVE 0x0000 /* @ECU_Address@cal_ModeDoorVolAmend_CUR@ */ Lookup1D_WORD 0 ME11_CM_int16_mv -1000.0 1000.0
 /begin AXIS_DESCR COM_AXIS SENCtl_uModeDoorVol ME11_CM_uint16_mv 2 0.0 5000.0 AXIS_PTS_REF cal_ModeDoorVolAmend_1X /end AXIS_DESCR
/end CHARACTERISTIC
/begin AXIS_PTS cal_ModeDoorVolAmend_1X "" 0x0000 /* @ECU_Address@cal_ModeDoorVolAmend_1X@ */ SENCtl_uModeDoorVol Lookup1D_X_UWORD 0 ME11_CM_uint16_mv 2 0.0 5000.0 /end AXIS_PTS
/begin CHARACTERISTIC cal_RecirActVal_CUR "" CURVE 0x0000 /* @ECU_Address@cal_RecirActVal_CUR@ */ Lookup1D_UBYTE 0 ME11_CM_uint8_percent_ 0.0 110.0
 /begin AXIS_DESCR COM_AXIS NO_INPUT_QUANTITY ME11_CM_single_v 2 0.0 5.0 AXIS_PTS_REF cal_RecirActVal_1X /end AXIS_DESCR
/end CHARACTERISTIC
/begin AXIS_PTS cal_RecirActVal_1X "" 0x0000 /* @ECU_Address@cal_RecirActVal_1X@ */ NO_INPUT_QUANTITY Lookup1D_X_FLOAT32_IEEE 0 ME11_CM_single_v 2 0.0 5.0 /end AXIS_PTS
/begin CHARACTERISTIC cal_RecircDoorVolAmend_CUR "" CURVE 0x0000 /* @ECU_Address@cal_RecircDoorVolAmend_CUR@ */ Lookup1D_WORD 0 ME11_CM_int16_mv -1000.0 1000.0
 /begin AXIS_DESCR COM_AXIS SENCtl_uRecircDoorVol ME11_CM_uint16_mv 2 0.0 5000.0 AXIS_PTS_REF cal_RecircDoorVolAmend_1X /end AXIS_DESCR
/end CHARACTERISTIC
/begin AXIS_PTS cal_RecircDoorVolAmend_1X "" 0x0000 /* @ECU_Address@cal_RecircDoorVolAmend_1X@ */ SENCtl_uRecircDoorVol Lookup1D_X_UWORD 0 ME11_CM_uint16_mv 2 0.0 5000.0 /end AXIS_PTS
/begin CHARACTERISTIC cal_SolarValRaw_CUR "" CURVE 0x0000 /* @ECU_Address@cal_SolarValRaw_CUR@ */ Lookup1D_UWORD 0 ME11_CM_uint16_w_per_m_2 0.0 1200.0
 /begin AXIS_DESCR COM_AXIS NO_INPUT_QUANTITY ME11_CM_single_v 11 0.0 5.0 AXIS_PTS_REF cal_SolarValRaw_1X /end AXIS_DESCR
/end CHARACTERISTIC
/begin AXIS_PTS cal_SolarValRaw_1X "" 0x0000 /* @ECU_Address@cal_SolarValRaw_1X@ */ NO_INPUT_QUANTITY Lookup1D_X_FLOAT32_IEEE 0 ME11_CM_single_v 11 0.0 5.0 /end AXIS_PTS
/begin CHARACTERISTIC cal_SolorVolAmend_CUR "" CURVE 0x0000 /* @ECU_Address@cal_SolorVolAmend_CUR@ */ Lookup1D_WORD 0 ME11_CM_int16_mv -1000.0 1000.0
 /begin AXIS_DESCR COM_AXIS SENCtl_uSolorVol ME11_CM_uint16_mv 2 0.0 5000.0 AXIS_PTS_REF cal_SolorVolAmend_1X /end AXIS_DESCR
/end CHARACTERISTIC
/begin AXIS_PTS cal_SolorVolAmend_1X "" 0x0000 /* @ECU_Address@cal_SolorVolAmend_1X@ */ SENCtl_uSolorVol Lookup1D_X_UWORD 0 ME11_CM_uint16_mv 2 0.0 5000.0 /end AXIS_PTS
/begin CHARACTERISTIC cal_ChillTempVolAmend_CUR "" CURVE 0x0000 /* @ECU_Address@cal_ChillTempVolAmend_CUR@ */ Lookup1D_WORD 0 ME11_CM_int16_mv -1000.0 1000.0
 /begin AXIS_DESCR COM_AXIS SENCtl_uChillTempVol ME11_CM_uint16_mv 2 0.0 5000.0 AXIS_PTS_REF cal_ChillTempVolAmend_1X /end AXIS_DESCR
/end CHARACTERISTIC
/begin AXIS_PTS cal_ChillTempVolAmend_1X "" 0x0000 /* @ECU_Address@cal_ChillTempVolAmend_1X@ */ SENCtl_uChillTempVol Lookup1D_X_UWORD 0 ME11_CM_uint16_mv 2 0.0 5000.0 /end AXIS_PTS
/begin CHARACTERISTIC cal_TChillOutRaw_CUR "" CURVE 0x0000 /* @ECU_Address@cal_TChillOutRaw_CUR@ */ Lookup1D_FLOAT32_IEEE 0 ME11_CM_single_C -40.0 160.0
 /begin AXIS_DESCR COM_AXIS NO_INPUT_QUANTITY ME11_CM_single_ohm 27 0.0 1.0E+6 AXIS_PTS_REF cal_TChillOutRaw_1X /end AXIS_DESCR
/end CHARACTERISTIC
/begin AXIS_PTS cal_TChillOutRaw_1X "" 0x0000 /* @ECU_Address@cal_TChillOutRaw_1X@ */ NO_INPUT_QUANTITY Lookup1D_X_FLOAT32_IEEE 0 ME11_CM_single_ohm 27 0.0 1.0E+6 /end AXIS_PTS
/begin CHARACTERISTIC cal_EnvVolAmend_CUR "" CURVE 0x0000 /* @ECU_Address@cal_EnvVolAmend_CUR@ */ Lookup1D_WORD 0 ME11_CM_int16_mv -1000.0 1000.0
 /begin AXIS_DESCR COM_AXIS SENCtl_uEnvVoltage ME11_CM_uint16_mv 2 0.0 5000.0 AXIS_PTS_REF cal_EnvVolAmend_1X /end AXIS_DESCR
/end CHARACTERISTIC
/begin AXIS_PTS cal_EnvVolAmend_1X "" 0x0000 /* @ECU_Address@cal_EnvVolAmend_1X@ */ SENCtl_uEnvVoltage Lookup1D_X_UWORD 0 ME11_CM_uint16_mv 2 0.0 5000.0 /end AXIS_PTS
/begin CHARACTERISTIC cal_TEnvRaw_CUR "" CURVE 0x0000 /* @ECU_Address@cal_TEnvRaw_CUR@ */ Lookup1D_FLOAT32_IEEE 0 ME11_CM_single_C -40.0 100.0
 /begin AXIS_DESCR COM_AXIS NO_INPUT_QUANTITY ME11_CM_single_Kohm 27 0.0 100.0 AXIS_PTS_REF cal_TEnvRaw_1X /end AXIS_DESCR
/end CHARACTERISTIC
/begin AXIS_PTS cal_TEnvRaw_1X "" 0x0000 /* @ECU_Address@cal_TEnvRaw_1X@ */ NO_INPUT_QUANTITY Lookup1D_X_FLOAT32_IEEE 0 ME11_CM_single_Kohm 27 0.0 100.0 /end AXIS_PTS
/begin CHARACTERISTIC cal_EVAPTempVolAmend_CUR "" CURVE 0x0000 /* @ECU_Address@cal_EVAPTempVolAmend_CUR@ */ Lookup1D_WORD 0 ME11_CM_int16_mv -1000.0 1000.0
 /begin AXIS_DESCR COM_AXIS SENCtl_uEVAPXTempVol ME11_CM_uint16_mv 2 0.0 5000.0 AXIS_PTS_REF cal_EVAPTempVolAmend_1X /end AXIS_DESCR
/end CHARACTERISTIC
/begin AXIS_PTS cal_EVAPTempVolAmend_1X "" 0x0000 /* @ECU_Address@cal_EVAPTempVolAmend_1X@ */ SENCtl_uEVAPXTempVol Lookup1D_X_UWORD 0 ME11_CM_uint16_mv 2 0.0 5000.0 /end AXIS_PTS
/begin CHARACTERISTIC cal_TEvapOutRaw_CUR "" CURVE 0x0000 /* @ECU_Address@cal_TEvapOutRaw_CUR@ */ Lookup1D_FLOAT32_IEEE 0 ME11_CM_single_C -40.0 160.0
 /begin AXIS_DESCR COM_AXIS NO_INPUT_QUANTITY ME11_CM_single_ohm 30 0.0 100000.0 AXIS_PTS_REF cal_TEvapOutRaw_1X /end AXIS_DESCR
/end CHARACTERISTIC
/begin AXIS_PTS cal_TEvapOutRaw_1X "" 0x0000 /* @ECU_Address@cal_TEvapOutRaw_1X@ */ NO_INPUT_QUANTITY Lookup1D_X_FLOAT32_IEEE 0 ME11_CM_single_ohm 30 0.0 100000.0 /end AXIS_PTS
/begin CHARACTERISTIC cal_EVAPSurfTempVolAmend_CUR "" CURVE 0x0000 /* @ECU_Address@cal_EVAPSurfTempVolAmend_CUR@ */ Lookup1D_WORD 0 ME11_CM_int16_mv -1000.0 1000.0
 /begin AXIS_DESCR COM_AXIS SENCtl_uEVAPSurfTempVol ME11_CM_uint16_mv 2 0.0 5000.0 AXIS_PTS_REF cal_EVAPSurfTempVolAmend_1X /end AXIS_DESCR
/end CHARACTERISTIC
/begin AXIS_PTS cal_EVAPSurfTempVolAmend_1X "" 0x0000 /* @ECU_Address@cal_EVAPSurfTempVolAmend_1X@ */ SENCtl_uEVAPSurfTempVol Lookup1D_X_UWORD 0 ME11_CM_uint16_mv 2 0.0 5000.0 /end AXIS_PTS
/begin CHARACTERISTIC cal_TEvapSurfRaw_CUR "" CURVE 0x0000 /* @ECU_Address@cal_TEvapSurfRaw_CUR@ */ Lookup1D_FLOAT32_IEEE 0 ME11_CM_single_C -60.0 150.0
 /begin AXIS_DESCR COM_AXIS NO_INPUT_QUANTITY ME11_CM_single_Kohm 23 0.0 149.0 AXIS_PTS_REF cal_TEvapSurfRaw_1X /end AXIS_DESCR
/end CHARACTERISTIC
/begin AXIS_PTS cal_TEvapSurfRaw_1X "" 0x0000 /* @ECU_Address@cal_TEvapSurfRaw_1X@ */ NO_INPUT_QUANTITY Lookup1D_X_FLOAT32_IEEE 0 ME11_CM_single_Kohm 23 0.0 149.0 /end AXIS_PTS
/begin CHARACTERISTIC cal_MotInletTempVolAmend_CUR "" CURVE 0x0000 /* @ECU_Address@cal_MotInletTempVolAmend_CUR@ */ Lookup1D_WORD 0 ME11_CM_int16_mv -1000.0 1000.0
 /begin AXIS_DESCR COM_AXIS SENCtl_uMotInletTempVol ME11_CM_uint16_mv 2 0.0 5000.0 AXIS_PTS_REF cal_MotInletTempVolAmend_1X /end AXIS_DESCR
/end CHARACTERISTIC
/begin AXIS_PTS cal_MotInletTempVolAmend_1X "" 0x0000 /* @ECU_Address@cal_MotInletTempVolAmend_1X@ */ SENCtl_uMotInletTempVol Lookup1D_X_UWORD 0 ME11_CM_uint16_mv 2 0.0 5000.0 /end AXIS_PTS
/begin CHARACTERISTIC cal_TMotEntRaw_CUR "" CURVE 0x0000 /* @ECU_Address@cal_TMotEntRaw_CUR@ */ Lookup1D_FLOAT32_IEEE 0 ME11_CM_single_C -60.0 150.0
 /begin AXIS_DESCR COM_AXIS NO_INPUT_QUANTITY ME11_CM_single_ohm 17 0.0 1.0E+6 AXIS_PTS_REF cal_TMotEntRaw_1X /end AXIS_DESCR
/end CHARACTERISTIC
/begin AXIS_PTS cal_TMotEntRaw_1X "" 0x0000 /* @ECU_Address@cal_TMotEntRaw_1X@ */ NO_INPUT_QUANTITY Lookup1D_X_FLOAT32_IEEE 0 ME11_CM_single_ohm 17 0.0 1.0E+6 /end AXIS_PTS
/begin CHARACTERISTIC cal_TOHXOutRaw_CUR "" CURVE 0x0000 /* @ECU_Address@cal_TOHXOutRaw_CUR@ */ Lookup1D_FLOAT32_IEEE 0 ME11_CM_single_C -40.0 160.0
 /begin AXIS_DESCR COM_AXIS NO_INPUT_QUANTITY ME11_CM_single_ohm 30 0.0 100000.0 AXIS_PTS_REF cal_TOHXOutRaw_1X /end AXIS_DESCR
/end CHARACTERISTIC
/begin AXIS_PTS cal_TOHXOutRaw_1X "" 0x0000 /* @ECU_Address@cal_TOHXOutRaw_1X@ */ NO_INPUT_QUANTITY Lookup1D_X_FLOAT32_IEEE 0 ME11_CM_single_ohm 30 0.0 100000.0 /end AXIS_PTS
/begin CHARACTERISTIC cal_OHXTempVolAmend_CUR "" CURVE 0x0000 /* @ECU_Address@cal_OHXTempVolAmend_CUR@ */ Lookup1D_WORD 0 ME11_CM_int16_mv -1000.0 1000.0
 /begin AXIS_DESCR COM_AXIS SENCtl_uOHXTempVol ME11_CM_uint16_mv 2 0.0 5000.0 AXIS_PTS_REF cal_OHXTempVolAmend_1X /end AXIS_DESCR
/end CHARACTERISTIC
/begin AXIS_PTS cal_OHXTempVolAmend_1X "" 0x0000 /* @ECU_Address@cal_OHXTempVolAmend_1X@ */ SENCtl_uOHXTempVol Lookup1D_X_UWORD 0 ME11_CM_uint16_mv 2 0.0 5000.0 /end AXIS_PTS
/begin CHARACTERISTIC cal_WCCHighTempVolAmend_CUR "" CURVE 0x0000 /* @ECU_Address@cal_WCCHighTempVolAmend_CUR@ */ Lookup1D_WORD 0 ME11_CM_int16_mv -1000.0 1000.0
 /begin AXIS_DESCR COM_AXIS SENCtl_uWCCHighTempVol ME11_CM_uint16_mv 2 0.0 5000.0 AXIS_PTS_REF cal_WCCHighTempVolAmend_1X /end AXIS_DESCR
/end CHARACTERISTIC
/begin AXIS_PTS cal_WCCHighTempVolAmend_1X "" 0x0000 /* @ECU_Address@cal_WCCHighTempVolAmend_1X@ */ SENCtl_uWCCHighTempVol Lookup1D_X_UWORD 0 ME11_CM_uint16_mv 2 0.0 5000.0 /end AXIS_PTS
/begin CHARACTERISTIC cal_TLCCOutRaw_CUR "" CURVE 0x0000 /* @ECU_Address@cal_TLCCOutRaw_CUR@ */ Lookup1D_FLOAT32_IEEE 0 ME11_CM_single_C -40.0 160.0
 /begin AXIS_DESCR COM_AXIS NO_INPUT_QUANTITY ME11_CM_single_ohm 20 0.0 1.0E+6 AXIS_PTS_REF cal_TLCCOutRaw_1X /end AXIS_DESCR
/end CHARACTERISTIC
/begin AXIS_PTS cal_TLCCOutRaw_1X "" 0x0000 /* @ECU_Address@cal_TLCCOutRaw_1X@ */ NO_INPUT_QUANTITY Lookup1D_X_FLOAT32_IEEE 0 ME11_CM_single_ohm 20 0.0 1.0E+6 /end AXIS_PTS
/begin CHARACTERISTIC cal_LCCOutHiPressRaw_CUR "" CURVE 0x0000 /* @ECU_Address@cal_LCCOutHiPressRaw_CUR@ */ Lookup1D_FLOAT32_IEEE 0 ME11_CM_single_Mpa 0.0 10.0
 /begin AXIS_DESCR COM_AXIS NO_INPUT_QUANTITY ME11_CM_single_mv 2 0.0 5000.0 AXIS_PTS_REF cal_LCCOutHiPressRaw_1X /end AXIS_DESCR
/end CHARACTERISTIC
/begin AXIS_PTS cal_LCCOutHiPressRaw_1X "" 0x0000 /* @ECU_Address@cal_LCCOutHiPressRaw_1X@ */ NO_INPUT_QUANTITY Lookup1D_X_FLOAT32_IEEE 0 ME11_CM_single_mv 2 0.0 5000.0 /end AXIS_PTS
/begin CHARACTERISTIC cal_WCCHPVolAmend_CUR "" CURVE 0x0000 /* @ECU_Address@cal_WCCHPVolAmend_CUR@ */ Lookup1D_WORD 0 ME11_CM_int16_mv -1000.0 1000.0
 /begin AXIS_DESCR COM_AXIS SENCtl_uWCCHPVol ME11_CM_uint16_mv 2 0.0 5000.0 AXIS_PTS_REF cal_WCCHPVolAmend_1X /end AXIS_DESCR
/end CHARACTERISTIC
/begin AXIS_PTS cal_WCCHPVolAmend_1X "" 0x0000 /* @ECU_Address@cal_WCCHPVolAmend_1X@ */ SENCtl_uWCCHPVol Lookup1D_X_UWORD 0 ME11_CM_uint16_mv 2 0.0 5000.0 /end AXIS_PTS
/begin CHARACTERISTIC cal_ACCMHighTempVolAmend_CUR "" CURVE 0x0000 /* @ECU_Address@cal_ACCMHighTempVolAmend_CUR@ */ Lookup1D_WORD 0 ME11_CM_int16_mv -1000.0 1000.0
 /begin AXIS_DESCR COM_AXIS SENCtl_uACCMHighTempVol ME11_CM_uint16_mv 2 0.0 5000.0 AXIS_PTS_REF cal_ACCMHighTempVolAmend_1X /end AXIS_DESCR
/end CHARACTERISTIC
/begin AXIS_PTS cal_ACCMHighTempVolAmend_1X "" 0x0000 /* @ECU_Address@cal_ACCMHighTempVolAmend_1X@ */ SENCtl_uACCMHighTempVol Lookup1D_X_UWORD 0 ME11_CM_uint16_mv 2 0.0 5000.0 /end AXIS_PTS
/begin CHARACTERISTIC cal_TACCMOutRaw_CUR "" CURVE 0x0000 /* @ECU_Address@cal_TACCMOutRaw_CUR@ */ Lookup1D_FLOAT32_IEEE 0 ME11_CM_single_C -40.0 160.0
 /begin AXIS_DESCR COM_AXIS NO_INPUT_QUANTITY ME11_CM_single_ohm 30 0.0 1.0E+6 AXIS_PTS_REF cal_TACCMOutRaw_1X /end AXIS_DESCR
/end CHARACTERISTIC
/begin AXIS_PTS cal_TACCMOutRaw_1X "" 0x0000 /* @ECU_Address@cal_TACCMOutRaw_1X@ */ NO_INPUT_QUANTITY Lookup1D_X_FLOAT32_IEEE 0 ME11_CM_single_ohm 30 0.0 1.0E+6 /end AXIS_PTS
/begin CHARACTERISTIC cal_CondDep_CUR "" CURVE 0x0000 /* @ECU_Address@cal_CondDep_CUR@ */ Lookup1D_FLOAT32_IEEE 0 ME11_CM_single_C -100.0 120.0
 /begin AXIS_DESCR COM_AXIS ACSen_sHiPressFilter ME11_CM_single_Mpa 28 0.0 10.0 AXIS_PTS_REF cal_CondDep_1X /end AXIS_DESCR
/end CHARACTERISTIC
/begin AXIS_PTS cal_CondDep_1X "" 0x0000 /* @ECU_Address@cal_CondDep_1X@ */ ACSen_sHiPressFilter Lookup1D_X_FLOAT32_IEEE 0 ME11_CM_single_Mpa 28 0.0 10.0 /end AXIS_PTS
/begin CHARACTERISTIC cal_SuperHeat_CUR "" CURVE 0x0000 /* @ECU_Address@cal_SuperHeat_CUR@ */ Lookup1D_FLOAT32_IEEE 0 ME11_CM_single_C -100.0 120.0
 /begin AXIS_DESCR COM_AXIS ACSen_sLoPressFilter ME11_CM_single_Mpa 28 0.0 10.0 AXIS_PTS_REF cal_SuperHeat_1X /end AXIS_DESCR
/end CHARACTERISTIC
/begin AXIS_PTS cal_SuperHeat_1X "" 0x0000 /* @ECU_Address@cal_SuperHeat_1X@ */ ACSen_sLoPressFilter Lookup1D_X_FLOAT32_IEEE 0 ME11_CM_single_Mpa 28 0.0 10.0 /end AXIS_PTS
/begin CHARACTERISTIC cal_CoolFanCtrl_MAP "" MAP 0x0000 /* @ECU_Address@cal_CoolFanCtrl_MAP@ */ Lookup2D_UBYTE 0 ME11_CM_uint8_percent_ 0.0 100.0
 /begin AXIS_DESCR COM_AXIS ACSen_sHiPressFilter ME11_CM_single_Mpa 13 0.0 30.0 AXIS_PTS_REF cal_CoolFanCtrl_2Y /end AXIS_DESCR
 /begin AXIS_DESCR COM_AXIS NO_INPUT_QUANTITY ME11_CM_single_km_per_h 4 0.0 150.0 AXIS_PTS_REF cal_CoolFanCtrl_2X /end AXIS_DESCR
/end CHARACTERISTIC
/begin AXIS_PTS cal_CoolFanCtrl_2X "" 0x0000 /* @ECU_Address@cal_CoolFanCtrl_2X@ */ NO_INPUT_QUANTITY Lookup2D_X_FLOAT32_IEEE 0 ME11_CM_single_km_per_h 4 0.0 150.0 /end AXIS_PTS
/begin AXIS_PTS cal_CoolFanCtrl_2Y "" 0x0000 /* @ECU_Address@cal_CoolFanCtrl_2Y@ */ ACSen_sHiPressFilter Lookup2D_X_FLOAT32_IEEE 0 ME11_CM_single_Mpa 13 0.0 30.0 /end AXIS_PTS
/begin CHARACTERISTIC cal_HeatFanCtrl_MAP "" MAP 0x0000 /* @ECU_Address@cal_HeatFanCtrl_MAP@ */ Lookup2D_UBYTE 0 ME11_CM_uint8_percent_ 0.0 100.0
 /begin AXIS_DESCR COM_AXIS NO_INPUT_QUANTITY ME11_CM_single_C 13 -60.0 60.0 AXIS_PTS_REF cal_HeatFanCtrl_2Y /end AXIS_DESCR
 /begin AXIS_DESCR COM_AXIS NO_INPUT_QUANTITY ME11_CM_single_km_per_h 4 0.0 150.0 AXIS_PTS_REF cal_HeatFanCtrl_2X /end AXIS_DESCR
/end CHARACTERISTIC
/begin AXIS_PTS cal_HeatFanCtrl_2X "" 0x0000 /* @ECU_Address@cal_HeatFanCtrl_2X@ */ NO_INPUT_QUANTITY Lookup2D_X_FLOAT32_IEEE 0 ME11_CM_single_km_per_h 4 0.0 150.0 /end AXIS_PTS
/begin AXIS_PTS cal_HeatFanCtrl_2Y "" 0x0000 /* @ECU_Address@cal_HeatFanCtrl_2Y@ */ NO_INPUT_QUANTITY Lookup2D_X_FLOAT32_IEEE 0 ME11_CM_single_C 13 -60.0 60.0 /end AXIS_PTS
/begin CHARACTERISTIC cal_PTCBatHeatPwrLmt_CUR "" CURVE 0x0000 /* @ECU_Address@cal_PTCBatHeatPwrLmt_CUR@ */ Lookup1D_FLOAT32_IEEE 0 ME11_CM_single_kw 0.0 10.0
 /begin AXIS_DESCR COM_AXIS NO_INPUT_QUANTITY ME11_CM_single_C 9 -10.0 40.0 AXIS_PTS_REF cal_PTCBatHeatPwrLmt_1X /end AXIS_DESCR
/end CHARACTERISTIC
/begin AXIS_PTS cal_PTCBatHeatPwrLmt_1X "" 0x0000 /* @ECU_Address@cal_PTCBatHeatPwrLmt_1X@ */ NO_INPUT_QUANTITY Lookup1D_X_FLOAT32_IEEE 0 ME11_CM_single_C 9 -10.0 40.0 /end AXIS_PTS
/begin CHARACTERISTIC cal_SOCHighPTCPwrLmt_CUR "" CURVE 0x0000 /* @ECU_Address@cal_SOCHighPTCPwrLmt_CUR@ */ Lookup1D_FLOAT32_IEEE 0 ME11_CM_single_kw 0.0 10.0
 /begin AXIS_DESCR COM_AXIS HMICtl_sLeftSetPoint ME11_CM_single_C 6 15.0 32.0 AXIS_PTS_REF cal_SOCHighPTCPwrLmt_1X /end AXIS_DESCR
/end CHARACTERISTIC
/begin AXIS_PTS cal_SOCHighPTCPwrLmt_1X "" 0x0000 /* @ECU_Address@cal_SOCHighPTCPwrLmt_1X@ */ HMICtl_sLeftSetPoint Lookup1D_X_FLOAT32_IEEE 0 ME11_CM_single_C 6 15.0 32.0 /end AXIS_PTS
/begin CHARACTERISTIC cal_BatPumpBal_CUR "" CURVE 0x0000 /* @ECU_Address@cal_BatPumpBal_CUR@ */ Lookup1D_UBYTE 0 ME11_CM_uint8_percent_ 0.0 255.0
 /begin AXIS_DESCR COM_AXIS NO_INPUT_QUANTITY ME11_CM_single_C 4 0.0 20.0 AXIS_PTS_REF cal_BatPumpBal_1X /end AXIS_DESCR
/end CHARACTERISTIC
/begin AXIS_PTS cal_BatPumpBal_1X "" 0x0000 /* @ECU_Address@cal_BatPumpBal_1X@ */ NO_INPUT_QUANTITY Lookup1D_X_FLOAT32_IEEE 0 ME11_CM_single_C 4 0.0 20.0 /end AXIS_PTS
/begin CHARACTERISTIC cal_BatPumpThSto_CUR "" CURVE 0x0000 /* @ECU_Address@cal_BatPumpThSto_CUR@ */ Lookup1D_UBYTE 0 ME11_CM_uint8_percent_ 0.0 255.0
 /begin AXIS_DESCR COM_AXIS NO_INPUT_QUANTITY ME11_CM_single_C 4 0.0 20.0 AXIS_PTS_REF cal_BatPumpThSto_1X /end AXIS_DESCR
/end CHARACTERISTIC
/begin AXIS_PTS cal_BatPumpThSto_1X "" 0x0000 /* @ECU_Address@cal_BatPumpThSto_1X@ */ NO_INPUT_QUANTITY Lookup1D_X_FLOAT32_IEEE 0 ME11_CM_single_C 4 0.0 20.0 /end AXIS_PTS
/begin CHARACTERISTIC cal_ColdStartPCUTempMinByEnv_CUR "" CURVE 0x0000 /* @ECU_Address@cal_ColdStartPCUTempMinByEnv_CUR@ */ Lookup1D_FLOAT32_IEEE 0 ME11_CM_single_C -40.0 100.0
 /begin AXIS_DESCR COM_AXIS EE_tEnv ME11_CM_single_C 7 -40.0 100.0 AXIS_PTS_REF cal_ColdStartPCUTempMinByEnv_1X /end AXIS_DESCR
/end CHARACTERISTIC
/begin AXIS_PTS cal_ColdStartPCUTempMinByEnv_1X "" 0x0000 /* @ECU_Address@cal_ColdStartPCUTempMinByEnv_1X@ */ EE_tEnv Lookup1D_X_FLOAT32_IEEE 0 ME11_CM_single_C 7 -40.0 100.0 /end AXIS_PTS
/begin CHARACTERISTIC cal_PCUtempOffset2ShutByEnv_CUR "" CURVE 0x0000 /* @ECU_Address@cal_PCUtempOffset2ShutByEnv_CUR@ */ Lookup1D_FLOAT32_IEEE 0 ME11_CM_single_C -40.0 100.0
 /begin AXIS_DESCR COM_AXIS EE_tEnv ME11_CM_single_C 7 -40.0 100.0 AXIS_PTS_REF cal_PCUtempOffset2ShutByEnv_1X /end AXIS_DESCR
/end CHARACTERISTIC
/begin AXIS_PTS cal_PCUtempOffset2ShutByEnv_1X "" 0x0000 /* @ECU_Address@cal_PCUtempOffset2ShutByEnv_1X@ */ EE_tEnv Lookup1D_X_FLOAT32_IEEE 0 ME11_CM_single_C 7 -40.0 100.0 /end AXIS_PTS
/begin CHARACTERISTIC cal_ACCMClsEnvTemp "" VALUE 0x0000 /* @ECU_Address@cal_ACCMClsEnvTemp@ */ Scalar_FLOAT32_IEEE 0 ME11_CM_single_C -30.0 10.0 /end CHARACTERISTIC
/begin CHARACTERISTIC cal_ACCMCtlKiDeadzoneNeg "" VALUE 0x0000 /* @ECU_Address@cal_ACCMCtlKiDeadzoneNeg@ */ Scalar_FLOAT32_IEEE 0 ME11_CM_single_C 0.0 10.0 /end CHARACTERISTIC
/begin CHARACTERISTIC cal_ACCMCtlKiDeadzonePos "" VALUE 0x0000 /* @ECU_Address@cal_ACCMCtlKiDeadzonePos@ */ Scalar_FLOAT32_IEEE 0 ME11_CM_single_C 0.0 10.0 /end CHARACTERISTIC
/begin CHARACTERISTIC cal_ACCMCtlKpDeadzoneNeg "" VALUE 0x0000 /* @ECU_Address@cal_ACCMCtlKpDeadzoneNeg@ */ Scalar_FLOAT32_IEEE 0 ME11_CM_single_C 0.0 10.0 /end CHARACTERISTIC
/begin CHARACTERISTIC cal_ACCMCtlKpDeadzonePos "" VALUE 0x0000 /* @ECU_Address@cal_ACCMCtlKpDeadzonePos@ */ Scalar_FLOAT32_IEEE 0 ME11_CM_single_C 0.0 10.0 /end CHARACTERISTIC
/begin CHARACTERISTIC cal_ACCMCtlPID_IsumMax "" VALUE 0x0000 /* @ECU_Address@cal_ACCMCtlPID_IsumMax@ */ Scalar_FLOAT32_IEEE 0 ME11_CM_single_rpm 0.0 10000.0 /end CHARACTERISTIC
/begin CHARACTERISTIC cal_ACCMCtlPID_IsumMin "" VALUE 0x0000 /* @ECU_Address@cal_ACCMCtlPID_IsumMin@ */ Scalar_FLOAT32_IEEE 0 ME11_CM_single_rpm -10000.0 10000.0 /end CHARACTERISTIC
/begin CHARACTERISTIC cal_ACCMCtrlKi "" VALUE 0x0000 /* @ECU_Address@cal_ACCMCtrlKi@ */ Scalar_FLOAT32_IEEE 0 ME11_CM_single_null 0.0 100.0 /end CHARACTERISTIC
/begin CHARACTERISTIC cal_ACCMCtrlKp "" VALUE 0x0000 /* @ECU_Address@cal_ACCMCtrlKp@ */ Scalar_FLOAT32_IEEE 0 ME11_CM_single_null 0.0 100.0 /end CHARACTERISTIC
/begin CHARACTERISTIC cal_ACCMHiTempData "" VALUE 0x0000 /* @ECU_Address@cal_ACCMHiTempData@ */ Scalar_FLOAT32_IEEE 0 ME11_CM_single_C -50.0 150.0 /end CHARACTERISTIC
/begin CHARACTERISTIC cal_ACCMHiTempFanOff "" VALUE 0x0000 /* @ECU_Address@cal_ACCMHiTempFanOff@ */ Scalar_FLOAT32_IEEE 0 ME11_CM_single_C 0.0 100.0 /end CHARACTERISTIC
/begin CHARACTERISTIC cal_ACCMHiTempFanOn "" VALUE 0x0000 /* @ECU_Address@cal_ACCMHiTempFanOn@ */ Scalar_FLOAT32_IEEE 0 ME11_CM_single_C 0.0 100.0 /end CHARACTERISTIC
/begin CHARACTERISTIC cal_ACCMOpenEnvTemp "" VALUE 0x0000 /* @ECU_Address@cal_ACCMOpenEnvTemp@ */ Scalar_FLOAT32_IEEE 0 ME11_CM_single_C -30.0 10.0 /end CHARACTERISTIC
/begin CHARACTERISTIC cal_ADCVCCVal "" VALUE 0x0000 /* @ECU_Address@cal_ADCVCCVal@ */ Scalar_FLOAT32_IEEE 0 ME11_CM_single_mv 0.0 5500.0 /end CHARACTERISTIC
/begin CHARACTERISTIC cal_BatHeatTrgTemp "" VALUE 0x0000 /* @ECU_Address@cal_BatHeatTrgTemp@ */ Scalar_FLOAT32_IEEE 0 ME11_CM_single_C 0.0 100.0 /end CHARACTERISTIC
/begin CHARACTERISTIC cal_BatTrgTempData "" VALUE 0x0000 /* @ECU_Address@cal_BatTrgTempData@ */ Scalar_FLOAT32_IEEE 0 ME11_CM_single_C 0.0 80.0 /end CHARACTERISTIC
/begin CHARACTERISTIC cal_COMPClsLowSpeed "" VALUE 0x0000 /* @ECU_Address@cal_COMPClsLowSpeed@ */ Scalar_FLOAT32_IEEE 0 ME11_CM_single_rpm 0.0 2000.0 /end CHARACTERISTIC
/begin CHARACTERISTIC cal_COMPEvapTFrbVal "" VALUE 0x0000 /* @ECU_Address@cal_COMPEvapTFrbVal@ */ Scalar_FLOAT32_IEEE 0 ME11_CM_single_C -60.0 10.0 /end CHARACTERISTIC
/begin CHARACTERISTIC cal_COMPEvapTNmlVal "" VALUE 0x0000 /* @ECU_Address@cal_COMPEvapTNmlVal@ */ Scalar_FLOAT32_IEEE 0 ME11_CM_single_C -10.0 10.0 /end CHARACTERISTIC
/begin CHARACTERISTIC cal_COMPExhTFrbVal "" VALUE 0x0000 /* @ECU_Address@cal_COMPExhTFrbVal@ */ Scalar_FLOAT32_IEEE 0 ME11_CM_single_C 0.0 150.0 /end CHARACTERISTIC
/begin CHARACTERISTIC cal_COMPExhTLmtRlybVal "" VALUE 0x0000 /* @ECU_Address@cal_COMPExhTLmtRlybVal@ */ Scalar_FLOAT32_IEEE 0 ME11_CM_single_C 0.0 150.0 /end CHARACTERISTIC
/begin CHARACTERISTIC cal_COMPExhTLmtVal "" VALUE 0x0000 /* @ECU_Address@cal_COMPExhTLmtVal@ */ Scalar_FLOAT32_IEEE 0 ME11_CM_single_C 0.0 150.0 /end CHARACTERISTIC
/begin CHARACTERISTIC cal_COMPExhTNmlVal "" VALUE 0x0000 /* @ECU_Address@cal_COMPExhTNmlVal@ */ Scalar_FLOAT32_IEEE 0 ME11_CM_single_C 0.0 150.0 /end CHARACTERISTIC
/begin CHARACTERISTIC cal_COMPONMinSpd "" VALUE 0x0000 /* @ECU_Address@cal_COMPONMinSpd@ */ Scalar_FLOAT32_IEEE 0 ME11_CM_single_rpm 0.0 8000.0 /end CHARACTERISTIC
/begin CHARACTERISTIC cal_COMPOffMaxSpd "" VALUE 0x0000 /* @ECU_Address@cal_COMPOffMaxSpd@ */ Scalar_FLOAT32_IEEE 0 ME11_CM_single_rpm 0.0 8000.0 /end CHARACTERISTIC
/begin CHARACTERISTIC cal_COMPSpdLmt "" VAL_BLK 0x0000 /* @ECU_Address@cal_COMPSpdLmt@ */ Scalar_FLOAT32_IEEE 0 ME11_CM_single_rpm 0.0 8000.0 NUMBER 4 /end CHARACTERISTIC
/begin CHARACTERISTIC cal_CabinCondToCoolHPEXVPos1 "" VALUE 0x0000 /* @ECU_Address@cal_CabinCondToCoolHPEXVPos1@ */ Scalar_FLOAT32_IEEE 0 ME11_CM_single_percent_ 0.0 100.0 /end CHARACTERISTIC
/begin CHARACTERISTIC cal_CabinCondToCoolHPEXVPos2 "" VALUE 0x0000 /* @ECU_Address@cal_CabinCondToCoolHPEXVPos2@ */ Scalar_FLOAT32_IEEE 0 ME11_CM_single_percent_ 0.0 100.0 /end CHARACTERISTIC
/begin CHARACTERISTIC cal_CabinCondToEvpHPEXVPos "" VALUE 0x0000 /* @ECU_Address@cal_CabinCondToEvpHPEXVPos@ */ Scalar_FLOAT32_IEEE 0 ME11_CM_single_percent_ 0.0 100.0 /end CHARACTERISTIC
/begin CHARACTERISTIC cal_CabinEvpToHPEnvTemp "" VALUE 0x0000 /* @ECU_Address@cal_CabinEvpToHPEnvTemp@ */ Scalar_FLOAT32_IEEE 0 ME11_CM_single_C -5.0 20.0 /end CHARACTERISTIC
/begin CHARACTERISTIC cal_CabinHys1TempOffset "" VALUE 0x0000 /* @ECU_Address@cal_CabinHys1TempOffset@ */ Scalar_FLOAT32_IEEE 0 ME11_CM_single_C -5.0 5.0 /end CHARACTERISTIC
/begin CHARACTERISTIC cal_CabinHys2TempOffset "" VALUE 0x0000 /* @ECU_Address@cal_CabinHys2TempOffset@ */ Scalar_FLOAT32_IEEE 0 ME11_CM_single_C -5.0 5.0 /end CHARACTERISTIC
/begin CHARACTERISTIC cal_CabinModeKeepStandbyTime "" VALUE 0x0000 /* @ECU_Address@cal_CabinModeKeepStandbyTime@ */ Scalar_FLOAT32_IEEE 0 ME11_CM_single_min 0.0 100.0 /end CHARACTERISTIC
/begin CHARACTERISTIC cal_CabinModeTransF1Constant "" VALUE 0x0000 /* @ECU_Address@cal_CabinModeTransF1Constant@ */ Scalar_FLOAT32_IEEE 0 ME11_CM_single_C -20.0 20.0 /end CHARACTERISTIC
/begin CHARACTERISTIC cal_CabinModeTransF1Slope "" VALUE 0x0000 /* @ECU_Address@cal_CabinModeTransF1Slope@ */ Scalar_FLOAT32_IEEE 0 ME11_CM_single_null 0.0 5.0 /end CHARACTERISTIC
/begin CHARACTERISTIC cal_CabinModeTransF2Constant "" VALUE 0x0000 /* @ECU_Address@cal_CabinModeTransF2Constant@ */ Scalar_FLOAT32_IEEE 0 ME11_CM_single_C -20.0 20.0 /end CHARACTERISTIC
/begin CHARACTERISTIC cal_CabinModeTransF2Slope "" VALUE 0x0000 /* @ECU_Address@cal_CabinModeTransF2Slope@ */ Scalar_FLOAT32_IEEE 0 ME11_CM_single_null 0.0 5.0 /end CHARACTERISTIC
/begin CHARACTERISTIC cal_CabinTempData "" VALUE 0x0000 /* @ECU_Address@cal_CabinTempData@ */ Scalar_FLOAT32_IEEE 0 ME11_CM_single_C -40.0 100.0 /end CHARACTERISTIC
/begin CHARACTERISTIC cal_ChiTempData "" VALUE 0x0000 /* @ECU_Address@cal_ChiTempData@ */ Scalar_FLOAT32_IEEE 0 ME11_CM_single_C -50.0 150.0 /end CHARACTERISTIC
/begin CHARACTERISTIC cal_ClsCoolInletTemp "" VALUE 0x0000 /* @ECU_Address@cal_ClsCoolInletTemp@ */ Scalar_FLOAT32_IEEE 0 ME11_CM_single_C 0.0 100.0 /end CHARACTERISTIC
/begin CHARACTERISTIC cal_ClsCoolInletTempTime "" VALUE 0x0000 /* @ECU_Address@cal_ClsCoolInletTempTime@ */ Scalar_FLOAT32_IEEE 0 ME11_CM_single_s 0.0 1000.0 /end CHARACTERISTIC
/begin CHARACTERISTIC cal_EVAPSufTempClsSOV "" VALUE 0x0000 /* @ECU_Address@cal_EVAPSufTempClsSOV@ */ Scalar_FLOAT32_IEEE 0 ME11_CM_single_C -40.0 80.0 /end CHARACTERISTIC
/begin CHARACTERISTIC cal_EVAPSufTempOpenSOV "" VALUE 0x0000 /* @ECU_Address@cal_EVAPSufTempOpenSOV@ */ Scalar_FLOAT32_IEEE 0 ME11_CM_single_C -40.0 80.0 /end CHARACTERISTIC
/begin CHARACTERISTIC cal_EntExtDefTime "" VALUE 0x0000 /* @ECU_Address@cal_EntExtDefTime@ */ Scalar_FLOAT32_IEEE 0 ME11_CM_single_min 0.0 100.0 /end CHARACTERISTIC
/begin CHARACTERISTIC cal_EnvTempCorData "" VALUE 0x0000 /* @ECU_Address@cal_EnvTempCorData@ */ Scalar_FLOAT32_IEEE 0 ME11_CM_single_C -40.0 100.0 /end CHARACTERISTIC
/begin CHARACTERISTIC cal_EnvTempRiseStep "" VALUE 0x0000 /* @ECU_Address@cal_EnvTempRiseStep@ */ Scalar_FLOAT32_IEEE 0 ME11_CM_single_C -40.0 100.0 /end CHARACTERISTIC
/begin CHARACTERISTIC cal_EvapSurTempData "" VALUE 0x0000 /* @ECU_Address@cal_EvapSurTempData@ */ Scalar_FLOAT32_IEEE 0 ME11_CM_single_C -50.0 150.0 /end CHARACTERISTIC
/begin CHARACTERISTIC cal_EvapTempData "" VALUE 0x0000 /* @ECU_Address@cal_EvapTempData@ */ Scalar_FLOAT32_IEEE 0 ME11_CM_single_C -50.0 150.0 /end CHARACTERISTIC
/begin CHARACTERISTIC cal_ExitExtDefTime "" VALUE 0x0000 /* @ECU_Address@cal_ExitExtDefTime@ */ Scalar_FLOAT32_IEEE 0 ME11_CM_single_min 0.0 30.0 /end CHARACTERISTIC
/begin CHARACTERISTIC cal_ExtDefBatMinT "" VALUE 0x0000 /* @ECU_Address@cal_ExtDefBatMinT@ */ Scalar_FLOAT32_IEEE 0 ME11_CM_single_C 0.0 40.0 /end CHARACTERISTIC
/begin CHARACTERISTIC cal_ExtDefEnvMaxTemp "" VALUE 0x0000 /* @ECU_Address@cal_ExtDefEnvMaxTemp@ */ Scalar_FLOAT32_IEEE 0 ME11_CM_single_C -40.0 40.0 /end CHARACTERISTIC
/begin CHARACTERISTIC cal_ExtDefEnvMinTemp "" VALUE 0x0000 /* @ECU_Address@cal_ExtDefEnvMinTemp@ */ Scalar_FLOAT32_IEEE 0 ME11_CM_single_C -40.0 40.0 /end CHARACTERISTIC
/begin CHARACTERISTIC cal_ExtDefOHXOffTemp "" VALUE 0x0000 /* @ECU_Address@cal_ExtDefOHXOffTemp@ */ Scalar_FLOAT32_IEEE 0 ME11_CM_single_C 0.0 20.0 /end CHARACTERISTIC
/begin CHARACTERISTIC cal_ExtDefOHXOnTemp "" VALUE 0x0000 /* @ECU_Address@cal_ExtDefOHXOnTemp@ */ Scalar_FLOAT32_IEEE 0 ME11_CM_single_C -20.0 10.0 /end CHARACTERISTIC
/begin CHARACTERISTIC cal_ExtDefPTCTrgTemp "" VALUE 0x0000 /* @ECU_Address@cal_ExtDefPTCTrgTemp@ */ Scalar_FLOAT32_IEEE 0 ME11_CM_single_C 0.0 60.0 /end CHARACTERISTIC
/begin CHARACTERISTIC cal_ExtDefTempDiff "" VALUE 0x0000 /* @ECU_Address@cal_ExtDefTempDiff@ */ Scalar_FLOAT32_IEEE 0 ME11_CM_single_C -40.0 40.0 /end CHARACTERISTIC
/begin CHARACTERISTIC cal_FaceDuctTempData "" VALUE 0x0000 /* @ECU_Address@cal_FaceDuctTempData@ */ Scalar_FLOAT32_IEEE 0 ME11_CM_single_C -40.0 100.0 /end CHARACTERISTIC
/begin CHARACTERISTIC cal_FootDuctTempData "" VALUE 0x0000 /* @ECU_Address@cal_FootDuctTempData@ */ Scalar_FLOAT32_IEEE 0 ME11_CM_single_C -40.0 100.0 /end CHARACTERISTIC
/begin CHARACTERISTIC cal_HPHighLmtVal "" VALUE 0x0000 /* @ECU_Address@cal_HPHighLmtVal@ */ Scalar_FLOAT32_IEEE 0 ME11_CM_single_Mpa 0.0 10.0 /end CHARACTERISTIC
/begin CHARACTERISTIC cal_HeatPumpCOMPHPrsDownSpd "" VALUE 0x0000 /* @ECU_Address@cal_HeatPumpCOMPHPrsDownSpd@ */ Scalar_FLOAT32_IEEE 0 ME11_CM_single_rpm 0.0 2000.0 /end CHARACTERISTIC
/begin CHARACTERISTIC cal_HeatPumpCOMPHPrsP1 "" VALUE 0x0000 /* @ECU_Address@cal_HeatPumpCOMPHPrsP1@ */ Scalar_FLOAT32_IEEE 0 ME11_CM_single_Mpa 0.0 10.0 /end CHARACTERISTIC
/begin CHARACTERISTIC cal_HeatPumpCOMPHPrsP2 "" VALUE 0x0000 /* @ECU_Address@cal_HeatPumpCOMPHPrsP2@ */ Scalar_FLOAT32_IEEE 0 ME11_CM_single_Mpa 0.0 10.0 /end CHARACTERISTIC
/begin CHARACTERISTIC cal_HeatPumpCOMPHPrsP3 "" VALUE 0x0000 /* @ECU_Address@cal_HeatPumpCOMPHPrsP3@ */ Scalar_FLOAT32_IEEE 0 ME11_CM_single_Mpa 0.0 10.0 /end CHARACTERISTIC
/begin CHARACTERISTIC cal_HeatPumpCOMPHPrsP4 "" VALUE 0x0000 /* @ECU_Address@cal_HeatPumpCOMPHPrsP4@ */ Scalar_FLOAT32_IEEE 0 ME11_CM_single_Mpa 0.0 10.0 /end CHARACTERISTIC
/begin CHARACTERISTIC cal_HeatPumpCOMPHPrsP5 "" VALUE 0x0000 /* @ECU_Address@cal_HeatPumpCOMPHPrsP5@ */ Scalar_FLOAT32_IEEE 0 ME11_CM_single_Mpa 0.0 10.0 /end CHARACTERISTIC
/begin CHARACTERISTIC cal_HeatPumpCOMPHPrsP6 "" VALUE 0x0000 /* @ECU_Address@cal_HeatPumpCOMPHPrsP6@ */ Scalar_FLOAT32_IEEE 0 ME11_CM_single_Mpa 0.0 10.0 /end CHARACTERISTIC
/begin CHARACTERISTIC cal_HeatPumpCOMPHPrsP7 "" VALUE 0x0000 /* @ECU_Address@cal_HeatPumpCOMPHPrsP7@ */ Scalar_FLOAT32_IEEE 0 ME11_CM_single_Mpa 0.0 10.0 /end CHARACTERISTIC
/begin CHARACTERISTIC cal_HeatPumpCOMPHPrsP8 "" VALUE 0x0000 /* @ECU_Address@cal_HeatPumpCOMPHPrsP8@ */ Scalar_FLOAT32_IEEE 0 ME11_CM_single_Mpa 0.0 10.0 /end CHARACTERISTIC
/begin CHARACTERISTIC cal_HeatPumpCOMPLPrsDownSpd "" VALUE 0x0000 /* @ECU_Address@cal_HeatPumpCOMPLPrsDownSpd@ */ Scalar_FLOAT32_IEEE 0 ME11_CM_single_rpm 0.0 2000.0 /end CHARACTERISTIC
/begin CHARACTERISTIC cal_HeatPumpCOMPLPrsP1 "" VALUE 0x0000 /* @ECU_Address@cal_HeatPumpCOMPLPrsP1@ */ Scalar_FLOAT32_IEEE 0 ME11_CM_single_Mpa 0.0 10.0 /end CHARACTERISTIC
/begin CHARACTERISTIC cal_HeatPumpCOMPLPrsP2 "" VALUE 0x0000 /* @ECU_Address@cal_HeatPumpCOMPLPrsP2@ */ Scalar_FLOAT32_IEEE 0 ME11_CM_single_Mpa 0.0 10.0 /end CHARACTERISTIC
/begin CHARACTERISTIC cal_HeatPumpCOMPLPrsP3 "" VALUE 0x0000 /* @ECU_Address@cal_HeatPumpCOMPLPrsP3@ */ Scalar_FLOAT32_IEEE 0 ME11_CM_single_Mpa 0.0 10.0 /end CHARACTERISTIC
/begin CHARACTERISTIC cal_HeatPumpCOMPLPrsP4 "" VALUE 0x0000 /* @ECU_Address@cal_HeatPumpCOMPLPrsP4@ */ Scalar_FLOAT32_IEEE 0 ME11_CM_single_Mpa 0.0 10.0 /end CHARACTERISTIC
/begin CHARACTERISTIC cal_HeatPumpCOMPLPrsP5 "" VALUE 0x0000 /* @ECU_Address@cal_HeatPumpCOMPLPrsP5@ */ Scalar_FLOAT32_IEEE 0 ME11_CM_single_Mpa 0.0 10.0 /end CHARACTERISTIC
/begin CHARACTERISTIC cal_HeatPumpCOMPLPrsP6 "" VALUE 0x0000 /* @ECU_Address@cal_HeatPumpCOMPLPrsP6@ */ Scalar_FLOAT32_IEEE 0 ME11_CM_single_Mpa 0.0 10.0 /end CHARACTERISTIC
/begin CHARACTERISTIC cal_HeatPumpCOMPLPrsP7 "" VALUE 0x0000 /* @ECU_Address@cal_HeatPumpCOMPLPrsP7@ */ Scalar_FLOAT32_IEEE 0 ME11_CM_single_Mpa 0.0 10.0 /end CHARACTERISTIC
/begin CHARACTERISTIC cal_HeatPumpCOMPLPrsP8 "" VALUE 0x0000 /* @ECU_Address@cal_HeatPumpCOMPLPrsP8@ */ Scalar_FLOAT32_IEEE 0 ME11_CM_single_Mpa 0.0 10.0 /end CHARACTERISTIC
/begin CHARACTERISTIC cal_HiPressData "" VALUE 0x0000 /* @ECU_Address@cal_HiPressData@ */ Scalar_FLOAT32_IEEE 0 ME11_CM_single_Mpa 0.0 10.0 /end CHARACTERISTIC
/begin CHARACTERISTIC cal_IGBTDownLmtTemp "" VALUE 0x0000 /* @ECU_Address@cal_IGBTDownLmtTemp@ */ Scalar_FLOAT32_IEEE 0 ME11_CM_single_C 0.0 150.0 /end CHARACTERISTIC
/begin CHARACTERISTIC cal_IGBTUpLmtTemp "" VALUE 0x0000 /* @ECU_Address@cal_IGBTUpLmtTemp@ */ Scalar_FLOAT32_IEEE 0 ME11_CM_single_C 0.0 150.0 /end CHARACTERISTIC
/begin CHARACTERISTIC cal_LPFanOff "" VALUE 0x0000 /* @ECU_Address@cal_LPFanOff@ */ Scalar_FLOAT32_IEEE 0 ME11_CM_single_Mpa 0.0 100.0 /end CHARACTERISTIC
/begin CHARACTERISTIC cal_LPFanOn "" VALUE 0x0000 /* @ECU_Address@cal_LPFanOn@ */ Scalar_FLOAT32_IEEE 0 ME11_CM_single_Mpa 0.0 100.0 /end CHARACTERISTIC
/begin CHARACTERISTIC cal_LPProOffTimer "" VALUE 0x0000 /* @ECU_Address@cal_LPProOffTimer@ */ Scalar_FLOAT32_IEEE 0 ME11_CM_single_s 0.0 100.0 /end CHARACTERISTIC
/begin CHARACTERISTIC cal_LPProOnTimer "" VALUE 0x0000 /* @ECU_Address@cal_LPProOnTimer@ */ Scalar_FLOAT32_IEEE 0 ME11_CM_single_s 0.0 100.0 /end CHARACTERISTIC
/begin CHARACTERISTIC cal_LoPressData "" VALUE 0x0000 /* @ECU_Address@cal_LoPressData@ */ Scalar_FLOAT32_IEEE 0 ME11_CM_single_Mpa 0.0 10.0 /end CHARACTERISTIC
/begin CHARACTERISTIC cal_MixDoorNErr "" VALUE 0x0000 /* @ECU_Address@cal_MixDoorNErr@ */ Scalar_FLOAT32_IEEE 0 ME11_CM_single_percent_ 0.0 10.0 /end CHARACTERISTIC
/begin CHARACTERISTIC cal_MixDoorPErr "" VALUE 0x0000 /* @ECU_Address@cal_MixDoorPErr@ */ Scalar_FLOAT32_IEEE 0 ME11_CM_single_percent_ 0.0 10.0 /end CHARACTERISTIC
/begin CHARACTERISTIC cal_MixDoorPercData "" VALUE 0x0000 /* @ECU_Address@cal_MixDoorPercData@ */ Scalar_FLOAT32_IEEE 0 ME11_CM_single_percent_ 0.0 100.0 /end CHARACTERISTIC
/begin CHARACTERISTIC cal_ModeMotorNErr "" VALUE 0x0000 /* @ECU_Address@cal_ModeMotorNErr@ */ Scalar_FLOAT32_IEEE 0 ME11_CM_single_v 0.0 1.0 /end CHARACTERISTIC
/begin CHARACTERISTIC cal_ModeMotorPErr "" VALUE 0x0000 /* @ECU_Address@cal_ModeMotorPErr@ */ Scalar_FLOAT32_IEEE 0 ME11_CM_single_v 0.0 1.0 /end CHARACTERISTIC
/begin CHARACTERISTIC cal_ModeMotorTrgPosData "" VALUE 0x0000 /* @ECU_Address@cal_ModeMotorTrgPosData@ */ Scalar_FLOAT32_IEEE 0 ME11_CM_single_v 0.0 100.0 /end CHARACTERISTIC
/begin CHARACTERISTIC cal_MotTempData "" VALUE 0x0000 /* @ECU_Address@cal_MotTempData@ */ Scalar_FLOAT32_IEEE 0 ME11_CM_single_C -50.0 150.0 /end CHARACTERISTIC
/begin CHARACTERISTIC cal_MotTempDownLmt "" VALUE 0x0000 /* @ECU_Address@cal_MotTempDownLmt@ */ Scalar_FLOAT32_IEEE 0 ME11_CM_single_C 30.0 130.0 /end CHARACTERISTIC
/begin CHARACTERISTIC cal_MotTempUpLmt "" VALUE 0x0000 /* @ECU_Address@cal_MotTempUpLmt@ */ Scalar_FLOAT32_IEEE 0 ME11_CM_single_C 30.0 130.0 /end CHARACTERISTIC
/begin CHARACTERISTIC cal_MotorModeData "" VALUE 0x0000 /* @ECU_Address@cal_MotorModeData@ */ Scalar_FLOAT32_IEEE 0 ME11_CM_single_null 0.0 5.0 /end CHARACTERISTIC
/begin CHARACTERISTIC cal_NmlCOMPHPrsDownSpd "" VALUE 0x0000 /* @ECU_Address@cal_NmlCOMPHPrsDownSpd@ */ Scalar_FLOAT32_IEEE 0 ME11_CM_single_rpm 0.0 2000.0 /end CHARACTERISTIC
/begin CHARACTERISTIC cal_NmlCOMPHPrsP1 "" VALUE 0x0000 /* @ECU_Address@cal_NmlCOMPHPrsP1@ */ Scalar_FLOAT32_IEEE 0 ME11_CM_single_Mpa 0.0 10.0 /end CHARACTERISTIC
/begin CHARACTERISTIC cal_NmlCOMPHPrsP2 "" VALUE 0x0000 /* @ECU_Address@cal_NmlCOMPHPrsP2@ */ Scalar_FLOAT32_IEEE 0 ME11_CM_single_Mpa 0.0 10.0 /end CHARACTERISTIC
/begin CHARACTERISTIC cal_NmlCOMPHPrsP3 "" VALUE 0x0000 /* @ECU_Address@cal_NmlCOMPHPrsP3@ */ Scalar_FLOAT32_IEEE 0 ME11_CM_single_Mpa 0.0 10.0 /end CHARACTERISTIC
/begin CHARACTERISTIC cal_NmlCOMPHPrsP4 "" VALUE 0x0000 /* @ECU_Address@cal_NmlCOMPHPrsP4@ */ Scalar_FLOAT32_IEEE 0 ME11_CM_single_Mpa 0.0 10.0 /end CHARACTERISTIC
/begin CHARACTERISTIC cal_NmlCOMPHPrsP5 "" VALUE 0x0000 /* @ECU_Address@cal_NmlCOMPHPrsP5@ */ Scalar_FLOAT32_IEEE 0 ME11_CM_single_Mpa 0.0 10.0 /end CHARACTERISTIC
/begin CHARACTERISTIC cal_NmlCOMPHPrsP6 "" VALUE 0x0000 /* @ECU_Address@cal_NmlCOMPHPrsP6@ */ Scalar_FLOAT32_IEEE 0 ME11_CM_single_Mpa 0.0 10.0 /end CHARACTERISTIC
/begin CHARACTERISTIC cal_NmlCOMPHPrsP7 "" VALUE 0x0000 /* @ECU_Address@cal_NmlCOMPHPrsP7@ */ Scalar_FLOAT32_IEEE 0 ME11_CM_single_Mpa 0.0 10.0 /end CHARACTERISTIC
/begin CHARACTERISTIC cal_NmlCOMPHPrsP8 "" VALUE 0x0000 /* @ECU_Address@cal_NmlCOMPHPrsP8@ */ Scalar_FLOAT32_IEEE 0 ME11_CM_single_Mpa 0.0 10.0 /end CHARACTERISTIC
/begin CHARACTERISTIC cal_NmlCOMPLPrsDownSpd "" VALUE 0x0000 /* @ECU_Address@cal_NmlCOMPLPrsDownSpd@ */ Scalar_FLOAT32_IEEE 0 ME11_CM_single_rpm 0.0 2000.0 /end CHARACTERISTIC
/begin CHARACTERISTIC cal_NmlCOMPLPrsP1 "" VALUE 0x0000 /* @ECU_Address@cal_NmlCOMPLPrsP1@ */ Scalar_FLOAT32_IEEE 0 ME11_CM_single_Mpa 0.0 10.0 /end CHARACTERISTIC
/begin CHARACTERISTIC cal_NmlCOMPLPrsP2 "" VALUE 0x0000 /* @ECU_Address@cal_NmlCOMPLPrsP2@ */ Scalar_FLOAT32_IEEE 0 ME11_CM_single_Mpa 0.0 10.0 /end CHARACTERISTIC
/begin CHARACTERISTIC cal_NmlCOMPLPrsP3 "" VALUE 0x0000 /* @ECU_Address@cal_NmlCOMPLPrsP3@ */ Scalar_FLOAT32_IEEE 0 ME11_CM_single_Mpa 0.0 10.0 /end CHARACTERISTIC
/begin CHARACTERISTIC cal_NmlCOMPLPrsP4 "" VALUE 0x0000 /* @ECU_Address@cal_NmlCOMPLPrsP4@ */ Scalar_FLOAT32_IEEE 0 ME11_CM_single_Mpa 0.0 10.0 /end CHARACTERISTIC
/begin CHARACTERISTIC cal_NmlCOMPLPrsP5 "" VALUE 0x0000 /* @ECU_Address@cal_NmlCOMPLPrsP5@ */ Scalar_FLOAT32_IEEE 0 ME11_CM_single_Mpa 0.0 10.0 /end CHARACTERISTIC
/begin CHARACTERISTIC cal_NmlCOMPLPrsP6 "" VALUE 0x0000 /* @ECU_Address@cal_NmlCOMPLPrsP6@ */ Scalar_FLOAT32_IEEE 0 ME11_CM_single_Mpa 0.0 10.0 /end CHARACTERISTIC
/begin CHARACTERISTIC cal_NmlCOMPLPrsP7 "" VALUE 0x0000 /* @ECU_Address@cal_NmlCOMPLPrsP7@ */ Scalar_FLOAT32_IEEE 0 ME11_CM_single_Mpa 0.0 10.0 /end CHARACTERISTIC
/begin CHARACTERISTIC cal_NmlCOMPLPrsP8 "" VALUE 0x0000 /* @ECU_Address@cal_NmlCOMPLPrsP8@ */ Scalar_FLOAT32_IEEE 0 ME11_CM_single_Mpa 0.0 10.0 /end CHARACTERISTIC
/begin CHARACTERISTIC cal_OHXTempData "" VALUE 0x0000 /* @ECU_Address@cal_OHXTempData@ */ Scalar_FLOAT32_IEEE 0 ME11_CM_single_C -50.0 150.0 /end CHARACTERISTIC
/begin CHARACTERISTIC cal_OpenCoolInletTemp "" VALUE 0x0000 /* @ECU_Address@cal_OpenCoolInletTemp@ */ Scalar_FLOAT32_IEEE 0 ME11_CM_single_C 0.0 100.0 /end CHARACTERISTIC
/begin CHARACTERISTIC cal_PTCMaxTemp "" VALUE 0x0000 /* @ECU_Address@cal_PTCMaxTemp@ */ Scalar_FLOAT32_IEEE 0 ME11_CM_single_C 0.0 100.0 /end CHARACTERISTIC
/begin CHARACTERISTIC cal_PTCMinTemp "" VALUE 0x0000 /* @ECU_Address@cal_PTCMinTemp@ */ Scalar_FLOAT32_IEEE 0 ME11_CM_single_C -40.0 100.0 /end CHARACTERISTIC
/begin CHARACTERISTIC cal_PTCPwrOffFlt "" VALUE 0x0000 /* @ECU_Address@cal_PTCPwrOffFlt@ */ Scalar_FLOAT32_IEEE 0 ME11_CM_single_kw 0.0 2.0 /end CHARACTERISTIC
/begin CHARACTERISTIC cal_PTCReqTempData "" VALUE 0x0000 /* @ECU_Address@cal_PTCReqTempData@ */ Scalar_FLOAT32_IEEE 0 ME11_CM_single_C -40.0 100.0 /end CHARACTERISTIC
/begin CHARACTERISTIC cal_PTCRunAcPMPFFTime "" VALUE 0x0000 /* @ECU_Address@cal_PTCRunAcPMPFFTime@ */ Scalar_FLOAT32_IEEE 0 ME11_CM_single_s 0.0 100.0 /end CHARACTERISTIC
/begin CHARACTERISTIC cal_RecircDoorNErr "" VALUE 0x0000 /* @ECU_Address@cal_RecircDoorNErr@ */ Scalar_FLOAT32_IEEE 0 ME11_CM_single_percent_ 0.0 10.0 /end CHARACTERISTIC
/begin CHARACTERISTIC cal_RecircDoorPErr "" VALUE 0x0000 /* @ECU_Address@cal_RecircDoorPErr@ */ Scalar_FLOAT32_IEEE 0 ME11_CM_single_percent_ 0.0 10.0 /end CHARACTERISTIC
/begin CHARACTERISTIC cal_SOCHighPTCPwrLmtOff "" VALUE 0x0000 /* @ECU_Address@cal_SOCHighPTCPwrLmtOff@ */ Scalar_FLOAT32_IEEE 0 ME11_CM_single_percent_ 0.0 100.0 /end CHARACTERISTIC
/begin CHARACTERISTIC cal_SOCHighPTCPwrLmtOn "" VALUE 0x0000 /* @ECU_Address@cal_SOCHighPTCPwrLmtOn@ */ Scalar_FLOAT32_IEEE 0 ME11_CM_single_percent_ 0.0 100.0 /end CHARACTERISTIC
/begin CHARACTERISTIC cal_SensorVolDownFlg "" VALUE 0x0000 /* @ECU_Address@cal_SensorVolDownFlg@ */ Scalar_FLOAT32_IEEE 0 ME11_CM_single_mv 0.0 5000.0 /end CHARACTERISTIC
/begin CHARACTERISTIC cal_SensorVolUpFlg "" VALUE 0x0000 /* @ECU_Address@cal_SensorVolUpFlg@ */ Scalar_FLOAT32_IEEE 0 ME11_CM_single_mv 0.0 5000.0 /end CHARACTERISTIC
/begin CHARACTERISTIC cal_SetLeftMixDoorTrgData "" VALUE 0x0000 /* @ECU_Address@cal_SetLeftMixDoorTrgData@ */ Scalar_FLOAT32_IEEE 0 ME11_CM_single_percent_ 0.0 100.0 /end CHARACTERISTIC
/begin CHARACTERISTIC cal_StartPrsProTimes "" VALUE 0x0000 /* @ECU_Address@cal_StartPrsProTimes@ */ Scalar_FLOAT32_IEEE 0 ME11_CM_single_min 0.0 10.0 /end CHARACTERISTIC
/begin CHARACTERISTIC cal_TempRampStepFast "" VALUE 0x0000 /* @ECU_Address@cal_TempRampStepFast@ */ Scalar_FLOAT32_IEEE 0 ME11_CM_single_C -40.0 100.0 /end CHARACTERISTIC
/begin CHARACTERISTIC cal_TempRampStepLoVSpeed "" VALUE 0x0000 /* @ECU_Address@cal_TempRampStepLoVSpeed@ */ Scalar_FLOAT32_IEEE 0 ME11_CM_single_C -40.0 100.0 /end CHARACTERISTIC
/begin CHARACTERISTIC cal_TempRampStepSlow "" VALUE 0x0000 /* @ECU_Address@cal_TempRampStepSlow@ */ Scalar_FLOAT32_IEEE 0 ME11_CM_single_C -40.0 100.0 /end CHARACTERISTIC
/begin CHARACTERISTIC cal_VehicleSpeedHighVs "" VALUE 0x0000 /* @ECU_Address@cal_VehicleSpeedHighVs@ */ Scalar_FLOAT32_IEEE 0 ME11_CM_single_km_per_h -40.0 200.0 /end CHARACTERISTIC
/begin CHARACTERISTIC cal_VehicleSpeedLowVs "" VALUE 0x0000 /* @ECU_Address@cal_VehicleSpeedLowVs@ */ Scalar_FLOAT32_IEEE 0 ME11_CM_single_km_per_h -40.0 200.0 /end CHARACTERISTIC
/begin CHARACTERISTIC cal_WCCTempData "" VALUE 0x0000 /* @ECU_Address@cal_WCCTempData@ */ Scalar_FLOAT32_IEEE 0 ME11_CM_single_C -50.0 150.0 /end CHARACTERISTIC
/begin CHARACTERISTIC cal_rCabinCoolToCondMixDoor "" VALUE 0x0000 /* @ECU_Address@cal_rCabinCoolToCondMixDoor@ */ Scalar_FLOAT32_IEEE 0 ME11_CM_single_percent_ 0.0 100.0 /end CHARACTERISTIC
/begin CHARACTERISTIC cal_sMixDoorData "" VALUE 0x0000 /* @ECU_Address@cal_sMixDoorData@ */ Scalar_FLOAT32_IEEE 0 ME11_CM_single_percent_ 0.0 100.0 /end CHARACTERISTIC
/begin CHARACTERISTIC cal_tCabinCondToCoolDvtDiff "" VALUE 0x0000 /* @ECU_Address@cal_tCabinCondToCoolDvtDiff@ */ Scalar_FLOAT32_IEEE 0 ME11_CM_single_C -10.0 10.0 /end CHARACTERISTIC
/begin CHARACTERISTIC cal_tCabinCondToCoolEvapTemp "" VALUE 0x0000 /* @ECU_Address@cal_tCabinCondToCoolEvapTemp@ */ Scalar_FLOAT32_IEEE 0 ME11_CM_single_C -5.0 20.0 /end CHARACTERISTIC
/begin CHARACTERISTIC cal_tCabinCondToEvpEvapTemp "" VALUE 0x0000 /* @ECU_Address@cal_tCabinCondToEvpEvapTemp@ */ Scalar_FLOAT32_IEEE 0 ME11_CM_single_C -5.0 20.0 /end CHARACTERISTIC
/begin CHARACTERISTIC cal_tCabinCoolEnvTempHigh "" VALUE 0x0000 /* @ECU_Address@cal_tCabinCoolEnvTempHigh@ */ Scalar_FLOAT32_IEEE 0 ME11_CM_single_C 0.0 40.0 /end CHARACTERISTIC
/begin CHARACTERISTIC cal_tCabinCoolEnvTempLow "" VALUE 0x0000 /* @ECU_Address@cal_tCabinCoolEnvTempLow@ */ Scalar_FLOAT32_IEEE 0 ME11_CM_single_C 0.0 20.0 /end CHARACTERISTIC
/begin CHARACTERISTIC cal_tCabinCoolToCondDvtDiff "" VALUE 0x0000 /* @ECU_Address@cal_tCabinCoolToCondDvtDiff@ */ Scalar_FLOAT32_IEEE 0 ME11_CM_single_C -10.0 10.0 /end CHARACTERISTIC
/begin CHARACTERISTIC cal_tCabinEvpToCondDvtDiff "" VALUE 0x0000 /* @ECU_Address@cal_tCabinEvpToCondDvtDiff@ */ Scalar_FLOAT32_IEEE 0 ME11_CM_single_C -10.0 10.0 /end CHARACTERISTIC
/begin CHARACTERISTIC cal_tCabinHPToEvpEnvTemp "" VALUE 0x0000 /* @ECU_Address@cal_tCabinHPToEvpEnvTemp@ */ Scalar_FLOAT32_IEEE 0 ME11_CM_single_C -5.0 20.0 /end CHARACTERISTIC
/begin CHARACTERISTIC cal_tLeftSetPointData "" VALUE 0x0000 /* @ECU_Address@cal_tLeftSetPointData@ */ Scalar_FLOAT32_IEEE 0 ME11_CM_single_C 16.0 32.0 /end CHARACTERISTIC
/begin CHARACTERISTIC cal_CAPStartCoolantMin "" VALUE 0x0000 /* @ECU_Address@cal_CAPStartCoolantMin@ */ Scalar_SWORD 0 ME11_CM_int16_C -40.0 100.0 /end CHARACTERISTIC
/begin CHARACTERISTIC cal_HAPevap_min "" VALUE 0x0000 /* @ECU_Address@cal_HAPevap_min@ */ Scalar_SWORD 0 ME11_CM_int16_C -40.0 100.0 /end CHARACTERISTIC
/begin CHARACTERISTIC cal_BatCoolStopBatPMPRunTime "" VALUE 0x0000 /* @ECU_Address@cal_BatCoolStopBatPMPRunTime@ */ Scalar_UWORD 0 ME11_CM_uint16_sec 0.0 1000.0 /end CHARACTERISTIC
/begin CHARACTERISTIC cal_BlwFrqVal "" VALUE 0x0000 /* @ECU_Address@cal_BlwFrqVal@ */ Scalar_UWORD 0 ME11_CM_uint16_hz 0.0 65535.0 /end CHARACTERISTIC
/begin CHARACTERISTIC cal_CabinEvpToCondCompLmt "" VALUE 0x0000 /* @ECU_Address@cal_CabinEvpToCondCompLmt@ */ Scalar_UWORD 0 ME11_CM_uint16_rpm 0.0 8000.0 /end CHARACTERISTIC
/begin CHARACTERISTIC cal_ExhaustTime "" VALUE 0x0000 /* @ECU_Address@cal_ExhaustTime@ */ Scalar_UWORD 0 ME11_CM_uint16_s 0.0 1000.0 /end CHARACTERISTIC
/begin CHARACTERISTIC cal_FallTime2Tamb "" VALUE 0x0000 /* @ECU_Address@cal_FallTime2Tamb@ */ Scalar_UWORD 0 ME11_CM_uint16_ms 0.0 6000.0 /end CHARACTERISTIC
/begin CHARACTERISTIC cal_HAPparkdly_time "" VALUE 0x0000 /* @ECU_Address@cal_HAPparkdly_time@ */ Scalar_UWORD 0 ME11_CM_uint16_min 0.0 255.0 /end CHARACTERISTIC
/begin CHARACTERISTIC cal_HAPpurge_time "" VALUE 0x0000 /* @ECU_Address@cal_HAPpurge_time@ */ Scalar_UWORD 0 ME11_CM_uint16_s 0.0 255.0 /end CHARACTERISTIC
/begin CHARACTERISTIC cal_HAPtimelim2activtic "" VALUE 0x0000 /* @ECU_Address@cal_HAPtimelim2activtic@ */ Scalar_UWORD 0 ME11_CM_uint16_s 0.0 255.0 /end CHARACTERISTIC
/begin CHARACTERISTIC cal_RiseTime2Tamb "" VALUE 0x0000 /* @ECU_Address@cal_RiseTime2Tamb@ */ Scalar_UWORD 0 ME11_CM_uint16_ms 0.0 6000.0 /end CHARACTERISTIC
/begin CHARACTERISTIC cal_SolarData "" VALUE 0x0000 /* @ECU_Address@cal_SolarData@ */ Scalar_UWORD 0 ME11_CM_uint16_w_per_m_2 0.0 1200.0 /end CHARACTERISTIC
/begin CHARACTERISTIC cal_tiColdStartTimeMax "" VALUE 0x0000 /* @ECU_Address@cal_tiColdStartTimeMax@ */ Scalar_UWORD 0 ME11_CM_uint16_per_ 0 65535 /end CHARACTERISTIC
/begin CHARACTERISTIC cal_TMSStatusData "" VALUE 0x0000 /* @ECU_Address@cal_TMSStatusData@ */ Scalar_UBYTE 0 ME11_CM_PwrModes_null 0 5 /end CHARACTERISTIC
/begin CHARACTERISTIC cal_RefModeData "" VALUE 0x0000 /* @ECU_Address@cal_RefModeData@ */ Scalar_UBYTE 0 ME11_CM_RefModes_null 0 14 /end CHARACTERISTIC
/begin CHARACTERISTIC cal_WaterModeData "" VALUE 0x0000 /* @ECU_Address@cal_WaterModeData@ */ Scalar_UBYTE 0 ME11_CM_WaterModes_flg 0 6 /end CHARACTERISTIC
/begin CHARACTERISTIC cal_ACCMForbidCtrl "" VALUE 0x0000 /* @ECU_Address@cal_ACCMForbidCtrl@ */ Scalar_BOOLEAN 0 ME11_CM_boolean_flg 0.0 1.0 /end CHARACTERISTIC
/begin CHARACTERISTIC cal_ACCMHiTempDataEnb "" VALUE 0x0000 /* @ECU_Address@cal_ACCMHiTempDataEnb@ */ Scalar_BOOLEAN 0 ME11_CM_boolean_flg 0.0 1.0 /end CHARACTERISTIC
/begin CHARACTERISTIC cal_AirInletPerEnb "" VALUE 0x0000 /* @ECU_Address@cal_AirInletPerEnb@ */ Scalar_BOOLEAN 0 ME11_CM_boolean_flg 0.0 1.0 /end CHARACTERISTIC
/begin CHARACTERISTIC cal_AvgSwitch "" VALUE 0x0000 /* @ECU_Address@cal_AvgSwitch@ */ Scalar_BOOLEAN 0 ME11_CM_boolean_per_ 0.0 1.0 /end CHARACTERISTIC
/begin CHARACTERISTIC cal_BatModeSwitch "" VALUE 0x0000 /* @ECU_Address@cal_BatModeSwitch@ */ Scalar_BOOLEAN 0 ME11_CM_boolean_flg 0.0 1.0 /end CHARACTERISTIC
/begin CHARACTERISTIC cal_BatTrgTempEnb "" VALUE 0x0000 /* @ECU_Address@cal_BatTrgTempEnb@ */ Scalar_BOOLEAN 0 ME11_CM_boolean_flg 0.0 1.0 /end CHARACTERISTIC
/begin CHARACTERISTIC cal_BlwFanEnb "" VALUE 0x0000 /* @ECU_Address@cal_BlwFanEnb@ */ Scalar_BOOLEAN 0 ME11_CM_boolean_flg 0.0 1.0 /end CHARACTERISTIC
/begin CHARACTERISTIC cal_CANAliveEnable "" VALUE 0x0000 /* @ECU_Address@cal_CANAliveEnable@ */ Scalar_BOOLEAN 0 ME11_CM_boolean_flg 0.0 1.0 /end CHARACTERISTIC
/begin CHARACTERISTIC cal_CabinTempEnb "" VALUE 0x0000 /* @ECU_Address@cal_CabinTempEnb@ */ Scalar_BOOLEAN 0 ME11_CM_boolean_flg 0.0 1.0 /end CHARACTERISTIC
/begin CHARACTERISTIC cal_ChiTempDataEnb "" VALUE 0x0000 /* @ECU_Address@cal_ChiTempDataEnb@ */ Scalar_BOOLEAN 0 ME11_CM_boolean_flg 0.0 1.0 /end CHARACTERISTIC
/begin CHARACTERISTIC cal_CoolFanEnb "" VALUE 0x0000 /* @ECU_Address@cal_CoolFanEnb@ */ Scalar_BOOLEAN 0 ME11_CM_boolean_flg 0.0 1.0 /end CHARACTERISTIC
/begin CHARACTERISTIC cal_EnvFailSwFlg "" VALUE 0x0000 /* @ECU_Address@cal_EnvFailSwFlg@ */ Scalar_BOOLEAN 0 ME11_CM_boolean_flg 0.0 1.0 /end CHARACTERISTIC
/begin CHARACTERISTIC cal_EnvTempCorEnb "" VALUE 0x0000 /* @ECU_Address@cal_EnvTempCorEnb@ */ Scalar_BOOLEAN 0 ME11_CM_boolean_flg 0.0 1.0 /end CHARACTERISTIC
/begin CHARACTERISTIC cal_EvapSurTempDataEnb "" VALUE 0x0000 /* @ECU_Address@cal_EvapSurTempDataEnb@ */ Scalar_BOOLEAN 0 ME11_CM_boolean_flg 0.0 1.0 /end CHARACTERISTIC
/begin CHARACTERISTIC cal_EvapTempDataEnb "" VALUE 0x0000 /* @ECU_Address@cal_EvapTempDataEnb@ */ Scalar_BOOLEAN 0 ME11_CM_boolean_flg 0.0 1.0 /end CHARACTERISTIC
/begin CHARACTERISTIC cal_ExtDefFlgData "" VALUE 0x0000 /* @ECU_Address@cal_ExtDefFlgData@ */ Scalar_BOOLEAN 0 ME11_CM_boolean_flg 0.0 1.0 /end CHARACTERISTIC
/begin CHARACTERISTIC cal_ExtDefFlgDataEnb "" VALUE 0x0000 /* @ECU_Address@cal_ExtDefFlgDataEnb@ */ Scalar_BOOLEAN 0 ME11_CM_boolean_flg 0.0 1.0 /end CHARACTERISTIC
/begin CHARACTERISTIC cal_FaceDuctTempEnb "" VALUE 0x0000 /* @ECU_Address@cal_FaceDuctTempEnb@ */ Scalar_BOOLEAN 0 ME11_CM_boolean_flg 0.0 1.0 /end CHARACTERISTIC
/begin CHARACTERISTIC cal_FootDuctTempEnb "" VALUE 0x0000 /* @ECU_Address@cal_FootDuctTempEnb@ */ Scalar_BOOLEAN 0 ME11_CM_boolean_flg 0.0 1.0 /end CHARACTERISTIC
/begin CHARACTERISTIC cal_HVPartModeEnb "" VALUE 0x0000 /* @ECU_Address@cal_HVPartModeEnb@ */ Scalar_BOOLEAN 0 ME11_CM_boolean_flg 0.0 1.0 /end CHARACTERISTIC
/begin CHARACTERISTIC cal_HiPressDataEnb "" VALUE 0x0000 /* @ECU_Address@cal_HiPressDataEnb@ */ Scalar_BOOLEAN 0 ME11_CM_boolean_flg 0.0 1.0 /end CHARACTERISTIC
/begin CHARACTERISTIC cal_LoPressDataEnb "" VALUE 0x0000 /* @ECU_Address@cal_LoPressDataEnb@ */ Scalar_BOOLEAN 0 ME11_CM_boolean_flg 0.0 1.0 /end CHARACTERISTIC
/begin CHARACTERISTIC cal_MixDoorEnb "" VALUE 0x0000 /* @ECU_Address@cal_MixDoorEnb@ */ Scalar_BOOLEAN 0 ME11_CM_boolean_flg 0.0 1.0 /end CHARACTERISTIC
/begin CHARACTERISTIC cal_MixDoorPercDataEnb "" VALUE 0x0000 /* @ECU_Address@cal_MixDoorPercDataEnb@ */ Scalar_BOOLEAN 0 ME11_CM_boolean_flg 0.0 1.0 /end CHARACTERISTIC
/begin CHARACTERISTIC cal_ModeMotorEnb "" VALUE 0x0000 /* @ECU_Address@cal_ModeMotorEnb@ */ Scalar_BOOLEAN 0 ME11_CM_boolean_flg 0.0 1.0 /end CHARACTERISTIC
/begin CHARACTERISTIC cal_ModeMotorTrgPosDataEnb "" VALUE 0x0000 /* @ECU_Address@cal_ModeMotorTrgPosDataEnb@ */ Scalar_BOOLEAN 0 ME11_CM_boolean_flg 0.0 1.0 /end CHARACTERISTIC
/begin CHARACTERISTIC cal_MotTempDataEnb "" VALUE 0x0000 /* @ECU_Address@cal_MotTempDataEnb@ */ Scalar_BOOLEAN 0 ME11_CM_boolean_flg 0.0 1.0 /end CHARACTERISTIC
/begin CHARACTERISTIC cal_MotorModeEnb "" VALUE 0x0000 /* @ECU_Address@cal_MotorModeEnb@ */ Scalar_BOOLEAN 0 ME11_CM_boolean_flg 0.0 1.0 /end CHARACTERISTIC
/begin CHARACTERISTIC cal_OHXTempDataEnb "" VALUE 0x0000 /* @ECU_Address@cal_OHXTempDataEnb@ */ Scalar_BOOLEAN 0 ME11_CM_boolean_flg 0.0 1.0 /end CHARACTERISTIC
/begin CHARACTERISTIC cal_PTCReqTempDataEnb "" VALUE 0x0000 /* @ECU_Address@cal_PTCReqTempDataEnb@ */ Scalar_BOOLEAN 0 ME11_CM_boolean_flg 0.0 1.0 /end CHARACTERISTIC
/begin CHARACTERISTIC cal_PwrACPumpData "" VALUE 0x0000 /* @ECU_Address@cal_PwrACPumpData@ */ Scalar_BOOLEAN 0 ME11_CM_boolean_flg 0.0 1.0 /end CHARACTERISTIC
/begin CHARACTERISTIC cal_PwrACPumpEnb "" VALUE 0x0000 /* @ECU_Address@cal_PwrACPumpEnb@ */ Scalar_BOOLEAN 0 ME11_CM_boolean_flg 0.0 1.0 /end CHARACTERISTIC
/begin CHARACTERISTIC cal_PwrBlwData "" VALUE 0x0000 /* @ECU_Address@cal_PwrBlwData@ */ Scalar_BOOLEAN 0 ME11_CM_boolean_flg 0.0 1.0 /end CHARACTERISTIC
/begin CHARACTERISTIC cal_PwrBlwEnb "" VALUE 0x0000 /* @ECU_Address@cal_PwrBlwEnb@ */ Scalar_BOOLEAN 0 ME11_CM_boolean_flg 0.0 1.0 /end CHARACTERISTIC
/begin CHARACTERISTIC cal_PwrFanAndPumpDataEnb "" VALUE 0x0000 /* @ECU_Address@cal_PwrFanAndPumpDataEnb@ */ Scalar_BOOLEAN 0 ME11_CM_boolean_flg 0.0 1.0 /end CHARACTERISTIC
/begin CHARACTERISTIC cal_PwrFanData "" VALUE 0x0000 /* @ECU_Address@cal_PwrFanData@ */ Scalar_BOOLEAN 0 ME11_CM_boolean_flg 0.0 1.0 /end CHARACTERISTIC
/begin CHARACTERISTIC cal_PwrFanEnb "" VALUE 0x0000 /* @ECU_Address@cal_PwrFanEnb@ */ Scalar_BOOLEAN 0 ME11_CM_boolean_flg 0.0 1.0 /end CHARACTERISTIC
/begin CHARACTERISTIC cal_PwrHVPartData "" VALUE 0x0000 /* @ECU_Address@cal_PwrHVPartData@ */ Scalar_BOOLEAN 0 ME11_CM_boolean_flg 0.0 1.0 /end CHARACTERISTIC
/begin CHARACTERISTIC cal_PwrHVPartEnb "" VALUE 0x0000 /* @ECU_Address@cal_PwrHVPartEnb@ */ Scalar_BOOLEAN 0 ME11_CM_boolean_flg 0.0 1.0 /end CHARACTERISTIC
/begin CHARACTERISTIC cal_PwrSensorData "" VALUE 0x0000 /* @ECU_Address@cal_PwrSensorData@ */ Scalar_BOOLEAN 0 ME11_CM_boolean_flg 0.0 1.0 /end CHARACTERISTIC
/begin CHARACTERISTIC cal_PwrSensorEnb "" VALUE 0x0000 /* @ECU_Address@cal_PwrSensorEnb@ */ Scalar_BOOLEAN 0 ME11_CM_boolean_flg 0.0 1.0 /end CHARACTERISTIC
/begin CHARACTERISTIC cal_RecircMotorEnb "" VALUE 0x0000 /* @ECU_Address@cal_RecircMotorEnb@ */ Scalar_BOOLEAN 0 ME11_CM_boolean_flg 0.0 1.0 /end CHARACTERISTIC
/begin CHARACTERISTIC cal_RecircTrgPosDataEnb "" VALUE 0x0000 /* @ECU_Address@cal_RecircTrgPosDataEnb@ */ Scalar_BOOLEAN 0 ME11_CM_boolean_flg 0.0 1.0 /end CHARACTERISTIC
/begin CHARACTERISTIC cal_RefModeEnb "" VALUE 0x0000 /* @ECU_Address@cal_RefModeEnb@ */ Scalar_BOOLEAN 0 ME11_CM_boolean_flg 0.0 1.0 /end CHARACTERISTIC
/begin CHARACTERISTIC cal_SOVData "" VALUE 0x0000 /* @ECU_Address@cal_SOVData@ */ Scalar_BOOLEAN 0 ME11_CM_boolean_flg 0.0 1.0 /end CHARACTERISTIC
/begin CHARACTERISTIC cal_SOVEnb "" VALUE 0x0000 /* @ECU_Address@cal_SOVEnb@ */ Scalar_BOOLEAN 0 ME11_CM_boolean_flg 0.0 1.0 /end CHARACTERISTIC
/begin CHARACTERISTIC cal_SetLeftMixDoorTrgDataEnb "" VALUE 0x0000 /* @ECU_Address@cal_SetLeftMixDoorTrgDataEnb@ */ Scalar_BOOLEAN 0 ME11_CM_boolean_flg 0.0 1.0 /end CHARACTERISTIC
/begin CHARACTERISTIC cal_SolarEnb "" VALUE 0x0000 /* @ECU_Address@cal_SolarEnb@ */ Scalar_BOOLEAN 0 ME11_CM_boolean_flg 0.0 1.0 /end CHARACTERISTIC
/begin CHARACTERISTIC cal_WCCTempDataEnb "" VALUE 0x0000 /* @ECU_Address@cal_WCCTempDataEnb@ */ Scalar_BOOLEAN 0 ME11_CM_boolean_flg 0.0 1.0 /end CHARACTERISTIC
/begin CHARACTERISTIC cal_WaterModeEnb "" VALUE 0x0000 /* @ECU_Address@cal_WaterModeEnb@ */ Scalar_BOOLEAN 0 ME11_CM_boolean_null 0.0 1.0 /end CHARACTERISTIC
/begin CHARACTERISTIC cal_bExhFlgData "" VALUE 0x0000 /* @ECU_Address@cal_bExhFlgData@ */ Scalar_BOOLEAN 0 ME11_CM_boolean_flg 0.0 1.0 /end CHARACTERISTIC
/begin CHARACTERISTIC cal_bExhFlgEnb "" VALUE 0x0000 /* @ECU_Address@cal_bExhFlgEnb@ */ Scalar_BOOLEAN 0 ME11_CM_boolean_flg 0.0 1.0 /end CHARACTERISTIC
/begin CHARACTERISTIC cal_bLeftSetHighData "" VALUE 0x0000 /* @ECU_Address@cal_bLeftSetHighData@ */ Scalar_BOOLEAN 0 ME11_CM_boolean_flg 0.0 1.0 /end CHARACTERISTIC
/begin CHARACTERISTIC cal_bLeftSetHighEnb "" VALUE 0x0000 /* @ECU_Address@cal_bLeftSetHighEnb@ */ Scalar_BOOLEAN 0 ME11_CM_boolean_flg 0.0 1.0 /end CHARACTERISTIC
/begin CHARACTERISTIC cal_bLeftSetLowData "" VALUE 0x0000 /* @ECU_Address@cal_bLeftSetLowData@ */ Scalar_BOOLEAN 0 ME11_CM_boolean_flg 0.0 1.0 /end CHARACTERISTIC
/begin CHARACTERISTIC cal_bLeftSetLowEnb "" VALUE 0x0000 /* @ECU_Address@cal_bLeftSetLowEnb@ */ Scalar_BOOLEAN 0 ME11_CM_boolean_flg 0.0 1.0 /end CHARACTERISTIC
/begin CHARACTERISTIC cal_eBlwStsEnb "" VALUE 0x0000 /* @ECU_Address@cal_eBlwStsEnb@ */ Scalar_BOOLEAN 0 ME11_CM_boolean_flg 0.0 1.0 /end CHARACTERISTIC
/begin CHARACTERISTIC cal_eC3WVValueEnb "" VALUE 0x0000 /* @ECU_Address@cal_eC3WVValueEnb@ */ Scalar_BOOLEAN 0 ME11_CM_boolean_flg 0.0 1.0 /end CHARACTERISTIC
/begin CHARACTERISTIC cal_eC5WVValueEnb "" VALUE 0x0000 /* @ECU_Address@cal_eC5WVValueEnb@ */ Scalar_BOOLEAN 0 ME11_CM_boolean_flg 0.0 1.0 /end CHARACTERISTIC
/begin CHARACTERISTIC cal_eInnerEnb "" VALUE 0x0000 /* @ECU_Address@cal_eInnerEnb@ */ Scalar_BOOLEAN 0 ME11_CM_boolean_flg 0.0 1.0 /end CHARACTERISTIC
/begin CHARACTERISTIC cal_eModeMotorEnb "" VALUE 0x0000 /* @ECU_Address@cal_eModeMotorEnb@ */ Scalar_BOOLEAN 0 ME11_CM_boolean_flg 0.0 1.0 /end CHARACTERISTIC
/begin CHARACTERISTIC cal_sMixDoorEnb "" VALUE 0x0000 /* @ECU_Address@cal_sMixDoorEnb@ */ Scalar_BOOLEAN 0 ME11_CM_boolean_flg 0.0 1.0 /end CHARACTERISTIC
/begin CHARACTERISTIC cal_tLeftSetPointEnb "" VALUE 0x0000 /* @ECU_Address@cal_tLeftSetPointEnb@ */ Scalar_BOOLEAN 0 ME11_CM_boolean_flg 0.0 1.0 /end CHARACTERISTIC
/begin CHARACTERISTIC ACOff "" VALUE 0x0000 /* @ECU_Address@ACOff@ */ Scalar_UBYTE 0 ME11_CM_uint8_flg 0.0 64.0 /end CHARACTERISTIC
/begin CHARACTERISTIC cal_ACCMHiTempFanCtrl "" VALUE 0x0000 /* @ECU_Address@cal_ACCMHiTempFanCtrl@ */ Scalar_UBYTE 0 ME11_CM_uint8_percent_ 0.0 100.0 /end CHARACTERISTIC
/begin CHARACTERISTIC cal_ACPMPSpdDiffVal "" VALUE 0x0000 /* @ECU_Address@cal_ACPMPSpdDiffVal@ */ Scalar_UBYTE 0 ME11_CM_uint8_percent_ 0.0 100.0 /end CHARACTERISTIC
/begin CHARACTERISTIC cal_ACPumpBatHeatSpd "" VALUE 0x0000 /* @ECU_Address@cal_ACPumpBatHeatSpd@ */ Scalar_UBYTE 0 ME11_CM_uint8_percent_ 0.0 100.0 /end CHARACTERISTIC
/begin CHARACTERISTIC cal_ACPumpCtrlASpd "" VALUE 0x0000 /* @ECU_Address@cal_ACPumpCtrlASpd@ */ Scalar_UBYTE 0 ME11_CM_uint8_percent_ 0.0 255.0 /end CHARACTERISTIC
/begin CHARACTERISTIC cal_ACPumpDefSpd "" VALUE 0x0000 /* @ECU_Address@cal_ACPumpDefSpd@ */ Scalar_UBYTE 0 ME11_CM_uint8_percent_ 0.0 255.0 /end CHARACTERISTIC
/begin CHARACTERISTIC cal_ACPumpDehSpd "" VALUE 0x0000 /* @ECU_Address@cal_ACPumpDehSpd@ */ Scalar_UBYTE 0 ME11_CM_uint8_percent_ 0.0 100.0 /end CHARACTERISTIC
/begin CHARACTERISTIC cal_ACPumpDoubleHeatSpd "" VALUE 0x0000 /* @ECU_Address@cal_ACPumpDoubleHeatSpd@ */ Scalar_UBYTE 0 ME11_CM_uint8_percent_ 0.0 100.0 /end CHARACTERISTIC
/begin CHARACTERISTIC cal_AirInletPerData "" VALUE 0x0000 /* @ECU_Address@cal_AirInletPerData@ */ Scalar_UBYTE 0 ME11_CM_uint8_percent_ 0.0 100.0 /end CHARACTERISTIC
/begin CHARACTERISTIC cal_BATPMPSpdDiffVal "" VALUE 0x0000 /* @ECU_Address@cal_BATPMPSpdDiffVal@ */ Scalar_UBYTE 0 ME11_CM_uint8_percent_ 0.0 100.0 /end CHARACTERISTIC
/begin CHARACTERISTIC cal_BatCoolStopBatPMPSpd "" VALUE 0x0000 /* @ECU_Address@cal_BatCoolStopBatPMPSpd@ */ Scalar_UBYTE 0 ME11_CM_uint8_percent_ 10.0 100.0 /end CHARACTERISTIC
/begin CHARACTERISTIC cal_BatPumpCtrlASpd "" VALUE 0x0000 /* @ECU_Address@cal_BatPumpCtrlASpd@ */ Scalar_UBYTE 0 ME11_CM_uint8_percent_ 0.0 255.0 /end CHARACTERISTIC
/begin CHARACTERISTIC cal_BatPumpMotHeatBatSpd "" VALUE 0x0000 /* @ECU_Address@cal_BatPumpMotHeatBatSpd@ */ Scalar_UBYTE 0 ME11_CM_uint8_percent_ 0.0 100.0 /end CHARACTERISTIC
/begin CHARACTERISTIC cal_BatPumpMotLTRAndBatCHSpd "" VALUE 0x0000 /* @ECU_Address@cal_BatPumpMotLTRAndBatCHSpd@ */ Scalar_UBYTE 0 ME11_CM_uint8_percent_ 0.0 100.0 /end CHARACTERISTIC
/begin CHARACTERISTIC cal_BlwFanData "" VALUE 0x0000 /* @ECU_Address@cal_BlwFanData@ */ Scalar_UBYTE 0 ME11_CM_uint8_percent_ 0.0 100.0 /end CHARACTERISTIC
/begin CHARACTERISTIC cal_COMPFanSpdLmt "" VAL_BLK 0x0000 /* @ECU_Address@cal_COMPFanSpdLmt@ */ Scalar_UBYTE 0 ME11_CM_uint8_percent_ 0.0 100.0 NUMBER 3 /end CHARACTERISTIC
/begin CHARACTERISTIC cal_CoolFanData "" VALUE 0x0000 /* @ECU_Address@cal_CoolFanData@ */ Scalar_UBYTE 0 ME11_CM_uint8_percent_ 0.0 100.0 /end CHARACTERISTIC
/begin CHARACTERISTIC cal_FanCtrlOff "" VALUE 0x0000 /* @ECU_Address@cal_FanCtrlOff@ */ Scalar_UBYTE 0 ME11_CM_uint8_percent_ 0.0 100.0 /end CHARACTERISTIC
/begin CHARACTERISTIC cal_HVPartModeData "" VALUE 0x0000 /* @ECU_Address@cal_HVPartModeData@ */ Scalar_UBYTE 0 ME11_CM_uint8_null 0.0 8.0 /end CHARACTERISTIC
/begin CHARACTERISTIC cal_HeatCabinAndCoolBatFanSpd "" VALUE 0x0000 /* @ECU_Address@cal_HeatCabinAndCoolBatFanSpd@ */ Scalar_UBYTE 0 ME11_CM_uint8_rpm 0.0 100.0 /end CHARACTERISTIC
/begin CHARACTERISTIC cal_IGNONDelayTime "" VALUE 0x0000 /* @ECU_Address@cal_IGNONDelayTime@ */ Scalar_UBYTE 0 ME11_CM_uint8_ms 0.0 100.0 /end CHARACTERISTIC
/begin CHARACTERISTIC cal_InnerRecTrgPos "" VALUE 0x0000 /* @ECU_Address@cal_InnerRecTrgPos@ */ Scalar_UBYTE 0 ME11_CM_uint8_percent_ 0.0 100.0 /end CHARACTERISTIC
/begin CHARACTERISTIC cal_LPFanCtrl "" VALUE 0x0000 /* @ECU_Address@cal_LPFanCtrl@ */ Scalar_UBYTE 0 ME11_CM_uint8_percent_ 0.0 100.0 /end CHARACTERISTIC
/begin CHARACTERISTIC cal_MixCoolTrgPos "" VALUE 0x0000 /* @ECU_Address@cal_MixCoolTrgPos@ */ Scalar_UBYTE 0 ME11_CM_uint8_percent_ 0.0 100.0 /end CHARACTERISTIC
/begin CHARACTERISTIC cal_MixDoorNData "" VALUE 0x0000 /* @ECU_Address@cal_MixDoorNData@ */ Scalar_UBYTE 0 ME11_CM_uint8_flg 0.0 2.0 /end CHARACTERISTIC
/begin CHARACTERISTIC cal_MixDoorPData "" VALUE 0x0000 /* @ECU_Address@cal_MixDoorPData@ */ Scalar_UBYTE 0 ME11_CM_uint8_flg 0.0 2.0 /end CHARACTERISTIC
/begin CHARACTERISTIC cal_MixWarmTrgPos "" VALUE 0x0000 /* @ECU_Address@cal_MixWarmTrgPos@ */ Scalar_UBYTE 0 ME11_CM_uint8_percent_ 0.0 100.0 /end CHARACTERISTIC
/begin CHARACTERISTIC cal_ModeMotorNData "" VALUE 0x0000 /* @ECU_Address@cal_ModeMotorNData@ */ Scalar_UBYTE 0 ME11_CM_uint8_flg 0.0 1.0 /end CHARACTERISTIC
/begin CHARACTERISTIC cal_ModeMotorPData "" VALUE 0x0000 /* @ECU_Address@cal_ModeMotorPData@ */ Scalar_UBYTE 0 ME11_CM_uint8_flg 0.0 1.0 /end CHARACTERISTIC
/begin CHARACTERISTIC cal_MotPMPDefaultSpd "" VALUE 0x0000 /* @ECU_Address@cal_MotPMPDefaultSpd@ */ Scalar_UBYTE 0 ME11_CM_uint8_percent_ 0.0 100.0 /end CHARACTERISTIC
/begin CHARACTERISTIC cal_MotPMPMotHeatBatSpd "" VALUE 0x0000 /* @ECU_Address@cal_MotPMPMotHeatBatSpd@ */ Scalar_UBYTE 0 ME11_CM_uint8_percent_ 0.0 100.0 /end CHARACTERISTIC
/begin CHARACTERISTIC cal_MotPMPSpdDiffVal "" VALUE 0x0000 /* @ECU_Address@cal_MotPMPSpdDiffVal@ */ Scalar_UBYTE 0 ME11_CM_uint8_percent_ 0.0 100.0 /end CHARACTERISTIC
/begin CHARACTERISTIC cal_MotPMPThStoSpd "" VALUE 0x0000 /* @ECU_Address@cal_MotPMPThStoSpd@ */ Scalar_UBYTE 0 ME11_CM_uint8_percent_ 0.0 100.0 /end CHARACTERISTIC
/begin CHARACTERISTIC cal_OutRecTrgPos "" VALUE 0x0000 /* @ECU_Address@cal_OutRecTrgPos@ */ Scalar_UBYTE 0 ME11_CM_uint8_percent_ 0.0 100.0 /end CHARACTERISTIC
/begin CHARACTERISTIC cal_PTCDelOffTime "" VALUE 0x0000 /* @ECU_Address@cal_PTCDelOffTime@ */ Scalar_UBYTE 0 ME11_CM_uint8_s 0.0 255.0 /end CHARACTERISTIC
/begin CHARACTERISTIC cal_PTCOffAcPMPSpd "" VALUE 0x0000 /* @ECU_Address@cal_PTCOffAcPMPSpd@ */ Scalar_UBYTE 0 ME11_CM_uint8_rpm 0.0 100.0 /end CHARACTERISTIC
/begin CHARACTERISTIC cal_PTCRunAcPMPFFSpd "" VALUE 0x0000 /* @ECU_Address@cal_PTCRunAcPMPFFSpd@ */ Scalar_UBYTE 0 ME11_CM_uint8_rpm 0.0 100.0 /end CHARACTERISTIC
/begin CHARACTERISTIC cal_PwrFanAndPumpData "" VALUE 0x0000 /* @ECU_Address@cal_PwrFanAndPumpData@ */ Scalar_UBYTE 0 ME11_CM_uint8_null 0.0 8.0 /end CHARACTERISTIC
/begin CHARACTERISTIC cal_RecircMotorNData "" VALUE 0x0000 /* @ECU_Address@cal_RecircMotorNData@ */ Scalar_UBYTE 0 ME11_CM_uint8_flg 0.0 2.0 /end CHARACTERISTIC
/begin CHARACTERISTIC cal_RecircMotorPData "" VALUE 0x0000 /* @ECU_Address@cal_RecircMotorPData@ */ Scalar_UBYTE 0 ME11_CM_uint8_flg 0.0 2.0 /end CHARACTERISTIC
/begin CHARACTERISTIC cal_RecircTrgPosData "" VALUE 0x0000 /* @ECU_Address@cal_RecircTrgPosData@ */ Scalar_UBYTE 0 ME11_CM_uint8_percent_ 0.0 100.0 /end CHARACTERISTIC
/begin CHARACTERISTIC cal_TMSStatusEnb "" VALUE 0x0000 /* @ECU_Address@cal_TMSStatusEnb@ */ Scalar_UBYTE 0 ME11_CM_uint8_flg 0.0 1.0 /end CHARACTERISTIC
/begin CHARACTERISTIC cal_eBlwStsData "" VALUE 0x0000 /* @ECU_Address@cal_eBlwStsData@ */ Scalar_UBYTE 0 ME11_CM_uint8_null 0.0 9.0 /end CHARACTERISTIC
/begin CHARACTERISTIC cal_eC3WVValueData "" VALUE 0x0000 /* @ECU_Address@cal_eC3WVValueData@ */ Scalar_UBYTE 0 ME11_CM_uint8_null 0.0 255.0 /end CHARACTERISTIC
/begin CHARACTERISTIC cal_eC5WVValueData "" VALUE 0x0000 /* @ECU_Address@cal_eC5WVValueData@ */ Scalar_UBYTE 0 ME11_CM_uint8_null 0.0 255.0 /end CHARACTERISTIC
/begin CHARACTERISTIC cal_eInnerData "" VALUE 0x0000 /* @ECU_Address@cal_eInnerData@ */ Scalar_UBYTE 0 ME11_CM_uint8_null 0.0 4.0 /end CHARACTERISTIC
/begin CHARACTERISTIC cal_eModeMotorData "" VALUE 0x0000 /* @ECU_Address@cal_eModeMotorData@ */ Scalar_UBYTE 0 ME11_CM_uint8_null 0.0 9.0 /end CHARACTERISTIC
/begin CHARACTERISTIC cal_rCabinEvpToHPInnRatio "" VALUE 0x0000 /* @ECU_Address@cal_rCabinEvpToHPInnRatio@ */ Scalar_UBYTE 0 ME11_CM_uint8_percent_ 0.0 100.0 /end CHARACTERISTIC
/begin CHARACTERISTIC cal_rCabinHPToEvpInnRatio "" VALUE 0x0000 /* @ECU_Address@cal_rCabinHPToEvpInnRatio@ */ Scalar_UBYTE 0 ME11_CM_uint8_percent_ 0.0 100.0 /end CHARACTERISTIC
/begin MEASUREMENT PWRCtl_uTMSRunTimer "" ULONG ME11_CM_uint32_t 0 0 0 4294967295 ECU_ADDRESS 0x0000 /* @ECU_Address@PWRCtl_uTMSRunTimer@ */ /end MEASUREMENT
/begin MEASUREMENT SEN_TEnvRaw "" FLOAT32_IEEE ME11_CM_single_C 0 0 -3.4E+38 3.4E+38 ECU_ADDRESS 0x0000 /* @ECU_Address@SEN_TEnvRaw@ */ /end MEASUREMENT
/begin MEASUREMENT SEN_TMotRaw "" FLOAT32_IEEE ME11_CM_single_C 0 0 -3.4E+38 3.4E+38 ECU_ADDRESS 0x0000 /* @ECU_Address@SEN_TMotRaw@ */ /end MEASUREMENT
/begin MEASUREMENT ACSen_sMotTempFilter "" FLOAT32_IEEE ME11_CM_single_C 0 0 -3.4E+38 3.4E+38 ECU_ADDRESS 0x0000 /* @ECU_Address@ACSen_sMotTempFilter@ */ /end MEASUREMENT
/begin MEASUREMENT ColdPCUTempMinByEnv "" FLOAT32_IEEE ME11_CM_single_C 0 0 -3.4E+38 3.4E+38 ECU_ADDRESS 0x0000 /* @ECU_Address@ColdPCUTempMinByEnv@ */ /end MEASUREMENT
/begin MEASUREMENT ACSen_sEnvTAme "" FLOAT32_IEEE ME11_CM_single_C 0 0 -3.4E+38 3.4E+38 ECU_ADDRESS 0x0000 /* @ECU_Address@ACSen_sEnvTAme@ */ /end MEASUREMENT
/begin MEASUREMENT ACSen_sEnvTempCor "" FLOAT32_IEEE ME11_CM_single_C 0 0 -3.4E+38 3.4E+38 ECU_ADDRESS 0x0000 /* @ECU_Address@ACSen_sEnvTempCor@ */ /end MEASUREMENT
/begin MEASUREMENT SEN_TCabinRaw "" FLOAT32_IEEE ME11_CM_single_C 0 0 -3.4E+38 3.4E+38 ECU_ADDRESS 0x0000 /* @ECU_Address@SEN_TCabinRaw@ */ /end MEASUREMENT
/begin MEASUREMENT ACSen_sCabinTempFilter "" FLOAT32_IEEE ME11_CM_single_C 0 0 -3.4E+38 3.4E+38 ECU_ADDRESS 0x0000 /* @ECU_Address@ACSen_sCabinTempFilter@ */ /end MEASUREMENT
/begin MEASUREMENT SEN_TDuctRaw "" FLOAT32_IEEE ME11_CM_single_C 0 0 -3.4E+38 3.4E+38 ECU_ADDRESS 0x0000 /* @ECU_Address@SEN_TDuctRaw@ */ /end MEASUREMENT
/begin MEASUREMENT ACSen_sFaceDuctTempFilter "" FLOAT32_IEEE ME11_CM_single_C 0 0 -3.4E+38 3.4E+38 ECU_ADDRESS 0x0000 /* @ECU_Address@ACSen_sFaceDuctTempFilter@ */ /end MEASUREMENT
/begin MEASUREMENT SEN_TFootDuctRaw "" FLOAT32_IEEE ME11_CM_single_C 0 0 -3.4E+38 3.4E+38 ECU_ADDRESS 0x0000 /* @ECU_Address@SEN_TFootDuctRaw@ */ /end MEASUREMENT
/begin MEASUREMENT ACSen_sFootDuctTempFilter "" FLOAT32_IEEE ME11_CM_single_C 0 0 -3.4E+38 3.4E+38 ECU_ADDRESS 0x0000 /* @ECU_Address@ACSen_sFootDuctTempFilter@ */ /end MEASUREMENT
/begin MEASUREMENT SEN_EvapTRaw "" FLOAT32_IEEE ME11_CM_single_C 0 0 -3.4E+38 3.4E+38 ECU_ADDRESS 0x0000 /* @ECU_Address@SEN_EvapTRaw@ */ /end MEASUREMENT
/begin MEASUREMENT ACSen_sEvapTempFilter "" FLOAT32_IEEE ME11_CM_single_C 0 0 -3.4E+38 3.4E+38 ECU_ADDRESS 0x0000 /* @ECU_Address@ACSen_sEvapTempFilter@ */ /end MEASUREMENT
/begin MEASUREMENT BMS_HVBatCellTempMax "" FLOAT32_IEEE ME11_CM_single_C 0 0 -3.4E+38 3.4E+38 ECU_ADDRESS 0x0000 /* @ECU_Address@BMS_HVBatCellTempMax@ */ /end MEASUREMENT
/begin MEASUREMENT BMS_HVBatCellTempMin "" FLOAT32_IEEE ME11_CM_single_C 0 0 -3.4E+38 3.4E+38 ECU_ADDRESS 0x0000 /* @ECU_Address@BMS_HVBatCellTempMin@ */ /end MEASUREMENT
/begin MEASUREMENT BMS_InletCooltActlTemp "" FLOAT32_IEEE ME11_CM_single_C 0 0 -3.4E+38 3.4E+38 ECU_ADDRESS 0x0000 /* @ECU_Address@BMS_InletCooltActlTemp@ */ /end MEASUREMENT
/begin MEASUREMENT BMS_BatSOCAct_pct "" FLOAT32_IEEE ME11_CM_single_percent_ 0 0 -3.4E+38 3.4E+38 ECU_ADDRESS 0x0000 /* @ECU_Address@BMS_BatSOCAct_pct@ */ /end MEASUREMENT
/begin MEASUREMENT IOCtl_sModeMotorTrgPos "" FLOAT32_IEEE ME11_CM_single_v 0 0 -3.4E+38 3.4E+38 ECU_ADDRESS 0x0000 /* @ECU_Address@IOCtl_sModeMotorTrgPos@ */ /end MEASUREMENT
/begin MEASUREMENT ACSen_sModeMotorVol "" FLOAT32_IEEE ME11_CM_single_null 0 0 -3.4E+38 3.4E+38 ECU_ADDRESS 0x0000 /* @ECU_Address@ACSen_sModeMotorVol@ */ /end MEASUREMENT
/begin MEASUREMENT SOMCtl_sF1Value "" FLOAT32_IEEE ME11_CM_single_C 0 0 -3.4E+38 3.4E+38 ECU_ADDRESS 0x0000 /* @ECU_Address@SOMCtl_sF1Value@ */ /end MEASUREMENT
/begin MEASUREMENT SOMCtl_sF2Value "" FLOAT32_IEEE ME11_CM_single_C 0 0 -3.4E+38 3.4E+38 ECU_ADDRESS 0x0000 /* @ECU_Address@SOMCtl_sF2Value@ */ /end MEASUREMENT
/begin MEASUREMENT HP_EXV_CurrentPosition_B "" FLOAT32_IEEE ME11_CM_single_null 0 0 -3.4E+38 3.4E+38 ECU_ADDRESS 0x0000 /* @ECU_Address@HP_EXV_CurrentPosition_B@ */ /end MEASUREMENT
/begin MEASUREMENT SEN_TEvapSurRaw "" FLOAT32_IEEE ME11_CM_single_C 0 0 -3.4E+38 3.4E+38 ECU_ADDRESS 0x0000 /* @ECU_Address@SEN_TEvapSurRaw@ */ /end MEASUREMENT
/begin MEASUREMENT ACSen_sEvapSurTemp "" FLOAT32_IEEE ME11_CM_single_C 0 0 -3.4E+38 3.4E+38 ECU_ADDRESS 0x0000 /* @ECU_Address@ACSen_sEvapSurTemp@ */ /end MEASUREMENT
/begin MEASUREMENT SEN_MixDoorRaw "" FLOAT32_IEEE ME11_CM_single_percent_ 0 0 -3.4E+38 3.4E+38 ECU_ADDRESS 0x0000 /* @ECU_Address@SEN_MixDoorRaw@ */ /end MEASUREMENT
/begin MEASUREMENT ACSen_sMixDoorPerc "" FLOAT32_IEEE ME11_CM_single_percent_ 0 0 -3.4E+38 3.4E+38 ECU_ADDRESS 0x0000 /* @ECU_Address@ACSen_sMixDoorPerc@ */ /end MEASUREMENT
/begin MEASUREMENT COMP_EcompActSpd "" FLOAT32_IEEE ME11_CM_single_null 0 0 -3.4E+38 3.4E+38 ECU_ADDRESS 0x0000 /* @ECU_Address@COMP_EcompActSpd@ */ /end MEASUREMENT
/begin MEASUREMENT SEN_OHXTRaw "" FLOAT32_IEEE ME11_CM_single_C 0 0 -3.4E+38 3.4E+38 ECU_ADDRESS 0x0000 /* @ECU_Address@SEN_OHXTRaw@ */ /end MEASUREMENT
/begin MEASUREMENT ACSen_sOHXTempFilter "" FLOAT32_IEEE ME11_CM_single_C 0 0 -3.4E+38 3.4E+38 ECU_ADDRESS 0x0000 /* @ECU_Address@ACSen_sOHXTempFilter@ */ /end MEASUREMENT
/begin MEASUREMENT EXV_CurrentPosition "" FLOAT32_IEEE ME11_CM_single_null 0 0 -3.4E+38 3.4E+38 ECU_ADDRESS 0x0000 /* @ECU_Address@EXV_CurrentPosition@ */ /end MEASUREMENT
/begin MEASUREMENT BAT_EXV_CurrentPosition_B "" FLOAT32_IEEE ME11_CM_single_null 0 0 -3.4E+38 3.4E+38 ECU_ADDRESS 0x0000 /* @ECU_Address@BAT_EXV_CurrentPosition_B@ */ /end MEASUREMENT
/begin MEASUREMENT SEN_WCCTHiRaw "" FLOAT32_IEEE ME11_CM_single_C 0 0 -3.4E+38 3.4E+38 ECU_ADDRESS 0x0000 /* @ECU_Address@SEN_WCCTHiRaw@ */ /end MEASUREMENT
/begin MEASUREMENT ACSen_sWCCHiTempFilter "" FLOAT32_IEEE ME11_CM_single_C 0 0 -3.4E+38 3.4E+38 ECU_ADDRESS 0x0000 /* @ECU_Address@ACSen_sWCCHiTempFilter@ */ /end MEASUREMENT
/begin MEASUREMENT SEN_WCCHiPressRaw "" FLOAT32_IEEE ME11_CM_single_Mpa 0 0 -3.4E+38 3.4E+38 ECU_ADDRESS 0x0000 /* @ECU_Address@SEN_WCCHiPressRaw@ */ /end MEASUREMENT
/begin MEASUREMENT ACSen_sHiPressFilter "" FLOAT32_IEEE ME11_CM_single_Mpa 0 0 -3.4E+38 3.4E+38 ECU_ADDRESS 0x0000 /* @ECU_Address@ACSen_sHiPressFilter@ */ /end MEASUREMENT
/begin MEASUREMENT SEN_LoPressRaw "" FLOAT32_IEEE ME11_CM_single_Mpa 0 0 -3.4E+38 3.4E+38 ECU_ADDRESS 0x0000 /* @ECU_Address@SEN_LoPressRaw@ */ /end MEASUREMENT
/begin MEASUREMENT ACSen_sLoPressFilter "" FLOAT32_IEEE ME11_CM_single_Mpa 0 0 -3.4E+38 3.4E+38 ECU_ADDRESS 0x0000 /* @ECU_Address@ACSen_sLoPressFilter@ */ /end MEASUREMENT
/begin MEASUREMENT SEN_ACCMTHiRaw "" FLOAT32_IEEE ME11_CM_single_C 0 0 -3.4E+38 3.4E+38 ECU_ADDRESS 0x0000 /* @ECU_Address@SEN_ACCMTHiRaw@ */ /end MEASUREMENT
/begin MEASUREMENT ACSen_sACCMHiTempFilter "" FLOAT32_IEEE ME11_CM_single_C 0 0 -3.4E+38 3.4E+38 ECU_ADDRESS 0x0000 /* @ECU_Address@ACSen_sACCMHiTempFilter@ */ /end MEASUREMENT
/begin MEASUREMENT SEN_ChiTRaw "" FLOAT32_IEEE ME11_CM_single_C 0 0 -3.4E+38 3.4E+38 ECU_ADDRESS 0x0000 /* @ECU_Address@SEN_ChiTRaw@ */ /end MEASUREMENT
/begin MEASUREMENT ACSen_sChiTempFilter "" FLOAT32_IEEE ME11_CM_single_C 0 0 -3.4E+38 3.4E+38 ECU_ADDRESS 0x0000 /* @ECU_Address@ACSen_sChiTempFilter@ */ /end MEASUREMENT
/begin MEASUREMENT AcPMP_RealRPM "" FLOAT32_IEEE ME11_CM_single_null 0 0 -3.4E+38 3.4E+38 ECU_ADDRESS 0x0000 /* @ECU_Address@AcPMP_RealRPM@ */ /end MEASUREMENT
/begin MEASUREMENT SOMCtl_sBatTrgTemp "" FLOAT32_IEEE ME11_CM_single_C 0 0 -3.4E+38 3.4E+38 ECU_ADDRESS 0x0000 /* @ECU_Address@SOMCtl_sBatTrgTemp@ */ /end MEASUREMENT
/begin MEASUREMENT ACTCtl_sPTCRequestTemp "" FLOAT32_IEEE ME11_CM_single_C 0 0 -3.4E+38 3.4E+38 ECU_ADDRESS 0x0000 /* @ECU_Address@ACTCtl_sPTCRequestTemp@ */ /end MEASUREMENT
/begin MEASUREMENT BatPMP_RealRPM "" FLOAT32_IEEE ME11_CM_single_null 0 0 -3.4E+38 3.4E+38 ECU_ADDRESS 0x0000 /* @ECU_Address@BatPMP_RealRPM@ */ /end MEASUREMENT
/begin MEASUREMENT IOCtl_sMixDoorTrgPos "" FLOAT32_IEEE ME11_CM_single_percent_ 0 0 -3.4E+38 3.4E+38 ECU_ADDRESS 0x0000 /* @ECU_Address@IOCtl_sMixDoorTrgPos@ */ /end MEASUREMENT
/begin MEASUREMENT ACTCtl_sCOMPSetPoint "" FLOAT32_IEEE ME11_CM_single_null 0 0 -3.4E+38 3.4E+38 ECU_ADDRESS 0x0000 /* @ECU_Address@ACTCtl_sCOMPSetPoint@ */ /end MEASUREMENT
/begin MEASUREMENT ACTCtl_sCOMPActure "" FLOAT32_IEEE ME11_CM_single_null 0 0 -3.4E+38 3.4E+38 ECU_ADDRESS 0x0000 /* @ECU_Address@ACTCtl_sCOMPActure@ */ /end MEASUREMENT
/begin MEASUREMENT ACTCtl_sDvtCOMPCtrl "" FLOAT32_IEEE ME11_CM_single_C 0 0 -3.4E+38 3.4E+38 ECU_ADDRESS 0x0000 /* @ECU_Address@ACTCtl_sDvtCOMPCtrl@ */ /end MEASUREMENT
/begin MEASUREMENT ACTCtl_sCOMPCtrlKi "" FLOAT32_IEEE ME11_CM_single_null 0 0 -3.4E+38 3.4E+38 ECU_ADDRESS 0x0000 /* @ECU_Address@ACTCtl_sCOMPCtrlKi@ */ /end MEASUREMENT
/begin MEASUREMENT ACTCtl_sCOMPCtrlKp "" FLOAT32_IEEE ME11_CM_single_null 0 0 -3.4E+38 3.4E+38 ECU_ADDRESS 0x0000 /* @ECU_Address@ACTCtl_sCOMPCtrlKp@ */ /end MEASUREMENT
/begin MEASUREMENT ACTCtl_sCOMPLmtMaxSpd "" FLOAT32_IEEE ME11_CM_single_rpm 0 0 -3.4E+38 3.4E+38 ECU_ADDRESS 0x0000 /* @ECU_Address@ACTCtl_sCOMPLmtMaxSpd@ */ /end MEASUREMENT
/begin MEASUREMENT ACTCtl_sACCMCtlSpd "" FLOAT32_IEEE ME11_CM_single_rpm 0 0 -3.4E+38 3.4E+38 ECU_ADDRESS 0x0000 /* @ECU_Address@ACTCtl_sACCMCtlSpd@ */ /end MEASUREMENT
/begin MEASUREMENT BMS_HVBatCellTempAve "" FLOAT32_IEEE ME11_CM_single_C 0 0 -3.4E+38 3.4E+38 ECU_ADDRESS 0x0000 /* @ECU_Address@BMS_HVBatCellTempAve@ */ /end MEASUREMENT
/begin MEASUREMENT ACTCtl_sCoolCondDep "" FLOAT32_IEEE ME11_CM_single_C 0 0 -3.4E+38 3.4E+38 ECU_ADDRESS 0x0000 /* @ECU_Address@ACTCtl_sCoolCondDep@ */ /end MEASUREMENT
/begin MEASUREMENT ACTCtl_sEvapSuperHeat "" FLOAT32_IEEE ME11_CM_single_C 0 0 -3.4E+38 3.4E+38 ECU_ADDRESS 0x0000 /* @ECU_Address@ACTCtl_sEvapSuperHeat@ */ /end MEASUREMENT
/begin MEASUREMENT ACTCtl_sAEXVSetPoint "" FLOAT32_IEEE ME11_CM_single_null 0 0 -3.4E+38 3.4E+38 ECU_ADDRESS 0x0000 /* @ECU_Address@ACTCtl_sAEXVSetPoint@ */ /end MEASUREMENT
/begin MEASUREMENT ACTCtl_sAEXVActure "" FLOAT32_IEEE ME11_CM_single_null 0 0 -3.4E+38 3.4E+38 ECU_ADDRESS 0x0000 /* @ECU_Address@ACTCtl_sAEXVActure@ */ /end MEASUREMENT
/begin MEASUREMENT ACTCtl_sAEXVCtrlKi "" FLOAT32_IEEE ME11_CM_single_null 0 0 -3.4E+38 3.4E+38 ECU_ADDRESS 0x0000 /* @ECU_Address@ACTCtl_sAEXVCtrlKi@ */ /end MEASUREMENT
/begin MEASUREMENT ACTCtl_sAEXVCtrlKp "" FLOAT32_IEEE ME11_CM_single_null 0 0 -3.4E+38 3.4E+38 ECU_ADDRESS 0x0000 /* @ECU_Address@ACTCtl_sAEXVCtrlKp@ */ /end MEASUREMENT
/begin MEASUREMENT ACTCtl_sChiSuperHeat "" FLOAT32_IEEE ME11_CM_single_C 0 0 -3.4E+38 3.4E+38 ECU_ADDRESS 0x0000 /* @ECU_Address@ACTCtl_sChiSuperHeat@ */ /end MEASUREMENT
/begin MEASUREMENT ACTCtl_sBEXVSetPoint "" FLOAT32_IEEE ME11_CM_single_null 0 0 -3.4E+38 3.4E+38 ECU_ADDRESS 0x0000 /* @ECU_Address@ACTCtl_sBEXVSetPoint@ */ /end MEASUREMENT
/begin MEASUREMENT ACTCtl_sBEXVActure "" FLOAT32_IEEE ME11_CM_single_null 0 0 -3.4E+38 3.4E+38 ECU_ADDRESS 0x0000 /* @ECU_Address@ACTCtl_sBEXVActure@ */ /end MEASUREMENT
/begin MEASUREMENT ACTCtl_sBEXVCtrlKi "" FLOAT32_IEEE ME11_CM_single_null 0 0 -3.4E+38 3.4E+38 ECU_ADDRESS 0x0000 /* @ECU_Address@ACTCtl_sBEXVCtrlKi@ */ /end MEASUREMENT
/begin MEASUREMENT ACTCtl_sBEXVCtrlKp "" FLOAT32_IEEE ME11_CM_single_null 0 0 -3.4E+38 3.4E+38 ECU_ADDRESS 0x0000 /* @ECU_Address@ACTCtl_sBEXVCtrlKp@ */ /end MEASUREMENT
/begin MEASUREMENT ACTCtl_sCondDep "" FLOAT32_IEEE ME11_CM_single_C 0 0 -3.4E+38 3.4E+38 ECU_ADDRESS 0x0000 /* @ECU_Address@ACTCtl_sCondDep@ */ /end MEASUREMENT
/begin MEASUREMENT ACTCtl_sHPEXVActure "" FLOAT32_IEEE ME11_CM_single_null 0 0 -3.4E+38 3.4E+38 ECU_ADDRESS 0x0000 /* @ECU_Address@ACTCtl_sHPEXVActure@ */ /end MEASUREMENT
/begin MEASUREMENT ACTCtl_sHPEXVCtrlKp "" FLOAT32_IEEE ME11_CM_single_null 0 0 -3.4E+38 3.4E+38 ECU_ADDRESS 0x0000 /* @ECU_Address@ACTCtl_sHPEXVCtrlKp@ */ /end MEASUREMENT
/begin MEASUREMENT ACTCtl_sHPEXVCtrlKi "" FLOAT32_IEEE ME11_CM_single_null 0 0 -3.4E+38 3.4E+38 ECU_ADDRESS 0x0000 /* @ECU_Address@ACTCtl_sHPEXVCtrlKi@ */ /end MEASUREMENT
/begin MEASUREMENT ACTCtl_sSuperHeat "" FLOAT32_IEEE ME11_CM_single_C 0 0 -3.4E+38 3.4E+38 ECU_ADDRESS 0x0000 /* @ECU_Address@ACTCtl_sSuperHeat@ */ /end MEASUREMENT
/begin MEASUREMENT ACTCtl_sExhSuperHeat "" FLOAT32_IEEE ME11_CM_single_C 0 0 -3.4E+38 3.4E+38 ECU_ADDRESS 0x0000 /* @ECU_Address@ACTCtl_sExhSuperHeat@ */ /end MEASUREMENT
/begin MEASUREMENT ACTCtl_sPTCBatHeatPwrLmt "" FLOAT32_IEEE ME11_CM_single_kw 0 0 -3.4E+38 3.4E+38 ECU_ADDRESS 0x0000 /* @ECU_Address@ACTCtl_sPTCBatHeatPwrLmt@ */ /end MEASUREMENT
/begin MEASUREMENT ACTCtl_sSOCHighPTCPwrLmt "" FLOAT32_IEEE ME11_CM_single_kw 0 0 -3.4E+38 3.4E+38 ECU_ADDRESS 0x0000 /* @ECU_Address@ACTCtl_sSOCHighPTCPwrLmt@ */ /end MEASUREMENT
/begin MEASUREMENT MotPMP_RealRPM "" FLOAT32_IEEE ME11_CM_single_null 0 0 -3.4E+38 3.4E+38 ECU_ADDRESS 0x0000 /* @ECU_Address@MotPMP_RealRPM@ */ /end MEASUREMENT
/begin MEASUREMENT COMP_High_Voltage "" FLOAT32_IEEE ME11_CM_single_null 0 0 -3.4E+38 3.4E+38 ECU_ADDRESS 0x0000 /* @ECU_Address@COMP_High_Voltage@ */ /end MEASUREMENT
/begin MEASUREMENT COMP_InputCurrent "" FLOAT32_IEEE ME11_CM_single_null 0 0 -3.4E+38 3.4E+38 ECU_ADDRESS 0x0000 /* @ECU_Address@COMP_InputCurrent@ */ /end MEASUREMENT
/begin MEASUREMENT PWRCtl_sCOMPActlPwr "" FLOAT32_IEEE ME11_CM_single_kw 0 0 -3.4E+38 3.4E+38 ECU_ADDRESS 0x0000 /* @ECU_Address@PWRCtl_sCOMPActlPwr@ */ /end MEASUREMENT
/begin MEASUREMENT COMP_Temperature "" FLOAT32_IEEE ME11_CM_single_null 0 0 -3.4E+38 3.4E+38 ECU_ADDRESS 0x0000 /* @ECU_Address@COMP_Temperature@ */ /end MEASUREMENT
/begin MEASUREMENT EE_tEnv "" FLOAT32_IEEE ME11_CM_single_C 0 0 -3.4E+38 3.4E+38 ECU_ADDRESS 0x0000 /* @ECU_Address@EE_tEnv@ */ /end MEASUREMENT
/begin MEASUREMENT EE_PCUInletTemp "" FLOAT32_IEEE ME11_CM_single_C 0 0 -3.4E+38 3.4E+38 ECU_ADDRESS 0x0000 /* @ECU_Address@EE_PCUInletTemp@ */ /end MEASUREMENT
/begin MEASUREMENT PCU_StartClntTemp "" FLOAT32_IEEE ME11_CM_single_C 0 0 -3.4E+38 3.4E+38 ECU_ADDRESS 0x0000 /* @ECU_Address@PCU_StartClntTemp@ */ /end MEASUREMENT
/begin MEASUREMENT ColdStartPCUTempMinByEnv "" FLOAT32_IEEE ME11_CM_single_C 0 0 -3.4E+38 3.4E+38 ECU_ADDRESS 0x0000 /* @ECU_Address@ColdStartPCUTempMinByEnv@ */ /end MEASUREMENT
/begin MEASUREMENT PCUtempOffset2ShutByEnv "" FLOAT32_IEEE ME11_CM_single_C 0 0 -3.4E+38 3.4E+38 ECU_ADDRESS 0x0000 /* @ECU_Address@PCUtempOffset2ShutByEnv@ */ /end MEASUREMENT
/begin MEASUREMENT HMICtl_sLeftSetPoint "" FLOAT32_IEEE ME11_CM_single_C 0 0 -3.4E+38 3.4E+38 ECU_ADDRESS 0x0000 /* @ECU_Address@HMICtl_sLeftSetPoint@ */ /end MEASUREMENT
/begin MEASUREMENT HMICtl_sMixDoor "" FLOAT32_IEEE ME11_CM_single_percent_ 0 0 -3.4E+38 3.4E+38 ECU_ADDRESS 0x0000 /* @ECU_Address@HMICtl_sMixDoor@ */ /end MEASUREMENT
/begin MEASUREMENT ACTCtl_sACCMCtlFF "" FLOAT32_IEEE ME11_CM_single_rpm 0 0 -3.4E+38 3.4E+38 ECU_ADDRESS 0x0000 /* @ECU_Address@ACTCtl_sACCMCtlFF@ */ /end MEASUREMENT
/begin MEASUREMENT ACNvm_sACEnvTemp "" FLOAT32_IEEE ME11_CM_single_C 0 0 -3.4E+38 3.4E+38 ECU_ADDRESS 0x0000 /* @ECU_Address@ACNvm_sACEnvTemp@ */ /end MEASUREMENT
/begin MEASUREMENT ACNvm_sPCUInletTemp "" FLOAT32_IEEE ME11_CM_single_C 0 0 -3.4E+38 3.4E+38 ECU_ADDRESS 0x0000 /* @ECU_Address@ACNvm_sPCUInletTemp@ */ /end MEASUREMENT
/begin MEASUREMENT SENCtl_uSolorVol "" UWORD ME11_CM_uint16_mv 0 0 0 65535 ECU_ADDRESS 0x0000 /* @ECU_Address@SENCtl_uSolorVol@ */ /end MEASUREMENT
/begin MEASUREMENT SEN_SolarRaw "" UWORD ME11_CM_uint16_w_per_m_2 0 0 0 65535 ECU_ADDRESS 0x0000 /* @ECU_Address@SEN_SolarRaw@ */ /end MEASUREMENT
/begin MEASUREMENT AC_rSolarRight "" UWORD ME11_CM_uint16_null 0 0 0 65535 ECU_ADDRESS 0x0000 /* @ECU_Address@AC_rSolarRight@ */ /end MEASUREMENT
/begin MEASUREMENT SENCtl_uEnvVoltage "" UWORD ME11_CM_uint16_mv 0 0 0 65535 ECU_ADDRESS 0x0000 /* @ECU_Address@SENCtl_uEnvVoltage@ */ /end MEASUREMENT
/begin MEASUREMENT SENCtl_uMotInletTempVol "" UWORD ME11_CM_uint16_mv 0 0 0 65535 ECU_ADDRESS 0x0000 /* @ECU_Address@SENCtl_uMotInletTempVol@ */ /end MEASUREMENT
/begin MEASUREMENT SENCtl_uCabinVoltage "" UWORD ME11_CM_uint16_mv 0 0 0 65535 ECU_ADDRESS 0x0000 /* @ECU_Address@SENCtl_uCabinVoltage@ */ /end MEASUREMENT
/begin MEASUREMENT SENCtl_uFaceDuctVal "" UWORD ME11_CM_uint16_v 0 0 0 65535 ECU_ADDRESS 0x0000 /* @ECU_Address@SENCtl_uFaceDuctVal@ */ /end MEASUREMENT
/begin MEASUREMENT SENCtl_uFootDuctVal "" UWORD ME11_CM_uint16_v 0 0 0 65535 ECU_ADDRESS 0x0000 /* @ECU_Address@SENCtl_uFootDuctVal@ */ /end MEASUREMENT
/begin MEASUREMENT SENCtl_uEVAPXTempVol "" UWORD ME11_CM_uint16_mv 0 0 0 65535 ECU_ADDRESS 0x0000 /* @ECU_Address@SENCtl_uEVAPXTempVol@ */ /end MEASUREMENT
/begin MEASUREMENT SENCtl_uRecircDoorVol "" UWORD ME11_CM_uint16_mv 0 0 0 65535 ECU_ADDRESS 0x0000 /* @ECU_Address@SENCtl_uRecircDoorVol@ */ /end MEASUREMENT
/begin MEASUREMENT SENCtl_uModeDoorVol "" UWORD ME11_CM_uint16_mv 0 0 0 65535 ECU_ADDRESS 0x0000 /* @ECU_Address@SENCtl_uModeDoorVol@ */ /end MEASUREMENT
/begin MEASUREMENT SENCtl_uWCCLPVol "" UWORD ME11_CM_uint16_mv 0 0 0 65535 ECU_ADDRESS 0x0000 /* @ECU_Address@SENCtl_uWCCLPVol@ */ /end MEASUREMENT
/begin MEASUREMENT SENCtl_uWCCHPVol "" UWORD ME11_CM_uint16_mv 0 0 0 65535 ECU_ADDRESS 0x0000 /* @ECU_Address@SENCtl_uWCCHPVol@ */ /end MEASUREMENT
/begin MEASUREMENT SENCtl_uEVAPSurfTempVol "" UWORD ME11_CM_uint16_mv 0 0 0 65535 ECU_ADDRESS 0x0000 /* @ECU_Address@SENCtl_uEVAPSurfTempVol@ */ /end MEASUREMENT
/begin MEASUREMENT SENCtl_uMixDoorVol "" UWORD ME11_CM_uint16_mv 0 0 0 65535 ECU_ADDRESS 0x0000 /* @ECU_Address@SENCtl_uMixDoorVol@ */ /end MEASUREMENT
/begin MEASUREMENT SENCtl_uOHXTempVol "" UWORD ME11_CM_uint16_mv 0 0 0 65535 ECU_ADDRESS 0x0000 /* @ECU_Address@SENCtl_uOHXTempVol@ */ /end MEASUREMENT
/begin MEASUREMENT ACCtl_pwrHeatingReq "" UWORD ME11_CM_uint16_null 0 0 0 65535 ECU_ADDRESS 0x0000 /* @ECU_Address@ACCtl_pwrHeatingReq@ */ /end MEASUREMENT
/begin MEASUREMENT SENCtl_uWCCHighTempVol "" UWORD ME11_CM_uint16_mv 0 0 0 65535 ECU_ADDRESS 0x0000 /* @ECU_Address@SENCtl_uWCCHighTempVol@ */ /end MEASUREMENT
/begin MEASUREMENT SENCtl_uACCMHighTempVol "" UWORD ME11_CM_uint16_mv 0 0 0 65535 ECU_ADDRESS 0x0000 /* @ECU_Address@SENCtl_uACCMHighTempVol@ */ /end MEASUREMENT
/begin MEASUREMENT SENCtl_uChillTempVol "" UWORD ME11_CM_uint16_mv 0 0 0 65535 ECU_ADDRESS 0x0000 /* @ECU_Address@SENCtl_uChillTempVol@ */ /end MEASUREMENT
/begin MEASUREMENT adc2_group0_0 "" UWORD ME11_CM_uint16_mv 0 0 0 65535 ECU_ADDRESS 0x0000 /* @ECU_Address@adc2_group0_0@ */ /end MEASUREMENT
/begin MEASUREMENT adc2_group0_1 "" UWORD ME11_CM_uint16_mv 0 0 0 65535 ECU_ADDRESS 0x0000 /* @ECU_Address@adc2_group0_1@ */ /end MEASUREMENT
/begin MEASUREMENT adc2_group0_2 "" UWORD ME11_CM_uint16_mv 0 0 0 65535 ECU_ADDRESS 0x0000 /* @ECU_Address@adc2_group0_2@ */ /end MEASUREMENT
/begin MEASUREMENT adc2_group1_7 "" UWORD ME11_CM_uint16_mv 0 0 0 65535 ECU_ADDRESS 0x0000 /* @ECU_Address@adc2_group1_7@ */ /end MEASUREMENT
/begin MEASUREMENT adc2_group1_8 "" UWORD ME11_CM_uint16_mv 0 0 0 65535 ECU_ADDRESS 0x0000 /* @ECU_Address@adc2_group1_8@ */ /end MEASUREMENT
/begin MEASUREMENT adc2_group1_9 "" UWORD ME11_CM_uint16_mv 0 0 0 65535 ECU_ADDRESS 0x0000 /* @ECU_Address@adc2_group1_9@ */ /end MEASUREMENT
/begin MEASUREMENT adc2_group1_0 "" UWORD ME11_CM_uint16_mv 0 0 0 65535 ECU_ADDRESS 0x0000 /* @ECU_Address@adc2_group1_0@ */ /end MEASUREMENT
/begin MEASUREMENT adc2_group1_1 "" UWORD ME11_CM_uint16_mv 0 0 0 65535 ECU_ADDRESS 0x0000 /* @ECU_Address@adc2_group1_1@ */ /end MEASUREMENT
/begin MEASUREMENT adc2_group1_2 "" UWORD ME11_CM_uint16_mv 0 0 0 65535 ECU_ADDRESS 0x0000 /* @ECU_Address@adc2_group1_2@ */ /end MEASUREMENT
/begin MEASUREMENT adc2_group1_3 "" UWORD ME11_CM_uint16_mv 0 0 0 65535 ECU_ADDRESS 0x0000 /* @ECU_Address@adc2_group1_3@ */ /end MEASUREMENT
/begin MEASUREMENT adc2_group1_4 "" UWORD ME11_CM_uint16_mv 0 0 0 65535 ECU_ADDRESS 0x0000 /* @ECU_Address@adc2_group1_4@ */ /end MEASUREMENT
/begin MEASUREMENT adc2_group1_5 "" UWORD ME11_CM_uint16_mv 0 0 0 65535 ECU_ADDRESS 0x0000 /* @ECU_Address@adc2_group1_5@ */ /end MEASUREMENT
/begin MEASUREMENT adc2_group1_6 "" UWORD ME11_CM_uint16_mv 0 0 0 65535 ECU_ADDRESS 0x0000 /* @ECU_Address@adc2_group1_6@ */ /end MEASUREMENT
/begin MEASUREMENT adc2_group2_3 "" UWORD ME11_CM_uint16_mv 0 0 0 65535 ECU_ADDRESS 0x0000 /* @ECU_Address@adc2_group2_3@ */ /end MEASUREMENT
/begin MEASUREMENT adc2_group2_4 "" UWORD ME11_CM_uint16_mv 0 0 0 65535 ECU_ADDRESS 0x0000 /* @ECU_Address@adc2_group2_4@ */ /end MEASUREMENT
/begin MEASUREMENT adc2_group2_0 "" UWORD ME11_CM_uint16_mv 0 0 0 65535 ECU_ADDRESS 0x0000 /* @ECU_Address@adc2_group2_0@ */ /end MEASUREMENT
/begin MEASUREMENT adc2_group2_1 "" UWORD ME11_CM_uint16_mv 0 0 0 65535 ECU_ADDRESS 0x0000 /* @ECU_Address@adc2_group2_1@ */ /end MEASUREMENT
/begin MEASUREMENT adc2_group2_2 "" UWORD ME11_CM_uint16_mv 0 0 0 65535 ECU_ADDRESS 0x0000 /* @ECU_Address@adc2_group2_2@ */ /end MEASUREMENT
/begin MEASUREMENT MCV_PosRec "" UWORD ME11_CM_uint16_null 0 0 0 65535 ECU_ADDRESS 0x0000 /* @ECU_Address@MCV_PosRec@ */ /end MEASUREMENT
/begin MEASUREMENT BCV_PosRec "" UWORD ME11_CM_uint16_null 0 0 0 65535 ECU_ADDRESS 0x0000 /* @ECU_Address@BCV_PosRec@ */ /end MEASUREMENT
/begin MEASUREMENT GlbDa_uBat "" UWORD ME11_CM_uint16_null 0 0 0 65535 ECU_ADDRESS 0x0000 /* @ECU_Address@GlbDa_uBat@ */ /end MEASUREMENT
/begin MEASUREMENT HU_LeftTempSet "" UBYTE ME11_CM_uint8_null 0 0 0 255 ECU_ADDRESS 0x0000 /* @ECU_Address@HU_LeftTempSet@ */ /end MEASUREMENT
/begin MEASUREMENT PWRCtl_eVCUPTSts "" UBYTE ME11_CM_uint8_flg 0 0 0 255 ECU_ADDRESS 0x0000 /* @ECU_Address@PWRCtl_eVCUPTSts@ */ /end MEASUREMENT
/begin MEASUREMENT CoAC_stwork "" UBYTE ME11_CM_uint8_flg 0 0 0 255 ECU_ADDRESS 0x0000 /* @ECU_Address@CoAC_stwork@ */ /end MEASUREMENT
/begin MEASUREMENT ACSen_eAirInletPer "" UBYTE ME11_CM_uint8_percent_ 0 0 0 255 ECU_ADDRESS 0x0000 /* @ECU_Address@ACSen_eAirInletPer@ */ /end MEASUREMENT
/begin MEASUREMENT EXV_FaultState "" UBYTE ME11_CM_uint8_null 0 0 0 255 ECU_ADDRESS 0x0000 /* @ECU_Address@EXV_FaultState@ */ /end MEASUREMENT
/begin MEASUREMENT EXV_VoltageState "" UBYTE ME11_CM_uint8_null 0 0 0 255 ECU_ADDRESS 0x0000 /* @ECU_Address@EXV_VoltageState@ */ /end MEASUREMENT
/begin MEASUREMENT EXV_TemperatureWarn "" UBYTE ME11_CM_uint8_null 0 0 0 255 ECU_ADDRESS 0x0000 /* @ECU_Address@EXV_TemperatureWarn@ */ /end MEASUREMENT
/begin MEASUREMENT BAT_EXV_FaultState_B "" UBYTE ME11_CM_uint8_null 0 0 0 255 ECU_ADDRESS 0x0000 /* @ECU_Address@BAT_EXV_FaultState_B@ */ /end MEASUREMENT
/begin MEASUREMENT BAT_EXV_VoltageState_B "" UBYTE ME11_CM_uint8_null 0 0 0 255 ECU_ADDRESS 0x0000 /* @ECU_Address@BAT_EXV_VoltageState_B@ */ /end MEASUREMENT
/begin MEASUREMENT BAT_EXV_TemperatureWarn_B "" UBYTE ME11_CM_uint8_null 0 0 0 255 ECU_ADDRESS 0x0000 /* @ECU_Address@BAT_EXV_TemperatureWarn_B@ */ /end MEASUREMENT
/begin MEASUREMENT HP_EXV_FaultState_B "" UBYTE ME11_CM_uint8_null 0 0 0 255 ECU_ADDRESS 0x0000 /* @ECU_Address@HP_EXV_FaultState_B@ */ /end MEASUREMENT
/begin MEASUREMENT HP_EXV_VoltageState_B "" UBYTE ME11_CM_uint8_null 0 0 0 255 ECU_ADDRESS 0x0000 /* @ECU_Address@HP_EXV_VoltageState_B@ */ /end MEASUREMENT
/begin MEASUREMENT BatPMP_PumpMotorSta "" UBYTE ME11_CM_uint8_null 0 0 0 255 ECU_ADDRESS 0x0000 /* @ECU_Address@BatPMP_PumpMotorSta@ */ /end MEASUREMENT
/begin MEASUREMENT BatPMP_PumpPowerSta "" UBYTE ME11_CM_uint8_null 0 0 0 255 ECU_ADDRESS 0x0000 /* @ECU_Address@BatPMP_PumpPowerSta@ */ /end MEASUREMENT
/begin MEASUREMENT BatPMP_PumpTempSta "" UBYTE ME11_CM_uint8_null 0 0 0 255 ECU_ADDRESS 0x0000 /* @ECU_Address@BatPMP_PumpTempSta@ */ /end MEASUREMENT
/begin MEASUREMENT MotPMP_PumpMotorSta "" UBYTE ME11_CM_uint8_null 0 0 0 255 ECU_ADDRESS 0x0000 /* @ECU_Address@MotPMP_PumpMotorSta@ */ /end MEASUREMENT
/begin MEASUREMENT MotPMP_PumpPowerSta "" UBYTE ME11_CM_uint8_null 0 0 0 255 ECU_ADDRESS 0x0000 /* @ECU_Address@MotPMP_PumpPowerSta@ */ /end MEASUREMENT
/begin MEASUREMENT MotPMP_PumpTempSta "" UBYTE ME11_CM_uint8_null 0 0 0 255 ECU_ADDRESS 0x0000 /* @ECU_Address@MotPMP_PumpTempSta@ */ /end MEASUREMENT
/begin MEASUREMENT AcPMP_PumpMotorSta "" UBYTE ME11_CM_uint8_null 0 0 0 255 ECU_ADDRESS 0x0000 /* @ECU_Address@AcPMP_PumpMotorSta@ */ /end MEASUREMENT
/begin MEASUREMENT AcPMP_PumpPowerSta "" UBYTE ME11_CM_uint8_null 0 0 0 255 ECU_ADDRESS 0x0000 /* @ECU_Address@AcPMP_PumpPowerSta@ */ /end MEASUREMENT
/begin MEASUREMENT AcPMP_PumpTempSta "" UBYTE ME11_CM_uint8_null 0 0 0 255 ECU_ADDRESS 0x0000 /* @ECU_Address@AcPMP_PumpTempSta@ */ /end MEASUREMENT
/begin MEASUREMENT ACCtl_stRecLevelFinal "" UBYTE ME11_CM_uint8_null 0 0 0 255 ECU_ADDRESS 0x0000 /* @ECU_Address@ACCtl_stRecLevelFinal@ */ /end MEASUREMENT
/begin MEASUREMENT ACCtl_BloweFanSpeed "" UBYTE ME11_CM_uint8_null 0 0 0 255 ECU_ADDRESS 0x0000 /* @ECU_Address@ACCtl_BloweFanSpeed@ */ /end MEASUREMENT
/begin MEASUREMENT AC_FanLevelAct "" UBYTE ME11_CM_uint8_null 0 0 0 255 ECU_ADDRESS 0x0000 /* @ECU_Address@AC_FanLevelAct@ */ /end MEASUREMENT
/begin MEASUREMENT AC_FanLeVel "" UBYTE ME11_CM_uint8_null 0 0 0 255 ECU_ADDRESS 0x0000 /* @ECU_Address@AC_FanLeVel@ */ /end MEASUREMENT
/begin MEASUREMENT SOMCtl_eHVPartMode "" UBYTE ME11_CM_uint8_null 0 0 0 255 ECU_ADDRESS 0x0000 /* @ECU_Address@SOMCtl_eHVPartMode@ */ /end MEASUREMENT
/begin MEASUREMENT EXV_CurrentInitState "" UBYTE ME11_CM_uint8_null 0 0 0 255 ECU_ADDRESS 0x0000 /* @ECU_Address@EXV_CurrentInitState@ */ /end MEASUREMENT
/begin MEASUREMENT BAT_EXV_CurrentInitState_B "" UBYTE ME11_CM_uint8_null 0 0 0 255 ECU_ADDRESS 0x0000 /* @ECU_Address@BAT_EXV_CurrentInitState_B@ */ /end MEASUREMENT
/begin MEASUREMENT Bat_EXV_ProjectCode1 "" UBYTE ME11_CM_uint8_null 0 0 0 255 ECU_ADDRESS 0x0000 /* @ECU_Address@Bat_EXV_ProjectCode1@ */ /end MEASUREMENT
/begin MEASUREMENT Bat_EXV_ProjectCode2 "" UBYTE ME11_CM_uint8_null 0 0 0 255 ECU_ADDRESS 0x0000 /* @ECU_Address@Bat_EXV_ProjectCode2@ */ /end MEASUREMENT
/begin MEASUREMENT Bat_EXV_SupplierNumber "" UBYTE ME11_CM_uint8_null 0 0 0 255 ECU_ADDRESS 0x0000 /* @ECU_Address@Bat_EXV_SupplierNumber@ */ /end MEASUREMENT
/begin MEASUREMENT Bat_EXV_PartNumber "" UBYTE ME11_CM_uint8_null 0 0 0 255 ECU_ADDRESS 0x0000 /* @ECU_Address@Bat_EXV_PartNumber@ */ /end MEASUREMENT
/begin MEASUREMENT Bat_EXV_HWVersion "" UBYTE ME11_CM_uint8_null 0 0 0 255 ECU_ADDRESS 0x0000 /* @ECU_Address@Bat_EXV_HWVersion@ */ /end MEASUREMENT
/begin MEASUREMENT Bat_EXV_SWVersion_Main "" UBYTE ME11_CM_uint8_null 0 0 0 255 ECU_ADDRESS 0x0000 /* @ECU_Address@Bat_EXV_SWVersion_Main@ */ /end MEASUREMENT
/begin MEASUREMENT Bat_EXV_SWVersion_Sub "" UBYTE ME11_CM_uint8_null 0 0 0 255 ECU_ADDRESS 0x0000 /* @ECU_Address@Bat_EXV_SWVersion_Sub@ */ /end MEASUREMENT
/begin MEASUREMENT Bat_EXV_SWVersion_Patch "" UBYTE ME11_CM_uint8_null 0 0 0 255 ECU_ADDRESS 0x0000 /* @ECU_Address@Bat_EXV_SWVersion_Patch@ */ /end MEASUREMENT
/begin MEASUREMENT HP_EXV_initialize_status "" UBYTE ME11_CM_uint8_null 0 0 0 255 ECU_ADDRESS 0x0000 /* @ECU_Address@HP_EXV_initialize_status@ */ /end MEASUREMENT
/begin MEASUREMENT HP_EXV_ProjectCode1 "" UBYTE ME11_CM_uint8_null 0 0 0 255 ECU_ADDRESS 0x0000 /* @ECU_Address@HP_EXV_ProjectCode1@ */ /end MEASUREMENT
/begin MEASUREMENT HP_EXV_ProjectCode2 "" UBYTE ME11_CM_uint8_null 0 0 0 255 ECU_ADDRESS 0x0000 /* @ECU_Address@HP_EXV_ProjectCode2@ */ /end MEASUREMENT
/begin MEASUREMENT HP_EXV_SupplierNumber "" UBYTE ME11_CM_uint8_null 0 0 0 255 ECU_ADDRESS 0x0000 /* @ECU_Address@HP_EXV_SupplierNumber@ */ /end MEASUREMENT
/begin MEASUREMENT HP_EXV_PartNumber "" UBYTE ME11_CM_uint8_null 0 0 0 255 ECU_ADDRESS 0x0000 /* @ECU_Address@HP_EXV_PartNumber@ */ /end MEASUREMENT
/begin MEASUREMENT HP_EXV_HWVersion "" UBYTE ME11_CM_uint8_null 0 0 0 255 ECU_ADDRESS 0x0000 /* @ECU_Address@HP_EXV_HWVersion@ */ /end MEASUREMENT
/begin MEASUREMENT HP_EXV_SWVersion_Main "" UBYTE ME11_CM_uint8_null 0 0 0 255 ECU_ADDRESS 0x0000 /* @ECU_Address@HP_EXV_SWVersion_Main@ */ /end MEASUREMENT
/begin MEASUREMENT HP_EXV_SWVersion_Sub "" UBYTE ME11_CM_uint8_null 0 0 0 255 ECU_ADDRESS 0x0000 /* @ECU_Address@HP_EXV_SWVersion_Sub@ */ /end MEASUREMENT
/begin MEASUREMENT HP_EXV_SWVersion_Patch "" UBYTE ME11_CM_uint8_null 0 0 0 255 ECU_ADDRESS 0x0000 /* @ECU_Address@HP_EXV_SWVersion_Patch@ */ /end MEASUREMENT
/begin MEASUREMENT IOCtl_BloweFanSpeed "" UBYTE ME11_CM_uint8_percent_ 0 0 0 255 ECU_ADDRESS 0x0000 /* @ECU_Address@IOCtl_BloweFanSpeed@ */ /end MEASUREMENT
/begin MEASUREMENT ACTCtl_eCoolFanCtrl "" UBYTE ME11_CM_uint8_percent_ 0 0 0 255 ECU_ADDRESS 0x0000 /* @ECU_Address@ACTCtl_eCoolFanCtrl@ */ /end MEASUREMENT
/begin MEASUREMENT COMP_SelfCheckError "" UBYTE ME11_CM_uint8_null 0 0 0 255 ECU_ADDRESS 0x0000 /* @ECU_Address@COMP_SelfCheckError@ */ /end MEASUREMENT
/begin MEASUREMENT COMP_OverCurrent "" UBYTE ME11_CM_uint8_null 0 0 0 255 ECU_ADDRESS 0x0000 /* @ECU_Address@COMP_OverCurrent@ */ /end MEASUREMENT
/begin MEASUREMENT ACTCtl_eACPumpRefSpd "" UBYTE ME11_CM_uint8_percent_ 0 0 0 255 ECU_ADDRESS 0x0000 /* @ECU_Address@ACTCtl_eACPumpRefSpd@ */ /end MEASUREMENT
/begin MEASUREMENT ACTCtl_eHeatFanCtrl "" UBYTE ME11_CM_uint8_percent_ 0 0 0 255 ECU_ADDRESS 0x0000 /* @ECU_Address@ACTCtl_eHeatFanCtrl@ */ /end MEASUREMENT
/begin MEASUREMENT ACTCtl_eFanPerc "" UBYTE ME11_CM_uint8_percent_ 0 0 0 255 ECU_ADDRESS 0x0000 /* @ECU_Address@ACTCtl_eFanPerc@ */ /end MEASUREMENT
/begin MEASUREMENT IOCtl_RecircTrgPos "" UBYTE ME11_CM_uint8_percent_ 0 0 0 255 ECU_ADDRESS 0x0000 /* @ECU_Address@IOCtl_RecircTrgPos@ */ /end MEASUREMENT
/begin MEASUREMENT ACTCtl_eCOMPPrsPrtSts "" UBYTE ME11_CM_uint8_flg 0 0 0 255 ECU_ADDRESS 0x0000 /* @ECU_Address@ACTCtl_eCOMPPrsPrtSts@ */ /end MEASUREMENT
/begin MEASUREMENT MCV_FltSts "" UBYTE ME11_CM_uint8_null 0 0 0 255 ECU_ADDRESS 0x0000 /* @ECU_Address@MCV_FltSts@ */ /end MEASUREMENT
/begin MEASUREMENT MCV_Mode "" UBYTE ME11_CM_uint8_null 0 0 0 255 ECU_ADDRESS 0x0000 /* @ECU_Address@MCV_Mode@ */ /end MEASUREMENT
/begin MEASUREMENT BCV_FltSts "" UBYTE ME11_CM_uint8_null 0 0 0 255 ECU_ADDRESS 0x0000 /* @ECU_Address@BCV_FltSts@ */ /end MEASUREMENT
/begin MEASUREMENT BCV_Mode "" UBYTE ME11_CM_uint8_null 0 0 0 255 ECU_ADDRESS 0x0000 /* @ECU_Address@BCV_Mode@ */ /end MEASUREMENT
/begin MEASUREMENT ACTCtl_eC3WVValue "" UBYTE ME11_CM_uint8_null 0 0 0 255 ECU_ADDRESS 0x0000 /* @ECU_Address@ACTCtl_eC3WVValue@ */ /end MEASUREMENT
/begin MEASUREMENT ACTCtl_eC5WVValue "" UBYTE ME11_CM_uint8_null 0 0 0 255 ECU_ADDRESS 0x0000 /* @ECU_Address@ACTCtl_eC5WVValue@ */ /end MEASUREMENT
/begin MEASUREMENT ACTCtl_eAcPMPSpdSet "" UBYTE ME11_CM_uint8_percent_ 0 0 0 255 ECU_ADDRESS 0x0000 /* @ECU_Address@ACTCtl_eAcPMPSpdSet@ */ /end MEASUREMENT
/begin MEASUREMENT ACTCtl_eBatPMPSpdSet "" UBYTE ME11_CM_uint8_percent_ 0 0 0 255 ECU_ADDRESS 0x0000 /* @ECU_Address@ACTCtl_eBatPMPSpdSet@ */ /end MEASUREMENT
/begin MEASUREMENT ACTCtl_eMotPMPSpdSet "" UBYTE ME11_CM_uint8_percent_ 0 0 0 255 ECU_ADDRESS 0x0000 /* @ECU_Address@ACTCtl_eMotPMPSpdSet@ */ /end MEASUREMENT
/begin MEASUREMENT AcPMP_PumpInputVolt "" UBYTE ME11_CM_uint8_null 0 0 0 255 ECU_ADDRESS 0x0000 /* @ECU_Address@AcPMP_PumpInputVolt@ */ /end MEASUREMENT
/begin MEASUREMENT AcPMP_ProjectCode1 "" UBYTE ME11_CM_uint8_null 0 0 0 255 ECU_ADDRESS 0x0000 /* @ECU_Address@AcPMP_ProjectCode1@ */ /end MEASUREMENT
/begin MEASUREMENT AcPMP_ProjectCode2 "" UBYTE ME11_CM_uint8_null 0 0 0 255 ECU_ADDRESS 0x0000 /* @ECU_Address@AcPMP_ProjectCode2@ */ /end MEASUREMENT
/begin MEASUREMENT AcPMP_SupplierNumber "" UBYTE ME11_CM_uint8_null 0 0 0 255 ECU_ADDRESS 0x0000 /* @ECU_Address@AcPMP_SupplierNumber@ */ /end MEASUREMENT
/begin MEASUREMENT AcPMP_PartNumber "" UBYTE ME11_CM_uint8_null 0 0 0 255 ECU_ADDRESS 0x0000 /* @ECU_Address@AcPMP_PartNumber@ */ /end MEASUREMENT
/begin MEASUREMENT AcPMP_HWVersion "" UBYTE ME11_CM_uint8_null 0 0 0 255 ECU_ADDRESS 0x0000 /* @ECU_Address@AcPMP_HWVersion@ */ /end MEASUREMENT
/begin MEASUREMENT AcPMP_SWVersion_Main "" UBYTE ME11_CM_uint8_null 0 0 0 255 ECU_ADDRESS 0x0000 /* @ECU_Address@AcPMP_SWVersion_Main@ */ /end MEASUREMENT
/begin MEASUREMENT AcPMP_SWVersion_Sub "" UBYTE ME11_CM_uint8_null 0 0 0 255 ECU_ADDRESS 0x0000 /* @ECU_Address@AcPMP_SWVersion_Sub@ */ /end MEASUREMENT
/begin MEASUREMENT AcPMP_SWVersion_Patch "" UBYTE ME11_CM_uint8_null 0 0 0 255 ECU_ADDRESS 0x0000 /* @ECU_Address@AcPMP_SWVersion_Patch@ */ /end MEASUREMENT
/begin MEASUREMENT BCV_SpdLvl "" UBYTE ME11_CM_uint8_null 0 0 0 255 ECU_ADDRESS 0x0000 /* @ECU_Address@BCV_SpdLvl@ */ /end MEASUREMENT
/begin MEASUREMENT BCV_TempSts "" UBYTE ME11_CM_uint8_null 0 0 0 255 ECU_ADDRESS 0x0000 /* @ECU_Address@BCV_TempSts@ */ /end MEASUREMENT
/begin MEASUREMENT BCV_VoltSts "" UBYTE ME11_CM_uint8_null 0 0 0 255 ECU_ADDRESS 0x0000 /* @ECU_Address@BCV_VoltSts@ */ /end MEASUREMENT
/begin MEASUREMENT BatPMP_PumpInputVolt "" UBYTE ME11_CM_uint8_null 0 0 0 255 ECU_ADDRESS 0x0000 /* @ECU_Address@BatPMP_PumpInputVolt@ */ /end MEASUREMENT
/begin MEASUREMENT MCV_SpdLvl "" UBYTE ME11_CM_uint8_null 0 0 0 255 ECU_ADDRESS 0x0000 /* @ECU_Address@MCV_SpdLvl@ */ /end MEASUREMENT
/begin MEASUREMENT MCV_TempSts "" UBYTE ME11_CM_uint8_null 0 0 0 255 ECU_ADDRESS 0x0000 /* @ECU_Address@MCV_TempSts@ */ /end MEASUREMENT
/begin MEASUREMENT MCV_VoltSts "" UBYTE ME11_CM_uint8_null 0 0 0 255 ECU_ADDRESS 0x0000 /* @ECU_Address@MCV_VoltSts@ */ /end MEASUREMENT
/begin MEASUREMENT MotPMP_PumpInputVolt "" UBYTE ME11_CM_uint8_null 0 0 0 255 ECU_ADDRESS 0x0000 /* @ECU_Address@MotPMP_PumpInputVolt@ */ /end MEASUREMENT
/begin MEASUREMENT COMP_EcompST "" UBYTE ME11_CM_uint8_null 0 0 0 255 ECU_ADDRESS 0x0000 /* @ECU_Address@COMP_EcompST@ */ /end MEASUREMENT
/begin MEASUREMENT COMP_HvError "" UBYTE ME11_CM_uint8_null 0 0 0 255 ECU_ADDRESS 0x0000 /* @ECU_Address@COMP_HvError@ */ /end MEASUREMENT
/begin MEASUREMENT COMP_LvError "" UBYTE ME11_CM_uint8_null 0 0 0 255 ECU_ADDRESS 0x0000 /* @ECU_Address@COMP_LvError@ */ /end MEASUREMENT
/begin MEASUREMENT TMS_VersionNumber "" UBYTE ME11_CM_uint8_null 0 0 0 255 ECU_ADDRESS 0x0000 /* @ECU_Address@TMS_VersionNumber@ */ /end MEASUREMENT
/begin MEASUREMENT EE_TimeHour "" UBYTE ME11_CM_uint8_h 0 0 0 255 ECU_ADDRESS 0x0000 /* @ECU_Address@EE_TimeHour@ */ /end MEASUREMENT
/begin MEASUREMENT EE_TimeMin "" UBYTE ME11_CM_uint8_min 0 0 0 255 ECU_ADDRESS 0x0000 /* @ECU_Address@EE_TimeMin@ */ /end MEASUREMENT
/begin MEASUREMENT EE_TimeDay "" UBYTE ME11_CM_uint8_day 0 0 0 255 ECU_ADDRESS 0x0000 /* @ECU_Address@EE_TimeDay@ */ /end MEASUREMENT
/begin MEASUREMENT PWRCtl_eBatChargSts "" UBYTE ME11_CM_uint8_flg 0 0 0 255 ECU_ADDRESS 0x0000 /* @ECU_Address@PWRCtl_eBatChargSts@ */ /end MEASUREMENT
/begin MEASUREMENT HMICtl_eInner "" UBYTE ME11_CM_uint8_null 0 0 0 255 ECU_ADDRESS 0x0000 /* @ECU_Address@HMICtl_eInner@ */ /end MEASUREMENT
/begin MEASUREMENT HMICtl_eModeMotor "" UBYTE ME11_CM_uint8_null 0 0 0 255 ECU_ADDRESS 0x0000 /* @ECU_Address@HMICtl_eModeMotor@ */ /end MEASUREMENT
/begin MEASUREMENT HMICtl_eBlwSts "" UBYTE ME11_CM_uint8_null 0 0 0 255 ECU_ADDRESS 0x0000 /* @ECU_Address@HMICtl_eBlwSts@ */ /end MEASUREMENT
/begin MEASUREMENT ACTCtl_eCOMPExhTPrtSts "" UBYTE ME11_CM_uint8_flg 0 0 0 255 ECU_ADDRESS 0x0000 /* @ECU_Address@ACTCtl_eCOMPExhTPrtSts@ */ /end MEASUREMENT
/begin MEASUREMENT ACCtl_stStartState "" UBYTE ME11_CM_uint8_null 0 0 0 255 ECU_ADDRESS 0x0000 /* @ECU_Address@ACCtl_stStartState@ */ /end MEASUREMENT
/begin MEASUREMENT ACNvm_eCainRecDoor "" UBYTE ME11_CM_uint8_flg 0 0 0 255 ECU_ADDRESS 0x0000 /* @ECU_Address@ACNvm_eCainRecDoor@ */ /end MEASUREMENT
/begin MEASUREMENT ACNvm_eCainModeDoor "" UBYTE ME11_CM_uint8_flg 0 0 0 255 ECU_ADDRESS 0x0000 /* @ECU_Address@ACNvm_eCainModeDoor@ */ /end MEASUREMENT
/begin MEASUREMENT ACNvm_eCabinSetTemp "" UBYTE ME11_CM_uint8_flg 0 0 0 255 ECU_ADDRESS 0x0000 /* @ECU_Address@ACNvm_eCabinSetTemp@ */ /end MEASUREMENT
/begin MEASUREMENT ACNvm_eACCabinMode "" UBYTE ME11_CM_uint8_flg 0 0 0 255 ECU_ADDRESS 0x0000 /* @ECU_Address@ACNvm_eACCabinMode@ */ /end MEASUREMENT
/begin MEASUREMENT ACNvm_eCabinBlower "" UBYTE ME11_CM_uint8_flg 0 0 0 255 ECU_ADDRESS 0x0000 /* @ECU_Address@ACNvm_eCabinBlower@ */ /end MEASUREMENT
/begin MEASUREMENT PWRCtl_bKL15swtSt "" UBYTE ME11_CM_boolean_flg 0 0 0 1 ECU_ADDRESS 0x0000 /* @ECU_Address@PWRCtl_bKL15swtSt@ */ /end MEASUREMENT
/begin MEASUREMENT AC_stIGNON "" UBYTE ME11_CM_boolean_flg 0 0 0 1 ECU_ADDRESS 0x0000 /* @ECU_Address@AC_stIGNON@ */ /end MEASUREMENT
/begin MEASUREMENT CoAC_stColdStart "" UBYTE ME11_CM_boolean_flg 0 0 0 1 ECU_ADDRESS 0x0000 /* @ECU_Address@CoAC_stColdStart@ */ /end MEASUREMENT
/begin MEASUREMENT ACCtl_stRecTempLowEna "" UBYTE ME11_CM_boolean_null 0 0 0 1 ECU_ADDRESS 0x0000 /* @ECU_Address@ACCtl_stRecTempLowEna@ */ /end MEASUREMENT
/begin MEASUREMENT EXV_ResponseError "" UBYTE ME11_CM_boolean_null 0 0 0 1 ECU_ADDRESS 0x0000 /* @ECU_Address@EXV_ResponseError@ */ /end MEASUREMENT
/begin MEASUREMENT BAT_EXV_ResponseError_B "" UBYTE ME11_CM_boolean_null 0 0 0 1 ECU_ADDRESS 0x0000 /* @ECU_Address@BAT_EXV_ResponseError_B@ */ /end MEASUREMENT
/begin MEASUREMENT HP_EXV_Warning_OverTemp "" UBYTE ME11_CM_boolean_null 0 0 0 1 ECU_ADDRESS 0x0000 /* @ECU_Address@HP_EXV_Warning_OverTemp@ */ /end MEASUREMENT
/begin MEASUREMENT HP_EXV_ResponseError_B "" UBYTE ME11_CM_boolean_null 0 0 0 1 ECU_ADDRESS 0x0000 /* @ECU_Address@HP_EXV_ResponseError_B@ */ /end MEASUREMENT
/begin MEASUREMENT BatPMP_RESP_ERROR "" UBYTE ME11_CM_boolean_null 0 0 0 1 ECU_ADDRESS 0x0000 /* @ECU_Address@BatPMP_RESP_ERROR@ */ /end MEASUREMENT
/begin MEASUREMENT BatPMP_PumpDryRunningSta "" UBYTE ME11_CM_boolean_null 0 0 0 1 ECU_ADDRESS 0x0000 /* @ECU_Address@BatPMP_PumpDryRunningSta@ */ /end MEASUREMENT
/begin MEASUREMENT MotPMP_RESP_ERROR "" UBYTE ME11_CM_boolean_null 0 0 0 1 ECU_ADDRESS 0x0000 /* @ECU_Address@MotPMP_RESP_ERROR@ */ /end MEASUREMENT
/begin MEASUREMENT MotPMP_PumpDryRunningSta "" UBYTE ME11_CM_boolean_null 0 0 0 1 ECU_ADDRESS 0x0000 /* @ECU_Address@MotPMP_PumpDryRunningSta@ */ /end MEASUREMENT
/begin MEASUREMENT SOMCtl_bMotorLTRAndBatBalFlg "" UBYTE ME11_CM_boolean_flg 0 0 0 1 ECU_ADDRESS 0x0000 /* @ECU_Address@SOMCtl_bMotorLTRAndBatBalFlg@ */ /end MEASUREMENT
/begin MEASUREMENT SOMCtl_bMotAndBatLTRFlg "" UBYTE ME11_CM_boolean_flg 0 0 0 1 ECU_ADDRESS 0x0000 /* @ECU_Address@SOMCtl_bMotAndBatLTRFlg@ */ /end MEASUREMENT
/begin MEASUREMENT AcPMP_RESP_ERROR "" UBYTE ME11_CM_boolean_null 0 0 0 1 ECU_ADDRESS 0x0000 /* @ECU_Address@AcPMP_RESP_ERROR@ */ /end MEASUREMENT
/begin MEASUREMENT AcPMP_PumpDryRunningSta "" UBYTE ME11_CM_boolean_null 0 0 0 1 ECU_ADDRESS 0x0000 /* @ECU_Address@AcPMP_PumpDryRunningSta@ */ /end MEASUREMENT
/begin MEASUREMENT SOMCtl_bMotorHeatBatOnFlg "" UBYTE ME11_CM_boolean_flg 0 0 0 1 ECU_ADDRESS 0x0000 /* @ECU_Address@SOMCtl_bMotorHeatBatOnFlg@ */ /end MEASUREMENT
/begin MEASUREMENT SOMCtl_bMotHeatBatFlg "" UBYTE ME11_CM_boolean_flg 0 0 0 1 ECU_ADDRESS 0x0000 /* @ECU_Address@SOMCtl_bMotHeatBatFlg@ */ /end MEASUREMENT
/begin MEASUREMENT SOMCtl_bBatLTRFlg "" UBYTE ME11_CM_boolean_flg 0 0 0 1 ECU_ADDRESS 0x0000 /* @ECU_Address@SOMCtl_bBatLTRFlg@ */ /end MEASUREMENT
/begin MEASUREMENT SOMCtl_bB1toB31 "" UBYTE ME11_CM_boolean_flg 0 0 0 1 ECU_ADDRESS 0x0000 /* @ECU_Address@SOMCtl_bB1toB31@ */ /end MEASUREMENT
/begin MEASUREMENT SOMCtl_bBatHeatB3tB1Flg "" UBYTE ME11_CM_boolean_flg 0 0 0 1 ECU_ADDRESS 0x0000 /* @ECU_Address@SOMCtl_bBatHeatB3tB1Flg@ */ /end MEASUREMENT
/begin MEASUREMENT SOMCtl_bMD2ToMD1Flg "" UBYTE ME11_CM_boolean_flg 0 0 0 1 ECU_ADDRESS 0x0000 /* @ECU_Address@SOMCtl_bMD2ToMD1Flg@ */ /end MEASUREMENT
/begin MEASUREMENT SOMCtl_bEntExtDefFlg "" UBYTE ME11_CM_boolean_flg 0 0 0 1 ECU_ADDRESS 0x0000 /* @ECU_Address@SOMCtl_bEntExtDefFlg@ */ /end MEASUREMENT
/begin MEASUREMENT SOMCtl_bExitExtDefTempFlg "" UBYTE ME11_CM_boolean_flg 0 0 0 1 ECU_ADDRESS 0x0000 /* @ECU_Address@SOMCtl_bExitExtDefTempFlg@ */ /end MEASUREMENT
/begin MEASUREMENT SOMCtl_bExtDefFlg "" UBYTE ME11_CM_boolean_flg 0 0 0 1 ECU_ADDRESS 0x0000 /* @ECU_Address@SOMCtl_bExtDefFlg@ */ /end MEASUREMENT
/begin MEASUREMENT ACCtl_stCabinCoolingEn "" UBYTE ME11_CM_boolean_null 0 0 0 1 ECU_ADDRESS 0x0000 /* @ECU_Address@ACCtl_stCabinCoolingEn@ */ /end MEASUREMENT
/begin MEASUREMENT EXV_RunState "" UBYTE ME11_CM_boolean_null 0 0 0 1 ECU_ADDRESS 0x0000 /* @ECU_Address@EXV_RunState@ */ /end MEASUREMENT
/begin MEASUREMENT BAT_EXV_RunState_B "" UBYTE ME11_CM_boolean_null 0 0 0 1 ECU_ADDRESS 0x0000 /* @ECU_Address@BAT_EXV_RunState_B@ */ /end MEASUREMENT
/begin MEASUREMENT BAT_EXV_SupplierLabel "" UBYTE ME11_CM_boolean_null 0 0 0 1 ECU_ADDRESS 0x0000 /* @ECU_Address@BAT_EXV_SupplierLabel@ */ /end MEASUREMENT
/begin MEASUREMENT HP_EXV_SupplierLabel "" UBYTE ME11_CM_boolean_null 0 0 0 1 ECU_ADDRESS 0x0000 /* @ECU_Address@HP_EXV_SupplierLabel@ */ /end MEASUREMENT
/begin MEASUREMENT HP_EXV_RunState_B "" UBYTE ME11_CM_boolean_null 0 0 0 1 ECU_ADDRESS 0x0000 /* @ECU_Address@HP_EXV_RunState_B@ */ /end MEASUREMENT
/begin MEASUREMENT ACTCtl_bSOVCmd "" UBYTE ME11_CM_boolean_flg 0 0 0 1 ECU_ADDRESS 0x0000 /* @ECU_Address@ACTCtl_bSOVCmd@ */ /end MEASUREMENT
/begin MEASUREMENT COMP_OverDuty "" UBYTE ME11_CM_boolean_null 0 0 0 1 ECU_ADDRESS 0x0000 /* @ECU_Address@COMP_OverDuty@ */ /end MEASUREMENT
/begin MEASUREMENT COMP_PI_Saturation "" UBYTE ME11_CM_boolean_null 0 0 0 1 ECU_ADDRESS 0x0000 /* @ECU_Address@COMP_PI_Saturation@ */ /end MEASUREMENT
/begin MEASUREMENT COMP_IPM_Error "" UBYTE ME11_CM_boolean_null 0 0 0 1 ECU_ADDRESS 0x0000 /* @ECU_Address@COMP_IPM_Error@ */ /end MEASUREMENT
/begin MEASUREMENT COMP_CurrentOffset "" UBYTE ME11_CM_boolean_null 0 0 0 1 ECU_ADDRESS 0x0000 /* @ECU_Address@COMP_CurrentOffset@ */ /end MEASUREMENT
/begin MEASUREMENT ACTCtl_bCOMPForbidFlg "" UBYTE ME11_CM_boolean_flg 0 0 0 1 ECU_ADDRESS 0x0000 /* @ECU_Address@ACTCtl_bCOMPForbidFlg@ */ /end MEASUREMENT
/begin MEASUREMENT ACTCtl_bCOMPEnvpTPrtFlg "" UBYTE ME11_CM_boolean_flg 0 0 0 1 ECU_ADDRESS 0x0000 /* @ECU_Address@ACTCtl_bCOMPEnvpTPrtFlg@ */ /end MEASUREMENT
/begin MEASUREMENT ACTCtl_bAcPMPSpdFlt "" UBYTE ME11_CM_boolean_flg 0 0 0 1 ECU_ADDRESS 0x0000 /* @ECU_Address@ACTCtl_bAcPMPSpdFlt@ */ /end MEASUREMENT
/begin MEASUREMENT ACTCtl_bBatPMPSpdFlt "" UBYTE ME11_CM_boolean_flg 0 0 0 1 ECU_ADDRESS 0x0000 /* @ECU_Address@ACTCtl_bBatPMPSpdFlt@ */ /end MEASUREMENT
/begin MEASUREMENT ACTCtl_bCOMPDvtFlg "" UBYTE ME11_CM_boolean_flg 0 0 0 1 ECU_ADDRESS 0x0000 /* @ECU_Address@ACTCtl_bCOMPDvtFlg@ */ /end MEASUREMENT
/begin MEASUREMENT ACTCtl_bCOMPHPLmtFlg "" UBYTE ME11_CM_boolean_flg 0 0 0 1 ECU_ADDRESS 0x0000 /* @ECU_Address@ACTCtl_bCOMPHPLmtFlg@ */ /end MEASUREMENT
/begin MEASUREMENT ACTCtl_bCOMPHPFrbFlg "" UBYTE ME11_CM_boolean_flg 0 0 0 1 ECU_ADDRESS 0x0000 /* @ECU_Address@ACTCtl_bCOMPHPFrbFlg@ */ /end MEASUREMENT
/begin MEASUREMENT ACTCtl_bCOMPLPLmtFlg "" UBYTE ME11_CM_boolean_flg 0 0 0 1 ECU_ADDRESS 0x0000 /* @ECU_Address@ACTCtl_bCOMPLPLmtFlg@ */ /end MEASUREMENT
/begin MEASUREMENT ACTCtl_bCOMPLPFrbFlg "" UBYTE ME11_CM_boolean_flg 0 0 0 1 ECU_ADDRESS 0x0000 /* @ECU_Address@ACTCtl_bCOMPLPFrbFlg@ */ /end MEASUREMENT
/begin MEASUREMENT ACTCtl_bAEXVPIEnble "" UBYTE ME11_CM_boolean_flg 0 0 0 1 ECU_ADDRESS 0x0000 /* @ECU_Address@ACTCtl_bAEXVPIEnble@ */ /end MEASUREMENT
/begin MEASUREMENT ACTCtl_bBEXVPIEnble "" UBYTE ME11_CM_boolean_flg 0 0 0 1 ECU_ADDRESS 0x0000 /* @ECU_Address@ACTCtl_bBEXVPIEnble@ */ /end MEASUREMENT
/begin MEASUREMENT ACTCtl_bHPEXVPIEnble "" UBYTE ME11_CM_boolean_flg 0 0 0 1 ECU_ADDRESS 0x0000 /* @ECU_Address@ACTCtl_bHPEXVPIEnble@ */ /end MEASUREMENT
/begin MEASUREMENT BCV_RunSts "" UBYTE ME11_CM_boolean_null 0 0 0 1 ECU_ADDRESS 0x0000 /* @ECU_Address@BCV_RunSts@ */ /end MEASUREMENT
/begin MEASUREMENT BCV_ErrResp "" UBYTE ME11_CM_boolean_null 0 0 0 1 ECU_ADDRESS 0x0000 /* @ECU_Address@BCV_ErrResp@ */ /end MEASUREMENT
/begin MEASUREMENT MCV_RunSts "" UBYTE ME11_CM_boolean_null 0 0 0 1 ECU_ADDRESS 0x0000 /* @ECU_Address@MCV_RunSts@ */ /end MEASUREMENT
/begin MEASUREMENT MCV_ErrResp "" UBYTE ME11_CM_boolean_null 0 0 0 1 ECU_ADDRESS 0x0000 /* @ECU_Address@MCV_ErrResp@ */ /end MEASUREMENT
/begin MEASUREMENT COMP_CANBusOff "" UBYTE ME11_CM_boolean_null 0 0 0 1 ECU_ADDRESS 0x0000 /* @ECU_Address@COMP_CANBusOff@ */ /end MEASUREMENT
/begin MEASUREMENT COMP_Commu_Error "" UBYTE ME11_CM_boolean_null 0 0 0 1 ECU_ADDRESS 0x0000 /* @ECU_Address@COMP_Commu_Error@ */ /end MEASUREMENT
/begin MEASUREMENT COMP_LoseStep "" UBYTE ME11_CM_boolean_null 0 0 0 1 ECU_ADDRESS 0x0000 /* @ECU_Address@COMP_LoseStep@ */ /end MEASUREMENT
/begin MEASUREMENT COMP_TempError "" UBYTE ME11_CM_boolean_null 0 0 0 1 ECU_ADDRESS 0x0000 /* @ECU_Address@COMP_TempError@ */ /end MEASUREMENT
/begin MEASUREMENT ECUHighVoltInterlockSignal "" UBYTE ME11_CM_boolean_null 0 0 0 1 ECU_ADDRESS 0x0000 /* @ECU_Address@ECUHighVoltInterlockSignal@ */ /end MEASUREMENT
/begin MEASUREMENT SOMCtl_bMD3ToMD4Flg "" UBYTE ME11_CM_boolean_flg 0 0 0 1 ECU_ADDRESS 0x0000 /* @ECU_Address@SOMCtl_bMD3ToMD4Flg@ */ /end MEASUREMENT
/begin MEASUREMENT SOMCtl_bMD4ToMD3Flg "" UBYTE ME11_CM_boolean_flg 0 0 0 1 ECU_ADDRESS 0x0000 /* @ECU_Address@SOMCtl_bMD4ToMD3Flg@ */ /end MEASUREMENT
/begin MEASUREMENT SOMCtl_bMD3DHMD2Flg "" UBYTE ME11_CM_boolean_flg 0 0 0 1 ECU_ADDRESS 0x0000 /* @ECU_Address@SOMCtl_bMD3DHMD2Flg@ */ /end MEASUREMENT
/begin MEASUREMENT SOMCtl_bMD2ToMD3Flg "" UBYTE ME11_CM_boolean_flg 0 0 0 1 ECU_ADDRESS 0x0000 /* @ECU_Address@SOMCtl_bMD2ToMD3Flg@ */ /end MEASUREMENT
/begin MEASUREMENT SOMCtl_bMD3ToMD2Flg "" UBYTE ME11_CM_boolean_flg 0 0 0 1 ECU_ADDRESS 0x0000 /* @ECU_Address@SOMCtl_bMD3ToMD2Flg@ */ /end MEASUREMENT
/begin MEASUREMENT SOMCtl_bMD2DHMD1Flg "" UBYTE ME11_CM_boolean_flg 0 0 0 1 ECU_ADDRESS 0x0000 /* @ECU_Address@SOMCtl_bMD2DHMD1Flg@ */ /end MEASUREMENT
/begin MEASUREMENT SOMCtl_bMD1CLMSts "" UBYTE ME11_CM_boolean_flg 0 0 0 1 ECU_ADDRESS 0x0000 /* @ECU_Address@SOMCtl_bMD1CLMSts@ */ /end MEASUREMENT
/begin MEASUREMENT SOMCtl_bMD1ToMD2Flg "" UBYTE ME11_CM_boolean_flg 0 0 0 1 ECU_ADDRESS 0x0000 /* @ECU_Address@SOMCtl_bMD1ToMD2Flg@ */ /end MEASUREMENT
/begin MEASUREMENT SOMCtl_bBatBalFlg "" UBYTE ME11_CM_boolean_flg 0 0 0 1 ECU_ADDRESS 0x0000 /* @ECU_Address@SOMCtl_bBatBalFlg@ */ /end MEASUREMENT
/begin MEASUREMENT HMICtl_bLeftSetLow "" UBYTE ME11_CM_boolean_flg 0 0 0 1 ECU_ADDRESS 0x0000 /* @ECU_Address@HMICtl_bLeftSetLow@ */ /end MEASUREMENT
/begin MEASUREMENT HMICtl_bLeftSetHigh "" UBYTE ME11_CM_boolean_flg 0 0 0 1 ECU_ADDRESS 0x0000 /* @ECU_Address@HMICtl_bLeftSetHigh@ */ /end MEASUREMENT
/begin MEASUREMENT ACCtl_bExhaustFlg "" UBYTE ME11_CM_boolean_flg 0 0 0 1 ECU_ADDRESS 0x0000 /* @ECU_Address@ACCtl_bExhaustFlg@ */ /end MEASUREMENT
/begin MEASUREMENT ACCtl_bExhFlg "" UBYTE ME11_CM_boolean_flg 0 0 0 1 ECU_ADDRESS 0x0000 /* @ECU_Address@ACCtl_bExhFlg@ */ /end MEASUREMENT
/begin MEASUREMENT ACTCtl_bMotPMPSpdFlt "" UBYTE ME11_CM_boolean_flg 0 0 0 1 ECU_ADDRESS 0x0000 /* @ECU_Address@ACTCtl_bMotPMPSpdFlt@ */ /end MEASUREMENT
/begin MEASUREMENT ACTCtl_bCOMPPIEnble "" UBYTE ME11_CM_boolean_flg 0 0 0 1 ECU_ADDRESS 0x0000 /* @ECU_Address@ACTCtl_bCOMPPIEnble@ */ /end MEASUREMENT
/begin MEASUREMENT ACTCtl_bCOMPSpdDiffFlt "" UBYTE ME11_CM_boolean_flg 0 0 0 1 ECU_ADDRESS 0x0000 /* @ECU_Address@ACTCtl_bCOMPSpdDiffFlt@ */ /end MEASUREMENT
/begin MEASUREMENT AC_stExhaust "" UBYTE ME11_CM_boolean_flg 0 0 0 1 ECU_ADDRESS 0x0000 /* @ECU_Address@AC_stExhaust@ */ /end MEASUREMENT
/begin MEASUREMENT ACNvm_bACAutoSts "" UBYTE ME11_CM_boolean_flg 0 0 0 1 ECU_ADDRESS 0x0000 /* @ECU_Address@ACNvm_bACAutoSts@ */ /end MEASUREMENT
/begin MEASUREMENT ACNvm_bACOnOff "" UBYTE ME11_CM_boolean_flg 0 0 0 1 ECU_ADDRESS 0x0000 /* @ECU_Address@ACNvm_bACOnOff@ */ /end MEASUREMENT
/begin MEASUREMENT SOMCtl_eWaterMode "" UBYTE ME11_CM_WaterModes_null 0 0 0 6 ECU_ADDRESS 0x0000 /* @ECU_Address@SOMCtl_eWaterMode@ */ /end MEASUREMENT
/begin MEASUREMENT SOMCtl_eRefModes "" UBYTE ME11_CM_RefModes_null 0 0 0 14 ECU_ADDRESS 0x0000 /* @ECU_Address@SOMCtl_eRefModes@ */ /end MEASUREMENT
/begin MEASUREMENT PWRCtl_eTMSStatus "" UBYTE ME11_CM_PwrModes_null 0 0 0 5 ECU_ADDRESS 0x0000 /* @ECU_Address@PWRCtl_eTMSStatus@ */ /end MEASUREMENT
/begin MEASUREMENT ACSen_eRecircSenSts "" UBYTE ME11_CM_FaultStatus_flg 0 0 0 2 ECU_ADDRESS 0x0000 /* @ECU_Address@ACSen_eRecircSenSts@ */ /end MEASUREMENT
/begin MEASUREMENT ACSen_eMixDoorSenSts "" UBYTE ME11_CM_FaultStatus_flg 0 0 0 2 ECU_ADDRESS 0x0000 /* @ECU_Address@ACSen_eMixDoorSenSts@ */ /end MEASUREMENT
/begin MEASUREMENT ACSen_eModeSenSts "" UBYTE ME11_CM_FaultStatus_flg 0 0 0 2 ECU_ADDRESS 0x0000 /* @ECU_Address@ACSen_eModeSenSts@ */ /end MEASUREMENT
/begin MEASUREMENT ACSen_eWCCHPSenSts "" UBYTE ME11_CM_FaultStatus_flg 0 0 0 2 ECU_ADDRESS 0x0000 /* @ECU_Address@ACSen_eWCCHPSenSts@ */ /end MEASUREMENT
/begin MEASUREMENT ACSen_eLPSenSts "" UBYTE ME11_CM_FaultStatus_flg 0 0 0 2 ECU_ADDRESS 0x0000 /* @ECU_Address@ACSen_eLPSenSts@ */ /end MEASUREMENT
/begin MEASUREMENT ACSen_eSOLARSenSts "" UBYTE ME11_CM_FaultStatus_flg 0 0 0 2 ECU_ADDRESS 0x0000 /* @ECU_Address@ACSen_eSOLARSenSts@ */ /end MEASUREMENT
/begin MEASUREMENT ACSen_eACCMHTSenSts "" UBYTE ME11_CM_FaultStatus_flg 0 0 0 2 ECU_ADDRESS 0x0000 /* @ECU_Address@ACSen_eACCMHTSenSts@ */ /end MEASUREMENT
/begin MEASUREMENT ACSen_eWCCHTSenSts "" UBYTE ME11_CM_FaultStatus_flg 0 0 0 2 ECU_ADDRESS 0x0000 /* @ECU_Address@ACSen_eWCCHTSenSts@ */ /end MEASUREMENT
/begin MEASUREMENT ACSen_eOHXTSenSts "" UBYTE ME11_CM_FaultStatus_flg 0 0 0 2 ECU_ADDRESS 0x0000 /* @ECU_Address@ACSen_eOHXTSenSts@ */ /end MEASUREMENT
/begin MEASUREMENT ACSen_eMOTORTSenSts "" UBYTE ME11_CM_FaultStatus_flg 0 0 0 2 ECU_ADDRESS 0x0000 /* @ECU_Address@ACSen_eMOTORTSenSts@ */ /end MEASUREMENT
/begin MEASUREMENT ACSen_eEVAPSurfTSenSts "" UBYTE ME11_CM_FaultStatus_flg 0 0 0 2 ECU_ADDRESS 0x0000 /* @ECU_Address@ACSen_eEVAPSurfTSenSts@ */ /end MEASUREMENT
/begin MEASUREMENT ACSen_eEVAPTSenSts "" UBYTE ME11_CM_FaultStatus_flg 0 0 0 2 ECU_ADDRESS 0x0000 /* @ECU_Address@ACSen_eEVAPTSenSts@ */ /end MEASUREMENT
/begin MEASUREMENT ACSen_eEnvSenSts "" UBYTE ME11_CM_FaultStatus_flg 0 0 0 2 ECU_ADDRESS 0x0000 /* @ECU_Address@ACSen_eEnvSenSts@ */ /end MEASUREMENT
/begin MEASUREMENT ACSen_eChillerTSenSts "" UBYTE ME11_CM_FaultStatus_flg 0 0 0 2 ECU_ADDRESS 0x0000 /* @ECU_Address@ACSen_eChillerTSenSts@ */ /end MEASUREMENT
/begin MEASUREMENT ACSen_eFootDuctSenSts "" UBYTE ME11_CM_FaultStatus_flg 0 0 0 2 ECU_ADDRESS 0x0000 /* @ECU_Address@ACSen_eFootDuctSenSts@ */ /end MEASUREMENT
/begin MEASUREMENT ACSen_eFaceDuctSenSts "" UBYTE ME11_CM_FaultStatus_flg 0 0 0 2 ECU_ADDRESS 0x0000 /* @ECU_Address@ACSen_eFaceDuctSenSts@ */ /end MEASUREMENT
/begin MEASUREMENT ACSen_eCabinSenSts "" UBYTE ME11_CM_FaultStatus_flg 0 0 0 2 ECU_ADDRESS 0x0000 /* @ECU_Address@ACSen_eCabinSenSts@ */ /end MEASUREMENT
/begin MEASUREMENT SOMCtl_eCabinModePre "" UBYTE ME11_CM_CabinMode_null 0 0 0 7 ECU_ADDRESS 0x0000 /* @ECU_Address@SOMCtl_eCabinModePre@ */ /end MEASUREMENT
/begin MEASUREMENT ACCtl_BlowerMode "" UBYTE ME11_CM_BlowerModes_null 0 0 0 8 ECU_ADDRESS 0x0000 /* @ECU_Address@ACCtl_BlowerMode@ */ /end MEASUREMENT
/begin MEASUREMENT Buffer_DcmDspData_3238 "" UBYTE ME11_CM_uint8 0 0 0 255 ARRAY_SIZE 5 ECU_ADDRESS 0x0000 /* @ECU_Address@Buffer_DcmDspData_3238@ */ /end MEASUREMENT
/begin MEASUREMENT Buffer_DcmDspData_F266H "" UBYTE ME11_CM_uint8 0 0 0 255 ARRAY_SIZE 2 ECU_ADDRESS 0x0000 /* @ECU_Address@Buffer_DcmDspData_F266H@ */ /end MEASUREMENT
/begin MEASUREMENT Buffer_DcmDspData_F267H "" UBYTE ME11_CM_uint8 0 0 0 255 ARRAY_SIZE 2 ECU_ADDRESS 0x0000 /* @ECU_Address@Buffer_DcmDspData_F267H@ */ /end MEASUREMENT
/begin MEASUREMENT Buffer_DcmDspData_F268H "" UBYTE ME11_CM_uint8 0 0 0 255 ARRAY_SIZE 2 ECU_ADDRESS 0x0000 /* @ECU_Address@Buffer_DcmDspData_F268H@ */ /end MEASUREMENT
/begin MEASUREMENT Buffer_DcmDspData_F26CH "" UBYTE ME11_CM_uint8 0 0 0 255 ARRAY_SIZE 2 ECU_ADDRESS 0x0000 /* @ECU_Address@Buffer_DcmDspData_F26CH@ */ /end MEASUREMENT
/begin MEASUREMENT Buffer_DcmDspData_F271H "" UBYTE ME11_CM_uint8 0 0 0 255 ARRAY_SIZE 2 ECU_ADDRESS 0x0000 /* @ECU_Address@Buffer_DcmDspData_F271H@ */ /end MEASUREMENT
/begin MEASUREMENT Buffer_DcmDspData_F272H "" UBYTE ME11_CM_uint8 0 0 0 255 ARRAY_SIZE 2 ECU_ADDRESS 0x0000 /* @ECU_Address@Buffer_DcmDspData_F272H@ */ /end MEASUREMENT
/begin MEASUREMENT Buffer_DcmDspData_F27CH "" UBYTE ME11_CM_uint8 0 0 0 255 ARRAY_SIZE 2 ECU_ADDRESS 0x0000 /* @ECU_Address@Buffer_DcmDspData_F27CH@ */ /end MEASUREMENT
/begin MEASUREMENT Buffer_DcmDspData_F27DH "" UBYTE ME11_CM_uint8 0 0 0 255 ARRAY_SIZE 2 ECU_ADDRESS 0x0000 /* @ECU_Address@Buffer_DcmDspData_F27DH@ */ /end MEASUREMENT
/begin MEASUREMENT Buffer_DcmDspData_F27EH "" UBYTE ME11_CM_uint8 0 0 0 255 ARRAY_SIZE 2 ECU_ADDRESS 0x0000 /* @ECU_Address@Buffer_DcmDspData_F27EH@ */ /end MEASUREMENT
/begin MEASUREMENT Buffer_DcmDspData_F270H "" UBYTE ME11_CM_uint8 0 0 0 255 ARRAY_SIZE 2 ECU_ADDRESS 0x0000 /* @ECU_Address@Buffer_DcmDspData_F270H@ */ /end MEASUREMENT
/begin MEASUREMENT Rte_DcmDspData_3237_CtlFlg "" UBYTE ME11_CM_uint8 0 0 0 255 ECU_ADDRESS 0x0000 /* @ECU_Address@Rte_DcmDspData_3237_CtlFlg@ */ /end MEASUREMENT
/begin MEASUREMENT Rte_DcmDspData_3238_CtlFlg "" UBYTE ME11_CM_uint8 0 0 0 255 ECU_ADDRESS 0x0000 /* @ECU_Address@Rte_DcmDspData_3238_CtlFlg@ */ /end MEASUREMENT
/begin COMPU_METHOD ME11_CM_single_v "Q = V" RAT_FUNC "%8.6" "v" COEFFS 0 1 0 0 0 1 /end COMPU_METHOD
/begin COMPU_METHOD ME11_CM_uint8_null "Q = V" RAT_FUNC "%3.0" "null" COEFFS 0 1 0 0 0 1 /end COMPU_METHOD
/begin COMPU_METHOD ME11_CM_int16_mv "Q = V" RAT_FUNC "%5.0" "mv" COEFFS 0 1 0 0 0 1 /end COMPU_METHOD
/begin COMPU_METHOD ME11_CM_uint16_mv "Q = V" RAT_FUNC "%5.0" "mv" COEFFS 0 1 0 0 0 1 /end COMPU_METHOD
/begin COMPU_METHOD ME11_CM_single_C "Q = V" RAT_FUNC "%8.6" "C" COEFFS 0 1 0 0 0 1 /end COMPU_METHOD
/begin COMPU_METHOD ME11_CM_single_Kohm "Q = V" RAT_FUNC "%8.6" "Kohm" COEFFS 0 1 0 0 0 1 /end COMPU_METHOD
/begin COMPU_METHOD ME11_CM_single_Mpa "Q = V" RAT_FUNC "%8.6" "Mpa" COEFFS 0 1 0 0 0 1 /end COMPU_METHOD
/begin COMPU_METHOD ME11_CM_single_mv "Q = V" RAT_FUNC "%8.6" "mv" COEFFS 0 1 0 0 0 1 /end COMPU_METHOD
/begin COMPU_METHOD ME11_CM_single_percent_ "Q = V" RAT_FUNC "%8.6" "%" COEFFS 0 1 0 0 0 1 /end COMPU_METHOD
/begin COMPU_METHOD ME11_CM_uint8_percent_ "Q = V" RAT_FUNC "%3.0" "%" COEFFS 0 1 0 0 0 1 /end COMPU_METHOD
/begin COMPU_METHOD ME11_CM_uint16_w_per_m_2 "Q = V" RAT_FUNC "%5.0" "w/m^2" COEFFS 0 1 0 0 0 1 /end COMPU_METHOD
/begin COMPU_METHOD ME11_CM_single_ohm "Q = V" RAT_FUNC "%8.6" "ohm" COEFFS 0 1 0 0 0 1 /end COMPU_METHOD
/begin COMPU_METHOD ME11_CM_single_km_per_h "Q = V" RAT_FUNC "%8.6" "km/h" COEFFS 0 1 0 0 0 1 /end COMPU_METHOD
/begin COMPU_METHOD ME11_CM_single_kw "Q = V" RAT_FUNC "%8.6" "kw" COEFFS 0 1 0 0 0 1 /end COMPU_METHOD
/begin COMPU_METHOD ME11_CM_single_rpm "Q = V" RAT_FUNC "%8.6" "rpm" COEFFS 0 1 0 0 0 1 /end COMPU_METHOD
/begin COMPU_METHOD ME11_CM_single_null "Q = V" RAT_FUNC "%8.6" "null" COEFFS 0 1 0 0 0 1 /end COMPU_METHOD
/begin COMPU_METHOD ME11_CM_single_s "Q = V" RAT_FUNC "%8.6" "s" COEFFS 0 1 0 0 0 1 /end COMPU_METHOD
/begin COMPU_METHOD ME11_CM_single_min "Q = V" RAT_FUNC "%8.6" "min" COEFFS 0 1 0 0 0 1 /end COMPU_METHOD
/begin COMPU_METHOD ME11_CM_int16_C "Q = V" RAT_FUNC "%5.0" "C" COEFFS 0 1 0 0 0 1 /end COMPU_METHOD
/begin COMPU_METHOD ME11_CM_uint16_sec "Q = V" RAT_FUNC "%5.0" "sec" COEFFS 0 1 0 0 0 1 /end COMPU_METHOD
/begin COMPU_METHOD ME11_CM_uint16_hz "Q = V" RAT_FUNC "%5.0" "hz" COEFFS 0 1 0 0 0 1 /end COMPU_METHOD
/begin COMPU_METHOD ME11_CM_uint16_rpm "Q = V" RAT_FUNC "%5.0" "rpm" COEFFS 0 1 0 0 0 1 /end COMPU_METHOD
/begin COMPU_METHOD ME11_CM_uint16_s "Q = V" RAT_FUNC "%5.0" "s" COEFFS 0 1 0 0 0 1 /end COMPU_METHOD
/begin COMPU_METHOD ME11_CM_uint16_ms "Q = V" RAT_FUNC "%5.0" "ms" COEFFS 0 1 0 0 0 1 /end COMPU_METHOD
/begin COMPU_METHOD ME11_CM_uint16_per_ "Q = V" RAT_FUNC "%5.0" "/" COEFFS 0 1 0 0 0 1 /end COMPU_METHOD
/begin COMPU_METHOD ME11_CM_uint16_min "Q = V" RAT_FUNC "%5.0" "min" COEFFS 0 1 0 0 0 1 /end COMPU_METHOD
/begin COMPU_METHOD ME11_CM_CabinMode_null "Enumerated data type: CabinMode" TAB_VERB "%0.6" "null" COMPU_TAB_REF VTAB_FOR_ME11_CM_CabinMode_null /end COMPU_METHOD
/begin COMPU_VTAB VTAB_FOR_ME11_CM_CabinMode_null "Enumerated data type: CabinMode" TAB_VERB 7 0 "CabinMode_MD_Off" 1 "CabinMode_MD1_CLM" 2 "CabinMode_MD2_DHMD1" 3 "CabinMode_MD3_DHMD2" 4 "CabinMode_MD4_HP" 6 "CabinMode_VENT" 7 "CabinMode_STANDBY" /end COMPU_VTAB
/begin COMPU_METHOD ME11_CM_PwrModes_null "Enumerated data type: PwrModes" TAB_VERB "%0.6" "null" COMPU_TAB_REF VTAB_FOR_ME11_CM_PwrModes_null /end COMPU_METHOD
/begin COMPU_VTAB VTAB_FOR_ME11_CM_PwrModes_null "Enumerated data type: PwrModes" TAB_VERB 6 0 "PwrOff" 1 "Standby" 2 "HVNormal" 3 "ACChrg" 4 "DCChrg" 5 "PTReady" /end COMPU_VTAB
/begin COMPU_METHOD ME11_CM_RefModes_null "Enumerated data type: RefModes" TAB_VERB "%0.6" "null" COMPU_TAB_REF VTAB_FOR_ME11_CM_RefModes_null /end COMPU_METHOD
/begin COMPU_VTAB VTAB_FOR_ME11_CM_RefModes_null "Enumerated data type: RefModes" TAB_VERB 15 0 "RefModes_Ref_Off" 1 "RefModes_CoolCabin" 2 "RefModes_CoolBat" 3 "RefModes_CoolDouble" 4 "RefModes_HeatCabin" 5 "RefModes_HeatBat" 6 "RefModes_HeatDouble" 7 "RefModes_SerDeh_LCC" 8 "RefModes_SerDeh_EVAP" 9 "RefModes_ParDeh" 10 "RefModes_Def" 11 "RefModes_Defrosting" 12 "RefModes_CoolCabinAHeatBat" 13 "RefModes_CoolBatAHeatCabin" 14 "RefModes_DehAndBatCool" /end COMPU_VTAB
/begin COMPU_METHOD ME11_CM_WaterModes_flg "Enumerated data type: WaterModes" TAB_VERB "%0.6" "flg" COMPU_TAB_REF VTAB_FOR_ME11_CM_WaterModes_flg /end COMPU_METHOD
/begin COMPU_VTAB VTAB_FOR_ME11_CM_WaterModes_flg "Enumerated data type: WaterModes" TAB_VERB 7 0 "WaterOff" 1 "WaterLTR" 2 "LTRAndCoolOrHeat" 3 "RecAndBal" 4 "LTRAndBal" 5 "Water_MotorHeatBat" 6 "WasteHeatRec" /end COMPU_VTAB
/begin COMPU_METHOD ME11_CM_boolean_flg "Q = V" RAT_FUNC "%1.0" "flg" COEFFS 0 1 0 0 0 1 /end COMPU_METHOD
/begin COMPU_METHOD ME11_CM_boolean_per_ "Q = V" RAT_FUNC "%1.0" "/" COEFFS 0 1 0 0 0 1 /end COMPU_METHOD
/begin COMPU_METHOD ME11_CM_boolean_null "Q = V" RAT_FUNC "%1.0" "null" COEFFS 0 1 0 0 0 1 /end COMPU_METHOD
/begin COMPU_METHOD ME11_CM_uint8_flg "Q = V" RAT_FUNC "%3.0" "flg" COEFFS 0 1 0 0 0 1 /end COMPU_METHOD
/begin COMPU_METHOD ME11_CM_uint8_s "Q = V" RAT_FUNC "%3.0" "s" COEFFS 0 1 0 0 0 1 /end COMPU_METHOD
/begin COMPU_METHOD ME11_CM_uint8_rpm "Q = V" RAT_FUNC "%3.0" "rpm" COEFFS 0 1 0 0 0 1 /end COMPU_METHOD
/begin COMPU_METHOD ME11_CM_uint8_ms "Q = V" RAT_FUNC "%3.0" "ms" COEFFS 0 1 0 0 0 1 /end COMPU_METHOD
/begin COMPU_METHOD ME11_CM_uint32_t "Q = V" RAT_FUNC "%10.0" "t" COEFFS 0 1 0 0 0 1 /end COMPU_METHOD
/begin COMPU_METHOD ME11_CM_uint16_null "Q = V" RAT_FUNC "%5.0" "null" COEFFS 0 1 0 0 0 1 /end COMPU_METHOD
/begin COMPU_METHOD ME11_CM_uint16_v "Q = V" RAT_FUNC "%5.0" "v" COEFFS 0 1 0 0 0 1 /end COMPU_METHOD
/begin COMPU_METHOD ME11_CM_uint8_h "Q = V" RAT_FUNC "%3.0" "h" COEFFS 0 1 0 0 0 1 /end COMPU_METHOD
/begin COMPU_METHOD ME11_CM_uint8_min "Q = V" RAT_FUNC "%3.0" "min" COEFFS 0 1 0 0 0 1 /end COMPU_METHOD
/begin COMPU_METHOD ME11_CM_uint8_day "Q = V" RAT_FUNC "%3.0" "day" COEFFS 0 1 0 0 0 1 /end COMPU_METHOD
/begin COMPU_METHOD ME11_CM_WaterModes_null "Enumerated data type: WaterModes" TAB_VERB "%0.6" "null" COMPU_TAB_REF VTAB_FOR_ME11_CM_WaterModes_null /end COMPU_METHOD
/begin COMPU_VTAB VTAB_FOR_ME11_CM_WaterModes_null "Enumerated data type: WaterModes" TAB_VERB 7 0 "WaterOff" 1 "WaterLTR" 2 "LTRAndCoolOrHeat" 3 "RecAndBal" 4 "LTRAndBal" 5 "Water_MotorHeatBat" 6 "WasteHeatRec" /end COMPU_VTAB
/begin COMPU_METHOD ME11_CM_FaultStatus_flg "Enumerated data type: FaultStatus" TAB_VERB "%0.6" "flg" COMPU_TAB_REF VTAB_FOR_ME11_CM_FaultStatus_flg /end COMPU_METHOD
/begin COMPU_VTAB VTAB_FOR_ME11_CM_FaultStatus_flg "Enumerated data type: FaultStatus" TAB_VERB 3 0 "Normal" 1 "Ground" 2 "Power" /end COMPU_VTAB
/begin COMPU_METHOD ME11_CM_BlowerModes_null "Enumerated data type: BlowerModes" TAB_VERB "%0.6" "null" COMPU_TAB_REF VTAB_FOR_ME11_CM_BlowerModes_null /end COMPU_METHOD
/begin COMPU_VTAB VTAB_FOR_ME11_CM_BlowerModes_null "Enumerated data type: BlowerModes" TAB_VERB 9 5 "BlowerModes_FaceMode" 4 "BlowerModes_FaceHeaterMode" 2 "BlowerModes_HeaterMode" 3 "BlowerModes_HeaterDeforstMode" 1 "BlowerModes_DeforstMode" 0 "BlowerModes_OffMode" 8 "BlowerModes_AutoMode" 6 "BlowerModes_FaceDeforstMode" 7 "BlowerModes_FaceHeaterDeforstMode" /end COMPU_VTAB
/begin COMPU_METHOD ME11_CM_uint8 "Q = V" RAT_FUNC "%3.0" "" COEFFS 0 1 0 0 0 1 /end COMPU_METHOD
/begin GROUP ME11 "ME11" /* Root */ ROOT /begin SUB_GROUP Root_Init Root_ME11_TMS /end SUB_GROUP
 /begin REF_MEASUREMENT Buffer_DcmDspData_3238 Buffer_DcmDspData_F266H Buffer_DcmDspData_F267H Buffer_DcmDspData_F268H Buffer_DcmDspData_F26CH Buffer_DcmDspData_F270H Buffer_DcmDspData_F271H Buffer_DcmDspData_F272H Buffer_DcmDspData_F27CH Buffer_DcmDspData_F27DH Buffer_DcmDspData_F27EH Rte_DcmDspData_3237_CtlFlg Rte_DcmDspData_3238_CtlFlg /end REF_MEASUREMENT
/end GROUP
/begin GROUP Root_Init "ME11/Init" /begin SUB_GROUP S1_Nvm_Read /end SUB_GROUP /end GROUP
/begin GROUP Root_ME11_TMS "ME11/ME11_TMS"
 /begin SUB_GROUP S2_ACC S2_Actuator S2_CAN_OUT S2_HMI S2_IODriver S2_Info_AEXV S2_Info_AcPump S2_Info_BCV S2_Info_BEXV S2_Info_BatPump S2_Info_HPEXV S2_Info_MCV S2_Info_MotPump S2_Power S2_PowerCal S2_SOM S2_Sensor /end SUB_GROUP
 /begin REF_CHARACTERISTIC cal_CANAliveEnable /end REF_CHARACTERISTIC
 /begin REF_MEASUREMENT BMS_BatSOCAct_pct BMS_HVBatCellTempAve BMS_HVBatCellTempMax BMS_HVBatCellTempMin BMS_InletCooltActlTemp COMP_CANBusOff COMP_Commu_Error COMP_CurrentOffset COMP_EcompActSpd COMP_EcompST COMP_High_Voltage COMP_HvError COMP_IPM_Error COMP_InputCurrent COMP_LoseStep COMP_LvError COMP_OverCurrent COMP_OverDuty COMP_PI_Saturation COMP_SelfCheckError COMP_TempError COMP_Temperature ECUHighVoltInterlockSignal GlbDa_uBat HU_LeftTempSet PWRCtl_bKL15swtSt PWRCtl_eVCUPTSts /end REF_MEASUREMENT
/end GROUP
/begin GROUP S1_Nvm_Read "ME11/Init/Nvm_Read"
 /begin REF_MEASUREMENT ACNvm_bACAutoSts ACNvm_bACOnOff ACNvm_eACCabinMode ACNvm_eCabinBlower ACNvm_eCabinSetTemp ACNvm_eCainModeDoor ACNvm_eCainRecDoor ACNvm_sACEnvTemp ACNvm_sPCUInletTemp /end REF_MEASUREMENT
/end GROUP
/begin GROUP S2_ACC "ME11/ME11_TMS/ACC" /begin SUB_GROUP S4_AutoAc /end SUB_GROUP /begin REF_CHARACTERISTIC ACOff /end REF_CHARACTERISTIC /begin REF_MEASUREMENT AC_stExhaust /end REF_MEASUREMENT /end GROUP
/begin GROUP S2_Actuator "ME11/ME11_TMS/Actuator" /begin SUB_GROUP S6_COMP S6_CWV S6_EXV S6_Fan S6_PTC S6_PUMP S6_SOV /end SUB_GROUP /end GROUP
/begin GROUP S2_CAN_OUT "ME11/ME11_TMS/CAN_OUT" /begin REF_MEASUREMENT TMS_VersionNumber /end REF_MEASUREMENT /end GROUP
/begin GROUP S2_HMI "ME11/ME11_TMS/HMI"
 /begin SUB_GROUP S10_Blower S10_Inner S10_MixDoor S10_ModeMotor S10_Override_eExhFlg S10_SetTemp S10_Status /end SUB_GROUP
 /begin REF_CHARACTERISTIC cal_ExhaustTime /end REF_CHARACTERISTIC
 /begin REF_MEASUREMENT ACCtl_bExhaustFlg /end REF_MEASUREMENT
/end GROUP
/begin GROUP S2_IODriver "ME11/ME11_TMS/IODriver"
 /begin SUB_GROUP S11_ACPMPAndEXV S11_Blower S11_FanAndPMP S11_HVPower S11_InnerDoor S11_MixDoor S11_ModeMotor S11_Override_PwrFanCabin S11_Override_PwrSensor S11_SOVPwrSts /end SUB_GROUP
/end GROUP
/begin GROUP S2_Info_AEXV "ME11/ME11_TMS/Info_AEXV" /begin SUB_GROUP S13_Info_AEXV /end SUB_GROUP
 /begin REF_MEASUREMENT EXV_CurrentInitState EXV_FaultState EXV_ResponseError EXV_RunState EXV_TemperatureWarn EXV_VoltageState /end REF_MEASUREMENT
/end GROUP
/begin GROUP S2_Info_AcPump "ME11/ME11_TMS/Info_AcPump" /begin SUB_GROUP S14_Info_AcPMP /end SUB_GROUP
 /begin REF_MEASUREMENT AcPMP_HWVersion AcPMP_PartNumber AcPMP_ProjectCode1 AcPMP_ProjectCode2 AcPMP_PumpDryRunningSta AcPMP_PumpInputVolt AcPMP_PumpMotorSta AcPMP_PumpPowerSta AcPMP_PumpTempSta AcPMP_RESP_ERROR AcPMP_SWVersion_Main AcPMP_SWVersion_Patch AcPMP_SWVersion_Sub AcPMP_SupplierNumber /end REF_MEASUREMENT
/end GROUP
/begin GROUP S2_Info_BCV "ME11/ME11_TMS/Info_BCV"
 /begin REF_MEASUREMENT BCV_ErrResp BCV_FltSts BCV_Mode BCV_PosRec BCV_RunSts BCV_SpdLvl BCV_TempSts BCV_VoltSts /end REF_MEASUREMENT
/end GROUP
/begin GROUP S2_Info_BEXV "ME11/ME11_TMS/Info_BEXV" /begin SUB_GROUP S16_Info_BEXV /end SUB_GROUP
 /begin REF_MEASUREMENT BAT_EXV_CurrentInitState_B BAT_EXV_FaultState_B BAT_EXV_ResponseError_B BAT_EXV_RunState_B BAT_EXV_SupplierLabel BAT_EXV_VoltageState_B Bat_EXV_HWVersion Bat_EXV_PartNumber Bat_EXV_ProjectCode1 Bat_EXV_ProjectCode2 Bat_EXV_SWVersion_Main Bat_EXV_SWVersion_Patch Bat_EXV_SWVersion_Sub Bat_EXV_SupplierNumber /end REF_MEASUREMENT
/end GROUP
/begin GROUP S2_Info_BatPump "ME11/ME11_TMS/Info_BatPump" /begin SUB_GROUP S18_Info_BatPMP /end SUB_GROUP
 /begin REF_MEASUREMENT BatPMP_PumpDryRunningSta BatPMP_PumpInputVolt BatPMP_PumpMotorSta BatPMP_PumpPowerSta BatPMP_PumpTempSta BatPMP_RESP_ERROR /end REF_MEASUREMENT
/end GROUP
/begin GROUP S2_Info_HPEXV "ME11/ME11_TMS/Info_HPEXV" /begin SUB_GROUP S20_Info_HPEXV /end SUB_GROUP
 /begin REF_MEASUREMENT HP_EXV_FaultState_B HP_EXV_HWVersion HP_EXV_PartNumber HP_EXV_ProjectCode1 HP_EXV_ProjectCode2 HP_EXV_ResponseError_B HP_EXV_RunState_B HP_EXV_SWVersion_Main HP_EXV_SWVersion_Patch HP_EXV_SWVersion_Sub HP_EXV_SupplierLabel HP_EXV_SupplierNumber HP_EXV_VoltageState_B HP_EXV_Warning_OverTemp HP_EXV_initialize_status /end REF_MEASUREMENT
/end GROUP
/begin GROUP S2_Info_MCV "ME11/ME11_TMS/Info_MCV"
 /begin REF_MEASUREMENT MCV_ErrResp MCV_FltSts MCV_Mode MCV_PosRec MCV_RunSts MCV_SpdLvl MCV_TempSts MCV_VoltSts /end REF_MEASUREMENT
/end GROUP
/begin GROUP S2_Info_MotPump "ME11/ME11_TMS/Info_MotPump" /begin SUB_GROUP S23_Info_MotPMP /end SUB_GROUP
 /begin REF_MEASUREMENT MotPMP_PumpDryRunningSta MotPMP_PumpInputVolt MotPMP_PumpMotorSta MotPMP_PumpPowerSta MotPMP_PumpTempSta MotPMP_RESP_ERROR /end REF_MEASUREMENT
/end GROUP
/begin GROUP S2_Power "ME11/ME11_TMS/Power" /begin SUB_GROUP S28_DisplaySet S28_IGONDelay S28_RDCWorkMng /end SUB_GROUP /begin REF_CHARACTERISTIC cal_IGNONDelayTime /end REF_CHARACTERISTIC /begin REF_MEASUREMENT CoAC_stwork PWRCtl_eBatChargSts PWRCtl_uTMSRunTimer /end REF_MEASUREMENT /end GROUP
/begin GROUP S2_PowerCal "ME11/ME11_TMS/PowerCal" /begin REF_MEASUREMENT PWRCtl_sCOMPActlPwr /end REF_MEASUREMENT /end GROUP
/begin GROUP S2_SOM "ME11/ME11_TMS/SOM"
 /begin SUB_GROUP S30_BattaryMode S30_Cabin S30_DisplaySet S30_ExternalizingDef S30_HVPart S30_REF /end SUB_GROUP
 /begin REF_CHARACTERISTIC cal_BatModeSwitch /end REF_CHARACTERISTIC
/end GROUP
/begin GROUP S2_Sensor "ME11/ME11_TMS/Sensor"
 /begin SUB_GROUP S31_AdcGroup S31_Cabin S31_EnvTempSensor S31_Env_amendment S31_FaceDuct S31_FootDuct S31_LoPress S31_MixDoor S31_ModeMotor S31_Recirc S31_Solar S31_TempChiller S31_TempEnvironment S31_TempEvap S31_TempEvapSurface S31_TempMotor S31_TempOHX S31_WCCHiTemp S31_pressWCCHi S31_tempACCMHi /end SUB_GROUP
/end GROUP
/begin GROUP S4_AutoAc "ME11/ME11_TMS/ACC/AutoAc"
 /begin SUB_GROUP S32_AutoACFun S32_CheckAirConditionStartState S32_EvaporatorAndPTCAimTempCal_FIX S32_MixDoorOpenCloseDesCal /end SUB_GROUP
 /begin REF_MEASUREMENT ACCtl_stRecTempLowEna /end REF_MEASUREMENT
/end GROUP
/begin GROUP S6_COMP "ME11/ME11_TMS/Actuator/COMP"
 /begin SUB_GROUP S437_ACCMEnble S437_ACCMPICtrl S437_COMPFaultHandling S437_COMPLimitSpeed S437_COMPSpeedLmt S437_NegAndPosCheck_COMP S437_ParameterCal S437_PressProtect S437_RunSts S437_TempProtect /end SUB_GROUP
 /begin REF_CHARACTERISTIC cal_ACCMForbidCtrl /end REF_CHARACTERISTIC
 /begin REF_MEASUREMENT ACTCtl_sCOMPActure ACTCtl_sCOMPCtrlKi ACTCtl_sCOMPCtrlKp ACTCtl_sCOMPSetPoint /end REF_MEASUREMENT
/end GROUP
/begin GROUP S6_CWV "ME11/ME11_TMS/Actuator/CWV"
 /begin SUB_GROUP S438_C3WV__MCV S438_C5WV__BCV S438_Override_C3WV S438_Override_C5WV /end SUB_GROUP
/end GROUP
/begin GROUP S6_EXV "ME11/ME11_TMS/Actuator/EXV"
 /begin SUB_GROUP S439_AEXV S439_BEXV S439_HPEXV S439_SupercoolingOrSuperheat /end SUB_GROUP
/end GROUP
/begin GROUP S6_Fan "ME11/ME11_TMS/Actuator/Fan"
 /begin SUB_GROUP S440_BatBalOrLTR S440_CoolFanCtrl S440_HTFanCtrl S440_HeatPumpFanCtrl S440_LowPressFanCtrl S440_MotHeatBatFanCtrl S440_Override_CoolFan /end SUB_GROUP
 /begin REF_CHARACTERISTIC cal_COMPFanSpdLmt cal_COMPSpdLmt cal_HeatCabinAndCoolBatFanSpd /end REF_CHARACTERISTIC
/end GROUP
/begin GROUP S6_PTC "ME11/ME11_TMS/Actuator/PTC" /begin SUB_GROUP S441_Override S441_PTCEnable S441_PTCRequestPwr /end SUB_GROUP
 /begin REF_CHARACTERISTIC cal_ACCMClsEnvTemp cal_ACCMOpenEnvTemp cal_ExtDefBatMinT cal_ExtDefPTCTrgTemp cal_PTCMaxTemp cal_PTCMinTemp /end REF_CHARACTERISTIC
/end GROUP
/begin GROUP S6_PUMP "ME11/ME11_TMS/Actuator/PUMP" /begin SUB_GROUP S442_AcPMP S442_BatPMP S442_MotPMP /end SUB_GROUP /end GROUP
/begin GROUP S6_SOV "ME11/ME11_TMS/Actuator/SOV" /begin REF_CHARACTERISTIC cal_EVAPSufTempClsSOV cal_EVAPSufTempOpenSOV /end REF_CHARACTERISTIC /begin REF_MEASUREMENT ACTCtl_bSOVCmd /end REF_MEASUREMENT /end GROUP
/begin GROUP S10_Blower "ME11/ME11_TMS/HMI/Blower" /begin SUB_GROUP S1069_Override_eBlwSts /end SUB_GROUP /end GROUP
/begin GROUP S10_Inner "ME11/ME11_TMS/HMI/Inner" /begin SUB_GROUP S1078_Override_eInner /end SUB_GROUP /end GROUP
/begin GROUP S10_MixDoor "ME11/ME11_TMS/HMI/MixDoor" /begin SUB_GROUP S1079_Override_sMixDoor /end SUB_GROUP /end GROUP
/begin GROUP S10_ModeMotor "ME11/ME11_TMS/HMI/ModeMotor" /begin SUB_GROUP S1080_Override_eModeMotor /end SUB_GROUP /end GROUP
/begin GROUP S10_Override_eExhFlg "ME11/ME11_TMS/HMI/Override_eExhFlg" /begin REF_CHARACTERISTIC cal_bExhFlgData cal_bExhFlgEnb /end REF_CHARACTERISTIC /begin REF_MEASUREMENT ACCtl_bExhFlg /end REF_MEASUREMENT /end GROUP
/begin GROUP S10_SetTemp "ME11/ME11_TMS/HMI/SetTemp"
 /begin SUB_GROUP S1082_Override_bLeftSetHigh S1082_Override_bLeftSetLow S1082_Override_sLeftSetPoint /end SUB_GROUP
/end GROUP
/begin GROUP S10_Status "ME11/ME11_TMS/HMI/Status" /begin SUB_GROUP S1083_ACAuto S1083_ACDefrost S1083_ACOnOff S1083_ACSts /end SUB_GROUP /end GROUP
/begin GROUP S11_ACPMPAndEXV "ME11/ME11_TMS/IODriver/ACPMPAndEXV" /begin SUB_GROUP S1187_Override_PwrACPump /end SUB_GROUP /end GROUP
/begin GROUP S11_Blower "ME11/ME11_TMS/IODriver/Blower" /begin SUB_GROUP S1188_Override_BlwFan S1188_Override_PwrBlw /end SUB_GROUP /begin REF_CHARACTERISTIC cal_BlwFrqVal /end REF_CHARACTERISTIC /end GROUP
/begin GROUP S11_FanAndPMP "ME11/ME11_TMS/IODriver/FanAndPMP" /begin SUB_GROUP S1194_Override_PwrSensor1 /end SUB_GROUP /end GROUP
/begin GROUP S11_HVPower "ME11/ME11_TMS/IODriver/HVPower" /begin SUB_GROUP S1195_Override_PwrHVPart /end SUB_GROUP /end GROUP
/begin GROUP S11_InnerDoor "ME11/ME11_TMS/IODriver/InnerDoor"
 /begin SUB_GROUP S1196_Override_RecircMotorN S1196_Override_RecircMotorP S1196_RecircTrgPos /end SUB_GROUP
 /begin REF_CHARACTERISTIC cal_InnerRecTrgPos cal_OutRecTrgPos cal_RecircDoorNErr cal_RecircDoorPErr cal_RecircMotorEnb cal_RecircTrgPosDataEnb /end REF_CHARACTERISTIC
/end GROUP
/begin GROUP S11_MixDoor "ME11/ME11_TMS/IODriver/MixDoor"
 /begin SUB_GROUP S1197_Override_MixDoorN S1197_Override_MixDoorP S1197_SetLeftMixDoor /end SUB_GROUP
 /begin REF_CHARACTERISTIC cal_MixCoolTrgPos cal_MixDoorEnb cal_MixDoorNErr cal_MixDoorPErr cal_MixWarmTrgPos cal_SetLeftMixDoorTrgDataEnb /end REF_CHARACTERISTIC
/end GROUP
/begin GROUP S11_ModeMotor "ME11/ME11_TMS/IODriver/ModeMotor"
 /begin SUB_GROUP S1198_ModeMotorTrgPos S1198_Override_ModeMotorN S1198_Override_ModeMotorP /end SUB_GROUP
 /begin REF_CHARACTERISTIC cal_ModeMotorEnb cal_ModeMotorNErr cal_ModeMotorPErr cal_ModeMotorTrgPosDataEnb cal_ModeMotorTrgPos_CUR /end REF_CHARACTERISTIC
/end GROUP
/begin GROUP S11_Override_PwrFanCabin "ME11/ME11_TMS/IODriver/Override_PwrFanCabin" /begin REF_CHARACTERISTIC cal_PwrFanData cal_PwrFanEnb /end REF_CHARACTERISTIC /end GROUP
/begin GROUP S11_Override_PwrSensor "ME11/ME11_TMS/IODriver/Override_PwrSensor" /begin REF_CHARACTERISTIC cal_PwrSensorData cal_PwrSensorEnb /end REF_CHARACTERISTIC /end GROUP
/begin GROUP S11_SOVPwrSts "ME11/ME11_TMS/IODriver/SOVPwrSts" /begin SUB_GROUP S1201_Override_SOV /end SUB_GROUP /end GROUP
/begin GROUP S13_Info_AEXV "ME11/ME11_TMS/Info_AEXV/Info_AEXV" /begin REF_MEASUREMENT EXV_CurrentPosition /end REF_MEASUREMENT /end GROUP
/begin GROUP S14_Info_AcPMP "ME11/ME11_TMS/Info_AcPump/Info_AcPMP" /begin REF_MEASUREMENT AcPMP_RealRPM /end REF_MEASUREMENT /end GROUP
/begin GROUP S16_Info_BEXV "ME11/ME11_TMS/Info_BEXV/Info_BEXV" /begin REF_MEASUREMENT BAT_EXV_CurrentPosition_B BAT_EXV_TemperatureWarn_B /end REF_MEASUREMENT /end GROUP
/begin GROUP S18_Info_BatPMP "ME11/ME11_TMS/Info_BatPump/Info_BatPMP" /begin REF_MEASUREMENT BatPMP_RealRPM /end REF_MEASUREMENT /end GROUP
/begin GROUP S20_Info_HPEXV "ME11/ME11_TMS/Info_HPEXV/Info_HPEXV" /begin REF_MEASUREMENT HP_EXV_CurrentPosition_B /end REF_MEASUREMENT /end GROUP
/begin GROUP S23_Info_MotPMP "ME11/ME11_TMS/Info_MotPump/Info_MotPMP" /begin REF_MEASUREMENT MotPMP_RealRPM /end REF_MEASUREMENT /end GROUP
/begin GROUP S28_DisplaySet "ME11/ME11_TMS/Power/DisplaySet" /begin SUB_GROUP S1254_Override_TMSStatus /end SUB_GROUP /end GROUP
/begin GROUP S28_IGONDelay "ME11/ME11_TMS/Power/IGONDelay" /begin REF_MEASUREMENT AC_stIGNON /end REF_MEASUREMENT /end GROUP
/begin GROUP S28_RDCWorkMng "ME11/ME11_TMS/Power/RDCWorkMng" /begin SUB_GROUP S1256_Start_Manage S1256_Stop_Manage /end SUB_GROUP /begin REF_MEASUREMENT CoAC_stColdStart /end REF_MEASUREMENT /end GROUP
/begin GROUP S30_BattaryMode "ME11/ME11_TMS/SOM/BattaryMode"
 /begin SUB_GROUP S1275_Balance S1275_Cool S1275_DLTR S1275_DisplaySet S1275_Heat S1275_MotorAndBatLTR S1275_MotorHeatBat S1275_MotorHeatBat_OTS S1275_MotorLTRAndBatBalance S1275_Override_BatTrgTemp /end SUB_GROUP
 /begin REF_CHARACTERISTIC cal_BatModeSwitch /end REF_CHARACTERISTIC
/end GROUP
/begin GROUP S30_Cabin "ME11/ME11_TMS/SOM/Cabin"
 /begin SUB_GROUP S1276_Cal_F2AndF1 S1276_MD1ShiftMD2 S1276_MD1_CLM S1276_MD2_DHMD1 S1276_MD3ShiftMD2 S1276_MD3_DHMD2 S1276_MD4ShiftMD3 S1276_MD4_HP S1276_ModeDisplay /end SUB_GROUP
/end GROUP
/begin GROUP S30_DisplaySet "ME11/ME11_TMS/SOM/DisplaySet" /begin SUB_GROUP S1277_Override_WaterModed /end SUB_GROUP /end GROUP
/begin GROUP S30_ExternalizingDef "ME11/ME11_TMS/SOM/ExternalizingDef"
 /begin SUB_GROUP S1278_EnterCondition S1278_ExitCondition S1278_Override_RefModed /end SUB_GROUP
/end GROUP
/begin GROUP S30_HVPart "ME11/ME11_TMS/SOM/HVPart" /begin SUB_GROUP S1279_Override_HvPartModed /end SUB_GROUP
 /begin REF_CHARACTERISTIC cal_IGBTDownLmtTemp cal_IGBTUpLmtTemp cal_MotTempDownLmt cal_MotTempUpLmt /end REF_CHARACTERISTIC
/end GROUP
/begin GROUP S30_REF "ME11/ME11_TMS/SOM/REF" /begin SUB_GROUP S1280_Override_RefModed /end SUB_GROUP /end GROUP
/begin GROUP S31_AdcGroup "ME11/ME11_TMS/Sensor/AdcGroup"
 /begin REF_MEASUREMENT adc2_group0_0 adc2_group0_1 adc2_group0_2 adc2_group1_0 adc2_group1_1 adc2_group1_2 adc2_group1_3 adc2_group1_4 adc2_group1_5 adc2_group1_6 adc2_group1_7 adc2_group1_8 adc2_group1_9 adc2_group2_0 adc2_group2_1 adc2_group2_2 adc2_group2_3 adc2_group2_4 /end REF_MEASUREMENT
/end GROUP
/begin GROUP S31_Cabin "ME11/ME11_TMS/Sensor/Cabin" /begin SUB_GROUP S1705_Cabin S1705_Override_HvPartModed /end SUB_GROUP /begin REF_CHARACTERISTIC cal_ADCVCCVal cal_CabinVolAmend_CUR cal_TCabinRaw_CUR /end REF_CHARACTERISTIC /begin REF_MEASUREMENT SENCtl_uCabinVoltage SEN_TCabinRaw /end REF_MEASUREMENT /end GROUP
/begin GROUP S31_EnvTempSensor "ME11/ME11_TMS/Sensor/EnvTempSensor"
 /begin REF_CHARACTERISTIC cal_ColdPCUTempMinByEnv_CUR cal_EnvTempRiseStep cal_FallTime2Tamb cal_RiseTime2Tamb cal_TempRampStepFast cal_TempRampStepLoVSpeed cal_TempRampStepSlow cal_VehicleSpeedHighVs cal_VehicleSpeedLowVs /end REF_CHARACTERISTIC
 /begin REF_MEASUREMENT ColdPCUTempMinByEnv /end REF_MEASUREMENT
/end GROUP
/begin GROUP S31_Env_amendment "ME11/ME11_TMS/Sensor/Env_amendment" /begin SUB_GROUP S1707_Override_HvPartModed /end SUB_GROUP /begin REF_CHARACTERISTIC cal_EnvTAme_CUR /end REF_CHARACTERISTIC /begin REF_MEASUREMENT ACSen_sEnvTAme /end REF_MEASUREMENT /end GROUP
/begin GROUP S31_FaceDuct "ME11/ME11_TMS/Sensor/FaceDuct" /begin SUB_GROUP S1708_Face S1708_Override_DuctTemp /end SUB_GROUP /begin REF_CHARACTERISTIC cal_ADCVCCVal cal_FaceDuctVolAmend_CUR cal_TDuctRaw_CUR /end REF_CHARACTERISTIC /begin REF_MEASUREMENT SENCtl_uFaceDuctVal SEN_TDuctRaw /end REF_MEASUREMENT /end GROUP
/begin GROUP S31_FootDuct "ME11/ME11_TMS/Sensor/FootDuct" /begin SUB_GROUP S1709_Foot S1709_Override_DuctTemp /end SUB_GROUP /begin REF_CHARACTERISTIC cal_ADCVCCVal cal_FootDuctVolAmend_CUR cal_TDuctRaw_CUR /end REF_CHARACTERISTIC /begin REF_MEASUREMENT SENCtl_uFootDuctVal SEN_TFootDuctRaw /end REF_MEASUREMENT /end GROUP
/begin GROUP S31_LoPress "ME11/ME11_TMS/Sensor/LoPress" /begin SUB_GROUP S1710_Override_HvPartModed S1710_SenDiagnostic /end SUB_GROUP /begin REF_CHARACTERISTIC cal_LoPressRaw_CUR cal_WCCLPVolAmend_CUR /end REF_CHARACTERISTIC /begin REF_MEASUREMENT ACSen_eLPSenSts SENCtl_uWCCLPVol SEN_LoPressRaw /end REF_MEASUREMENT /end GROUP
/begin GROUP S31_MixDoor "ME11/ME11_TMS/Sensor/MixDoor" /begin SUB_GROUP S1711_Override_HvPartModed S1711_SenDiagnostic /end SUB_GROUP /begin REF_CHARACTERISTIC cal_MixDoorPerc_CUR cal_MixDoorVolAmend_CUR /end REF_CHARACTERISTIC /begin REF_MEASUREMENT ACSen_eMixDoorSenSts SENCtl_uMixDoorVol SEN_MixDoorRaw /end REF_MEASUREMENT /end GROUP
/begin GROUP S31_ModeMotor "ME11/ME11_TMS/Sensor/ModeMotor" /begin SUB_GROUP S1712_Override_HvPartModed S1712_SenDiagnostic /end SUB_GROUP /begin REF_CHARACTERISTIC cal_ModeDoorVolAmend_CUR /end REF_CHARACTERISTIC /begin REF_MEASUREMENT ACSen_eModeSenSts SENCtl_uModeDoorVol /end REF_MEASUREMENT /end GROUP
/begin GROUP S31_Recirc "ME11/ME11_TMS/Sensor/Recirc" /begin SUB_GROUP S1713_Override_HvPartModed S1713_SenDiagnostic /end SUB_GROUP /begin REF_CHARACTERISTIC cal_RecirActVal_CUR cal_RecircDoorVolAmend_CUR /end REF_CHARACTERISTIC /begin REF_MEASUREMENT ACSen_eRecircSenSts SENCtl_uRecircDoorVol /end REF_MEASUREMENT /end GROUP
/begin GROUP S31_Solar "ME11/ME11_TMS/Sensor/Solar" /begin SUB_GROUP S1714_Override_HvPartModed S1714_SenDiagnostic /end SUB_GROUP /begin REF_CHARACTERISTIC cal_SolarValRaw_CUR cal_SolorVolAmend_CUR /end REF_CHARACTERISTIC /begin REF_MEASUREMENT ACSen_eSOLARSenSts SENCtl_uSolorVol SEN_SolarRaw /end REF_MEASUREMENT /end GROUP
/begin GROUP S31_TempChiller "ME11/ME11_TMS/Sensor/TempChiller" /begin SUB_GROUP S1715_ChiTemp S1715_Chiller /end SUB_GROUP
 /begin REF_CHARACTERISTIC cal_ADCVCCVal cal_ChillTempVolAmend_CUR cal_TChillOutRaw_CUR /end REF_CHARACTERISTIC
 /begin REF_MEASUREMENT SENCtl_uChillTempVol SEN_ChiTRaw /end REF_MEASUREMENT
/end GROUP
/begin GROUP S31_TempEnvironment "ME11/ME11_TMS/Sensor/TempEnvironment" /begin SUB_GROUP S1716_Env S1716_EnvCal /end SUB_GROUP
 /begin REF_CHARACTERISTIC cal_ADCVCCVal cal_EnvFailSwFlg cal_EnvVolAmend_CUR cal_TEnvRaw_CUR /end REF_CHARACTERISTIC
 /begin REF_MEASUREMENT SENCtl_uEnvVoltage SEN_TEnvRaw /end REF_MEASUREMENT
/end GROUP
/begin GROUP S31_TempEvap "ME11/ME11_TMS/Sensor/TempEvap" /begin SUB_GROUP S1717_EVAP S1717_EvapTemp /end SUB_GROUP /begin REF_CHARACTERISTIC cal_ADCVCCVal cal_EVAPTempVolAmend_CUR cal_TEvapOutRaw_CUR /end REF_CHARACTERISTIC /begin REF_MEASUREMENT SENCtl_uEVAPXTempVol SEN_EvapTRaw /end REF_MEASUREMENT /end GROUP
/begin GROUP S31_TempEvapSurface "ME11/ME11_TMS/Sensor/TempEvapSurface" /begin SUB_GROUP S1718_EvapSurface S1718_Override_HvPartModed /end SUB_GROUP
 /begin REF_CHARACTERISTIC cal_ADCVCCVal cal_EVAPSurfTempVolAmend_CUR cal_TEvapSurfRaw_CUR /end REF_CHARACTERISTIC
 /begin REF_MEASUREMENT SENCtl_uEVAPSurfTempVol SEN_TEvapSurRaw /end REF_MEASUREMENT
/end GROUP
/begin GROUP S31_TempMotor "ME11/ME11_TMS/Sensor/TempMotor" /begin SUB_GROUP S1719_MotTemp S1719_motor /end SUB_GROUP
 /begin REF_CHARACTERISTIC cal_ADCVCCVal cal_MotInletTempVolAmend_CUR cal_TMotEntRaw_CUR /end REF_CHARACTERISTIC
 /begin REF_MEASUREMENT SENCtl_uMotInletTempVol SEN_TMotRaw /end REF_MEASUREMENT
/end GROUP
/begin GROUP S31_TempOHX "ME11/ME11_TMS/Sensor/TempOHX" /begin SUB_GROUP S1720_Env S1720_OHXTemp /end SUB_GROUP /begin REF_CHARACTERISTIC cal_ADCVCCVal cal_OHXTempVolAmend_CUR cal_TOHXOutRaw_CUR /end REF_CHARACTERISTIC /begin REF_MEASUREMENT SENCtl_uOHXTempVol SEN_OHXTRaw /end REF_MEASUREMENT /end GROUP
/begin GROUP S31_WCCHiTemp "ME11/ME11_TMS/Sensor/WCCHiTemp" /begin SUB_GROUP S1721_Env S1721_WCCTemp /end SUB_GROUP
 /begin REF_CHARACTERISTIC cal_ADCVCCVal cal_TLCCOutRaw_CUR cal_WCCHighTempVolAmend_CUR /end REF_CHARACTERISTIC
 /begin REF_MEASUREMENT SENCtl_uWCCHighTempVol SEN_WCCTHiRaw /end REF_MEASUREMENT
/end GROUP
/begin GROUP S31_pressWCCHi "ME11/ME11_TMS/Sensor/pressWCCHi" /begin SUB_GROUP S1722_Override_HvPartModed S1722_SenDiagnostic /end SUB_GROUP
 /begin REF_CHARACTERISTIC cal_HPHighLmtVal cal_LCCOutHiPressRaw_CUR cal_WCCHPVolAmend_CUR /end REF_CHARACTERISTIC
 /begin REF_MEASUREMENT ACSen_eWCCHPSenSts SENCtl_uWCCHPVol SEN_WCCHiPressRaw /end REF_MEASUREMENT
/end GROUP
/begin GROUP S31_tempACCMHi "ME11/ME11_TMS/Sensor/tempACCMHi" /begin SUB_GROUP S1723_ACCMHi S1723_ACCMHiTemp /end SUB_GROUP
 /begin REF_CHARACTERISTIC cal_ACCMHighTempVolAmend_CUR cal_ADCVCCVal cal_TACCMOutRaw_CUR /end REF_CHARACTERISTIC
 /begin REF_MEASUREMENT SENCtl_uACCMHighTempVol SEN_ACCMTHiRaw /end REF_MEASUREMENT
/end GROUP
/begin GROUP S32_AutoACFun "ME11/ME11_TMS/ACC/AutoAc/AutoACFun"
 /begin SUB_GROUP S35_BlowerFanSpeed S35_BlowerMode S35_Compressor_ACWorkModeCheck S35_PTC_ACWorkModeCheck S35_RecircModeEnaCalcu S35_RecircModeOut /end SUB_GROUP
 /begin REF_MEASUREMENT ACCtl_pwrHeatingReq ACCtl_stRecLevelFinal /end REF_MEASUREMENT
/end GROUP
/begin GROUP S32_CheckAirConditionStartState "ME11/ME11_TMS/ACC/AutoAc/CheckAirConditionStartState"
 /begin REF_CHARACTERISTIC cal_CAPStartCoolantMin cal_HAPevap_min cal_HAPparkdly_time cal_HAPpurge_time cal_HAPtimelim2activtic cal_tiColdStartTimeMax /end REF_CHARACTERISTIC
 /begin REF_MEASUREMENT ACCtl_stStartState /end REF_MEASUREMENT
/end GROUP
/begin GROUP S32_EvaporatorAndPTCAimTempCal_FIX "ME11/ME11_TMS/ACC/AutoAc/EvaporatorAndPTCAimTempCal_FIX"
 /begin SUB_GROUP S37_DesiredVentTempCal_FIX S37_DuctActualTemperature S37_InventedCabin S37_StartDvt S37_TargetEvaporatorTempGov S37_TargetPTCTempGov /end SUB_GROUP
/end GROUP
/begin GROUP S32_MixDoorOpenCloseDesCal "ME11/ME11_TMS/ACC/AutoAc/MixDoorOpenCloseDesCal"
 /begin SUB_GROUP S38_CalDrMixDoorDesRatio S38_CalPsMixDoorDesRatio S38_CoTS_rSetMixDoor /end SUB_GROUP
 /begin REF_CHARACTERISTIC ACOff /end REF_CHARACTERISTIC
/end GROUP
/begin GROUP S437_ACCMEnble "ME11/ME11_TMS/Actuator/COMP/ACCMEnble" /begin SUB_GROUP S444_ModeOnOrOff S444_Override S444_SpeedNotAllowCls /end SUB_GROUP /end GROUP
/begin GROUP S437_ACCMPICtrl "ME11/ME11_TMS/Actuator/COMP/ACCMPICtrl"
 /begin SUB_GROUP S445_IWin_Controller S445_PI_Controller S445_pWin_Controller /end SUB_GROUP
 /begin REF_CHARACTERISTIC cal_ACCMCtlKiDeadzoneNeg cal_ACCMCtlKiDeadzonePos cal_ACCMCtlKpDeadzoneNeg cal_ACCMCtlKpDeadzonePos cal_ACCMCtlPID_IsumMax cal_ACCMCtlPID_IsumMin cal_ACCMCtrlKi cal_ACCMCtrlKp /end REF_CHARACTERISTIC
/end GROUP
/begin GROUP S437_COMPFaultHandling "ME11/ME11_TMS/Actuator/COMP/COMPFaultHandling"
 /begin SUB_GROUP S446_ACCMFault S446_EnvLmt S446_OCOLmt S446_PressRateProtect /end SUB_GROUP
 /begin REF_MEASUREMENT ACTCtl_bCOMPForbidFlg /end REF_MEASUREMENT
/end GROUP
/begin GROUP S437_COMPLimitSpeed "ME11/ME11_TMS/Actuator/COMP/COMPLimitSpeed" /begin SUB_GROUP S447_COMP_AT_Noise_Lmt S447_COMP_Cool_Speed_Lmt /end SUB_GROUP /begin REF_MEASUREMENT ACTCtl_sCOMPLmtMaxSpd /end REF_MEASUREMENT /end GROUP
/begin GROUP S437_COMPSpeedLmt "ME11/ME11_TMS/Actuator/COMP/COMPSpeedLmt" /begin SUB_GROUP S448_OpenOrCloseFilter S448_Override S448_Spd /end SUB_GROUP /begin REF_CHARACTERISTIC cal_COMPClsLowSpeed cal_COMPONMinSpd cal_COMPOffMaxSpd /end REF_CHARACTERISTIC /begin REF_MEASUREMENT ACTCtl_bCOMPSpdDiffFlt ACTCtl_sACCMCtlSpd /end REF_MEASUREMENT /end GROUP
/begin GROUP S437_NegAndPosCheck_COMP "ME11/ME11_TMS/Actuator/COMP/NegAndPosCheck_COMP" /begin REF_MEASUREMENT ACTCtl_bCOMPDvtFlg ACTCtl_sDvtCOMPCtrl /end REF_MEASUREMENT /end GROUP
/begin GROUP S437_ParameterCal "ME11/ME11_TMS/Actuator/COMP/ParameterCal"
 /begin SUB_GROUP S451_ACCMCtrlA S451_ACCMCtrlB S451_ACCMCtrlC S451_ACCMCtrlD S451_ACCMCtrlE S451_ACCMCtrlF S451_ACCMCtrlH /end SUB_GROUP
/end GROUP
/begin GROUP S437_PressProtect "ME11/ME11_TMS/Actuator/COMP/PressProtect"
 /begin REF_CHARACTERISTIC cal_HeatPumpCOMPHPrsDownSpd cal_HeatPumpCOMPHPrsP1 cal_HeatPumpCOMPHPrsP2 cal_HeatPumpCOMPHPrsP3 cal_HeatPumpCOMPHPrsP4 cal_HeatPumpCOMPHPrsP5 cal_HeatPumpCOMPHPrsP6 cal_HeatPumpCOMPHPrsP7 cal_HeatPumpCOMPHPrsP8 cal_HeatPumpCOMPLPrsDownSpd cal_HeatPumpCOMPLPrsP1 cal_HeatPumpCOMPLPrsP2 cal_HeatPumpCOMPLPrsP3 cal_HeatPumpCOMPLPrsP4 cal_HeatPumpCOMPLPrsP5 cal_HeatPumpCOMPLPrsP6 cal_HeatPumpCOMPLPrsP7 cal_HeatPumpCOMPLPrsP8 cal_NmlCOMPHPrsDownSpd cal_NmlCOMPHPrsP1 cal_NmlCOMPHPrsP2 cal_NmlCOMPHPrsP3 cal_NmlCOMPHPrsP4 cal_NmlCOMPHPrsP5 cal_NmlCOMPHPrsP6 cal_NmlCOMPHPrsP7 cal_NmlCOMPHPrsP8 cal_NmlCOMPLPrsDownSpd cal_NmlCOMPLPrsP1 cal_NmlCOMPLPrsP2 cal_NmlCOMPLPrsP3 cal_NmlCOMPLPrsP4 cal_NmlCOMPLPrsP5 cal_NmlCOMPLPrsP6 cal_NmlCOMPLPrsP7 cal_NmlCOMPLPrsP8 cal_StartPrsProTimes /end REF_CHARACTERISTIC
 /begin REF_MEASUREMENT ACTCtl_bCOMPHPFrbFlg ACTCtl_bCOMPHPLmtFlg ACTCtl_bCOMPLPFrbFlg ACTCtl_bCOMPLPLmtFlg ACTCtl_eCOMPPrsPrtSts /end REF_MEASUREMENT
/end GROUP
/begin GROUP S437_RunSts "ME11/ME11_TMS/Actuator/COMP/RunSts" /begin REF_MEASUREMENT ACTCtl_bCOMPPIEnble ACTCtl_sACCMCtlFF /end REF_MEASUREMENT /end GROUP
/begin GROUP S437_TempProtect "ME11/ME11_TMS/Actuator/COMP/TempProtect"
 /begin REF_CHARACTERISTIC cal_COMPEvapTFrbVal cal_COMPEvapTNmlVal cal_COMPExhTFrbVal cal_COMPExhTLmtRlybVal cal_COMPExhTLmtVal cal_COMPExhTNmlVal /end REF_CHARACTERISTIC
 /begin REF_MEASUREMENT ACTCtl_bCOMPEnvpTPrtFlg ACTCtl_eCOMPExhTPrtSts /end REF_MEASUREMENT
/end GROUP
/begin GROUP S438_C3WV__MCV "ME11/ME11_TMS/Actuator/CWV/C3WV//MCV" /begin SUB_GROUP S635_MUL S635_selflearning /end SUB_GROUP /end GROUP
/begin GROUP S438_C5WV__BCV "ME11/ME11_TMS/Actuator/CWV/C5WV//BCV" /begin SUB_GROUP S636_Position S636_selflearning /end SUB_GROUP /end GROUP
/begin GROUP S438_Override_C3WV "ME11/ME11_TMS/Actuator/CWV/Override_C3WV" /begin REF_CHARACTERISTIC cal_eC3WVValueData cal_eC3WVValueEnb /end REF_CHARACTERISTIC /begin REF_MEASUREMENT ACTCtl_eC3WVValue /end REF_MEASUREMENT /end GROUP
/begin GROUP S438_Override_C5WV "ME11/ME11_TMS/Actuator/CWV/Override_C5WV" /begin REF_CHARACTERISTIC cal_eC5WVValueData cal_eC5WVValueEnb /end REF_CHARACTERISTIC /begin REF_MEASUREMENT ACTCtl_eC5WVValue /end REF_MEASUREMENT /end GROUP
/begin GROUP S439_AEXV "ME11/ME11_TMS/Actuator/EXV/AEXV"
 /begin SUB_GROUP S671_AEXVEnble S671_AEXVFault S671_AEXVInit S671_AEXVPICtrl S671_AEXVPIParameter S671_NegAndPosCheck_EXV S671_pressureprotection /end SUB_GROUP
 /begin REF_MEASUREMENT ACTCtl_bAEXVPIEnble ACTCtl_sAEXVActure ACTCtl_sAEXVCtrlKi ACTCtl_sAEXVCtrlKp ACTCtl_sAEXVSetPoint /end REF_MEASUREMENT
/end GROUP
/begin GROUP S439_BEXV "ME11/ME11_TMS/Actuator/EXV/BEXV"
 /begin SUB_GROUP S672_BEXVFault S672_BEXVInit S672_BEXVPICtrl S672_BEXVPIParameter S672_EXVEnble S672_NegAndPosCheck_EXV S672_pressure_protection /end SUB_GROUP
 /begin REF_MEASUREMENT ACTCtl_bBEXVPIEnble ACTCtl_sBEXVActure ACTCtl_sBEXVCtrlKi ACTCtl_sBEXVCtrlKp ACTCtl_sBEXVSetPoint /end REF_MEASUREMENT
/end GROUP
/begin GROUP S439_HPEXV "ME11/ME11_TMS/Actuator/EXV/HPEXV"
 /begin SUB_GROUP S673_Arbitration S673_FFCal S673_HPEXVFault S673_HPEXVPICtrl S673_HPEXVParameterCal S673_Init S673_NegAndPosCheck_EXV /end SUB_GROUP
 /begin REF_MEASUREMENT ACTCtl_bHPEXVPIEnble ACTCtl_sHPEXVActure ACTCtl_sHPEXVCtrlKi ACTCtl_sHPEXVCtrlKp /end REF_MEASUREMENT
/end GROUP
/begin GROUP S439_SupercoolingOrSuperheat "ME11/ME11_TMS/Actuator/EXV/SupercoolingOrSuperheat"
 /begin SUB_GROUP S674_AvgCondDep S674_AvgCondDep_Cool S674_EvapSuperHeat S674_EvapSuperHeat1 S674_ExhSuperHeat S674_SuperHeat /end SUB_GROUP
 /begin REF_CHARACTERISTIC cal_AvgSwitch cal_CondDep_CUR cal_SuperHeat_CUR /end REF_CHARACTERISTIC
 /begin REF_MEASUREMENT ACTCtl_sChiSuperHeat ACTCtl_sCondDep ACTCtl_sCoolCondDep ACTCtl_sEvapSuperHeat ACTCtl_sExhSuperHeat ACTCtl_sSuperHeat /end REF_MEASUREMENT
/end GROUP
/begin GROUP S440_BatBalOrLTR "ME11/ME11_TMS/Actuator/Fan/BatBalOrLTR" /begin SUB_GROUP S911_IPUTempJudge S911_MotorTempJudge /end SUB_GROUP /end GROUP
/begin GROUP S440_CoolFanCtrl "ME11/ME11_TMS/Actuator/Fan/CoolFanCtrl" /begin REF_CHARACTERISTIC cal_CoolFanCtrl_MAP /end REF_CHARACTERISTIC /begin REF_MEASUREMENT ACTCtl_eCoolFanCtrl /end REF_MEASUREMENT /end GROUP
/begin GROUP S440_HTFanCtrl "ME11/ME11_TMS/Actuator/Fan/HTFanCtrl"
 /begin REF_CHARACTERISTIC cal_ACCMHiTempFanCtrl cal_ACCMHiTempFanOff cal_ACCMHiTempFanOn /end REF_CHARACTERISTIC
/end GROUP
/begin GROUP S440_HeatPumpFanCtrl "ME11/ME11_TMS/Actuator/Fan/HeatPumpFanCtrl" /begin REF_CHARACTERISTIC cal_HeatFanCtrl_MAP /end REF_CHARACTERISTIC /begin REF_MEASUREMENT ACTCtl_eHeatFanCtrl /end REF_MEASUREMENT /end GROUP
/begin GROUP S440_LowPressFanCtrl "ME11/ME11_TMS/Actuator/Fan/LowPressFanCtrl"
 /begin REF_CHARACTERISTIC cal_LPFanCtrl cal_LPFanOff cal_LPFanOn cal_LPProOffTimer cal_LPProOnTimer /end REF_CHARACTERISTIC
/end GROUP
/begin GROUP S440_MotHeatBatFanCtrl "ME11/ME11_TMS/Actuator/Fan/MotHeatBatFanCtrl" /begin REF_CHARACTERISTIC cal_FanCtrlOff /end REF_CHARACTERISTIC /end GROUP
/begin GROUP S440_Override_CoolFan "ME11/ME11_TMS/Actuator/Fan/Override_CoolFan" /begin REF_CHARACTERISTIC cal_CoolFanData cal_CoolFanEnb /end REF_CHARACTERISTIC /begin REF_MEASUREMENT ACTCtl_eFanPerc /end REF_MEASUREMENT /end GROUP
/begin GROUP S441_Override "ME11/ME11_TMS/Actuator/PTC/Override" /begin REF_CHARACTERISTIC cal_PTCReqTempData cal_PTCReqTempDataEnb /end REF_CHARACTERISTIC /begin REF_MEASUREMENT ACTCtl_sPTCRequestTemp /end REF_MEASUREMENT /end GROUP
/begin GROUP S441_PTCEnable "ME11/ME11_TMS/Actuator/PTC/PTCEnable" /begin SUB_GROUP S942_Override1 /end SUB_GROUP /end GROUP
/begin GROUP S441_PTCRequestPwr "ME11/ME11_TMS/Actuator/PTC/PTCRequestPwr" /begin SUB_GROUP S944_Override2 /end SUB_GROUP
 /begin REF_CHARACTERISTIC cal_ACCMForbidCtrl cal_BatHeatTrgTemp cal_PTCBatHeatPwrLmt_CUR cal_PTCDelOffTime cal_PTCPwrOffFlt cal_SOCHighPTCPwrLmtOff cal_SOCHighPTCPwrLmtOn cal_SOCHighPTCPwrLmt_CUR /end REF_CHARACTERISTIC
 /begin REF_MEASUREMENT ACTCtl_sPTCBatHeatPwrLmt ACTCtl_sSOCHighPTCPwrLmt /end REF_MEASUREMENT
/end GROUP
/begin GROUP S442_AcPMP "ME11/ME11_TMS/Actuator/PUMP/AcPMP" /begin SUB_GROUP S1019_Override_AcPmp S1019_Override_AcPmpFault /end SUB_GROUP
 /begin REF_CHARACTERISTIC cal_ACPMPSpdDiffVal cal_ACPumpBatHeatSpd cal_ACPumpCtrlASpd cal_ACPumpDefSpd cal_ACPumpDehSpd cal_ACPumpDoubleHeatSpd cal_PTCOffAcPMPSpd cal_PTCRunAcPMPFFSpd cal_PTCRunAcPMPFFTime /end REF_CHARACTERISTIC
 /begin REF_MEASUREMENT ACTCtl_bAcPMPSpdFlt ACTCtl_eACPumpRefSpd ACTCtl_eAcPMPSpdSet /end REF_MEASUREMENT
/end GROUP
/begin GROUP S442_BatPMP "ME11/ME11_TMS/Actuator/PUMP/BatPMP" /begin SUB_GROUP S1020_Override_BatPmp S1020_Override_BatPmp1 /end SUB_GROUP
 /begin REF_CHARACTERISTIC cal_BATPMPSpdDiffVal cal_BatCoolStopBatPMPRunTime cal_BatCoolStopBatPMPSpd cal_BatPumpBal_CUR cal_BatPumpCtrlASpd cal_BatPumpMotHeatBatSpd cal_BatPumpMotLTRAndBatCHSpd cal_BatPumpThSto_CUR /end REF_CHARACTERISTIC
 /begin REF_MEASUREMENT ACTCtl_bBatPMPSpdFlt ACTCtl_eBatPMPSpdSet /end REF_MEASUREMENT
/end GROUP
/begin GROUP S442_MotPMP "ME11/ME11_TMS/Actuator/PUMP/MotPMP"
 /begin SUB_GROUP S1021_IGBTTempJudge S1021_MotorTempJudge S1021_Override_BatPmp1 S1021_Override_MotPmp S1021_PCUTempJudge /end SUB_GROUP
 /begin REF_CHARACTERISTIC cal_MotPMPDefaultSpd cal_MotPMPMotHeatBatSpd cal_MotPMPSpdDiffVal cal_MotPMPThStoSpd /end REF_CHARACTERISTIC
 /begin REF_MEASUREMENT ACTCtl_bMotPMPSpdFlt ACTCtl_eMotPMPSpdSet /end REF_MEASUREMENT
/end GROUP
/begin GROUP S1069_Override_eBlwSts "ME11/ME11_TMS/HMI/Blower/Override_eBlwSts" /begin REF_CHARACTERISTIC cal_eBlwStsData cal_eBlwStsEnb /end REF_CHARACTERISTIC /begin REF_MEASUREMENT HMICtl_eBlwSts /end REF_MEASUREMENT /end GROUP
/begin GROUP S1078_Override_eInner "ME11/ME11_TMS/HMI/Inner/Override_eInner" /begin REF_CHARACTERISTIC cal_eInnerData cal_eInnerEnb /end REF_CHARACTERISTIC /begin REF_MEASUREMENT HMICtl_eInner /end REF_MEASUREMENT /end GROUP
/begin GROUP S1079_Override_sMixDoor "ME11/ME11_TMS/HMI/MixDoor/Override_sMixDoor" /begin REF_CHARACTERISTIC cal_sMixDoorData cal_sMixDoorEnb /end REF_CHARACTERISTIC /begin REF_MEASUREMENT HMICtl_sMixDoor /end REF_MEASUREMENT /end GROUP
/begin GROUP S1080_Override_eModeMotor "ME11/ME11_TMS/HMI/ModeMotor/Override_eModeMotor" /begin REF_CHARACTERISTIC cal_eModeMotorData cal_eModeMotorEnb /end REF_CHARACTERISTIC /begin REF_MEASUREMENT HMICtl_eModeMotor /end REF_MEASUREMENT /end GROUP
/begin GROUP S1082_Override_bLeftSetHigh "ME11/ME11_TMS/HMI/SetTemp/Override_bLeftSetHigh" /begin REF_CHARACTERISTIC cal_bLeftSetHighData cal_bLeftSetHighEnb /end REF_CHARACTERISTIC /begin REF_MEASUREMENT HMICtl_bLeftSetHigh /end REF_MEASUREMENT /end GROUP
/begin GROUP S1082_Override_bLeftSetLow "ME11/ME11_TMS/HMI/SetTemp/Override_bLeftSetLow" /begin REF_CHARACTERISTIC cal_bLeftSetLowData cal_bLeftSetLowEnb /end REF_CHARACTERISTIC /begin REF_MEASUREMENT HMICtl_bLeftSetLow /end REF_MEASUREMENT /end GROUP
/begin GROUP S1082_Override_sLeftSetPoint "ME11/ME11_TMS/HMI/SetTemp/Override_sLeftSetPoint" /begin REF_CHARACTERISTIC cal_tLeftSetPointData cal_tLeftSetPointEnb /end REF_CHARACTERISTIC /begin REF_MEASUREMENT HMICtl_sLeftSetPoint /end REF_MEASUREMENT /end GROUP
/begin GROUP S1083_ACAuto "ME11/ME11_TMS/HMI/Status/ACAuto" /begin SUB_GROUP S1129_Override_bACAuto /end SUB_GROUP /end GROUP
/begin GROUP S1083_ACDefrost "ME11/ME11_TMS/HMI/Status/ACDefrost" /begin SUB_GROUP S1130_Override_bACDefrost /end SUB_GROUP /end GROUP
/begin GROUP S1083_ACOnOff "ME11/ME11_TMS/HMI/Status/ACOnOff" /begin SUB_GROUP S1131_Override_bACOnOff /end SUB_GROUP /end GROUP
/begin GROUP S1083_ACSts "ME11/ME11_TMS/HMI/Status/ACSts" /begin SUB_GROUP S1132_Override_eACSts /end SUB_GROUP /end GROUP
/begin GROUP S1187_Override_PwrACPump "ME11/ME11_TMS/IODriver/ACPMPAndEXV/Override_PwrACPump" /begin REF_CHARACTERISTIC cal_PwrACPumpData cal_PwrACPumpEnb /end REF_CHARACTERISTIC /end GROUP
/begin GROUP S1188_Override_BlwFan "ME11/ME11_TMS/IODriver/Blower/Override_BlwFan" /begin REF_CHARACTERISTIC cal_BlwFanData cal_BlwFanEnb /end REF_CHARACTERISTIC /begin REF_MEASUREMENT IOCtl_BloweFanSpeed /end REF_MEASUREMENT /end GROUP
/begin GROUP S1188_Override_PwrBlw "ME11/ME11_TMS/IODriver/Blower/Override_PwrBlw" /begin REF_CHARACTERISTIC cal_PwrBlwData cal_PwrBlwEnb /end REF_CHARACTERISTIC /end GROUP
/begin GROUP S1194_Override_PwrSensor1 "ME11/ME11_TMS/IODriver/FanAndPMP/Override_PwrSensor1" /begin REF_CHARACTERISTIC cal_PwrFanAndPumpData cal_PwrFanAndPumpDataEnb /end REF_CHARACTERISTIC /end GROUP
/begin GROUP S1195_Override_PwrHVPart "ME11/ME11_TMS/IODriver/HVPower/Override_PwrHVPart" /begin REF_CHARACTERISTIC cal_PwrHVPartData cal_PwrHVPartEnb /end REF_CHARACTERISTIC /end GROUP
/begin GROUP S1196_Override_RecircMotorN "ME11/ME11_TMS/IODriver/InnerDoor/Override_RecircMotorN" /begin REF_CHARACTERISTIC cal_RecircMotorEnb cal_RecircMotorNData /end REF_CHARACTERISTIC /end GROUP
/begin GROUP S1196_Override_RecircMotorP "ME11/ME11_TMS/IODriver/InnerDoor/Override_RecircMotorP" /begin REF_CHARACTERISTIC cal_RecircMotorEnb cal_RecircMotorPData /end REF_CHARACTERISTIC /end GROUP
/begin GROUP S1196_RecircTrgPos "ME11/ME11_TMS/IODriver/InnerDoor/RecircTrgPos" /begin REF_CHARACTERISTIC cal_RecircTrgPosData cal_RecircTrgPosDataEnb /end REF_CHARACTERISTIC /begin REF_MEASUREMENT IOCtl_RecircTrgPos /end REF_MEASUREMENT /end GROUP
/begin GROUP S1197_Override_MixDoorN "ME11/ME11_TMS/IODriver/MixDoor/Override_MixDoorN" /begin REF_CHARACTERISTIC cal_MixDoorEnb cal_MixDoorNData /end REF_CHARACTERISTIC /end GROUP
/begin GROUP S1197_Override_MixDoorP "ME11/ME11_TMS/IODriver/MixDoor/Override_MixDoorP" /begin REF_CHARACTERISTIC cal_MixDoorEnb cal_MixDoorPData /end REF_CHARACTERISTIC /end GROUP
/begin GROUP S1197_SetLeftMixDoor "ME11/ME11_TMS/IODriver/MixDoor/SetLeftMixDoor" /begin REF_CHARACTERISTIC cal_SetLeftMixDoorTrgData cal_SetLeftMixDoorTrgDataEnb /end REF_CHARACTERISTIC /begin REF_MEASUREMENT IOCtl_sMixDoorTrgPos /end REF_MEASUREMENT /end GROUP
/begin GROUP S1198_ModeMotorTrgPos "ME11/ME11_TMS/IODriver/ModeMotor/ModeMotorTrgPos" /begin REF_CHARACTERISTIC cal_ModeMotorTrgPosData cal_ModeMotorTrgPosDataEnb /end REF_CHARACTERISTIC /begin REF_MEASUREMENT IOCtl_sModeMotorTrgPos /end REF_MEASUREMENT /end GROUP
/begin GROUP S1198_Override_ModeMotorN "ME11/ME11_TMS/IODriver/ModeMotor/Override_ModeMotorN" /begin REF_CHARACTERISTIC cal_ModeMotorEnb cal_ModeMotorNData /end REF_CHARACTERISTIC /end GROUP
/begin GROUP S1198_Override_ModeMotorP "ME11/ME11_TMS/IODriver/ModeMotor/Override_ModeMotorP" /begin REF_CHARACTERISTIC cal_ModeMotorEnb cal_ModeMotorPData /end REF_CHARACTERISTIC /end GROUP
/begin GROUP S1201_Override_SOV "ME11/ME11_TMS/IODriver/SOVPwrSts/Override_SOV" /begin REF_CHARACTERISTIC cal_SOVData cal_SOVEnb /end REF_CHARACTERISTIC /end GROUP
/begin GROUP S1254_Override_TMSStatus "ME11/ME11_TMS/Power/DisplaySet/Override_TMSStatus" /begin REF_CHARACTERISTIC cal_TMSStatusData cal_TMSStatusEnb /end REF_CHARACTERISTIC /begin REF_MEASUREMENT PWRCtl_eTMSStatus /end REF_MEASUREMENT /end GROUP
/begin GROUP S1256_Start_Manage "ME11/ME11_TMS/Power/RDCWorkMng/Start_Manage"
 /begin REF_CHARACTERISTIC cal_ColdStartPCUTempMinByEnv_CUR cal_PCUtempOffset2ShutByEnv_CUR /end REF_CHARACTERISTIC
 /begin REF_MEASUREMENT ColdStartPCUTempMinByEnv EE_PCUInletTemp EE_tEnv PCU_StartClntTemp PCUtempOffset2ShutByEnv /end REF_MEASUREMENT
/end GROUP
/begin GROUP S1256_Stop_Manage "ME11/ME11_TMS/Power/RDCWorkMng/Stop_Manage" /begin SUB_GROUP S1264_ACRunOffTimeCal /end SUB_GROUP /begin REF_MEASUREMENT EE_TimeDay EE_TimeHour EE_TimeMin /end REF_MEASUREMENT /end GROUP
/begin GROUP S1275_Balance "ME11/ME11_TMS/SOM/BattaryMode/Balance"
 /begin SUB_GROUP S1282_ACCharge S1282_Exit S1282_Ready S1282_thermal_storage_enter S1282_thermal_storage_exit /end SUB_GROUP
 /begin REF_MEASUREMENT SOMCtl_bBatBalFlg /end REF_MEASUREMENT
/end GROUP
/begin GROUP S1275_Cool "ME11/ME11_TMS/SOM/BattaryMode/Cool"
 /begin SUB_GROUP S1283_B1_B21 S1283_B1_B22 S1283_B2_B1 S1283_Override_BatTrgTemp /end SUB_GROUP
 /begin REF_CHARACTERISTIC cal_ClsCoolInletTemp cal_ClsCoolInletTempTime cal_OpenCoolInletTemp /end REF_CHARACTERISTIC
/end GROUP
/begin GROUP S1275_DLTR "ME11/ME11_TMS/SOM/BattaryMode/DLTR" /begin SUB_GROUP S1284_B1_B33 S1284_B33_B1 /end SUB_GROUP /begin REF_MEASUREMENT SOMCtl_bBatLTRFlg /end REF_MEASUREMENT /end GROUP
/begin GROUP S1275_DisplaySet "ME11/ME11_TMS/SOM/BattaryMode/DisplaySet" /begin SUB_GROUP S1285_Override_BatModed /end SUB_GROUP /end GROUP
/begin GROUP S1275_Heat "ME11/ME11_TMS/SOM/BattaryMode/Heat"
 /begin SUB_GROUP S1286_B1_B41 S1286_B1_B42 S1286_B41_B1 S1286_Override_BatTrgTemp S1286_calTemp /end SUB_GROUP
/end GROUP
/begin GROUP S1275_MotorAndBatLTR "ME11/ME11_TMS/SOM/BattaryMode/MotorAndBatLTR" /begin SUB_GROUP S1288_Enter S1288_Exit /end SUB_GROUP /begin REF_MEASUREMENT SOMCtl_bMotAndBatLTRFlg /end REF_MEASUREMENT /end GROUP
/begin GROUP S1275_MotorHeatBat "ME11/ME11_TMS/SOM/BattaryMode/MotorHeatBat" /begin SUB_GROUP S1289_B1_B30 S1289_B1_B31_AC S1289_B1_B31_PT S1289_B31_B1 /end SUB_GROUP /begin REF_MEASUREMENT SOMCtl_bB1toB31 SOMCtl_bBatHeatB3tB1Flg /end REF_MEASUREMENT /end GROUP
/begin GROUP S1275_MotorHeatBat_OTS "ME11/ME11_TMS/SOM/BattaryMode/MotorHeatBat_OTS" /begin SUB_GROUP S1290_Enter_AC S1290_Enter_PT S1290_Exit /end SUB_GROUP /begin REF_MEASUREMENT SOMCtl_bMotHeatBatFlg SOMCtl_bMotorHeatBatOnFlg /end REF_MEASUREMENT /end GROUP
/begin GROUP S1275_MotorLTRAndBatBalance "ME11/ME11_TMS/SOM/BattaryMode/MotorLTRAndBatBalance" /begin SUB_GROUP S1291_B33_B1 S1291_Balance S1291_LTR /end SUB_GROUP /begin REF_MEASUREMENT SOMCtl_bMotorLTRAndBatBalFlg /end REF_MEASUREMENT /end GROUP
/begin GROUP S1275_Override_BatTrgTemp "ME11/ME11_TMS/SOM/BattaryMode/Override_BatTrgTemp" /begin REF_CHARACTERISTIC cal_BatTrgTempData cal_BatTrgTempEnb /end REF_CHARACTERISTIC /begin REF_MEASUREMENT SOMCtl_sBatTrgTemp /end REF_MEASUREMENT /end GROUP
/begin GROUP S1276_Cal_F2AndF1 "ME11/ME11_TMS/SOM/Cabin/Cal_F2AndF1"
 /begin REF_CHARACTERISTIC cal_CabinModeTransF1Constant cal_CabinModeTransF1Slope cal_CabinModeTransF2Constant cal_CabinModeTransF2Slope /end REF_CHARACTERISTIC
 /begin REF_MEASUREMENT SOMCtl_sF1Value SOMCtl_sF2Value /end REF_MEASUREMENT
/end GROUP
/begin GROUP S1276_MD1ShiftMD2 "ME11/ME11_TMS/SOM/Cabin/MD1ShiftMD2"
 /begin REF_CHARACTERISTIC cal_CabinCondToCoolHPEXVPos1 cal_CabinCondToCoolHPEXVPos2 cal_rCabinCoolToCondMixDoor cal_tCabinCondToCoolDvtDiff cal_tCabinCondToCoolEvapTemp cal_tCabinCoolToCondDvtDiff /end REF_CHARACTERISTIC
 /begin REF_MEASUREMENT SOMCtl_bMD1ToMD2Flg SOMCtl_bMD2ToMD1Flg /end REF_MEASUREMENT
/end GROUP
/begin GROUP S1276_MD1_CLM "ME11/ME11_TMS/SOM/Cabin/MD1_CLM"
 /begin REF_CHARACTERISTIC cal_CabinHys1TempOffset cal_CabinHys2TempOffset cal_tCabinCoolEnvTempHigh cal_tCabinCoolEnvTempLow /end REF_CHARACTERISTIC
 /begin REF_MEASUREMENT SOMCtl_bMD1CLMSts /end REF_MEASUREMENT
/end GROUP
/begin GROUP S1276_MD2_DHMD1 "ME11/ME11_TMS/SOM/Cabin/MD2_DHMD1" /begin SUB_GROUP S1644_Enter S1644_Exit /end SUB_GROUP /begin REF_MEASUREMENT SOMCtl_bMD2DHMD1Flg /end REF_MEASUREMENT /end GROUP
/begin GROUP S1276_MD3ShiftMD2 "ME11/ME11_TMS/SOM/Cabin/MD3ShiftMD2"
 /begin REF_CHARACTERISTIC cal_CabinCondToEvpHPEXVPos cal_CabinEvpToCondCompLmt cal_tCabinCondToEvpEvapTemp cal_tCabinEvpToCondDvtDiff /end REF_CHARACTERISTIC
 /begin REF_MEASUREMENT SOMCtl_bMD2ToMD3Flg SOMCtl_bMD3ToMD2Flg /end REF_MEASUREMENT
/end GROUP
/begin GROUP S1276_MD3_DHMD2 "ME11/ME11_TMS/SOM/Cabin/MD3_DHMD2" /begin SUB_GROUP S1646_Enter S1646_Exit /end SUB_GROUP /begin REF_MEASUREMENT SOMCtl_bMD3DHMD2Flg /end REF_MEASUREMENT /end GROUP
/begin GROUP S1276_MD4ShiftMD3 "ME11/ME11_TMS/SOM/Cabin/MD4ShiftMD3"
 /begin REF_CHARACTERISTIC cal_CabinEvpToHPEnvTemp cal_rCabinEvpToHPInnRatio cal_rCabinHPToEvpInnRatio cal_tCabinHPToEvpEnvTemp /end REF_CHARACTERISTIC
 /begin REF_MEASUREMENT SOMCtl_bMD3ToMD4Flg SOMCtl_bMD4ToMD3Flg /end REF_MEASUREMENT
/end GROUP
/begin GROUP S1276_MD4_HP "ME11/ME11_TMS/SOM/Cabin/MD4_HP" /begin REF_CHARACTERISTIC cal_CabinHys1TempOffset cal_tCabinCoolEnvTempLow /end REF_CHARACTERISTIC /end GROUP
/begin GROUP S1276_ModeDisplay "ME11/ME11_TMS/SOM/Cabin/ModeDisplay" /begin SUB_GROUP S1649_Override_CabinModed /end SUB_GROUP /begin REF_CHARACTERISTIC cal_ACCMForbidCtrl cal_CabinModeKeepStandbyTime /end REF_CHARACTERISTIC /begin REF_MEASUREMENT SOMCtl_eCabinModePre /end REF_MEASUREMENT /end GROUP
/begin GROUP S1277_Override_WaterModed "ME11/ME11_TMS/SOM/DisplaySet/Override_WaterModed" /begin REF_CHARACTERISTIC cal_WaterModeData cal_WaterModeEnb /end REF_CHARACTERISTIC /begin REF_MEASUREMENT SOMCtl_eWaterMode /end REF_MEASUREMENT /end GROUP
/begin GROUP S1278_EnterCondition "ME11/ME11_TMS/SOM/ExternalizingDef/EnterCondition"
 /begin REF_CHARACTERISTIC cal_EntExtDefTime cal_ExtDefEnvMaxTemp cal_ExtDefEnvMinTemp cal_ExtDefOHXOnTemp cal_ExtDefTempDiff /end REF_CHARACTERISTIC
 /begin REF_MEASUREMENT SOMCtl_bEntExtDefFlg /end REF_MEASUREMENT
/end GROUP
/begin GROUP S1278_ExitCondition "ME11/ME11_TMS/SOM/ExternalizingDef/ExitCondition" /begin REF_CHARACTERISTIC cal_ExitExtDefTime cal_ExtDefOHXOffTemp /end REF_CHARACTERISTIC /begin REF_MEASUREMENT SOMCtl_bExitExtDefTempFlg /end REF_MEASUREMENT /end GROUP
/begin GROUP S1278_Override_RefModed "ME11/ME11_TMS/SOM/ExternalizingDef/Override_RefModed" /begin REF_CHARACTERISTIC cal_ExtDefFlgData cal_ExtDefFlgDataEnb /end REF_CHARACTERISTIC /begin REF_MEASUREMENT SOMCtl_bExtDefFlg /end REF_MEASUREMENT /end GROUP
/begin GROUP S1279_Override_HvPartModed "ME11/ME11_TMS/SOM/HVPart/Override_HvPartModed" /begin REF_CHARACTERISTIC cal_HVPartModeData cal_HVPartModeEnb /end REF_CHARACTERISTIC /begin REF_MEASUREMENT SOMCtl_eHVPartMode /end REF_MEASUREMENT /end GROUP
/begin GROUP S1280_Override_RefModed "ME11/ME11_TMS/SOM/REF/Override_RefModed" /begin REF_CHARACTERISTIC cal_RefModeData cal_RefModeEnb /end REF_CHARACTERISTIC /begin REF_MEASUREMENT SOMCtl_eRefModes /end REF_MEASUREMENT /end GROUP
/begin GROUP S1705_Cabin "ME11/ME11_TMS/Sensor/Cabin/Cabin" /begin SUB_GROUP S1724_SenDiagnostic /end SUB_GROUP /begin REF_MEASUREMENT ACSen_eCabinSenSts /end REF_MEASUREMENT /end GROUP
/begin GROUP S1705_Override_HvPartModed "ME11/ME11_TMS/Sensor/Cabin/Override_HvPartModed" /begin REF_CHARACTERISTIC cal_CabinTempData cal_CabinTempEnb /end REF_CHARACTERISTIC /begin REF_MEASUREMENT ACSen_sCabinTempFilter /end REF_MEASUREMENT /end GROUP
/begin GROUP S1707_Override_HvPartModed "ME11/ME11_TMS/Sensor/Env_amendment/Override_HvPartModed" /begin REF_CHARACTERISTIC cal_EnvTempCorData cal_EnvTempCorEnb /end REF_CHARACTERISTIC /begin REF_MEASUREMENT ACSen_sEnvTempCor /end REF_MEASUREMENT /end GROUP
/begin GROUP S1708_Face "ME11/ME11_TMS/Sensor/FaceDuct/Face" /begin SUB_GROUP S1747_SenDiagnostic /end SUB_GROUP /begin REF_MEASUREMENT ACSen_eFaceDuctSenSts /end REF_MEASUREMENT /end GROUP
/begin GROUP S1708_Override_DuctTemp "ME11/ME11_TMS/Sensor/FaceDuct/Override_DuctTemp" /begin REF_CHARACTERISTIC cal_FaceDuctTempData cal_FaceDuctTempEnb /end REF_CHARACTERISTIC /begin REF_MEASUREMENT ACSen_sFaceDuctTempFilter /end REF_MEASUREMENT /end GROUP
/begin GROUP S1709_Foot "ME11/ME11_TMS/Sensor/FootDuct/Foot" /begin SUB_GROUP S1757_SenDiagnostic /end SUB_GROUP /begin REF_MEASUREMENT ACSen_eFootDuctSenSts /end REF_MEASUREMENT /end GROUP
/begin GROUP S1709_Override_DuctTemp "ME11/ME11_TMS/Sensor/FootDuct/Override_DuctTemp" /begin REF_CHARACTERISTIC cal_FootDuctTempData cal_FootDuctTempEnb /end REF_CHARACTERISTIC /begin REF_MEASUREMENT ACSen_sFootDuctTempFilter /end REF_MEASUREMENT /end GROUP
/begin GROUP S1710_Override_HvPartModed "ME11/ME11_TMS/Sensor/LoPress/Override_HvPartModed" /begin REF_CHARACTERISTIC cal_LoPressData cal_LoPressDataEnb /end REF_CHARACTERISTIC /begin REF_MEASUREMENT ACSen_sLoPressFilter /end REF_MEASUREMENT /end GROUP
/begin GROUP S1710_SenDiagnostic "ME11/ME11_TMS/Sensor/LoPress/SenDiagnostic" /begin REF_CHARACTERISTIC cal_SensorVolDownFlg cal_SensorVolUpFlg /end REF_CHARACTERISTIC /end GROUP
/begin GROUP S1711_Override_HvPartModed "ME11/ME11_TMS/Sensor/MixDoor/Override_HvPartModed" /begin REF_CHARACTERISTIC cal_MixDoorPercData cal_MixDoorPercDataEnb /end REF_CHARACTERISTIC /begin REF_MEASUREMENT ACSen_sMixDoorPerc /end REF_MEASUREMENT /end GROUP
/begin GROUP S1711_SenDiagnostic "ME11/ME11_TMS/Sensor/MixDoor/SenDiagnostic" /begin REF_CHARACTERISTIC cal_SensorVolDownFlg cal_SensorVolUpFlg /end REF_CHARACTERISTIC /end GROUP
/begin GROUP S1712_Override_HvPartModed "ME11/ME11_TMS/Sensor/ModeMotor/Override_HvPartModed" /begin REF_CHARACTERISTIC cal_MotorModeData cal_MotorModeEnb /end REF_CHARACTERISTIC /begin REF_MEASUREMENT ACSen_sModeMotorVol /end REF_MEASUREMENT /end GROUP
/begin GROUP S1712_SenDiagnostic "ME11/ME11_TMS/Sensor/ModeMotor/SenDiagnostic" /begin REF_CHARACTERISTIC cal_SensorVolDownFlg cal_SensorVolUpFlg /end REF_CHARACTERISTIC /end GROUP
/begin GROUP S1713_Override_HvPartModed "ME11/ME11_TMS/Sensor/Recirc/Override_HvPartModed" /begin REF_CHARACTERISTIC cal_AirInletPerData cal_AirInletPerEnb /end REF_CHARACTERISTIC /begin REF_MEASUREMENT ACSen_eAirInletPer /end REF_MEASUREMENT /end GROUP
/begin GROUP S1713_SenDiagnostic "ME11/ME11_TMS/Sensor/Recirc/SenDiagnostic" /begin REF_CHARACTERISTIC cal_SensorVolDownFlg cal_SensorVolUpFlg /end REF_CHARACTERISTIC /end GROUP
/begin GROUP S1714_Override_HvPartModed "ME11/ME11_TMS/Sensor/Solar/Override_HvPartModed" /begin REF_CHARACTERISTIC cal_SolarData cal_SolarEnb /end REF_CHARACTERISTIC /begin REF_MEASUREMENT AC_rSolarRight /end REF_MEASUREMENT /end GROUP
/begin GROUP S1714_SenDiagnostic "ME11/ME11_TMS/Sensor/Solar/SenDiagnostic" /begin REF_CHARACTERISTIC cal_SensorVolDownFlg cal_SensorVolUpFlg /end REF_CHARACTERISTIC /end GROUP
/begin GROUP S1715_ChiTemp "ME11/ME11_TMS/Sensor/TempChiller/ChiTemp" /begin REF_CHARACTERISTIC cal_ChiTempData cal_ChiTempDataEnb /end REF_CHARACTERISTIC /begin REF_MEASUREMENT ACSen_sChiTempFilter /end REF_MEASUREMENT /end GROUP
/begin GROUP S1715_Chiller "ME11/ME11_TMS/Sensor/TempChiller/Chiller" /begin SUB_GROUP S1797_SenDiagnostic /end SUB_GROUP /begin REF_MEASUREMENT ACSen_eChillerTSenSts /end REF_MEASUREMENT /end GROUP
/begin GROUP S1716_Env "ME11/ME11_TMS/Sensor/TempEnvironment/Env" /begin SUB_GROUP S1808_SenDiagnostic /end SUB_GROUP /begin REF_MEASUREMENT ACSen_eEnvSenSts /end REF_MEASUREMENT /end GROUP
/begin GROUP S1716_EnvCal "ME11/ME11_TMS/Sensor/TempEnvironment/EnvCal" /begin SUB_GROUP S1809_median /end SUB_GROUP /end GROUP
/begin GROUP S1717_EVAP "ME11/ME11_TMS/Sensor/TempEvap/EVAP" /begin SUB_GROUP S1817_SenDiagnostic /end SUB_GROUP /begin REF_MEASUREMENT ACSen_eEVAPTSenSts /end REF_MEASUREMENT /end GROUP
/begin GROUP S1717_EvapTemp "ME11/ME11_TMS/Sensor/TempEvap/EvapTemp" /begin REF_CHARACTERISTIC cal_EvapTempData cal_EvapTempDataEnb /end REF_CHARACTERISTIC /begin REF_MEASUREMENT ACSen_sEvapTempFilter /end REF_MEASUREMENT /end GROUP
/begin GROUP S1718_EvapSurface "ME11/ME11_TMS/Sensor/TempEvapSurface/EvapSurface" /begin SUB_GROUP S1827_SenDiagnostic /end SUB_GROUP /begin REF_MEASUREMENT ACSen_eEVAPSurfTSenSts /end REF_MEASUREMENT /end GROUP
/begin GROUP S1718_Override_HvPartModed "ME11/ME11_TMS/Sensor/TempEvapSurface/Override_HvPartModed" /begin REF_CHARACTERISTIC cal_EvapSurTempData cal_EvapSurTempDataEnb /end REF_CHARACTERISTIC /begin REF_MEASUREMENT ACSen_sEvapSurTemp /end REF_MEASUREMENT /end GROUP
/begin GROUP S1719_MotTemp "ME11/ME11_TMS/Sensor/TempMotor/MotTemp" /begin REF_CHARACTERISTIC cal_MotTempData cal_MotTempDataEnb /end REF_CHARACTERISTIC /begin REF_MEASUREMENT ACSen_sMotTempFilter /end REF_MEASUREMENT /end GROUP
/begin GROUP S1719_motor "ME11/ME11_TMS/Sensor/TempMotor/motor" /begin SUB_GROUP S1836_SenDiagnostic /end SUB_GROUP /begin REF_MEASUREMENT ACSen_eMOTORTSenSts /end REF_MEASUREMENT /end GROUP
/begin GROUP S1720_Env "ME11/ME11_TMS/Sensor/TempOHX/Env" /begin SUB_GROUP S1843_SenDiagnostic /end SUB_GROUP /begin REF_MEASUREMENT ACSen_eOHXTSenSts /end REF_MEASUREMENT /end GROUP
/begin GROUP S1720_OHXTemp "ME11/ME11_TMS/Sensor/TempOHX/OHXTemp" /begin REF_CHARACTERISTIC cal_OHXTempData cal_OHXTempDataEnb /end REF_CHARACTERISTIC /begin REF_MEASUREMENT ACSen_sOHXTempFilter /end REF_MEASUREMENT /end GROUP
/begin GROUP S1721_Env "ME11/ME11_TMS/Sensor/WCCHiTemp/Env" /begin SUB_GROUP S1852_SenDiagnostic /end SUB_GROUP /begin REF_MEASUREMENT ACSen_eWCCHTSenSts /end REF_MEASUREMENT /end GROUP
/begin GROUP S1721_WCCTemp "ME11/ME11_TMS/Sensor/WCCHiTemp/WCCTemp" /begin REF_CHARACTERISTIC cal_WCCTempData cal_WCCTempDataEnb /end REF_CHARACTERISTIC /begin REF_MEASUREMENT ACSen_sWCCHiTempFilter /end REF_MEASUREMENT /end GROUP
/begin GROUP S1722_Override_HvPartModed "ME11/ME11_TMS/Sensor/pressWCCHi/Override_HvPartModed" /begin REF_CHARACTERISTIC cal_HiPressData cal_HiPressDataEnb /end REF_CHARACTERISTIC /begin REF_MEASUREMENT ACSen_sHiPressFilter /end REF_MEASUREMENT /end GROUP
/begin GROUP S1722_SenDiagnostic "ME11/ME11_TMS/Sensor/pressWCCHi/SenDiagnostic" /begin REF_CHARACTERISTIC cal_SensorVolDownFlg cal_SensorVolUpFlg /end REF_CHARACTERISTIC /end GROUP
/begin GROUP S1723_ACCMHi "ME11/ME11_TMS/Sensor/tempACCMHi/ACCMHi" /begin SUB_GROUP S1868_SenDiagnostic /end SUB_GROUP /begin REF_MEASUREMENT ACSen_eACCMHTSenSts /end REF_MEASUREMENT /end GROUP
/begin GROUP S1723_ACCMHiTemp "ME11/ME11_TMS/Sensor/tempACCMHi/ACCMHiTemp" /begin REF_CHARACTERISTIC cal_ACCMHiTempData cal_ACCMHiTempDataEnb /end REF_CHARACTERISTIC /begin REF_MEASUREMENT ACSen_sACCMHiTempFilter /end REF_MEASUREMENT /end GROUP
/begin GROUP S35_BlowerFanSpeed "ME11/ME11_TMS/ACC/AutoAc/AutoACFun/BlowerFanSpeed"
 /begin SUB_GROUP S39_BlowerFanSpeedCalEnable S39_FanMaxSpeedLimCal S39_FanMinSpeedLimCal /end SUB_GROUP
 /begin REF_CHARACTERISTIC ACOff /end REF_CHARACTERISTIC
 /begin REF_MEASUREMENT ACCtl_BloweFanSpeed AC_FanLeVel AC_FanLevelAct /end REF_MEASUREMENT
/end GROUP
/begin GROUP S35_BlowerMode "ME11/ME11_TMS/ACC/AutoAc/AutoACFun/BlowerMode" /begin SUB_GROUP S40_BlowerControlEnable /end SUB_GROUP /begin REF_CHARACTERISTIC ACOff /end REF_CHARACTERISTIC /begin REF_MEASUREMENT ACCtl_BlowerMode /end REF_MEASUREMENT /end GROUP
/begin GROUP S35_Compressor_ACWorkModeCheck "ME11/ME11_TMS/ACC/AutoAc/AutoACFun/Compressor_ACWorkModeCheck" /begin SUB_GROUP S41_CabinAccmReqEnable /end SUB_GROUP /begin REF_CHARACTERISTIC ACOff /end REF_CHARACTERISTIC /begin REF_MEASUREMENT ACCtl_stCabinCoolingEn /end REF_MEASUREMENT /end GROUP
/begin GROUP S35_PTC_ACWorkModeCheck "ME11/ME11_TMS/ACC/AutoAc/AutoACFun/PTC_ACWorkModeCheck" /begin SUB_GROUP S42_AC_PTCCalEnableState S42_PTC_PID /end SUB_GROUP /end GROUP
/begin GROUP S37_StartDvt "ME11/ME11_TMS/ACC/AutoAc/EvaporatorAndPTCAimTempCal_FIX/StartDvt" /begin REF_CHARACTERISTIC ACOff /end REF_CHARACTERISTIC /end GROUP
/begin GROUP S38_CoTS_rSetMixDoor "ME11/ME11_TMS/ACC/AutoAc/MixDoorOpenCloseDesCal/CoTS_rSetMixDoor" /begin REF_CHARACTERISTIC ACOff /end REF_CHARACTERISTIC /end GROUP
/begin GROUP S444_SpeedNotAllowCls "ME11/ME11_TMS/Actuator/COMP/ACCMEnble/SpeedNotAllowCls" /begin REF_CHARACTERISTIC cal_COMPClsLowSpeed /end REF_CHARACTERISTIC /end GROUP
/begin GROUP S1646_Enter "ME11/ME11_TMS/SOM/Cabin/MD3_DHMD2/Enter" /begin REF_CHARACTERISTIC cal_tCabinCoolEnvTempLow /end REF_CHARACTERISTIC /end GROUP
/begin GROUP S42_AC_PTCCalEnableState "ME11/ME11_TMS/ACC/AutoAc/AutoACFun/PTC_ACWorkModeCheck/AC_PTCCalEnableState" /begin REF_CHARACTERISTIC ACOff /end REF_CHARACTERISTIC /end GROUP
/begin GROUP S43_Mannual "ME11/ME11_TMS/ACC/AutoAc/AutoACFun/RecircModeEnaCalcu/Mannual" /begin REF_CHARACTERISTIC ACOff /end REF_CHARACTERISTIC /end GROUP
/begin GROUP S43_RecPTCDvt "ME11/ME11_TMS/ACC/AutoAc/AutoACFun/RecircModeEnaCalcu/RecPTCDvt" /begin REF_CHARACTERISTIC ACOff /end REF_CHARACTERISTIC /end GROUP
/begin GROUP S43_RecTargetOutTemp "ME11/ME11_TMS/ACC/AutoAc/AutoACFun/RecircModeEnaCalcu/RecTargetOutTemp" /begin REF_CHARACTERISTIC ACOff /end REF_CHARACTERISTIC /end GROUP
/begin GROUP S172_PIDEnabLeCheck_ "ME11/ME11_TMS/ACC/AutoAc/EvaporatorAndPTCAimTempCal_FIX/DuctActualTemperature/PIDEnabLeCheck " /begin REF_CHARACTERISTIC ACOff /end REF_CHARACTERISTIC /end GROUP
/begin GROUP S1660_EnterCondition1 "ME11/ME11_TMS/SOM/Cabin/MD2_DHMD1/Enter/EnterCondition1" /begin REF_CHARACTERISTIC cal_tCabinCoolEnvTempLow /end REF_CHARACTERISTIC /end GROUP
/begin GROUP S1660_EnterCondition2 "ME11/ME11_TMS/SOM/Cabin/MD2_DHMD1/Enter/EnterCondition2" /begin REF_CHARACTERISTIC cal_tCabinCoolEnvTempHigh /end REF_CHARACTERISTIC /end GROUP
/begin GROUP S1661_Condition1And2 "ME11/ME11_TMS/SOM/Cabin/MD2_DHMD1/Exit/Condition1And2"
 /begin REF_CHARACTERISTIC cal_CabinHys1TempOffset cal_CabinHys2TempOffset cal_tCabinCoolEnvTempHigh cal_tCabinCoolEnvTempLow /end REF_CHARACTERISTIC
/end GROUP
/begin GROUP S1661_Condition3 "ME11/ME11_TMS/SOM/Cabin/MD2_DHMD1/Exit/Condition3"
 /begin REF_CHARACTERISTIC cal_CabinHys1TempOffset cal_CabinHys2TempOffset cal_tCabinCoolEnvTempLow /end REF_CHARACTERISTIC
/end GROUP
/begin GROUP S1661_Contidion4 "ME11/ME11_TMS/SOM/Cabin/MD2_DHMD1/Exit/Contidion4" /begin REF_CHARACTERISTIC cal_CabinHys1TempOffset cal_tCabinCoolEnvTempLow /end REF_CHARACTERISTIC /end GROUP
/begin GROUP S1676_Condition1 "ME11/ME11_TMS/SOM/Cabin/MD3_DHMD2/Exit/Condition1" /begin REF_CHARACTERISTIC cal_CabinHys1TempOffset cal_tCabinCoolEnvTempLow /end REF_CHARACTERISTIC /end GROUP
/begin GROUP S1676_Condition2 "ME11/ME11_TMS/SOM/Cabin/MD3_DHMD2/Exit/Condition2"
 /begin REF_CHARACTERISTIC cal_CabinHys1TempOffset cal_CabinHys2TempOffset cal_tCabinCoolEnvTempLow /end REF_CHARACTERISTIC
/end GROUP
/begin GROUP S1676_Contidion3 "ME11/ME11_TMS/SOM/Cabin/MD3_DHMD2/Exit/Contidion3" /begin REF_CHARACTERISTIC cal_CabinHys1TempOffset /end REF_CHARACTERISTIC /end GROUP
/* (add any file trailer comments here) */ /* EOF ME11.a2l */
