/******************************************************************************
* ASAP2 file: AppSwcIpm.a2l
* Code generation for model "AppSwcIpm".
* Model version : 9.172
* Simulink Coder version : 9.8 (R2022b) 13-May-2022
* C source code generated on : Tue Jul 16 10:34:34 2024
* Target selection: autosar.tlc
* Embedded hardware selection: NXP->Cortex-M4
* Code generation objectives: Unspecified
* Validation result: Not run
* (add additional file header information here)
******************************************************************************/
/* Version 1.31 */
ASAP2_VERSION 1 31
/begin PROJECT ProjectName "Project Comment Goes Here"
/begin HEADER "Header Comments go here" /end HEADER
/begin MODULE ModuleName "Module Comment Goes Here"
/begin MOD_PAR "MOD PAR Comment Goes Here" /end MOD_PAR
/begin MOD_COMMON "Mod Common Comment Here" BYTE_ORDER MSB_LAST /end MOD_COMMON
/begin RECORD_LAYOUT Scalar_BOOLEAN FNC_VALUES 1 UBYTE COLUMN_DIR DIRECT /end RECORD_LAYOUT
/begin RECORD_LAYOUT Scalar_UBYTE FNC_VALUES 1 UBYTE COLUMN_DIR DIRECT /end RECORD_LAYOUT
/begin RECORD_LAYOUT Scalar_BYTE FNC_VALUES 1 SBYTE COLUMN_DIR DIRECT /end RECORD_LAYOUT
/begin RECORD_LAYOUT Scalar_UWORD FNC_VALUES 1 UWORD COLUMN_DIR DIRECT /end RECORD_LAYOUT
/begin RECORD_LAYOUT Scalar_SWORD FNC_VALUES 1 SWORD COLUMN_DIR DIRECT /end RECORD_LAYOUT
/begin RECORD_LAYOUT Scalar_ULONG FNC_VALUES 1 ULONG COLUMN_DIR DIRECT /end RECORD_LAYOUT
/begin RECORD_LAYOUT Scalar_LONG FNC_VALUES 1 SLONG COLUMN_DIR DIRECT /end RECORD_LAYOUT
/begin RECORD_LAYOUT Scalar_FLOAT32_IEEE FNC_VALUES 1 FLOAT32_IEEE COLUMN_DIR DIRECT /end RECORD_LAYOUT
/begin RECORD_LAYOUT Scalar_FLOAT64_IEEE FNC_VALUES 1 FLOAT64_IEEE COLUMN_DIR DIRECT /end RECORD_LAYOUT
/begin RECORD_LAYOUT Lookup1D_BOOLEAN FNC_VALUES 1 UBYTE COLUMN_DIR DIRECT /end RECORD_LAYOUT
/begin RECORD_LAYOUT Lookup1D_X_BOOLEAN AXIS_PTS_X 1 UBYTE INDEX_INCR DIRECT /end RECORD_LAYOUT
/begin RECORD_LAYOUT Lookup1D_BYTE FNC_VALUES 1 SBYTE COLUMN_DIR DIRECT /end RECORD_LAYOUT
/begin RECORD_LAYOUT Lookup1D_X_BYTE AXIS_PTS_X 1 SBYTE INDEX_INCR DIRECT /end RECORD_LAYOUT
/begin RECORD_LAYOUT Lookup1D_UBYTE FNC_VALUES 1 UBYTE COLUMN_DIR DIRECT /end RECORD_LAYOUT
/begin RECORD_LAYOUT Lookup1D_X_UBYTE AXIS_PTS_X 1 UBYTE INDEX_INCR DIRECT /end RECORD_LAYOUT
/begin RECORD_LAYOUT Lookup1D_UWORD FNC_VALUES 1 UWORD COLUMN_DIR DIRECT /end RECORD_LAYOUT
/begin RECORD_LAYOUT Lookup1D_X_UWORD AXIS_PTS_X 1 UWORD INDEX_INCR DIRECT /end RECORD_LAYOUT
/begin RECORD_LAYOUT Lookup1D_WORD FNC_VALUES 1 SWORD COLUMN_DIR DIRECT /end RECORD_LAYOUT
/begin RECORD_LAYOUT Lookup1D_X_WORD AXIS_PTS_X 1 SWORD INDEX_INCR DIRECT /end RECORD_LAYOUT
/begin RECORD_LAYOUT Lookup1D_ULONG FNC_VALUES 1 ULONG COLUMN_DIR DIRECT /end RECORD_LAYOUT
/begin RECORD_LAYOUT Lookup1D_X_ULONG AXIS_PTS_X 1 ULONG INDEX_INCR DIRECT /end RECORD_LAYOUT
/begin RECORD_LAYOUT Lookup1D_SLONG FNC_VALUES 1 SLONG COLUMN_DIR DIRECT /end RECORD_LAYOUT
/begin RECORD_LAYOUT Lookup1D_X_LONG AXIS_PTS_X 1 SLONG INDEX_INCR DIRECT /end RECORD_LAYOUT
/begin RECORD_LAYOUT Lookup1D_FLOAT32_IEEE FNC_VALUES 1 FLOAT32_IEEE COLUMN_DIR DIRECT /end RECORD_LAYOUT
/begin RECORD_LAYOUT Lookup1D_X_FLOAT32_IEEE AXIS_PTS_X 1 FLOAT32_IEEE INDEX_INCR DIRECT /end RECORD_LAYOUT
/begin RECORD_LAYOUT Lookup1D_FLOAT64_IEEE FNC_VALUES 1 FLOAT64_IEEE COLUMN_DIR DIRECT /end RECORD_LAYOUT
/begin RECORD_LAYOUT Lookup1D_X_FLOAT64_IEEE AXIS_PTS_X 1 FLOAT64_IEEE INDEX_INCR DIRECT /end RECORD_LAYOUT
/begin CHARACTERISTIC KIPM_BMSHVBatCellTempAveDflt_C "" VALUE 0x0000 /* @ECU_Address@KIPM_BMSHVBatCellTempAveDflt_C@ */ Scalar_FLOAT32_IEEE 0 AppSwcIpm_CM_single_C -100000.0 100000.0 /end CHARACTERISTIC
/begin CHARACTERISTIC KIPM_BMSHVBatCellTempAveHi_C "" VALUE 0x0000 /* @ECU_Address@KIPM_BMSHVBatCellTempAveHi_C@ */ Scalar_FLOAT32_IEEE 0 AppSwcIpm_CM_single_C -100000.0 100000.0 /end CHARACTERISTIC
/begin CHARACTERISTIC KIPM_BMSHVBatCellTempAveLo_C "" VALUE 0x0000 /* @ECU_Address@KIPM_BMSHVBatCellTempAveLo_C@ */ Scalar_FLOAT32_IEEE 0 AppSwcIpm_CM_single_C -100000.0 100000.0 /end CHARACTERISTIC
/begin CHARACTERISTIC KIPM_BMSHVBatCellTempAve_C_ovrdval "" VALUE 0x0000 /* @ECU_Address@KIPM_BMSHVBatCellTempAve_C_ovrdval@ */ Scalar_FLOAT32_IEEE 0 AppSwcIpm_CM_single_C -100000.0 100000.0 /end CHARACTERISTIC
/begin CHARACTERISTIC KIPM_BMSHVBatCellTempMaxDflt_C "" VALUE 0x0000 /* @ECU_Address@KIPM_BMSHVBatCellTempMaxDflt_C@ */ Scalar_FLOAT32_IEEE 0 AppSwcIpm_CM_single_C -100000.0 100000.0 /end CHARACTERISTIC
/begin CHARACTERISTIC KIPM_BMSHVBatCellTempMaxHi_C "" VALUE 0x0000 /* @ECU_Address@KIPM_BMSHVBatCellTempMaxHi_C@ */ Scalar_FLOAT32_IEEE 0 AppSwcIpm_CM_single_C -100000.0 100000.0 /end CHARACTERISTIC
/begin CHARACTERISTIC KIPM_BMSHVBatCellTempMaxLo_C "" VALUE 0x0000 /* @ECU_Address@KIPM_BMSHVBatCellTempMaxLo_C@ */ Scalar_FLOAT32_IEEE 0 AppSwcIpm_CM_single_C -100000.0 100000.0 /end CHARACTERISTIC
/begin CHARACTERISTIC KIPM_BMSHVBatCellTempMax_C_ovrdval "" VALUE 0x0000 /* @ECU_Address@KIPM_BMSHVBatCellTempMax_C_ovrdval@ */ Scalar_FLOAT32_IEEE 0 AppSwcIpm_CM_single_C -100000.0 100000.0 /end CHARACTERISTIC
/begin CHARACTERISTIC KIPM_BMSHVBatCellTempMinDflt_C "" VALUE 0x0000 /* @ECU_Address@KIPM_BMSHVBatCellTempMinDflt_C@ */ Scalar_FLOAT32_IEEE 0 AppSwcIpm_CM_single_C -100000.0 100000.0 /end CHARACTERISTIC
/begin CHARACTERISTIC KIPM_BMSHVBatCellTempMinHi_C "" VALUE 0x0000 /* @ECU_Address@KIPM_BMSHVBatCellTempMinHi_C@ */ Scalar_FLOAT32_IEEE 0 AppSwcIpm_CM_single_C -100000.0 100000.0 /end CHARACTERISTIC
/begin CHARACTERISTIC KIPM_BMSHVBatCellTempMinLo_C "" VALUE 0x0000 /* @ECU_Address@KIPM_BMSHVBatCellTempMinLo_C@ */ Scalar_FLOAT32_IEEE 0 AppSwcIpm_CM_single_C -100000.0 100000.0 /end CHARACTERISTIC
/begin CHARACTERISTIC KIPM_BMSHVBatCellTempMin_C_ovrdval "" VALUE 0x0000 /* @ECU_Address@KIPM_BMSHVBatCellTempMin_C_ovrdval@ */ Scalar_FLOAT32_IEEE 0 AppSwcIpm_CM_single_C -100000.0 100000.0 /end CHARACTERISTIC
/begin CHARACTERISTIC KIPM_COMPEcompActSpdDflt_rpm "" VALUE 0x0000 /* @ECU_Address@KIPM_COMPEcompActSpdDflt_rpm@ */ Scalar_FLOAT32_IEEE 0 AppSwcIpm_CM_single_rpm -100000.0 100000.0 /end CHARACTERISTIC
/begin CHARACTERISTIC KIPM_COMPEcompActSpdHi_rpm "" VALUE 0x0000 /* @ECU_Address@KIPM_COMPEcompActSpdHi_rpm@ */ Scalar_FLOAT32_IEEE 0 AppSwcIpm_CM_single_rpm -100000.0 100000.0 /end CHARACTERISTIC
/begin CHARACTERISTIC KIPM_COMPEcompActSpdLo_rpm "" VALUE 0x0000 /* @ECU_Address@KIPM_COMPEcompActSpdLo_rpm@ */ Scalar_FLOAT32_IEEE 0 AppSwcIpm_CM_single_rpm -100000.0 100000.0 /end CHARACTERISTIC
/begin CHARACTERISTIC KIPM_COMPEcompActSpd_rpm_ovrdval "" VALUE 0x0000 /* @ECU_Address@KIPM_COMPEcompActSpd_rpm_ovrdval@ */ Scalar_FLOAT32_IEEE 0 AppSwcIpm_CM_single_rpm -100000.0 100000.0 /end CHARACTERISTIC
/begin CHARACTERISTIC KIPM_COMPHiVoltDflt_V "" VALUE 0x0000 /* @ECU_Address@KIPM_COMPHiVoltDflt_V@ */ Scalar_FLOAT32_IEEE 0 AppSwcIpm_CM_single_V -100000.0 100000.0 /end CHARACTERISTIC
/begin CHARACTERISTIC KIPM_COMPHiVoltHi_V "" VALUE 0x0000 /* @ECU_Address@KIPM_COMPHiVoltHi_V@ */ Scalar_FLOAT32_IEEE 0 AppSwcIpm_CM_single_V -100000.0 100000.0 /end CHARACTERISTIC
/begin CHARACTERISTIC KIPM_COMPHiVoltLo_V "" VALUE 0x0000 /* @ECU_Address@KIPM_COMPHiVoltLo_V@ */ Scalar_FLOAT32_IEEE 0 AppSwcIpm_CM_single_V -100000.0 100000.0 /end CHARACTERISTIC
/begin CHARACTERISTIC KIPM_COMPHiVolt_V_ovrdval "" VALUE 0x0000 /* @ECU_Address@KIPM_COMPHiVolt_V_ovrdval@ */ Scalar_FLOAT32_IEEE 0 AppSwcIpm_CM_single_V -100000.0 100000.0 /end CHARACTERISTIC
/begin CHARACTERISTIC KIPM_COMPInCurrDflt_A "" VALUE 0x0000 /* @ECU_Address@KIPM_COMPInCurrDflt_A@ */ Scalar_FLOAT32_IEEE 0 AppSwcIpm_CM_single_A -100000.0 100000.0 /end CHARACTERISTIC
/begin CHARACTERISTIC KIPM_COMPInCurrHi_A "" VALUE 0x0000 /* @ECU_Address@KIPM_COMPInCurrHi_A@ */ Scalar_FLOAT32_IEEE 0 AppSwcIpm_CM_single_A -100000.0 100000.0 /end CHARACTERISTIC
/begin CHARACTERISTIC KIPM_COMPInCurrLo_A "" VALUE 0x0000 /* @ECU_Address@KIPM_COMPInCurrLo_A@ */ Scalar_FLOAT32_IEEE 0 AppSwcIpm_CM_single_A -100000.0 100000.0 /end CHARACTERISTIC
/begin CHARACTERISTIC KIPM_COMPInCurr_A_ovrdval "" VALUE 0x0000 /* @ECU_Address@KIPM_COMPInCurr_A_ovrdval@ */ Scalar_FLOAT32_IEEE 0 AppSwcIpm_CM_single_A -100000.0 100000.0 /end CHARACTERISTIC
/begin CHARACTERISTIC KIPM_COMPTempDflt_C "" VALUE 0x0000 /* @ECU_Address@KIPM_COMPTempDflt_C@ */ Scalar_FLOAT32_IEEE 0 AppSwcIpm_CM_single_C -100000.0 100000.0 /end CHARACTERISTIC
/begin CHARACTERISTIC KIPM_COMPTempHi_C "" VALUE 0x0000 /* @ECU_Address@KIPM_COMPTempHi_C@ */ Scalar_FLOAT32_IEEE 0 AppSwcIpm_CM_single_C -100000.0 100000.0 /end CHARACTERISTIC
/begin CHARACTERISTIC KIPM_COMPTempLo_C "" VALUE 0x0000 /* @ECU_Address@KIPM_COMPTempLo_C@ */ Scalar_FLOAT32_IEEE 0 AppSwcIpm_CM_single_C -100000.0 100000.0 /end CHARACTERISTIC
/begin CHARACTERISTIC KIPM_COMPTemp_C_ovrdval "" VALUE 0x0000 /* @ECU_Address@KIPM_COMPTemp_C_ovrdval@ */ Scalar_FLOAT32_IEEE 0 AppSwcIpm_CM_single_C -100000.0 100000.0 /end CHARACTERISTIC
/begin CHARACTERISTIC KIPM_EHBBrkPedlValPercDflt_pct "" VALUE 0x0000 /* @ECU_Address@KIPM_EHBBrkPedlValPercDflt_pct@ */ Scalar_FLOAT32_IEEE 0 AppSwcIpm_CM_single_pct -100000.0 100000.0 /end CHARACTERISTIC
/begin CHARACTERISTIC KIPM_EHBBrkPedlValPercHi_pct "" VALUE 0x0000 /* @ECU_Address@KIPM_EHBBrkPedlValPercHi_pct@ */ Scalar_FLOAT32_IEEE 0 AppSwcIpm_CM_single_pct -100000.0 100000.0 /end CHARACTERISTIC
/begin CHARACTERISTIC KIPM_EHBBrkPedlValPercLo_pct "" VALUE 0x0000 /* @ECU_Address@KIPM_EHBBrkPedlValPercLo_pct@ */ Scalar_FLOAT32_IEEE 0 AppSwcIpm_CM_single_pct -100000.0 100000.0 /end CHARACTERISTIC
/begin CHARACTERISTIC KIPM_EHBBrkPedlValPerc_pct_ovrdval "" VALUE 0x0000 /* @ECU_Address@KIPM_EHBBrkPedlValPerc_pct_ovrdval@ */ Scalar_FLOAT32_IEEE 0 AppSwcIpm_CM_single_pct -100000.0 100000.0 /end CHARACTERISTIC
/begin CHARACTERISTIC KIPM_EHBBrkPwrRecupTarWhlTqDflt_Nm "" VALUE 0x0000 /* @ECU_Address@KIPM_EHBBrkPwrRecupTarWhlTqDflt_Nm@ */ Scalar_FLOAT32_IEEE 0 AppSwcIpm_CM_single_Nm -100000.0 100000.0 /end CHARACTERISTIC
/begin CHARACTERISTIC KIPM_EHBBrkPwrRecupTarWhlTqHi_Nm "" VALUE 0x0000 /* @ECU_Address@KIPM_EHBBrkPwrRecupTarWhlTqHi_Nm@ */ Scalar_FLOAT32_IEEE 0 AppSwcIpm_CM_single_Nm -100000.0 100000.0 /end CHARACTERISTIC
/begin CHARACTERISTIC KIPM_EHBBrkPwrRecupTarWhlTqLo_Nm "" VALUE 0x0000 /* @ECU_Address@KIPM_EHBBrkPwrRecupTarWhlTqLo_Nm@ */ Scalar_FLOAT32_IEEE 0 AppSwcIpm_CM_single_Nm -100000.0 100000.0 /end CHARACTERISTIC
/begin CHARACTERISTIC KIPM_EHBBrkPwrRecupTarWhlTq_Nm_ovrdval "" VALUE 0x0000 /* @ECU_Address@KIPM_EHBBrkPwrRecupTarWhlTq_Nm_ovrdval@ */ Scalar_FLOAT32_IEEE 0 AppSwcIpm_CM_single_Nm -100000.0 100000.0 /end CHARACTERISTIC
/begin CHARACTERISTIC KIPM_EPSRotSpdDflt_degps "" VALUE 0x0000 /* @ECU_Address@KIPM_EPSRotSpdDflt_degps@ */ Scalar_FLOAT32_IEEE 0 AppSwcIpm_CM_single_degps -100000.0 100000.0 /end CHARACTERISTIC
/begin CHARACTERISTIC KIPM_EPSRotSpdHi_degps "" VALUE 0x0000 /* @ECU_Address@KIPM_EPSRotSpdHi_degps@ */ Scalar_FLOAT32_IEEE 0 AppSwcIpm_CM_single_degps -100000.0 100000.0 /end CHARACTERISTIC
/begin CHARACTERISTIC KIPM_EPSRotSpdLo_degps "" VALUE 0x0000 /* @ECU_Address@KIPM_EPSRotSpdLo_degps@ */ Scalar_FLOAT32_IEEE 0 AppSwcIpm_CM_single_degps -100000.0 100000.0 /end CHARACTERISTIC
/begin CHARACTERISTIC KIPM_EPSRotSpd_degps_ovrdval "" VALUE 0x0000 /* @ECU_Address@KIPM_EPSRotSpd_degps_ovrdval@ */ Scalar_FLOAT32_IEEE 0 AppSwcIpm_CM_single_degps -100000.0 100000.0 /end CHARACTERISTIC
/begin CHARACTERISTIC KIPM_HVCHCurrDflt_A "" VALUE 0x0000 /* @ECU_Address@KIPM_HVCHCurrDflt_A@ */ Scalar_FLOAT32_IEEE 0 AppSwcIpm_CM_single_A -100000.0 100000.0 /end CHARACTERISTIC
/begin CHARACTERISTIC KIPM_HVCHCurrHi_A "" VALUE 0x0000 /* @ECU_Address@KIPM_HVCHCurrHi_A@ */ Scalar_FLOAT32_IEEE 0 AppSwcIpm_CM_single_A -100000.0 100000.0 /end CHARACTERISTIC
/begin CHARACTERISTIC KIPM_HVCHCurrLo_A "" VALUE 0x0000 /* @ECU_Address@KIPM_HVCHCurrLo_A@ */ Scalar_FLOAT32_IEEE 0 AppSwcIpm_CM_single_A -100000.0 100000.0 /end CHARACTERISTIC
/begin CHARACTERISTIC KIPM_HVCHCurr_A_ovrdval "" VALUE 0x0000 /* @ECU_Address@KIPM_HVCHCurr_A_ovrdval@ */ Scalar_FLOAT32_IEEE 0 AppSwcIpm_CM_single_A -100000.0 100000.0 /end CHARACTERISTIC
/begin CHARACTERISTIC KIPM_HVCHHVVoltsDflt_V "" VALUE 0x0000 /* @ECU_Address@KIPM_HVCHHVVoltsDflt_V@ */ Scalar_FLOAT32_IEEE 0 AppSwcIpm_CM_single_V -100000.0 100000.0 /end CHARACTERISTIC
/begin CHARACTERISTIC KIPM_HVCHHVVoltsHi_V "" VALUE 0x0000 /* @ECU_Address@KIPM_HVCHHVVoltsHi_V@ */ Scalar_FLOAT32_IEEE 0 AppSwcIpm_CM_single_V -100000.0 100000.0 /end CHARACTERISTIC
/begin CHARACTERISTIC KIPM_HVCHHVVoltsLo_V "" VALUE 0x0000 /* @ECU_Address@KIPM_HVCHHVVoltsLo_V@ */ Scalar_FLOAT32_IEEE 0 AppSwcIpm_CM_single_V -100000.0 100000.0 /end CHARACTERISTIC
/begin CHARACTERISTIC KIPM_HVCHHVVolts_V_ovrdval "" VALUE 0x0000 /* @ECU_Address@KIPM_HVCHHVVolts_V_ovrdval@ */ Scalar_FLOAT32_IEEE 0 AppSwcIpm_CM_single_V -100000.0 100000.0 /end CHARACTERISTIC
/begin CHARACTERISTIC KIPM_HVCHInletTempDflt_C "" VALUE 0x0000 /* @ECU_Address@KIPM_HVCHInletTempDflt_C@ */ Scalar_FLOAT32_IEEE 0 AppSwcIpm_CM_single_C -100000.0 100000.0 /end CHARACTERISTIC
/begin CHARACTERISTIC KIPM_HVCHInletTempHi_C "" VALUE 0x0000 /* @ECU_Address@KIPM_HVCHInletTempHi_C@ */ Scalar_FLOAT32_IEEE 0 AppSwcIpm_CM_single_C -100000.0 100000.0 /end CHARACTERISTIC
/begin CHARACTERISTIC KIPM_HVCHInletTempLo_C "" VALUE 0x0000 /* @ECU_Address@KIPM_HVCHInletTempLo_C@ */ Scalar_FLOAT32_IEEE 0 AppSwcIpm_CM_single_C -100000.0 100000.0 /end CHARACTERISTIC
/begin CHARACTERISTIC KIPM_HVCHInletTemp_C_ovrdval "" VALUE 0x0000 /* @ECU_Address@KIPM_HVCHInletTemp_C_ovrdval@ */ Scalar_FLOAT32_IEEE 0 AppSwcIpm_CM_single_C -100000.0 100000.0 /end CHARACTERISTIC
/begin CHARACTERISTIC KIPM_HVCHOutlTempDflt_C "" VALUE 0x0000 /* @ECU_Address@KIPM_HVCHOutlTempDflt_C@ */ Scalar_FLOAT32_IEEE 0 AppSwcIpm_CM_single_C -100000.0 100000.0 /end CHARACTERISTIC
/begin CHARACTERISTIC KIPM_HVCHOutlTempHi_C "" VALUE 0x0000 /* @ECU_Address@KIPM_HVCHOutlTempHi_C@ */ Scalar_FLOAT32_IEEE 0 AppSwcIpm_CM_single_C -100000.0 100000.0 /end CHARACTERISTIC
/begin CHARACTERISTIC KIPM_HVCHOutlTempLo_C "" VALUE 0x0000 /* @ECU_Address@KIPM_HVCHOutlTempLo_C@ */ Scalar_FLOAT32_IEEE 0 AppSwcIpm_CM_single_C -100000.0 100000.0 /end CHARACTERISTIC
/begin CHARACTERISTIC KIPM_HVCHOutlTemp_C_ovrdval "" VALUE 0x0000 /* @ECU_Address@KIPM_HVCHOutlTemp_C_ovrdval@ */ Scalar_FLOAT32_IEEE 0 AppSwcIpm_CM_single_C -100000.0 100000.0 /end CHARACTERISTIC
/begin CHARACTERISTIC KIPM_HVCHPCBTempDflt_C "" VALUE 0x0000 /* @ECU_Address@KIPM_HVCHPCBTempDflt_C@ */ Scalar_FLOAT32_IEEE 0 AppSwcIpm_CM_single_C -100000.0 100000.0 /end CHARACTERISTIC
/begin CHARACTERISTIC KIPM_HVCHPCBTempHi_C "" VALUE 0x0000 /* @ECU_Address@KIPM_HVCHPCBTempHi_C@ */ Scalar_FLOAT32_IEEE 0 AppSwcIpm_CM_single_C -100000.0 100000.0 /end CHARACTERISTIC
/begin CHARACTERISTIC KIPM_HVCHPCBTempLo_C "" VALUE 0x0000 /* @ECU_Address@KIPM_HVCHPCBTempLo_C@ */ Scalar_FLOAT32_IEEE 0 AppSwcIpm_CM_single_C -100000.0 100000.0 /end CHARACTERISTIC
/begin CHARACTERISTIC KIPM_HVCHPCBTemp_C_ovrdval "" VALUE 0x0000 /* @ECU_Address@KIPM_HVCHPCBTemp_C_ovrdval@ */ Scalar_FLOAT32_IEEE 0 AppSwcIpm_CM_single_C -100000.0 100000.0 /end CHARACTERISTIC
/begin CHARACTERISTIC KIPM_HVCHPwrDflt_kW "" VALUE 0x0000 /* @ECU_Address@KIPM_HVCHPwrDflt_kW@ */ Scalar_FLOAT32_IEEE 0 AppSwcIpm_CM_single_kW -100000.0 100000.0 /end CHARACTERISTIC
/begin CHARACTERISTIC KIPM_HVCHPwrHi_kW "" VALUE 0x0000 /* @ECU_Address@KIPM_HVCHPwrHi_kW@ */ Scalar_FLOAT32_IEEE 0 AppSwcIpm_CM_single_kW -100000.0 100000.0 /end CHARACTERISTIC
/begin CHARACTERISTIC KIPM_HVCHPwrLo_kW "" VALUE 0x0000 /* @ECU_Address@KIPM_HVCHPwrLo_kW@ */ Scalar_FLOAT32_IEEE 0 AppSwcIpm_CM_single_kW -100000.0 100000.0 /end CHARACTERISTIC
/begin CHARACTERISTIC KIPM_HVCHPwr_kW_ovrdval "" VALUE 0x0000 /* @ECU_Address@KIPM_HVCHPwr_kW_ovrdval@ */ Scalar_FLOAT32_IEEE 0 AppSwcIpm_CM_single_kW -100000.0 100000.0 /end CHARACTERISTIC
/begin CHARACTERISTIC KIPM_IPUDCCHiVoltActCurntDflt_A "" VALUE 0x0000 /* @ECU_Address@KIPM_IPUDCCHiVoltActCurntDflt_A@ */ Scalar_FLOAT32_IEEE 0 AppSwcIpm_CM_single_A -100000.0 100000.0 /end CHARACTERISTIC
/begin CHARACTERISTIC KIPM_IPUDCCHiVoltActCurntHi_A "" VALUE 0x0000 /* @ECU_Address@KIPM_IPUDCCHiVoltActCurntHi_A@ */ Scalar_FLOAT32_IEEE 0 AppSwcIpm_CM_single_A -100000.0 100000.0 /end CHARACTERISTIC
/begin CHARACTERISTIC KIPM_IPUDCCHiVoltActCurntLo_A "" VALUE 0x0000 /* @ECU_Address@KIPM_IPUDCCHiVoltActCurntLo_A@ */ Scalar_FLOAT32_IEEE 0 AppSwcIpm_CM_single_A -100000.0 100000.0 /end CHARACTERISTIC
/begin CHARACTERISTIC KIPM_IPUDCCHiVoltActCurnt_A_ovrdval "" VALUE 0x0000 /* @ECU_Address@KIPM_IPUDCCHiVoltActCurnt_A_ovrdval@ */ Scalar_FLOAT32_IEEE 0 AppSwcIpm_CM_single_A -100000.0 100000.0 /end CHARACTERISTIC
/begin CHARACTERISTIC KIPM_IPUDCCHiVoltActVoltDflt_V "" VALUE 0x0000 /* @ECU_Address@KIPM_IPUDCCHiVoltActVoltDflt_V@ */ Scalar_FLOAT32_IEEE 0 AppSwcIpm_CM_single_V -100000.0 100000.0 /end CHARACTERISTIC
/begin CHARACTERISTIC KIPM_IPUDCCHiVoltActVoltHi_V "" VALUE 0x0000 /* @ECU_Address@KIPM_IPUDCCHiVoltActVoltHi_V@ */ Scalar_FLOAT32_IEEE 0 AppSwcIpm_CM_single_V -100000.0 100000.0 /end CHARACTERISTIC
/begin CHARACTERISTIC KIPM_IPUDCCHiVoltActVoltLo_V "" VALUE 0x0000 /* @ECU_Address@KIPM_IPUDCCHiVoltActVoltLo_V@ */ Scalar_FLOAT32_IEEE 0 AppSwcIpm_CM_single_V -100000.0 100000.0 /end CHARACTERISTIC
/begin CHARACTERISTIC KIPM_IPUDCCHiVoltActVolt_V_ovrdval "" VALUE 0x0000 /* @ECU_Address@KIPM_IPUDCCHiVoltActVolt_V_ovrdval@ */ Scalar_FLOAT32_IEEE 0 AppSwcIpm_CM_single_V -100000.0 100000.0 /end CHARACTERISTIC
/begin CHARACTERISTIC KIPM_IPUDCCLoVoltActCurntDflt_A "" VALUE 0x0000 /* @ECU_Address@KIPM_IPUDCCLoVoltActCurntDflt_A@ */ Scalar_FLOAT32_IEEE 0 AppSwcIpm_CM_single_A -100000.0 100000.0 /end CHARACTERISTIC
/begin CHARACTERISTIC KIPM_IPUDCCLoVoltActCurntHi_A "" VALUE 0x0000 /* @ECU_Address@KIPM_IPUDCCLoVoltActCurntHi_A@ */ Scalar_FLOAT32_IEEE 0 AppSwcIpm_CM_single_A -100000.0 100000.0 /end CHARACTERISTIC
/begin CHARACTERISTIC KIPM_IPUDCCLoVoltActCurntLo_A "" VALUE 0x0000 /* @ECU_Address@KIPM_IPUDCCLoVoltActCurntLo_A@ */ Scalar_FLOAT32_IEEE 0 AppSwcIpm_CM_single_A -100000.0 100000.0 /end CHARACTERISTIC
/begin CHARACTERISTIC KIPM_IPUDCCLoVoltActCurnt_A_ovrdval "" VALUE 0x0000 /* @ECU_Address@KIPM_IPUDCCLoVoltActCurnt_A_ovrdval@ */ Scalar_FLOAT32_IEEE 0 AppSwcIpm_CM_single_A -100000.0 100000.0 /end CHARACTERISTIC
/begin CHARACTERISTIC KIPM_IPUDCCLoVoltActVoltDflt_V "" VALUE 0x0000 /* @ECU_Address@KIPM_IPUDCCLoVoltActVoltDflt_V@ */ Scalar_FLOAT32_IEEE 0 AppSwcIpm_CM_single_V -100000.0 100000.0 /end CHARACTERISTIC
/begin CHARACTERISTIC KIPM_IPUDCCLoVoltActVoltHi_V "" VALUE 0x0000 /* @ECU_Address@KIPM_IPUDCCLoVoltActVoltHi_V@ */ Scalar_FLOAT32_IEEE 0 AppSwcIpm_CM_single_V -100000.0 100000.0 /end CHARACTERISTIC
/begin CHARACTERISTIC KIPM_IPUDCCLoVoltActVoltLo_V "" VALUE 0x0000 /* @ECU_Address@KIPM_IPUDCCLoVoltActVoltLo_V@ */ Scalar_FLOAT32_IEEE 0 AppSwcIpm_CM_single_V -100000.0 100000.0 /end CHARACTERISTIC
/begin CHARACTERISTIC KIPM_IPUDCCLoVoltActVolt_V_ovrdval "" VALUE 0x0000 /* @ECU_Address@KIPM_IPUDCCLoVoltActVolt_V_ovrdval@ */ Scalar_FLOAT32_IEEE 0 AppSwcIpm_CM_single_V -100000.0 100000.0 /end CHARACTERISTIC
/begin CHARACTERISTIC KIPM_IPUDeviceIntTempDflt_C "" VALUE 0x0000 /* @ECU_Address@KIPM_IPUDeviceIntTempDflt_C@ */ Scalar_FLOAT32_IEEE 0 AppSwcIpm_CM_single_C -100000.0 100000.0 /end CHARACTERISTIC
/begin CHARACTERISTIC KIPM_IPUDeviceIntTempHi_C "" VALUE 0x0000 /* @ECU_Address@KIPM_IPUDeviceIntTempHi_C@ */ Scalar_FLOAT32_IEEE 0 AppSwcIpm_CM_single_C -100000.0 100000.0 /end CHARACTERISTIC
/begin CHARACTERISTIC KIPM_IPUDeviceIntTempLo_C "" VALUE 0x0000 /* @ECU_Address@KIPM_IPUDeviceIntTempLo_C@ */ Scalar_FLOAT32_IEEE 0 AppSwcIpm_CM_single_C -100000.0 100000.0 /end CHARACTERISTIC
/begin CHARACTERISTIC KIPM_IPUDeviceIntTemp_C_ovrdval "" VALUE 0x0000 /* @ECU_Address@KIPM_IPUDeviceIntTemp_C_ovrdval@ */ Scalar_FLOAT32_IEEE 0 AppSwcIpm_CM_single_C -100000.0 100000.0 /end CHARACTERISTIC
/begin CHARACTERISTIC KIPM_IPUOBCACMaxPwrAllowDflt_kW "" VALUE 0x0000 /* @ECU_Address@KIPM_IPUOBCACMaxPwrAllowDflt_kW@ */ Scalar_FLOAT32_IEEE 0 AppSwcIpm_CM_single_kW -100000.0 100000.0 /end CHARACTERISTIC
/begin CHARACTERISTIC KIPM_IPUOBCACMaxPwrAllowHi_kW "" VALUE 0x0000 /* @ECU_Address@KIPM_IPUOBCACMaxPwrAllowHi_kW@ */ Scalar_FLOAT32_IEEE 0 AppSwcIpm_CM_single_kW -100000.0 100000.0 /end CHARACTERISTIC
/begin CHARACTERISTIC KIPM_IPUOBCACMaxPwrAllowLo_kW "" VALUE 0x0000 /* @ECU_Address@KIPM_IPUOBCACMaxPwrAllowLo_kW@ */ Scalar_FLOAT32_IEEE 0 AppSwcIpm_CM_single_kW -100000.0 100000.0 /end CHARACTERISTIC
/begin CHARACTERISTIC KIPM_IPUOBCACMaxPwrAllow_kW_ovrdval "" VALUE 0x0000 /* @ECU_Address@KIPM_IPUOBCACMaxPwrAllow_kW_ovrdval@ */ Scalar_FLOAT32_IEEE 0 AppSwcIpm_CM_single_kW -100000.0 100000.0 /end CHARACTERISTIC
/begin CHARACTERISTIC KIPM_IPUOBCHVDCActCurDflt_A "" VALUE 0x0000 /* @ECU_Address@KIPM_IPUOBCHVDCActCurDflt_A@ */ Scalar_FLOAT32_IEEE 0 AppSwcIpm_CM_single_A -100000.0 100000.0 /end CHARACTERISTIC
/begin CHARACTERISTIC KIPM_IPUOBCHVDCActCurHi_A "" VALUE 0x0000 /* @ECU_Address@KIPM_IPUOBCHVDCActCurHi_A@ */ Scalar_FLOAT32_IEEE 0 AppSwcIpm_CM_single_A -100000.0 100000.0 /end CHARACTERISTIC
/begin CHARACTERISTIC KIPM_IPUOBCHVDCActCurLo_A "" VALUE 0x0000 /* @ECU_Address@KIPM_IPUOBCHVDCActCurLo_A@ */ Scalar_FLOAT32_IEEE 0 AppSwcIpm_CM_single_A -100000.0 100000.0 /end CHARACTERISTIC
/begin CHARACTERISTIC KIPM_IPUOBCHVDCActCur_A_ovrdval "" VALUE 0x0000 /* @ECU_Address@KIPM_IPUOBCHVDCActCur_A_ovrdval@ */ Scalar_FLOAT32_IEEE 0 AppSwcIpm_CM_single_A -100000.0 100000.0 /end CHARACTERISTIC
/begin CHARACTERISTIC KIPM_IPUOBCHVDCActVolDflt_V "" VALUE 0x0000 /* @ECU_Address@KIPM_IPUOBCHVDCActVolDflt_V@ */ Scalar_FLOAT32_IEEE 0 AppSwcIpm_CM_single_V -100000.0 100000.0 /end CHARACTERISTIC
/begin CHARACTERISTIC KIPM_IPUOBCHVDCActVolHi_V "" VALUE 0x0000 /* @ECU_Address@KIPM_IPUOBCHVDCActVolHi_V@ */ Scalar_FLOAT32_IEEE 0 AppSwcIpm_CM_single_V -100000.0 100000.0 /end CHARACTERISTIC
/begin CHARACTERISTIC KIPM_IPUOBCHVDCActVolLo_V "" VALUE 0x0000 /* @ECU_Address@KIPM_IPUOBCHVDCActVolLo_V@ */ Scalar_FLOAT32_IEEE 0 AppSwcIpm_CM_single_V -100000.0 100000.0 /end CHARACTERISTIC
/begin CHARACTERISTIC KIPM_IPUOBCHVDCActVol_V_ovrdval "" VALUE 0x0000 /* @ECU_Address@KIPM_IPUOBCHVDCActVol_V_ovrdval@ */ Scalar_FLOAT32_IEEE 0 AppSwcIpm_CM_single_V -100000.0 100000.0 /end CHARACTERISTIC
/begin CHARACTERISTIC KIPM_IPUOBCInletActPwrDflt_kW "" VALUE 0x0000 /* @ECU_Address@KIPM_IPUOBCInletActPwrDflt_kW@ */ Scalar_FLOAT32_IEEE 0 AppSwcIpm_CM_single_kW -100000.0 100000.0 /end CHARACTERISTIC
/begin CHARACTERISTIC KIPM_IPUOBCInletActPwrHi_kW "" VALUE 0x0000 /* @ECU_Address@KIPM_IPUOBCInletActPwrHi_kW@ */ Scalar_FLOAT32_IEEE 0 AppSwcIpm_CM_single_kW -100000.0 100000.0 /end CHARACTERISTIC
/begin CHARACTERISTIC KIPM_IPUOBCInletActPwrLo_kW "" VALUE 0x0000 /* @ECU_Address@KIPM_IPUOBCInletActPwrLo_kW@ */ Scalar_FLOAT32_IEEE 0 AppSwcIpm_CM_single_kW -100000.0 100000.0 /end CHARACTERISTIC
/begin CHARACTERISTIC KIPM_IPUOBCInletActPwr_kW_ovrdval "" VALUE 0x0000 /* @ECU_Address@KIPM_IPUOBCInletActPwr_kW_ovrdval@ */ Scalar_FLOAT32_IEEE 0 AppSwcIpm_CM_single_kW -100000.0 100000.0 /end CHARACTERISTIC
/begin CHARACTERISTIC KIPM_IPUOBCTempIntDflt_C "" VALUE 0x0000 /* @ECU_Address@KIPM_IPUOBCTempIntDflt_C@ */ Scalar_FLOAT32_IEEE 0 AppSwcIpm_CM_single_C -100000.0 100000.0 /end CHARACTERISTIC
/begin CHARACTERISTIC KIPM_IPUOBCTempIntHi_C "" VALUE 0x0000 /* @ECU_Address@KIPM_IPUOBCTempIntHi_C@ */ Scalar_FLOAT32_IEEE 0 AppSwcIpm_CM_single_C -100000.0 100000.0 /end CHARACTERISTIC
/begin CHARACTERISTIC KIPM_IPUOBCTempIntLo_C "" VALUE 0x0000 /* @ECU_Address@KIPM_IPUOBCTempIntLo_C@ */ Scalar_FLOAT32_IEEE 0 AppSwcIpm_CM_single_C -100000.0 100000.0 /end CHARACTERISTIC
/begin CHARACTERISTIC KIPM_IPUOBCTempInt_C_ovrdval "" VALUE 0x0000 /* @ECU_Address@KIPM_IPUOBCTempInt_C_ovrdval@ */ Scalar_FLOAT32_IEEE 0 AppSwcIpm_CM_single_C -100000.0 100000.0 /end CHARACTERISTIC
/begin CHARACTERISTIC KIPM_HVCHFltCodDflt_enum "" VALUE 0x0000 /* @ECU_Address@KIPM_HVCHFltCodDflt_enum@ */ Scalar_UWORD 0 AppSwcIpm_CM_uint16_enum 0.0 65535.0 /end CHARACTERISTIC
/begin CHARACTERISTIC KIPM_HVCHFltCod_enum_ovrdval "" VALUE 0x0000 /* @ECU_Address@KIPM_HVCHFltCod_enum_ovrdval@ */ Scalar_UWORD 0 AppSwcIpm_CM_uint16_enum 0.0 65535.0 /end CHARACTERISTIC
/begin CHARACTERISTIC KIPM_TBOXBJSTimeYearDflt_nu "" VALUE 0x0000 /* @ECU_Address@KIPM_TBOXBJSTimeYearDflt_nu@ */ Scalar_UWORD 0 AppSwcIpm_CM_uint16_nu 0.0 65535.0 /end CHARACTERISTIC
/begin CHARACTERISTIC KIPM_TBOXBJSTimeYear_nu_ovrdval "" VALUE 0x0000 /* @ECU_Address@KIPM_TBOXBJSTimeYear_nu_ovrdval@ */ Scalar_UWORD 0 AppSwcIpm_CM_uint16_enum 0.0 65535.0 /end CHARACTERISTIC
/begin CHARACTERISTIC KIPM_HUPeristalsisModeEnblDflt_enum "" VALUE 0x0000 /* @ECU_Address@KIPM_HUPeristalsisModeEnblDflt_enum@ */ Scalar_UBYTE 0 AppSwcIpm_CM_EnumCrpModeEnbl 0 3 /end CHARACTERISTIC
/begin CHARACTERISTIC KIPM_HUPeristalsisModeEnbl_enum_ovrdval "" VALUE 0x0000 /* @ECU_Address@KIPM_HUPeristalsisModeEnbl_enum_ovrdval@ */ Scalar_UBYTE 0 AppSwcIpm_CM_EnumCrpModeEnbl 0 3 /end CHARACTERISTIC
/begin CHARACTERISTIC KIPM_IPUDCCActOprtModeDflt_enum "" VALUE 0x0000 /* @ECU_Address@KIPM_IPUDCCActOprtModeDflt_enum@ */ Scalar_UBYTE 0 AppSwcIpm_CM_EnumDCCActMd 0 7 /end CHARACTERISTIC
/begin CHARACTERISTIC KIPM_IPUDCCActOprtMode_enum_ovrdval "" VALUE 0x0000 /* @ECU_Address@KIPM_IPUDCCActOprtMode_enum_ovrdval@ */ Scalar_UBYTE 0 AppSwcIpm_CM_EnumDCCActMd 0 7 /end CHARACTERISTIC
/begin CHARACTERISTIC KIPM_HUDrvModeSelDflt_enum "" VALUE 0x0000 /* @ECU_Address@KIPM_HUDrvModeSelDflt_enum@ */ Scalar_UBYTE 0 AppSwcIpm_CM_EnumDrvModeSelct 0 4 /end CHARACTERISTIC
/begin CHARACTERISTIC KIPM_HUDrvModeSel_enum_ovrdval "" VALUE 0x0000 /* @ECU_Address@KIPM_HUDrvModeSel_enum_ovrdval@ */ Scalar_UBYTE 0 AppSwcIpm_CM_EnumDrvModeSelct 0 4 /end CHARACTERISTIC
/begin CHARACTERISTIC KIPM_EHBEPBActuatorStRDflt_enum "" VALUE 0x0000 /* @ECU_Address@KIPM_EHBEPBActuatorStRDflt_enum@ */ Scalar_UBYTE 0 AppSwcIpm_CM_EnumEPBState 0 6 /end CHARACTERISTIC
/begin CHARACTERISTIC KIPM_EHBEPBActuatorStR_enum_ovrdval "" VALUE 0x0000 /* @ECU_Address@KIPM_EHBEPBActuatorStR_enum_ovrdval@ */ Scalar_UBYTE 0 AppSwcIpm_CM_EnumEPBState 0 6 /end CHARACTERISTIC
/begin CHARACTERISTIC KIPM_IPUOBCActOprtModeDflt_enum "" VALUE 0x0000 /* @ECU_Address@KIPM_IPUOBCActOprtModeDflt_enum@ */ Scalar_UBYTE 0 AppSwcIpm_CM_EnumOBCActMd 0 15 /end CHARACTERISTIC
/begin CHARACTERISTIC KIPM_IPUOBCActOprtMode_enum_ovrdval "" VALUE 0x0000 /* @ECU_Address@KIPM_IPUOBCActOprtMode_enum_ovrdval@ */ Scalar_UBYTE 0 AppSwcIpm_CM_EnumOBCActMd 0 15 /end CHARACTERISTIC
/begin CHARACTERISTIC KIPM_IPUOBCInletConnectStaDflt_enum "" VALUE 0x0000 /* @ECU_Address@KIPM_IPUOBCInletConnectStaDflt_enum@ */ Scalar_UBYTE 0 AppSwcIpm_CM_EnumOBCPlugSt 0 3 /end CHARACTERISTIC
/begin CHARACTERISTIC KIPM_IPUOBCInletConnectSta_enum_ovrdval "" VALUE 0x0000 /* @ECU_Address@KIPM_IPUOBCInletConnectSta_enum_ovrdval@ */ Scalar_UBYTE 0 AppSwcIpm_CM_EnumOBCPlugSt 0 3 /end CHARACTERISTIC
/begin CHARACTERISTIC KIPM_IPUOBCReqDflt_enum "" VALUE 0x0000 /* @ECU_Address@KIPM_IPUOBCReqDflt_enum@ */ Scalar_UBYTE 0 AppSwcIpm_CM_EnumOBCReq 0 3 /end CHARACTERISTIC
/begin CHARACTERISTIC KIPM_IPUOBCReq_enum_ovrdval "" VALUE 0x0000 /* @ECU_Address@KIPM_IPUOBCReq_enum_ovrdval@ */ Scalar_UBYTE 0 AppSwcIpm_CM_EnumOBCReq 0 3 /end CHARACTERISTIC
/begin CHARACTERISTIC KIPM_IPUOBCWakeUpModeDflt_enum "" VALUE 0x0000 /* @ECU_Address@KIPM_IPUOBCWakeUpModeDflt_enum@ */ Scalar_UBYTE 0 AppSwcIpm_CM_EnumOBCWakeUpMd 0 7 /end CHARACTERISTIC
/begin CHARACTERISTIC KIPM_IPUOBCWakeUpMode_enum_ovrdval "" VALUE 0x0000 /* @ECU_Address@KIPM_IPUOBCWakeUpMode_enum_ovrdval@ */ Scalar_UBYTE 0 AppSwcIpm_CM_EnumOBCWakeUpMd 0 7 /end CHARACTERISTIC
/begin CHARACTERISTIC KIPM_HUCstRecupModeSelDflt_enum "" VALUE 0x0000 /* @ECU_Address@KIPM_HUCstRecupModeSelDflt_enum@ */ Scalar_UBYTE 0 AppSwcIpm_CM_EnumRegenModeSelct 0 3 /end CHARACTERISTIC
/begin CHARACTERISTIC KIPM_HUCstRecupModeSel_enum_ovrdval "" VALUE 0x0000 /* @ECU_Address@KIPM_HUCstRecupModeSel_enum_ovrdval@ */ Scalar_UBYTE 0 AppSwcIpm_CM_EnumRegenModeSelct 0 3 /end CHARACTERISTIC
/begin CHARACTERISTIC KIPM_EHBBrkPwrRecupTarWhlTqStsDflt_enum "" VALUE 0x0000 /* @ECU_Address@KIPM_EHBBrkPwrRecupTarWhlTqStsDflt_enum@ */ Scalar_UBYTE 0 AppSwcIpm_CM_EnumRegenTgtTqStat 0 3 /end CHARACTERISTIC
/begin CHARACTERISTIC KIPM_EHBBrkPwrRecupTarWhlTqSts_enum_ovrdval "" VALUE 0x0000 /* @ECU_Address@KIPM_EHBBrkPwrRecupTarWhlTqSts_enum_ovrdval@ */ Scalar_UBYTE 0 AppSwcIpm_CM_EnumRegenTgtTqStat 0 3 /end CHARACTERISTIC
/begin CHARACTERISTIC KIPM_ACCMLostCommOvrdSw_flg "" VALUE 0x0000 /* @ECU_Address@KIPM_ACCMLostCommOvrdSw_flg@ */ Scalar_BOOLEAN 0 AppSwcIpm_CM_boolean_flg 0.0 1.0 /end CHARACTERISTIC
/begin CHARACTERISTIC KIPM_ACCMLostCommOvrdVal_flg "" VALUE 0x0000 /* @ECU_Address@KIPM_ACCMLostCommOvrdVal_flg@ */ Scalar_BOOLEAN 0 AppSwcIpm_CM_boolean_flg 0.0 1.0 /end CHARACTERISTIC
/begin CHARACTERISTIC KIPM_APPVerMax_enum_ovrdflg "" VALUE 0x0000 /* @ECU_Address@KIPM_APPVerMax_enum_ovrdflg@ */ Scalar_BOOLEAN 0 AppSwcIpm_CM_boolean_flg 0.0 1.0 /end CHARACTERISTIC
/begin CHARACTERISTIC KIPM_APPVerMin_enum_ovrdflg "" VALUE 0x0000 /* @ECU_Address@KIPM_APPVerMin_enum_ovrdflg@ */ Scalar_BOOLEAN 0 AppSwcIpm_CM_boolean_flg 0.0 1.0 /end CHARACTERISTIC
/begin CHARACTERISTIC KIPM_BACCANBusOffOvrdSw_flg "" VALUE 0x0000 /* @ECU_Address@KIPM_BACCANBusOffOvrdSw_flg@ */ Scalar_BOOLEAN 0 AppSwcIpm_CM_boolean_flg 0.0 1.0 /end CHARACTERISTIC
/begin CHARACTERISTIC KIPM_BACCANBusOffOvrdVal_flg "" VALUE 0x0000 /* @ECU_Address@KIPM_BACCANBusOffOvrdVal_flg@ */ Scalar_BOOLEAN 0 AppSwcIpm_CM_boolean_flg 0.0 1.0 /end CHARACTERISTIC
/begin CHARACTERISTIC KIPM_BMSBatCapcty_Ah_ovrdflg "" VALUE 0x0000 /* @ECU_Address@KIPM_BMSBatCapcty_Ah_ovrdflg@ */ Scalar_BOOLEAN 0 AppSwcIpm_CM_boolean_flg 0.0 1.0 /end CHARACTERISTIC
/begin CHARACTERISTIC KIPM_BMSHVBatCellTempAve_C_ovrdflg "" VALUE 0x0000 /* @ECU_Address@KIPM_BMSHVBatCellTempAve_C_ovrdflg@ */ Scalar_BOOLEAN 0 AppSwcIpm_CM_boolean_flg 0.0 1.0 /end CHARACTERISTIC
/begin CHARACTERISTIC KIPM_BMSHVBatCellTempMax_C_ovrdflg "" VALUE 0x0000 /* @ECU_Address@KIPM_BMSHVBatCellTempMax_C_ovrdflg@ */ Scalar_BOOLEAN 0 AppSwcIpm_CM_boolean_flg 0.0 1.0 /end CHARACTERISTIC
/begin CHARACTERISTIC KIPM_BMSHVBatCellTempMin_C_ovrdflg "" VALUE 0x0000 /* @ECU_Address@KIPM_BMSHVBatCellTempMin_C_ovrdflg@ */ Scalar_BOOLEAN 0 AppSwcIpm_CM_boolean_flg 0.0 1.0 /end CHARACTERISTIC
/begin CHARACTERISTIC KIPM_BMSLostCommOvrdSw_flg "" VALUE 0x0000 /* @ECU_Address@KIPM_BMSLostCommOvrdSw_flg@ */ Scalar_BOOLEAN 0 AppSwcIpm_CM_boolean_flg 0.0 1.0 /end CHARACTERISTIC
/begin CHARACTERISTIC KIPM_BMSLostCommOvrdVal_flg "" VALUE 0x0000 /* @ECU_Address@KIPM_BMSLostCommOvrdVal_flg@ */ Scalar_BOOLEAN 0 AppSwcIpm_CM_boolean_flg 0.0 1.0 /end CHARACTERISTIC
/begin CHARACTERISTIC KIPM_BMSPackID_enum_ovrdflg "" VALUE 0x0000 /* @ECU_Address@KIPM_BMSPackID_enum_ovrdflg@ */ Scalar_BOOLEAN 0 AppSwcIpm_CM_boolean_flg 0.0 1.0 /end CHARACTERISTIC
/begin CHARACTERISTIC KIPM_BODCANBusOffOvrdSw_flg "" VALUE 0x0000 /* @ECU_Address@KIPM_BODCANBusOffOvrdSw_flg@ */ Scalar_BOOLEAN 0 AppSwcIpm_CM_boolean_flg 0.0 1.0 /end CHARACTERISTIC
/begin CHARACTERISTIC KIPM_BODCANBusOffOvrdVal_flg "" VALUE 0x0000 /* @ECU_Address@KIPM_BODCANBusOffOvrdVal_flg@ */ Scalar_BOOLEAN 0 AppSwcIpm_CM_boolean_flg 0.0 1.0 /end CHARACTERISTIC
/begin CHARACTERISTIC KIPM_BootVer_enum_ovrdflg "" VALUE 0x0000 /* @ECU_Address@KIPM_BootVer_enum_ovrdflg@ */ Scalar_BOOLEAN 0 AppSwcIpm_CM_boolean_flg 0.0 1.0 /end CHARACTERISTIC
/begin CHARACTERISTIC KIPM_CDCBackLadjval_enum_ovrdflg "" VALUE 0x0000 /* @ECU_Address@KIPM_CDCBackLadjval_enum_ovrdflg@ */ Scalar_BOOLEAN 0 AppSwcIpm_CM_boolean_flg 0.0 1.0 /end CHARACTERISTIC
/begin CHARACTERISTIC KIPM_CDCLostCommOvrdSw_flg "" VALUE 0x0000 /* @ECU_Address@KIPM_CDCLostCommOvrdSw_flg@ */ Scalar_BOOLEAN 0 AppSwcIpm_CM_boolean_flg 0.0 1.0 /end CHARACTERISTIC
/begin CHARACTERISTIC KIPM_CDCLostCommOvrdVal_flg "" VALUE 0x0000 /* @ECU_Address@KIPM_CDCLostCommOvrdVal_flg@ */ Scalar_BOOLEAN 0 AppSwcIpm_CM_boolean_flg 0.0 1.0 /end CHARACTERISTIC
/begin CHARACTERISTIC KIPM_CHACANBusOffOvrdSw_flg "" VALUE 0x0000 /* @ECU_Address@KIPM_CHACANBusOffOvrdSw_flg@ */ Scalar_BOOLEAN 0 AppSwcIpm_CM_boolean_flg 0.0 1.0 /end CHARACTERISTIC
/begin CHARACTERISTIC KIPM_CHACANBusOffOvrdVal_flg "" VALUE 0x0000 /* @ECU_Address@KIPM_CHACANBusOffOvrdVal_flg@ */ Scalar_BOOLEAN 0 AppSwcIpm_CM_boolean_flg 0.0 1.0 /end CHARACTERISTIC
/begin CHARACTERISTIC KIPM_COMPCANBusOffDflt_flg "" VALUE 0x0000 /* @ECU_Address@KIPM_COMPCANBusOffDflt_flg@ */ Scalar_BOOLEAN 0 AppSwcIpm_CM_boolean_flg 0.0 1.0 /end CHARACTERISTIC
/begin CHARACTERISTIC KIPM_COMPCANBusOff_flg_ovrdflg "" VALUE 0x0000 /* @ECU_Address@KIPM_COMPCANBusOff_flg_ovrdflg@ */ Scalar_BOOLEAN 0 AppSwcIpm_CM_boolean_flg 0.0 1.0 /end CHARACTERISTIC
/begin CHARACTERISTIC KIPM_COMPCANBusOff_flg_ovrdval "" VALUE 0x0000 /* @ECU_Address@KIPM_COMPCANBusOff_flg_ovrdval@ */ Scalar_BOOLEAN 0 AppSwcIpm_CM_boolean_flg 0.0 1.0 /end CHARACTERISTIC
/begin CHARACTERISTIC KIPM_COMPCommuErrorDflt_flg "" VALUE 0x0000 /* @ECU_Address@KIPM_COMPCommuErrorDflt_flg@ */ Scalar_BOOLEAN 0 AppSwcIpm_CM_boolean_flg 0.0 1.0 /end CHARACTERISTIC
/begin CHARACTERISTIC KIPM_COMPCommuError_flg_ovrdflg "" VALUE 0x0000 /* @ECU_Address@KIPM_COMPCommuError_flg_ovrdflg@ */ Scalar_BOOLEAN 0 AppSwcIpm_CM_boolean_flg 0.0 1.0 /end CHARACTERISTIC
/begin CHARACTERISTIC KIPM_COMPCommuError_flg_ovrdval "" VALUE 0x0000 /* @ECU_Address@KIPM_COMPCommuError_flg_ovrdval@ */ Scalar_BOOLEAN 0 AppSwcIpm_CM_boolean_flg 0.0 1.0 /end CHARACTERISTIC
/begin CHARACTERISTIC KIPM_COMPCurrOfstDflt_flg "" VALUE 0x0000 /* @ECU_Address@KIPM_COMPCurrOfstDflt_flg@ */ Scalar_BOOLEAN 0 AppSwcIpm_CM_boolean_flg 0.0 1.0 /end CHARACTERISTIC
/begin CHARACTERISTIC KIPM_COMPCurrOfst_flg_ovrdflg "" VALUE 0x0000 /* @ECU_Address@KIPM_COMPCurrOfst_flg_ovrdflg@ */ Scalar_BOOLEAN 0 AppSwcIpm_CM_boolean_flg 0.0 1.0 /end CHARACTERISTIC
/begin CHARACTERISTIC KIPM_COMPCurrOfst_flg_ovrdval "" VALUE 0x0000 /* @ECU_Address@KIPM_COMPCurrOfst_flg_ovrdval@ */ Scalar_BOOLEAN 0 AppSwcIpm_CM_boolean_flg 0.0 1.0 /end CHARACTERISTIC
/begin CHARACTERISTIC KIPM_COMPEcompActSpd_rpm_ovrdflg "" VALUE 0x0000 /* @ECU_Address@KIPM_COMPEcompActSpd_rpm_ovrdflg@ */ Scalar_BOOLEAN 0 AppSwcIpm_CM_boolean_flg 0.0 1.0 /end CHARACTERISTIC
/begin CHARACTERISTIC KIPM_COMPEcompST_enum_ovrdflg "" VALUE 0x0000 /* @ECU_Address@KIPM_COMPEcompST_enum_ovrdflg@ */ Scalar_BOOLEAN 0 AppSwcIpm_CM_boolean_flg 0.0 1.0 /end CHARACTERISTIC
/begin CHARACTERISTIC KIPM_COMPHiVolt_V_ovrdflg "" VALUE 0x0000 /* @ECU_Address@KIPM_COMPHiVolt_V_ovrdflg@ */ Scalar_BOOLEAN 0 AppSwcIpm_CM_boolean_flg 0.0 1.0 /end CHARACTERISTIC
/begin CHARACTERISTIC KIPM_COMPHvErr_enum_ovrdflg "" VALUE 0x0000 /* @ECU_Address@KIPM_COMPHvErr_enum_ovrdflg@ */ Scalar_BOOLEAN 0 AppSwcIpm_CM_boolean_flg 0.0 1.0 /end CHARACTERISTIC
/begin CHARACTERISTIC KIPM_COMPIPMErrDflt_flg "" VALUE 0x0000 /* @ECU_Address@KIPM_COMPIPMErrDflt_flg@ */ Scalar_BOOLEAN 0 AppSwcIpm_CM_boolean_flg 0.0 1.0 /end CHARACTERISTIC
/begin CHARACTERISTIC KIPM_COMPIPMErr_flg_ovrdflg "" VALUE 0x0000 /* @ECU_Address@KIPM_COMPIPMErr_flg_ovrdflg@ */ Scalar_BOOLEAN 0 AppSwcIpm_CM_boolean_flg 0.0 1.0 /end CHARACTERISTIC
/begin CHARACTERISTIC KIPM_COMPIPMErr_flg_ovrdval "" VALUE 0x0000 /* @ECU_Address@KIPM_COMPIPMErr_flg_ovrdval@ */ Scalar_BOOLEAN 0 AppSwcIpm_CM_boolean_flg 0.0 1.0 /end CHARACTERISTIC
/begin CHARACTERISTIC KIPM_COMPInCurr_A_ovrdflg "" VALUE 0x0000 /* @ECU_Address@KIPM_COMPInCurr_A_ovrdflg@ */ Scalar_BOOLEAN 0 AppSwcIpm_CM_boolean_flg 0.0 1.0 /end CHARACTERISTIC
/begin CHARACTERISTIC KIPM_COMPLoseStepDflt_flg "" VALUE 0x0000 /* @ECU_Address@KIPM_COMPLoseStepDflt_flg@ */ Scalar_BOOLEAN 0 AppSwcIpm_CM_boolean_flg 0.0 1.0 /end CHARACTERISTIC
/begin CHARACTERISTIC KIPM_COMPLoseStep_flg_ovrdflg "" VALUE 0x0000 /* @ECU_Address@KIPM_COMPLoseStep_flg_ovrdflg@ */ Scalar_BOOLEAN 0 AppSwcIpm_CM_boolean_flg 0.0 1.0 /end CHARACTERISTIC
/begin CHARACTERISTIC KIPM_COMPLoseStep_flg_ovrdval "" VALUE 0x0000 /* @ECU_Address@KIPM_COMPLoseStep_flg_ovrdval@ */ Scalar_BOOLEAN 0 AppSwcIpm_CM_boolean_flg 0.0 1.0 /end CHARACTERISTIC
/begin CHARACTERISTIC KIPM_COMPLvErr_enum_ovrdflg "" VALUE 0x0000 /* @ECU_Address@KIPM_COMPLvErr_enum_ovrdflg@ */ Scalar_BOOLEAN 0 AppSwcIpm_CM_boolean_flg 0.0 1.0 /end CHARACTERISTIC
/begin CHARACTERISTIC KIPM_COMPOverDutyDflt_flg "" VALUE 0x0000 /* @ECU_Address@KIPM_COMPOverDutyDflt_flg@ */ Scalar_BOOLEAN 0 AppSwcIpm_CM_boolean_flg 0.0 1.0 /end CHARACTERISTIC
/begin CHARACTERISTIC KIPM_COMPOverDuty_flg_ovrdflg "" VALUE 0x0000 /* @ECU_Address@KIPM_COMPOverDuty_flg_ovrdflg@ */ Scalar_BOOLEAN 0 AppSwcIpm_CM_boolean_flg 0.0 1.0 /end CHARACTERISTIC
/begin CHARACTERISTIC KIPM_COMPOverDuty_flg_ovrdval "" VALUE 0x0000 /* @ECU_Address@KIPM_COMPOverDuty_flg_ovrdval@ */ Scalar_BOOLEAN 0 AppSwcIpm_CM_boolean_flg 0.0 1.0 /end CHARACTERISTIC
/begin CHARACTERISTIC KIPM_COMPOvrCurr_enum_ovrdflg "" VALUE 0x0000 /* @ECU_Address@KIPM_COMPOvrCurr_enum_ovrdflg@ */ Scalar_BOOLEAN 0 AppSwcIpm_CM_boolean_flg 0.0 1.0 /end CHARACTERISTIC
/begin CHARACTERISTIC KIPM_COMPPISaturationDflt_flg "" VALUE 0x0000 /* @ECU_Address@KIPM_COMPPISaturationDflt_flg@ */ Scalar_BOOLEAN 0 AppSwcIpm_CM_boolean_flg 0.0 1.0 /end CHARACTERISTIC
/begin CHARACTERISTIC KIPM_COMPPISaturation_flg_ovrdflg "" VALUE 0x0000 /* @ECU_Address@KIPM_COMPPISaturation_flg_ovrdflg@ */ Scalar_BOOLEAN 0 AppSwcIpm_CM_boolean_flg 0.0 1.0 /end CHARACTERISTIC
/begin CHARACTERISTIC KIPM_COMPPISaturation_flg_ovrdval "" VALUE 0x0000 /* @ECU_Address@KIPM_COMPPISaturation_flg_ovrdval@ */ Scalar_BOOLEAN 0 AppSwcIpm_CM_boolean_flg 0.0 1.0 /end CHARACTERISTIC
/begin CHARACTERISTIC KIPM_COMPSelfChkErr_enum_ovrdflg "" VALUE 0x0000 /* @ECU_Address@KIPM_COMPSelfChkErr_enum_ovrdflg@ */ Scalar_BOOLEAN 0 AppSwcIpm_CM_boolean_flg 0.0 1.0 /end CHARACTERISTIC
/begin CHARACTERISTIC KIPM_COMPTempErrDflt_flg "" VALUE 0x0000 /* @ECU_Address@KIPM_COMPTempErrDflt_flg@ */ Scalar_BOOLEAN 0 AppSwcIpm_CM_boolean_flg 0.0 1.0 /end CHARACTERISTIC
/begin CHARACTERISTIC KIPM_COMPTempErr_flg_ovrdflg "" VALUE 0x0000 /* @ECU_Address@KIPM_COMPTempErr_flg_ovrdflg@ */ Scalar_BOOLEAN 0 AppSwcIpm_CM_boolean_flg 0.0 1.0 /end CHARACTERISTIC
/begin CHARACTERISTIC KIPM_COMPTempErr_flg_ovrdval "" VALUE 0x0000 /* @ECU_Address@KIPM_COMPTempErr_flg_ovrdval@ */ Scalar_BOOLEAN 0 AppSwcIpm_CM_boolean_flg 0.0 1.0 /end CHARACTERISTIC
/begin CHARACTERISTIC KIPM_COMPTemp_C_ovrdflg "" VALUE 0x0000 /* @ECU_Address@KIPM_COMPTemp_C_ovrdflg@ */ Scalar_BOOLEAN 0 AppSwcIpm_CM_boolean_flg 0.0 1.0 /end CHARACTERISTIC
/begin CHARACTERISTIC KIPM_CRRRLostCommOvrdSw_flg "" VALUE 0x0000 /* @ECU_Address@KIPM_CRRRLostCommOvrdSw_flg@ */ Scalar_BOOLEAN 0 AppSwcIpm_CM_boolean_flg 0.0 1.0 /end CHARACTERISTIC
/begin CHARACTERISTIC KIPM_CRRRLostCommOvrdVal_flg "" VALUE 0x0000 /* @ECU_Address@KIPM_CRRRLostCommOvrdVal_flg@ */ Scalar_BOOLEAN 0 AppSwcIpm_CM_boolean_flg 0.0 1.0 /end CHARACTERISTIC
/begin CHARACTERISTIC KIPM_ClientNum_enum_ovrdflg "" VALUE 0x0000 /* @ECU_Address@KIPM_ClientNum_enum_ovrdflg@ */ Scalar_BOOLEAN 0 AppSwcIpm_CM_boolean_flg 0.0 1.0 /end CHARACTERISTIC
/begin CHARACTERISTIC KIPM_ECUHiVoltInterlockSigDflt_flg "" VALUE 0x0000 /* @ECU_Address@KIPM_ECUHiVoltInterlockSigDflt_flg@ */ Scalar_BOOLEAN 0 AppSwcIpm_CM_boolean_flg 0.0 1.0 /end CHARACTERISTIC
/begin CHARACTERISTIC KIPM_ECUHiVoltInterlockSig_flg_ovrdflg "" VALUE 0x0000 /* @ECU_Address@KIPM_ECUHiVoltInterlockSig_flg_ovrdflg@ */ Scalar_BOOLEAN 0 AppSwcIpm_CM_boolean_flg 0.0 1.0 /end CHARACTERISTIC
/begin CHARACTERISTIC KIPM_ECUHiVoltInterlockSig_flg_ovrdval "" VALUE 0x0000 /* @ECU_Address@KIPM_ECUHiVoltInterlockSig_flg_ovrdval@ */ Scalar_BOOLEAN 0 AppSwcIpm_CM_boolean_flg 0.0 1.0 /end CHARACTERISTIC
/begin CHARACTERISTIC KIPM_EHBBrkPedlValPerc_pct_ovrdflg "" VALUE 0x0000 /* @ECU_Address@KIPM_EHBBrkPedlValPerc_pct_ovrdflg@ */ Scalar_BOOLEAN 0 AppSwcIpm_CM_boolean_flg 0.0 1.0 /end CHARACTERISTIC
/begin CHARACTERISTIC KIPM_EHBBrkPwrRecupTarWhlTqSts_enum_ovrdflg "" VALUE 0x0000 /* @ECU_Address@KIPM_EHBBrkPwrRecupTarWhlTqSts_enum_ovrdflg@ */ Scalar_BOOLEAN 0 AppSwcIpm_CM_boolean_flg 0.0 1.0 /end CHARACTERISTIC
/begin CHARACTERISTIC KIPM_EHBBrkPwrRecupTarWhlTq_Nm_ovrdflg "" VALUE 0x0000 /* @ECU_Address@KIPM_EHBBrkPwrRecupTarWhlTq_Nm_ovrdflg@ */ Scalar_BOOLEAN 0 AppSwcIpm_CM_boolean_flg 0.0 1.0 /end CHARACTERISTIC
/begin CHARACTERISTIC KIPM_EHBCDDActvDflt_flg "" VALUE 0x0000 /* @ECU_Address@KIPM_EHBCDDActvDflt_flg@ */ Scalar_BOOLEAN 0 AppSwcIpm_CM_boolean_flg 0.0 1.0 /end CHARACTERISTIC
/begin CHARACTERISTIC KIPM_EHBCDDActv_flg_ovrdflg "" VALUE 0x0000 /* @ECU_Address@KIPM_EHBCDDActv_flg_ovrdflg@ */ Scalar_BOOLEAN 0 AppSwcIpm_CM_boolean_flg 0.0 1.0 /end CHARACTERISTIC
/begin CHARACTERISTIC KIPM_EHBCDDActv_flg_ovrdval "" VALUE 0x0000 /* @ECU_Address@KIPM_EHBCDDActv_flg_ovrdval@ */ Scalar_BOOLEAN 0 AppSwcIpm_CM_boolean_flg 0.0 1.0 /end CHARACTERISTIC
/begin CHARACTERISTIC KIPM_EHBEPBActuatorStR_enum_ovrdflg "" VALUE 0x0000 /* @ECU_Address@KIPM_EHBEPBActuatorStR_enum_ovrdflg@ */ Scalar_BOOLEAN 0 AppSwcIpm_CM_boolean_flg 0.0 1.0 /end CHARACTERISTIC
/begin CHARACTERISTIC KIPM_EHBFltLvl_enum_ovrdflg "" VALUE 0x0000 /* @ECU_Address@KIPM_EHBFltLvl_enum_ovrdflg@ */ Scalar_BOOLEAN 0 AppSwcIpm_CM_boolean_flg 0.0 1.0 /end CHARACTERISTIC
/begin CHARACTERISTIC KIPM_EHBReqBrkLiOnDflt_flg "" VALUE 0x0000 /* @ECU_Address@KIPM_EHBReqBrkLiOnDflt_flg@ */ Scalar_BOOLEAN 0 AppSwcIpm_CM_boolean_flg 0.0 1.0 /end CHARACTERISTIC
/begin CHARACTERISTIC KIPM_EHBReqBrkLiOn_flg_ovrdflg "" VALUE 0x0000 /* @ECU_Address@KIPM_EHBReqBrkLiOn_flg_ovrdflg@ */ Scalar_BOOLEAN 0 AppSwcIpm_CM_boolean_flg 0.0 1.0 /end CHARACTERISTIC
/begin CHARACTERISTIC KIPM_EHBReqBrkLiOn_flg_ovrdval "" VALUE 0x0000 /* @ECU_Address@KIPM_EHBReqBrkLiOn_flg_ovrdval@ */ Scalar_BOOLEAN 0 AppSwcIpm_CM_boolean_flg 0.0 1.0 /end CHARACTERISTIC
/begin CHARACTERISTIC KIPM_EPSLostCommOvrdSw_flg "" VALUE 0x0000 /* @ECU_Address@KIPM_EPSLostCommOvrdSw_flg@ */ Scalar_BOOLEAN 0 AppSwcIpm_CM_boolean_flg 0.0 1.0 /end CHARACTERISTIC
/begin CHARACTERISTIC KIPM_EPSLostCommOvrdVal_flg "" VALUE 0x0000 /* @ECU_Address@KIPM_EPSLostCommOvrdVal_flg@ */ Scalar_BOOLEAN 0 AppSwcIpm_CM_boolean_flg 0.0 1.0 /end CHARACTERISTIC
/begin CHARACTERISTIC KIPM_EPSRotSpd_degps_ovrdflg "" VALUE 0x0000 /* @ECU_Address@KIPM_EPSRotSpd_degps_ovrdflg@ */ Scalar_BOOLEAN 0 AppSwcIpm_CM_boolean_flg 0.0 1.0 /end CHARACTERISTIC
/begin CHARACTERISTIC KIPM_EPTCANBusOffOvrdSw_flg "" VALUE 0x0000 /* @ECU_Address@KIPM_EPTCANBusOffOvrdSw_flg@ */ Scalar_BOOLEAN 0 AppSwcIpm_CM_boolean_flg 0.0 1.0 /end CHARACTERISTIC
/begin CHARACTERISTIC KIPM_EPTCANBusOffOvrdVal_flg "" VALUE 0x0000 /* @ECU_Address@KIPM_EPTCANBusOffOvrdVal_flg@ */ Scalar_BOOLEAN 0 AppSwcIpm_CM_boolean_flg 0.0 1.0 /end CHARACTERISTIC
/begin CHARACTERISTIC KIPM_ESCLostCommOvrdSw_flg "" VALUE 0x0000 /* @ECU_Address@KIPM_ESCLostCommOvrdSw_flg@ */ Scalar_BOOLEAN 0 AppSwcIpm_CM_boolean_flg 0.0 1.0 /end CHARACTERISTIC
/begin CHARACTERISTIC KIPM_ESCLostCommOvrdVal_flg "" VALUE 0x0000 /* @ECU_Address@KIPM_ESCLostCommOvrdVal_flg@ */ Scalar_BOOLEAN 0 AppSwcIpm_CM_boolean_flg 0.0 1.0 /end CHARACTERISTIC
/begin CHARACTERISTIC KIPM_FCMLostCommOvrdSw_flg "" VALUE 0x0000 /* @ECU_Address@KIPM_FCMLostCommOvrdSw_flg@ */ Scalar_BOOLEAN 0 AppSwcIpm_CM_boolean_flg 0.0 1.0 /end CHARACTERISTIC
/begin CHARACTERISTIC KIPM_FCMLostCommOvrdVal_flg "" VALUE 0x0000 /* @ECU_Address@KIPM_FCMLostCommOvrdVal_flg@ */ Scalar_BOOLEAN 0 AppSwcIpm_CM_boolean_flg 0.0 1.0 /end CHARACTERISTIC
/begin CHARACTERISTIC KIPM_HUACAutoCtl_enum_ovrdflg "" VALUE 0x0000 /* @ECU_Address@KIPM_HUACAutoCtl_enum_ovrdflg@ */ Scalar_BOOLEAN 0 AppSwcIpm_CM_boolean_flg 0.0 1.0 /end CHARACTERISTIC
/begin CHARACTERISTIC KIPM_HUACPwrCtl_enum_ovrdflg "" VALUE 0x0000 /* @ECU_Address@KIPM_HUACPwrCtl_enum_ovrdflg@ */ Scalar_BOOLEAN 0 AppSwcIpm_CM_boolean_flg 0.0 1.0 /end CHARACTERISTIC
/begin CHARACTERISTIC KIPM_HUAirInletModeSet_enum_ovrdflg "" VALUE 0x0000 /* @ECU_Address@KIPM_HUAirInletModeSet_enum_ovrdflg@ */ Scalar_BOOLEAN 0 AppSwcIpm_CM_boolean_flg 0.0 1.0 /end CHARACTERISTIC
/begin CHARACTERISTIC KIPM_HUBlwrModeSet_enum_ovrdflg "" VALUE 0x0000 /* @ECU_Address@KIPM_HUBlwrModeSet_enum_ovrdflg@ */ Scalar_BOOLEAN 0 AppSwcIpm_CM_boolean_flg 0.0 1.0 /end CHARACTERISTIC
/begin CHARACTERISTIC KIPM_HUChgWiprMtMdSwSet_enum_ovrdflg "" VALUE 0x0000 /* @ECU_Address@KIPM_HUChgWiprMtMdSwSet_enum_ovrdflg@ */ Scalar_BOOLEAN 0 AppSwcIpm_CM_boolean_flg 0.0 1.0 /end CHARACTERISTIC
/begin CHARACTERISTIC KIPM_HUCstRecupModeSel_enum_ovrdflg "" VALUE 0x0000 /* @ECU_Address@KIPM_HUCstRecupModeSel_enum_ovrdflg@ */ Scalar_BOOLEAN 0 AppSwcIpm_CM_boolean_flg 0.0 1.0 /end CHARACTERISTIC
/begin CHARACTERISTIC KIPM_HUDrvModeSel_enum_ovrdflg "" VALUE 0x0000 /* @ECU_Address@KIPM_HUDrvModeSel_enum_ovrdflg@ */ Scalar_BOOLEAN 0 AppSwcIpm_CM_boolean_flg 0.0 1.0 /end CHARACTERISTIC
/begin CHARACTERISTIC KIPM_HUDrvPwrSet_cnt_ovrdflg "" VALUE 0x0000 /* @ECU_Address@KIPM_HUDrvPwrSet_cnt_ovrdflg@ */ Scalar_BOOLEAN 0 AppSwcIpm_CM_boolean_flg 0.0 1.0 /end CHARACTERISTIC
/begin CHARACTERISTIC KIPM_HUFlwrMeHmCtrl_enum_ovrdflg "" VALUE 0x0000 /* @ECU_Address@KIPM_HUFlwrMeHmCtrl_enum_ovrdflg@ */ Scalar_BOOLEAN 0 AppSwcIpm_CM_boolean_flg 0.0 1.0 /end CHARACTERISTIC
/begin CHARACTERISTIC KIPM_HUFrntFanSpdSet_enum_ovrdflg "" VALUE 0x0000 /* @ECU_Address@KIPM_HUFrntFanSpdSet_enum_ovrdflg@ */ Scalar_BOOLEAN 0 AppSwcIpm_CM_boolean_flg 0.0 1.0 /end CHARACTERISTIC
/begin CHARACTERISTIC KIPM_HUHybEcoModeSet_enum_ovrdflg "" VALUE 0x0000 /* @ECU_Address@KIPM_HUHybEcoModeSet_enum_ovrdflg@ */ Scalar_BOOLEAN 0 AppSwcIpm_CM_boolean_flg 0.0 1.0 /end CHARACTERISTIC
/begin CHARACTERISTIC KIPM_HUIllmndEntrySts_enum_ovrdflg "" VALUE 0x0000 /* @ECU_Address@KIPM_HUIllmndEntrySts_enum_ovrdflg@ */ Scalar_BOOLEAN 0 AppSwcIpm_CM_boolean_flg 0.0 1.0 /end CHARACTERISTIC
/begin CHARACTERISTIC KIPM_HUIllmndLckSts_enum_ovrdflg "" VALUE 0x0000 /* @ECU_Address@KIPM_HUIllmndLckSts_enum_ovrdflg@ */ Scalar_BOOLEAN 0 AppSwcIpm_CM_boolean_flg 0.0 1.0 /end CHARACTERISTIC
/begin CHARACTERISTIC KIPM_HUIllmndUnlckSts_enum_ovrdflg "" VALUE 0x0000 /* @ECU_Address@KIPM_HUIllmndUnlckSts_enum_ovrdflg@ */ Scalar_BOOLEAN 0 AppSwcIpm_CM_boolean_flg 0.0 1.0 /end CHARACTERISTIC
/begin CHARACTERISTIC KIPM_HULckHornOnSt_enum_ovrdflg "" VALUE 0x0000 /* @ECU_Address@KIPM_HULckHornOnSt_enum_ovrdflg@ */ Scalar_BOOLEAN 0 AppSwcIpm_CM_boolean_flg 0.0 1.0 /end CHARACTERISTIC
/begin CHARACTERISTIC KIPM_HULeftTempSet_enum_ovrdflg "" VALUE 0x0000 /* @ECU_Address@KIPM_HULeftTempSet_enum_ovrdflg@ */ Scalar_BOOLEAN 0 AppSwcIpm_CM_boolean_flg 0.0 1.0 /end CHARACTERISTIC
/begin CHARACTERISTIC KIPM_HUMaiDrvrSeatHeat_enum_ovrdflg "" VALUE 0x0000 /* @ECU_Address@KIPM_HUMaiDrvrSeatHeat_enum_ovrdflg@ */ Scalar_BOOLEAN 0 AppSwcIpm_CM_boolean_flg 0.0 1.0 /end CHARACTERISTIC
/begin CHARACTERISTIC KIPM_HUManlDefrstCtl_enum_ovrdflg "" VALUE 0x0000 /* @ECU_Address@KIPM_HUManlDefrstCtl_enum_ovrdflg@ */ Scalar_BOOLEAN 0 AppSwcIpm_CM_boolean_flg 0.0 1.0 /end CHARACTERISTIC
/begin CHARACTERISTIC KIPM_HUOvrspdCntrlLckSet_enum_ovrdflg "" VALUE 0x0000 /* @ECU_Address@KIPM_HUOvrspdCntrlLckSet_enum_ovrdflg@ */ Scalar_BOOLEAN 0 AppSwcIpm_CM_boolean_flg 0.0 1.0 /end CHARACTERISTIC
/begin CHARACTERISTIC KIPM_HUParkAutoUnlckSet_enum_ovrdflg "" VALUE 0x0000 /* @ECU_Address@KIPM_HUParkAutoUnlckSet_enum_ovrdflg@ */ Scalar_BOOLEAN 0 AppSwcIpm_CM_boolean_flg 0.0 1.0 /end CHARACTERISTIC
/begin CHARACTERISTIC KIPM_HUPeristalsisModeEnbl_enum_ovrdflg "" VALUE 0x0000 /* @ECU_Address@KIPM_HUPeristalsisModeEnbl_enum_ovrdflg@ */ Scalar_BOOLEAN 0 AppSwcIpm_CM_boolean_flg 0.0 1.0 /end CHARACTERISTIC
/begin CHARACTERISTIC KIPM_HUPwrOffReqDflt_flg "" VALUE 0x0000 /* @ECU_Address@KIPM_HUPwrOffReqDflt_flg@ */ Scalar_BOOLEAN 0 AppSwcIpm_CM_boolean_flg 0.0 1.0 /end CHARACTERISTIC
/begin CHARACTERISTIC KIPM_HUPwrOffReq_flg_ovrdflg "" VALUE 0x0000 /* @ECU_Address@KIPM_HUPwrOffReq_flg_ovrdflg@ */ Scalar_BOOLEAN 0 AppSwcIpm_CM_boolean_flg 0.0 1.0 /end CHARACTERISTIC
/begin CHARACTERISTIC KIPM_HUPwrOffReq_flg_ovrdval "" VALUE 0x0000 /* @ECU_Address@KIPM_HUPwrOffReq_flg_ovrdval@ */ Scalar_BOOLEAN 0 AppSwcIpm_CM_boolean_flg 0.0 1.0 /end CHARACTERISTIC
/begin CHARACTERISTIC KIPM_HURecupPwrSet_pct_ovrdflg "" VALUE 0x0000 /* @ECU_Address@KIPM_HURecupPwrSet_pct_ovrdflg@ */ Scalar_BOOLEAN 0 AppSwcIpm_CM_boolean_flg 0.0 1.0 /end CHARACTERISTIC
/begin CHARACTERISTIC KIPM_HURrMirrHeat_enum_ovrdflg "" VALUE 0x0000 /* @ECU_Address@KIPM_HURrMirrHeat_enum_ovrdflg@ */ Scalar_BOOLEAN 0 AppSwcIpm_CM_boolean_flg 0.0 1.0 /end CHARACTERISTIC
/begin CHARACTERISTIC KIPM_HUSteerWhlHeat_enum_ovrdflg "" VALUE 0x0000 /* @ECU_Address@KIPM_HUSteerWhlHeat_enum_ovrdflg@ */ Scalar_BOOLEAN 0 AppSwcIpm_CM_boolean_flg 0.0 1.0 /end CHARACTERISTIC
/begin CHARACTERISTIC KIPM_HUTPMSRstReqDflt_flg "" VALUE 0x0000 /* @ECU_Address@KIPM_HUTPMSRstReqDflt_flg@ */ Scalar_BOOLEAN 0 AppSwcIpm_CM_boolean_flg 0.0 1.0 /end CHARACTERISTIC
/begin CHARACTERISTIC KIPM_HUTPMSRstReq_flg_ovrdflg "" VALUE 0x0000 /* @ECU_Address@KIPM_HUTPMSRstReq_flg_ovrdflg@ */ Scalar_BOOLEAN 0 AppSwcIpm_CM_boolean_flg 0.0 1.0 /end CHARACTERISTIC
/begin CHARACTERISTIC KIPM_HUTPMSRstReq_flg_ovrdval "" VALUE 0x0000 /* @ECU_Address@KIPM_HUTPMSRstReq_flg_ovrdval@ */ Scalar_BOOLEAN 0 AppSwcIpm_CM_boolean_flg 0.0 1.0 /end CHARACTERISTIC
/begin CHARACTERISTIC KIPM_HUTrnkLckSwCtrl_enum_ovrdflg "" VALUE 0x0000 /* @ECU_Address@KIPM_HUTrnkLckSwCtrl_enum_ovrdflg@ */ Scalar_BOOLEAN 0 AppSwcIpm_CM_boolean_flg 0.0 1.0 /end CHARACTERISTIC
/begin CHARACTERISTIC KIPM_HUWiprIntlTmSet_enum_ovrdflg "" VALUE 0x0000 /* @ECU_Address@KIPM_HUWiprIntlTmSet_enum_ovrdflg@ */ Scalar_BOOLEAN 0 AppSwcIpm_CM_boolean_flg 0.0 1.0 /end CHARACTERISTIC
/begin CHARACTERISTIC KIPM_HVCHCurr_A_ovrdflg "" VALUE 0x0000 /* @ECU_Address@KIPM_HVCHCurr_A_ovrdflg@ */ Scalar_BOOLEAN 0 AppSwcIpm_CM_boolean_flg 0.0 1.0 /end CHARACTERISTIC
/begin CHARACTERISTIC KIPM_HVCHFltCod_enum_ovrdflg "" VALUE 0x0000 /* @ECU_Address@KIPM_HVCHFltCod_enum_ovrdflg@ */ Scalar_BOOLEAN 0 AppSwcIpm_CM_boolean_flg 0.0 1.0 /end CHARACTERISTIC
/begin CHARACTERISTIC KIPM_HVCHHVStDflt_flg "" VALUE 0x0000 /* @ECU_Address@KIPM_HVCHHVStDflt_flg@ */ Scalar_BOOLEAN 0 AppSwcIpm_CM_boolean_flg 0.0 1.0 /end CHARACTERISTIC
/begin CHARACTERISTIC KIPM_HVCHHVSt_flg_ovrdflg "" VALUE 0x0000 /* @ECU_Address@KIPM_HVCHHVSt_flg_ovrdflg@ */ Scalar_BOOLEAN 0 AppSwcIpm_CM_boolean_flg 0.0 1.0 /end CHARACTERISTIC
/begin CHARACTERISTIC KIPM_HVCHHVSt_flg_ovrdval "" VALUE 0x0000 /* @ECU_Address@KIPM_HVCHHVSt_flg_ovrdval@ */ Scalar_BOOLEAN 0 AppSwcIpm_CM_boolean_flg 0.0 1.0 /end CHARACTERISTIC
/begin CHARACTERISTIC KIPM_HVCHHVVolts_V_ovrdflg "" VALUE 0x0000 /* @ECU_Address@KIPM_HVCHHVVolts_V_ovrdflg@ */ Scalar_BOOLEAN 0 AppSwcIpm_CM_boolean_flg 0.0 1.0 /end CHARACTERISTIC
/begin CHARACTERISTIC KIPM_HVCHInletTemp_C_ovrdflg "" VALUE 0x0000 /* @ECU_Address@KIPM_HVCHInletTemp_C_ovrdflg@ */ Scalar_BOOLEAN 0 AppSwcIpm_CM_boolean_flg 0.0 1.0 /end CHARACTERISTIC
/begin CHARACTERISTIC KIPM_HVCHOutlTemp_C_ovrdflg "" VALUE 0x0000 /* @ECU_Address@KIPM_HVCHOutlTemp_C_ovrdflg@ */ Scalar_BOOLEAN 0 AppSwcIpm_CM_boolean_flg 0.0 1.0 /end CHARACTERISTIC
/begin CHARACTERISTIC KIPM_HVCHPCBTemp_C_ovrdflg "" VALUE 0x0000 /* @ECU_Address@KIPM_HVCHPCBTemp_C_ovrdflg@ */ Scalar_BOOLEAN 0 AppSwcIpm_CM_boolean_flg 0.0 1.0 /end CHARACTERISTIC
/begin CHARACTERISTIC KIPM_HVCHPwr_kW_ovrdflg "" VALUE 0x0000 /* @ECU_Address@KIPM_HVCHPwr_kW_ovrdflg@ */ Scalar_BOOLEAN 0 AppSwcIpm_CM_boolean_flg 0.0 1.0 /end CHARACTERISTIC
/begin CHARACTERISTIC KIPM_HVCHSt_enum_ovrdflg "" VALUE 0x0000 /* @ECU_Address@KIPM_HVCHSt_enum_ovrdflg@ */ Scalar_BOOLEAN 0 AppSwcIpm_CM_boolean_flg 0.0 1.0 /end CHARACTERISTIC
/begin CHARACTERISTIC KIPM_HVCHWorkMode_enum_ovrdflg "" VALUE 0x0000 /* @ECU_Address@KIPM_HVCHWorkMode_enum_ovrdflg@ */ Scalar_BOOLEAN 0 AppSwcIpm_CM_boolean_flg 0.0 1.0 /end CHARACTERISTIC
/begin CHARACTERISTIC KIPM_HVCHWorkSt_enum_ovrdflg "" VALUE 0x0000 /* @ECU_Address@KIPM_HVCHWorkSt_enum_ovrdflg@ */ Scalar_BOOLEAN 0 AppSwcIpm_CM_boolean_flg 0.0 1.0 /end CHARACTERISTIC
/begin CHARACTERISTIC KIPM_HwVerMax_enum_ovrdflg "" VALUE 0x0000 /* @ECU_Address@KIPM_HwVerMax_enum_ovrdflg@ */ Scalar_BOOLEAN 0 AppSwcIpm_CM_boolean_flg 0.0 1.0 /end CHARACTERISTIC
/begin CHARACTERISTIC KIPM_HwVerMin_enum_ovrdflg "" VALUE 0x0000 /* @ECU_Address@KIPM_HwVerMin_enum_ovrdflg@ */ Scalar_BOOLEAN 0 AppSwcIpm_CM_boolean_flg 0.0 1.0 /end CHARACTERISTIC
/begin CHARACTERISTIC KIPM_ICULostCommOvrdSw_flg "" VALUE 0x0000 /* @ECU_Address@KIPM_ICULostCommOvrdSw_flg@ */ Scalar_BOOLEAN 0 AppSwcIpm_CM_boolean_flg 0.0 1.0 /end CHARACTERISTIC
/begin CHARACTERISTIC KIPM_ICULostCommOvrdVal_flg "" VALUE 0x0000 /* @ECU_Address@KIPM_ICULostCommOvrdVal_flg@ */ Scalar_BOOLEAN 0 AppSwcIpm_CM_boolean_flg 0.0 1.0 /end CHARACTERISTIC
/begin CHARACTERISTIC KIPM_INVLrngData02_nu_ovrdflg "" VALUE 0x0000 /* @ECU_Address@KIPM_INVLrngData02_nu_ovrdflg@ */ Scalar_BOOLEAN 0 AppSwcIpm_CM_boolean_flg 0.0 1.0 /end CHARACTERISTIC
/begin CHARACTERISTIC KIPM_INVLrngData03_nu_ovrdflg "" VALUE 0x0000 /* @ECU_Address@KIPM_INVLrngData03_nu_ovrdflg@ */ Scalar_BOOLEAN 0 AppSwcIpm_CM_boolean_flg 0.0 1.0 /end CHARACTERISTIC
/begin CHARACTERISTIC KIPM_INVLrngData04_nu_ovrdflg "" VALUE 0x0000 /* @ECU_Address@KIPM_INVLrngData04_nu_ovrdflg@ */ Scalar_BOOLEAN 0 AppSwcIpm_CM_boolean_flg 0.0 1.0 /end CHARACTERISTIC
/begin CHARACTERISTIC KIPM_INVLrngData05_nu_ovrdflg "" VALUE 0x0000 /* @ECU_Address@KIPM_INVLrngData05_nu_ovrdflg@ */ Scalar_BOOLEAN 0 AppSwcIpm_CM_boolean_flg 0.0 1.0 /end CHARACTERISTIC
/begin CHARACTERISTIC KIPM_INVLrngData06_nu_ovrdflg "" VALUE 0x0000 /* @ECU_Address@KIPM_INVLrngData06_nu_ovrdflg@ */ Scalar_BOOLEAN 0 AppSwcIpm_CM_boolean_flg 0.0 1.0 /end CHARACTERISTIC
/begin CHARACTERISTIC KIPM_INVLrngData07_nu_ovrdflg "" VALUE 0x0000 /* @ECU_Address@KIPM_INVLrngData07_nu_ovrdflg@ */ Scalar_BOOLEAN 0 AppSwcIpm_CM_boolean_flg 0.0 1.0 /end CHARACTERISTIC
/begin CHARACTERISTIC KIPM_INVLrngSts_enum_ovrdflg "" VALUE 0x0000 /* @ECU_Address@KIPM_INVLrngSts_enum_ovrdflg@ */ Scalar_BOOLEAN 0 AppSwcIpm_CM_boolean_flg 0.0 1.0 /end CHARACTERISTIC
/begin CHARACTERISTIC KIPM_INVLrngSubID_cnt_ovrdflg "" VALUE 0x0000 /* @ECU_Address@KIPM_INVLrngSubID_cnt_ovrdflg@ */ Scalar_BOOLEAN 0 AppSwcIpm_CM_boolean_flg 0.0 1.0 /end CHARACTERISTIC
/begin CHARACTERISTIC KIPM_IPUDCCActOprtMode_enum_ovrdflg "" VALUE 0x0000 /* @ECU_Address@KIPM_IPUDCCActOprtMode_enum_ovrdflg@ */ Scalar_BOOLEAN 0 AppSwcIpm_CM_boolean_flg 0.0 1.0 /end CHARACTERISTIC
/begin CHARACTERISTIC KIPM_IPUDCCHiVoltActCurnt_A_ovrdflg "" VALUE 0x0000 /* @ECU_Address@KIPM_IPUDCCHiVoltActCurnt_A_ovrdflg@ */ Scalar_BOOLEAN 0 AppSwcIpm_CM_boolean_flg 0.0 1.0 /end CHARACTERISTIC
/begin CHARACTERISTIC KIPM_IPUDCCHiVoltActVolt_V_ovrdflg "" VALUE 0x0000 /* @ECU_Address@KIPM_IPUDCCHiVoltActVolt_V_ovrdflg@ */ Scalar_BOOLEAN 0 AppSwcIpm_CM_boolean_flg 0.0 1.0 /end CHARACTERISTIC
/begin CHARACTERISTIC KIPM_IPUDCCLoVoltActCurnt_A_ovrdflg "" VALUE 0x0000 /* @ECU_Address@KIPM_IPUDCCLoVoltActCurnt_A_ovrdflg@ */ Scalar_BOOLEAN 0 AppSwcIpm_CM_boolean_flg 0.0 1.0 /end CHARACTERISTIC
/begin CHARACTERISTIC KIPM_IPUDCCLoVoltActVolt_V_ovrdflg "" VALUE 0x0000 /* @ECU_Address@KIPM_IPUDCCLoVoltActVolt_V_ovrdflg@ */ Scalar_BOOLEAN 0 AppSwcIpm_CM_boolean_flg 0.0 1.0 /end CHARACTERISTIC
/begin CHARACTERISTIC KIPM_IPUDCCSysFailSta_enum_ovrdflg "" VALUE 0x0000 /* @ECU_Address@KIPM_IPUDCCSysFailSta_enum_ovrdflg@ */ Scalar_BOOLEAN 0 AppSwcIpm_CM_boolean_flg 0.0 1.0 /end CHARACTERISTIC
/begin CHARACTERISTIC KIPM_IPUDeviceIntTemp_C_ovrdflg "" VALUE 0x0000 /* @ECU_Address@KIPM_IPUDeviceIntTemp_C_ovrdflg@ */ Scalar_BOOLEAN 0 AppSwcIpm_CM_boolean_flg 0.0 1.0 /end CHARACTERISTIC
/begin CHARACTERISTIC KIPM_IPULostCommOvrdSw_flg "" VALUE 0x0000 /* @ECU_Address@KIPM_IPULostCommOvrdSw_flg@ */ Scalar_BOOLEAN 0 AppSwcIpm_CM_boolean_flg 0.0 1.0 /end CHARACTERISTIC
/begin CHARACTERISTIC KIPM_IPULostCommOvrdVal_flg "" VALUE 0x0000 /* @ECU_Address@KIPM_IPULostCommOvrdVal_flg@ */ Scalar_BOOLEAN 0 AppSwcIpm_CM_boolean_flg 0.0 1.0 /end CHARACTERISTIC
/begin CHARACTERISTIC KIPM_IPUOBCACMaxPwrAllow_kW_ovrdflg "" VALUE 0x0000 /* @ECU_Address@KIPM_IPUOBCACMaxPwrAllow_kW_ovrdflg@ */ Scalar_BOOLEAN 0 AppSwcIpm_CM_boolean_flg 0.0 1.0 /end CHARACTERISTIC
/begin CHARACTERISTIC KIPM_IPUOBCActOprtMode_enum_ovrdflg "" VALUE 0x0000 /* @ECU_Address@KIPM_IPUOBCActOprtMode_enum_ovrdflg@ */ Scalar_BOOLEAN 0 AppSwcIpm_CM_boolean_flg 0.0 1.0 /end CHARACTERISTIC
/begin CHARACTERISTIC KIPM_IPUOBCConnectMainStaDflt_flg "" VALUE 0x0000 /* @ECU_Address@KIPM_IPUOBCConnectMainStaDflt_flg@ */ Scalar_BOOLEAN 0 AppSwcIpm_CM_boolean_flg 0.0 1.0 /end CHARACTERISTIC
/begin CHARACTERISTIC KIPM_IPUOBCConnectMainSta_flg_ovrdflg "" VALUE 0x0000 /* @ECU_Address@KIPM_IPUOBCConnectMainSta_flg_ovrdflg@ */ Scalar_BOOLEAN 0 AppSwcIpm_CM_boolean_flg 0.0 1.0 /end CHARACTERISTIC
/begin CHARACTERISTIC KIPM_IPUOBCConnectMainSta_flg_ovrdval "" VALUE 0x0000 /* @ECU_Address@KIPM_IPUOBCConnectMainSta_flg_ovrdval@ */ Scalar_BOOLEAN 0 AppSwcIpm_CM_boolean_flg 0.0 1.0 /end CHARACTERISTIC
/begin CHARACTERISTIC KIPM_IPUOBCHVDCActCur_A_ovrdflg "" VALUE 0x0000 /* @ECU_Address@KIPM_IPUOBCHVDCActCur_A_ovrdflg@ */ Scalar_BOOLEAN 0 AppSwcIpm_CM_boolean_flg 0.0 1.0 /end CHARACTERISTIC
/begin CHARACTERISTIC KIPM_IPUOBCHVDCActVol_V_ovrdflg "" VALUE 0x0000 /* @ECU_Address@KIPM_IPUOBCHVDCActVol_V_ovrdflg@ */ Scalar_BOOLEAN 0 AppSwcIpm_CM_boolean_flg 0.0 1.0 /end CHARACTERISTIC
/begin CHARACTERISTIC KIPM_IPUOBCInletActPwr_kW_ovrdflg "" VALUE 0x0000 /* @ECU_Address@KIPM_IPUOBCInletActPwr_kW_ovrdflg@ */ Scalar_BOOLEAN 0 AppSwcIpm_CM_boolean_flg 0.0 1.0 /end CHARACTERISTIC
/begin CHARACTERISTIC KIPM_IPUOBCInletConnectSta_enum_ovrdflg "" VALUE 0x0000 /* @ECU_Address@KIPM_IPUOBCInletConnectSta_enum_ovrdflg@ */ Scalar_BOOLEAN 0 AppSwcIpm_CM_boolean_flg 0.0 1.0 /end CHARACTERISTIC
/begin CHARACTERISTIC KIPM_IPUOBCReq_enum_ovrdflg "" VALUE 0x0000 /* @ECU_Address@KIPM_IPUOBCReq_enum_ovrdflg@ */ Scalar_BOOLEAN 0 AppSwcIpm_CM_boolean_flg 0.0 1.0 /end CHARACTERISTIC
/begin CHARACTERISTIC KIPM_IPUOBCS2StateDflt_flg "" VALUE 0x0000 /* @ECU_Address@KIPM_IPUOBCS2StateDflt_flg@ */ Scalar_BOOLEAN 0 AppSwcIpm_CM_boolean_flg 0.0 1.0 /end CHARACTERISTIC
/begin CHARACTERISTIC KIPM_IPUOBCS2State_flg_ovrdflg "" VALUE 0x0000 /* @ECU_Address@KIPM_IPUOBCS2State_flg_ovrdflg@ */ Scalar_BOOLEAN 0 AppSwcIpm_CM_boolean_flg 0.0 1.0 /end CHARACTERISTIC
/begin CHARACTERISTIC KIPM_IPUOBCS2State_flg_ovrdval "" VALUE 0x0000 /* @ECU_Address@KIPM_IPUOBCS2State_flg_ovrdval@ */ Scalar_BOOLEAN 0 AppSwcIpm_CM_boolean_flg 0.0 1.0 /end CHARACTERISTIC
/begin CHARACTERISTIC KIPM_IPUOBCSysFailSta_enum_ovrdflg "" VALUE 0x0000 /* @ECU_Address@KIPM_IPUOBCSysFailSta_enum_ovrdflg@ */ Scalar_BOOLEAN 0 AppSwcIpm_CM_boolean_flg 0.0 1.0 /end CHARACTERISTIC
/begin CHARACTERISTIC KIPM_IPUOBCTempInt_C_ovrdflg "" VALUE 0x0000 /* @ECU_Address@KIPM_IPUOBCTempInt_C_ovrdflg@ */ Scalar_BOOLEAN 0 AppSwcIpm_CM_boolean_flg 0.0 1.0 /end CHARACTERISTIC
/begin CHARACTERISTIC KIPM_IPUOBCWakeUpMode_enum_ovrdflg "" VALUE 0x0000 /* @ECU_Address@KIPM_IPUOBCWakeUpMode_enum_ovrdflg@ */ Scalar_BOOLEAN 0 AppSwcIpm_CM_boolean_flg 0.0 1.0 /end CHARACTERISTIC
/begin CHARACTERISTIC KIPM_MCULostCommOvrdSw_flg "" VALUE 0x0000 /* @ECU_Address@KIPM_MCULostCommOvrdSw_flg@ */ Scalar_BOOLEAN 0 AppSwcIpm_CM_boolean_flg 0.0 1.0 /end CHARACTERISTIC
/begin CHARACTERISTIC KIPM_MCULostCommOvrdVal_flg "" VALUE 0x0000 /* @ECU_Address@KIPM_MCULostCommOvrdVal_flg@ */ Scalar_BOOLEAN 0 AppSwcIpm_CM_boolean_flg 0.0 1.0 /end CHARACTERISTIC
/begin CHARACTERISTIC KIPM_PPLostCommOvrdSw_flg "" VALUE 0x0000 /* @ECU_Address@KIPM_PPLostCommOvrdSw_flg@ */ Scalar_BOOLEAN 0 AppSwcIpm_CM_boolean_flg 0.0 1.0 /end CHARACTERISTIC
/begin CHARACTERISTIC KIPM_PPLostCommOvrdVal_flg "" VALUE 0x0000 /* @ECU_Address@KIPM_PPLostCommOvrdVal_flg@ */ Scalar_BOOLEAN 0 AppSwcIpm_CM_boolean_flg 0.0 1.0 /end CHARACTERISTIC
/begin CHARACTERISTIC KIPM_PTCLostCommOvrdSw_flg "" VALUE 0x0000 /* @ECU_Address@KIPM_PTCLostCommOvrdSw_flg@ */ Scalar_BOOLEAN 0 AppSwcIpm_CM_boolean_flg 0.0 1.0 /end CHARACTERISTIC
/begin CHARACTERISTIC KIPM_PTCLostCommOvrdVal_flg "" VALUE 0x0000 /* @ECU_Address@KIPM_PTCLostCommOvrdVal_flg@ */ Scalar_BOOLEAN 0 AppSwcIpm_CM_boolean_flg 0.0 1.0 /end CHARACTERISTIC
/begin CHARACTERISTIC KIPM_SRSLostCommOvrdSw_flg "" VALUE 0x0000 /* @ECU_Address@KIPM_SRSLostCommOvrdSw_flg@ */ Scalar_BOOLEAN 0 AppSwcIpm_CM_boolean_flg 0.0 1.0 /end CHARACTERISTIC
/begin CHARACTERISTIC KIPM_SRSLostCommOvrdVal_flg "" VALUE 0x0000 /* @ECU_Address@KIPM_SRSLostCommOvrdVal_flg@ */ Scalar_BOOLEAN 0 AppSwcIpm_CM_boolean_flg 0.0 1.0 /end CHARACTERISTIC
/begin CHARACTERISTIC KIPM_TBOXBJSTimeDay_nu_ovrdflg "" VALUE 0x0000 /* @ECU_Address@KIPM_TBOXBJSTimeDay_nu_ovrdflg@ */ Scalar_BOOLEAN 0 AppSwcIpm_CM_boolean_flg 0.0 1.0 /end CHARACTERISTIC
/begin CHARACTERISTIC KIPM_TBOXBJSTimeHour_nu_ovrdflg "" VALUE 0x0000 /* @ECU_Address@KIPM_TBOXBJSTimeHour_nu_ovrdflg@ */ Scalar_BOOLEAN 0 AppSwcIpm_CM_boolean_flg 0.0 1.0 /end CHARACTERISTIC
/begin CHARACTERISTIC KIPM_TBOXBJSTimeMin_nu_ovrdflg "" VALUE 0x0000 /* @ECU_Address@KIPM_TBOXBJSTimeMin_nu_ovrdflg@ */ Scalar_BOOLEAN 0 AppSwcIpm_CM_boolean_flg 0.0 1.0 /end CHARACTERISTIC
/begin CHARACTERISTIC KIPM_TBOXBJSTimeMonth_nu_ovrdflg "" VALUE 0x0000 /* @ECU_Address@KIPM_TBOXBJSTimeMonth_nu_ovrdflg@ */ Scalar_BOOLEAN 0 AppSwcIpm_CM_boolean_flg 0.0 1.0 /end CHARACTERISTIC
/begin CHARACTERISTIC KIPM_TBOXBJSTimeSec_nu_ovrdflg "" VALUE 0x0000 /* @ECU_Address@KIPM_TBOXBJSTimeSec_nu_ovrdflg@ */ Scalar_BOOLEAN 0 AppSwcIpm_CM_boolean_flg 0.0 1.0 /end CHARACTERISTIC
/begin CHARACTERISTIC KIPM_TBOXBJSTimeYear_nu_ovrdflg "" VALUE 0x0000 /* @ECU_Address@KIPM_TBOXBJSTimeYear_nu_ovrdflg@ */ Scalar_BOOLEAN 0 AppSwcIpm_CM_boolean_flg 0.0 1.0 /end CHARACTERISTIC
/begin CHARACTERISTIC KIPM_TBOXLostCommOvrdSw_flg "" VALUE 0x0000 /* @ECU_Address@KIPM_TBOXLostCommOvrdSw_flg@ */ Scalar_BOOLEAN 0 AppSwcIpm_CM_boolean_flg 0.0 1.0 /end CHARACTERISTIC
/begin CHARACTERISTIC KIPM_TBOXLostCommOvrdVal_flg "" VALUE 0x0000 /* @ECU_Address@KIPM_TBOXLostCommOvrdVal_flg@ */ Scalar_BOOLEAN 0 AppSwcIpm_CM_boolean_flg 0.0 1.0 /end CHARACTERISTIC
/begin CHARACTERISTIC KIPM_APPVerMaxDflt_enum "" VALUE 0x0000 /* @ECU_Address@KIPM_APPVerMaxDflt_enum@ */ Scalar_UBYTE 0 AppSwcIpm_CM_uint8_enum 0.0 255.0 /end CHARACTERISTIC
/begin CHARACTERISTIC KIPM_APPVerMax_enum_ovrdval "" VALUE 0x0000 /* @ECU_Address@KIPM_APPVerMax_enum_ovrdval@ */ Scalar_UBYTE 0 AppSwcIpm_CM_uint8_enum 0.0 255.0 /end CHARACTERISTIC
/begin CHARACTERISTIC KIPM_APPVerMinDflt_enum "" VALUE 0x0000 /* @ECU_Address@KIPM_APPVerMinDflt_enum@ */ Scalar_UBYTE 0 AppSwcIpm_CM_uint8_enum 0.0 255.0 /end CHARACTERISTIC
/begin CHARACTERISTIC KIPM_APPVerMin_enum_ovrdval "" VALUE 0x0000 /* @ECU_Address@KIPM_APPVerMin_enum_ovrdval@ */ Scalar_UBYTE 0 AppSwcIpm_CM_uint8_enum 0.0 255.0 /end CHARACTERISTIC
/begin CHARACTERISTIC KIPM_BMSBatCapctyDflt_Ah "" VALUE 0x0000 /* @ECU_Address@KIPM_BMSBatCapctyDflt_Ah@ */ Scalar_UBYTE 0 AppSwcIpm_CM_uint8_Ah 0.0 255.0 /end CHARACTERISTIC
/begin CHARACTERISTIC KIPM_BMSBatCapcty_Ah_ovrdval "" VALUE 0x0000 /* @ECU_Address@KIPM_BMSBatCapcty_Ah_ovrdval@ */ Scalar_UBYTE 0 AppSwcIpm_CM_uint8_Ah 0.0 255.0 /end CHARACTERISTIC
/begin CHARACTERISTIC KIPM_BMSPackIDDflt_enum "" VALUE 0x0000 /* @ECU_Address@KIPM_BMSPackIDDflt_enum@ */ Scalar_UBYTE 0 AppSwcIpm_CM_uint8_enum 0.0 255.0 /end CHARACTERISTIC
/begin CHARACTERISTIC KIPM_BMSPackID_enum_ovrdval "" VALUE 0x0000 /* @ECU_Address@KIPM_BMSPackID_enum_ovrdval@ */ Scalar_UBYTE 0 AppSwcIpm_CM_uint8_enum 0.0 255.0 /end CHARACTERISTIC
/begin CHARACTERISTIC KIPM_BootVerDflt_enum "" VALUE 0x0000 /* @ECU_Address@KIPM_BootVerDflt_enum@ */ Scalar_UBYTE 0 AppSwcIpm_CM_uint8_enum 0.0 255.0 /end CHARACTERISTIC
/begin CHARACTERISTIC KIPM_BootVer_enum_ovrdval "" VALUE 0x0000 /* @ECU_Address@KIPM_BootVer_enum_ovrdval@ */ Scalar_UBYTE 0 AppSwcIpm_CM_uint8_enum 0.0 255.0 /end CHARACTERISTIC
/begin CHARACTERISTIC KIPM_CDCBackLadjvalDflt_enum "" VALUE 0x0000 /* @ECU_Address@KIPM_CDCBackLadjvalDflt_enum@ */ Scalar_UBYTE 0 AppSwcIpm_CM_uint8_enum 0.0 255.0 /end CHARACTERISTIC
/begin CHARACTERISTIC KIPM_CDCBackLadjval_enum_ovrdval "" VALUE 0x0000 /* @ECU_Address@KIPM_CDCBackLadjval_enum_ovrdval@ */ Scalar_UBYTE 0 AppSwcIpm_CM_uint8_enum 0.0 255.0 /end CHARACTERISTIC
/begin CHARACTERISTIC KIPM_COMPEcompSTDflt_enum "" VALUE 0x0000 /* @ECU_Address@KIPM_COMPEcompSTDflt_enum@ */ Scalar_UBYTE 0 AppSwcIpm_CM_uint8_enum 0.0 255.0 /end CHARACTERISTIC
/begin CHARACTERISTIC KIPM_COMPEcompST_enum_ovrdval "" VALUE 0x0000 /* @ECU_Address@KIPM_COMPEcompST_enum_ovrdval@ */ Scalar_UBYTE 0 AppSwcIpm_CM_uint8_enum 0.0 255.0 /end CHARACTERISTIC
/begin CHARACTERISTIC KIPM_COMPHvErrDflt_enum "" VALUE 0x0000 /* @ECU_Address@KIPM_COMPHvErrDflt_enum@ */ Scalar_UBYTE 0 AppSwcIpm_CM_uint8_enum 0.0 255.0 /end CHARACTERISTIC
/begin CHARACTERISTIC KIPM_COMPHvErr_enum_ovrdval "" VALUE 0x0000 /* @ECU_Address@KIPM_COMPHvErr_enum_ovrdval@ */ Scalar_UBYTE 0 AppSwcIpm_CM_uint8_enum 0.0 255.0 /end CHARACTERISTIC
/begin CHARACTERISTIC KIPM_COMPLvErrDflt_enum "" VALUE 0x0000 /* @ECU_Address@KIPM_COMPLvErrDflt_enum@ */ Scalar_UBYTE 0 AppSwcIpm_CM_uint8_enum 0.0 255.0 /end CHARACTERISTIC
/begin CHARACTERISTIC KIPM_COMPLvErr_enum_ovrdval "" VALUE 0x0000 /* @ECU_Address@KIPM_COMPLvErr_enum_ovrdval@ */ Scalar_UBYTE 0 AppSwcIpm_CM_uint8_enum 0.0 255.0 /end CHARACTERISTIC
/begin CHARACTERISTIC KIPM_COMPOvrCurrDflt_enum "" VALUE 0x0000 /* @ECU_Address@KIPM_COMPOvrCurrDflt_enum@ */ Scalar_UBYTE 0 AppSwcIpm_CM_uint8_enum 0.0 255.0 /end CHARACTERISTIC
/begin CHARACTERISTIC KIPM_COMPOvrCurr_enum_ovrdval "" VALUE 0x0000 /* @ECU_Address@KIPM_COMPOvrCurr_enum_ovrdval@ */ Scalar_UBYTE 0 AppSwcIpm_CM_uint8_enum 0.0 255.0 /end CHARACTERISTIC
/begin CHARACTERISTIC KIPM_COMPSelfChkErrDflt_enum "" VALUE 0x0000 /* @ECU_Address@KIPM_COMPSelfChkErrDflt_enum@ */ Scalar_UBYTE 0 AppSwcIpm_CM_uint8_enum 0.0 255.0 /end CHARACTERISTIC
/begin CHARACTERISTIC KIPM_COMPSelfChkErr_enum_ovrdval "" VALUE 0x0000 /* @ECU_Address@KIPM_COMPSelfChkErr_enum_ovrdval@ */ Scalar_UBYTE 0 AppSwcIpm_CM_uint8_enum 0.0 255.0 /end CHARACTERISTIC
/begin CHARACTERISTIC KIPM_ClientNumDflt_enum "" VALUE 0x0000 /* @ECU_Address@KIPM_ClientNumDflt_enum@ */ Scalar_UBYTE 0 AppSwcIpm_CM_uint8_enum 0.0 255.0 /end CHARACTERISTIC
/begin CHARACTERISTIC KIPM_ClientNum_enum_ovrdval "" VALUE 0x0000 /* @ECU_Address@KIPM_ClientNum_enum_ovrdval@ */ Scalar_UBYTE 0 AppSwcIpm_CM_uint8_enum 0.0 255.0 /end CHARACTERISTIC
/begin CHARACTERISTIC KIPM_EHBFltLvlDflt_enum "" VALUE 0x0000 /* @ECU_Address@KIPM_EHBFltLvlDflt_enum@ */ Scalar_UBYTE 0 AppSwcIpm_CM_uint8_enum 0.0 255.0 /end CHARACTERISTIC
/begin CHARACTERISTIC KIPM_EHBFltLvl_enum_ovrdval "" VALUE 0x0000 /* @ECU_Address@KIPM_EHBFltLvl_enum_ovrdval@ */ Scalar_UBYTE 0 AppSwcIpm_CM_uint8_enum 0.0 255.0 /end CHARACTERISTIC
/begin CHARACTERISTIC KIPM_HUACAutoCtlDflt_enum "" VALUE 0x0000 /* @ECU_Address@KIPM_HUACAutoCtlDflt_enum@ */ Scalar_UBYTE 0 AppSwcIpm_CM_uint8_enum 0.0 255.0 /end CHARACTERISTIC
/begin CHARACTERISTIC KIPM_HUACAutoCtl_enum_ovrdval "" VALUE 0x0000 /* @ECU_Address@KIPM_HUACAutoCtl_enum_ovrdval@ */ Scalar_UBYTE 0 AppSwcIpm_CM_uint8_enum 0.0 255.0 /end CHARACTERISTIC
/begin CHARACTERISTIC KIPM_HUACPwrCtlDflt_enum "" VALUE 0x0000 /* @ECU_Address@KIPM_HUACPwrCtlDflt_enum@ */ Scalar_UBYTE 0 AppSwcIpm_CM_uint8_enum 0.0 255.0 /end CHARACTERISTIC
/begin CHARACTERISTIC KIPM_HUACPwrCtl_enum_ovrdval "" VALUE 0x0000 /* @ECU_Address@KIPM_HUACPwrCtl_enum_ovrdval@ */ Scalar_UBYTE 0 AppSwcIpm_CM_uint8_enum 0.0 255.0 /end CHARACTERISTIC
/begin CHARACTERISTIC KIPM_HUAirInletModeSetDflt_enum "" VALUE 0x0000 /* @ECU_Address@KIPM_HUAirInletModeSetDflt_enum@ */ Scalar_UBYTE 0 AppSwcIpm_CM_uint8_enum 0.0 255.0 /end CHARACTERISTIC
/begin CHARACTERISTIC KIPM_HUAirInletModeSet_enum_ovrdval "" VALUE 0x0000 /* @ECU_Address@KIPM_HUAirInletModeSet_enum_ovrdval@ */ Scalar_UBYTE 0 AppSwcIpm_CM_uint8_enum 0.0 255.0 /end CHARACTERISTIC
/begin CHARACTERISTIC KIPM_HUBlwrModeSetDflt_enum "" VALUE 0x0000 /* @ECU_Address@KIPM_HUBlwrModeSetDflt_enum@ */ Scalar_UBYTE 0 AppSwcIpm_CM_uint8_enum 0.0 255.0 /end CHARACTERISTIC
/begin CHARACTERISTIC KIPM_HUBlwrModeSet_enum_ovrdval "" VALUE 0x0000 /* @ECU_Address@KIPM_HUBlwrModeSet_enum_ovrdval@ */ Scalar_UBYTE 0 AppSwcIpm_CM_uint8_enum 0.0 255.0 /end CHARACTERISTIC
/begin CHARACTERISTIC KIPM_HUChgWiprMtMdSwSetDflt_enum "" VALUE 0x0000 /* @ECU_Address@KIPM_HUChgWiprMtMdSwSetDflt_enum@ */ Scalar_UBYTE 0 AppSwcIpm_CM_uint8_enum 0.0 255.0 /end CHARACTERISTIC
/begin CHARACTERISTIC KIPM_HUChgWiprMtMdSwSet_enum_ovrdval "" VALUE 0x0000 /* @ECU_Address@KIPM_HUChgWiprMtMdSwSet_enum_ovrdval@ */ Scalar_UBYTE 0 AppSwcIpm_CM_uint8_enum 0.0 255.0 /end CHARACTERISTIC
/begin CHARACTERISTIC KIPM_HUDrvPwrSetDflt_cnt "" VALUE 0x0000 /* @ECU_Address@KIPM_HUDrvPwrSetDflt_cnt@ */ Scalar_UBYTE 0 AppSwcIpm_CM_uint8_cnt 0.0 255.0 /end CHARACTERISTIC
/begin CHARACTERISTIC KIPM_HUDrvPwrSet_cnt_ovrdval "" VALUE 0x0000 /* @ECU_Address@KIPM_HUDrvPwrSet_cnt_ovrdval@ */ Scalar_UBYTE 0 AppSwcIpm_CM_uint8_cnt 0.0 255.0 /end CHARACTERISTIC
/begin CHARACTERISTIC KIPM_HUFlwrMeHmCtrlDflt_enum "" VALUE 0x0000 /* @ECU_Address@KIPM_HUFlwrMeHmCtrlDflt_enum@ */ Scalar_UBYTE 0 AppSwcIpm_CM_uint8_enum 0.0 255.0 /end CHARACTERISTIC
/begin CHARACTERISTIC KIPM_HUFlwrMeHmCtrl_enum_ovrdval "" VALUE 0x0000 /* @ECU_Address@KIPM_HUFlwrMeHmCtrl_enum_ovrdval@ */ Scalar_UBYTE 0 AppSwcIpm_CM_uint8_enum 0.0 255.0 /end CHARACTERISTIC
/begin CHARACTERISTIC KIPM_HUFrntFanSpdSetDflt_enum "" VALUE 0x0000 /* @ECU_Address@KIPM_HUFrntFanSpdSetDflt_enum@ */ Scalar_UBYTE 0 AppSwcIpm_CM_uint8_enum 0.0 255.0 /end CHARACTERISTIC
/begin CHARACTERISTIC KIPM_HUFrntFanSpdSet_enum_ovrdval "" VALUE 0x0000 /* @ECU_Address@KIPM_HUFrntFanSpdSet_enum_ovrdval@ */ Scalar_UBYTE 0 AppSwcIpm_CM_uint8_enum 0.0 255.0 /end CHARACTERISTIC
/begin CHARACTERISTIC KIPM_HUHybEcoModeSetDflt_enum "" VALUE 0x0000 /* @ECU_Address@KIPM_HUHybEcoModeSetDflt_enum@ */ Scalar_UBYTE 0 AppSwcIpm_CM_uint8_enum 0.0 255.0 /end CHARACTERISTIC
/begin CHARACTERISTIC KIPM_HUHybEcoModeSet_enum_ovrdval "" VALUE 0x0000 /* @ECU_Address@KIPM_HUHybEcoModeSet_enum_ovrdval@ */ Scalar_UBYTE 0 AppSwcIpm_CM_uint8_enum 0.0 255.0 /end CHARACTERISTIC
/begin CHARACTERISTIC KIPM_HUIllmndEntryStsDflt_enum "" VALUE 0x0000 /* @ECU_Address@KIPM_HUIllmndEntryStsDflt_enum@ */ Scalar_UBYTE 0 AppSwcIpm_CM_uint8_enum 0.0 255.0 /end CHARACTERISTIC
/begin CHARACTERISTIC KIPM_HUIllmndEntrySts_enum_ovrdval "" VALUE 0x0000 /* @ECU_Address@KIPM_HUIllmndEntrySts_enum_ovrdval@ */ Scalar_UBYTE 0 AppSwcIpm_CM_uint8_enum 0.0 255.0 /end CHARACTERISTIC
/begin CHARACTERISTIC KIPM_HUIllmndLckStsDflt_enum "" VALUE 0x0000 /* @ECU_Address@KIPM_HUIllmndLckStsDflt_enum@ */ Scalar_UBYTE 0 AppSwcIpm_CM_uint8_enum 0.0 255.0 /end CHARACTERISTIC
/begin CHARACTERISTIC KIPM_HUIllmndLckSts_enum_ovrdval "" VALUE 0x0000 /* @ECU_Address@KIPM_HUIllmndLckSts_enum_ovrdval@ */ Scalar_UBYTE 0 AppSwcIpm_CM_uint8_enum 0.0 255.0 /end CHARACTERISTIC
/begin CHARACTERISTIC KIPM_HUIllmndUnlckStsDflt_enum "" VALUE 0x0000 /* @ECU_Address@KIPM_HUIllmndUnlckStsDflt_enum@ */ Scalar_UBYTE 0 AppSwcIpm_CM_uint8_enum 0.0 255.0 /end CHARACTERISTIC
/begin CHARACTERISTIC KIPM_HUIllmndUnlckSts_enum_ovrdval "" VALUE 0x0000 /* @ECU_Address@KIPM_HUIllmndUnlckSts_enum_ovrdval@ */ Scalar_UBYTE 0 AppSwcIpm_CM_uint8_enum 0.0 255.0 /end CHARACTERISTIC
/begin CHARACTERISTIC KIPM_HULckHornOnStDflt_enum "" VALUE 0x0000 /* @ECU_Address@KIPM_HULckHornOnStDflt_enum@ */ Scalar_UBYTE 0 AppSwcIpm_CM_uint8_enum 0.0 255.0 /end CHARACTERISTIC
/begin CHARACTERISTIC KIPM_HULckHornOnSt_enum_ovrdval "" VALUE 0x0000 /* @ECU_Address@KIPM_HULckHornOnSt_enum_ovrdval@ */ Scalar_UBYTE 0 AppSwcIpm_CM_uint8_enum 0.0 255.0 /end CHARACTERISTIC
/begin CHARACTERISTIC KIPM_HULeftTempSetDflt_enum "" VALUE 0x0000 /* @ECU_Address@KIPM_HULeftTempSetDflt_enum@ */ Scalar_UBYTE 0 AppSwcIpm_CM_uint8_enum 0.0 255.0 /end CHARACTERISTIC
/begin CHARACTERISTIC KIPM_HULeftTempSet_enum_ovrdval "" VALUE 0x0000 /* @ECU_Address@KIPM_HULeftTempSet_enum_ovrdval@ */ Scalar_UBYTE 0 AppSwcIpm_CM_uint8_enum 0.0 255.0 /end CHARACTERISTIC
/begin CHARACTERISTIC KIPM_HUMaiDrvrSeatHeatDflt_enum "" VALUE 0x0000 /* @ECU_Address@KIPM_HUMaiDrvrSeatHeatDflt_enum@ */ Scalar_UBYTE 0 AppSwcIpm_CM_uint8_enum 0.0 255.0 /end CHARACTERISTIC
/begin CHARACTERISTIC KIPM_HUMaiDrvrSeatHeat_enum_ovrdval "" VALUE 0x0000 /* @ECU_Address@KIPM_HUMaiDrvrSeatHeat_enum_ovrdval@ */ Scalar_UBYTE 0 AppSwcIpm_CM_uint8_enum 0.0 255.0 /end CHARACTERISTIC
/begin CHARACTERISTIC KIPM_HUManlDefrstCtlDflt_enum "" VALUE 0x0000 /* @ECU_Address@KIPM_HUManlDefrstCtlDflt_enum@ */ Scalar_UBYTE 0 AppSwcIpm_CM_uint8_enum 0.0 255.0 /end CHARACTERISTIC
/begin CHARACTERISTIC KIPM_HUManlDefrstCtl_enum_ovrdval "" VALUE 0x0000 /* @ECU_Address@KIPM_HUManlDefrstCtl_enum_ovrdval@ */ Scalar_UBYTE 0 AppSwcIpm_CM_uint8_enum 0.0 255.0 /end CHARACTERISTIC
/begin CHARACTERISTIC KIPM_HUOvrspdCntrlLckSetDflt_enum "" VALUE 0x0000 /* @ECU_Address@KIPM_HUOvrspdCntrlLckSetDflt_enum@ */ Scalar_UBYTE 0 AppSwcIpm_CM_uint8_enum 0.0 255.0 /end CHARACTERISTIC
/begin CHARACTERISTIC KIPM_HUOvrspdCntrlLckSet_enum_ovrdval "" VALUE 0x0000 /* @ECU_Address@KIPM_HUOvrspdCntrlLckSet_enum_ovrdval@ */ Scalar_UBYTE 0 AppSwcIpm_CM_uint8_enum 0.0 255.0 /end CHARACTERISTIC
/begin CHARACTERISTIC KIPM_HUParkAutoUnlckSetDflt_enum "" VALUE 0x0000 /* @ECU_Address@KIPM_HUParkAutoUnlckSetDflt_enum@ */ Scalar_UBYTE 0 AppSwcIpm_CM_uint8_enum 0.0 255.0 /end CHARACTERISTIC
/begin CHARACTERISTIC KIPM_HUParkAutoUnlckSet_enum_ovrdval "" VALUE 0x0000 /* @ECU_Address@KIPM_HUParkAutoUnlckSet_enum_ovrdval@ */ Scalar_UBYTE 0 AppSwcIpm_CM_uint8_enum 0.0 255.0 /end CHARACTERISTIC
/begin CHARACTERISTIC KIPM_HURecupPwrSetDflt_pct "" VALUE 0x0000 /* @ECU_Address@KIPM_HURecupPwrSetDflt_pct@ */ Scalar_UBYTE 0 AppSwcIpm_CM_uint8_pct 0.0 255.0 /end CHARACTERISTIC
/begin CHARACTERISTIC KIPM_HURecupPwrSet_pct_ovrdval "" VALUE 0x0000 /* @ECU_Address@KIPM_HURecupPwrSet_pct_ovrdval@ */ Scalar_UBYTE 0 AppSwcIpm_CM_uint8_pct 0.0 255.0 /end CHARACTERISTIC
/begin CHARACTERISTIC KIPM_HURrMirrHeatDflt_enum "" VALUE 0x0000 /* @ECU_Address@KIPM_HURrMirrHeatDflt_enum@ */ Scalar_UBYTE 0 AppSwcIpm_CM_uint8_enum 0.0 255.0 /end CHARACTERISTIC
/begin CHARACTERISTIC KIPM_HURrMirrHeat_enum_ovrdval "" VALUE 0x0000 /* @ECU_Address@KIPM_HURrMirrHeat_enum_ovrdval@ */ Scalar_UBYTE 0 AppSwcIpm_CM_uint8_enum 0.0 255.0 /end CHARACTERISTIC
/begin CHARACTERISTIC KIPM_HUSteerWhlHeatDflt_enum "" VALUE 0x0000 /* @ECU_Address@KIPM_HUSteerWhlHeatDflt_enum@ */ Scalar_UBYTE 0 AppSwcIpm_CM_uint8_enum 0.0 255.0 /end CHARACTERISTIC
/begin CHARACTERISTIC KIPM_HUSteerWhlHeat_enum_ovrdval "" VALUE 0x0000 /* @ECU_Address@KIPM_HUSteerWhlHeat_enum_ovrdval@ */ Scalar_UBYTE 0 AppSwcIpm_CM_uint8_enum 0.0 255.0 /end CHARACTERISTIC
/begin CHARACTERISTIC KIPM_HUTrnkLckSwCtrlDflt_enum "" VALUE 0x0000 /* @ECU_Address@KIPM_HUTrnkLckSwCtrlDflt_enum@ */ Scalar_UBYTE 0 AppSwcIpm_CM_uint8_enum 0.0 255.0 /end CHARACTERISTIC
/begin CHARACTERISTIC KIPM_HUTrnkLckSwCtrl_enum_ovrdval "" VALUE 0x0000 /* @ECU_Address@KIPM_HUTrnkLckSwCtrl_enum_ovrdval@ */ Scalar_UBYTE 0 AppSwcIpm_CM_uint8_enum 0.0 255.0 /end CHARACTERISTIC
/begin CHARACTERISTIC KIPM_HUWiprIntlTmSetDflt_enum "" VALUE 0x0000 /* @ECU_Address@KIPM_HUWiprIntlTmSetDflt_enum@ */ Scalar_UBYTE 0 AppSwcIpm_CM_uint8_enum 0.0 255.0 /end CHARACTERISTIC
/begin CHARACTERISTIC KIPM_HUWiprIntlTmSet_enum_ovrdval "" VALUE 0x0000 /* @ECU_Address@KIPM_HUWiprIntlTmSet_enum_ovrdval@ */ Scalar_UBYTE 0 AppSwcIpm_CM_uint8_enum 0.0 255.0 /end CHARACTERISTIC
/begin CHARACTERISTIC KIPM_HVCHStDflt_enum "" VALUE 0x0000 /* @ECU_Address@KIPM_HVCHStDflt_enum@ */ Scalar_UBYTE 0 AppSwcIpm_CM_uint8_enum 0.0 255.0 /end CHARACTERISTIC
/begin CHARACTERISTIC KIPM_HVCHSt_enum_ovrdval "" VALUE 0x0000 /* @ECU_Address@KIPM_HVCHSt_enum_ovrdval@ */ Scalar_UBYTE 0 AppSwcIpm_CM_uint8_enum 0.0 255.0 /end CHARACTERISTIC
/begin CHARACTERISTIC KIPM_HVCHWorkModeDflt_enum "" VALUE 0x0000 /* @ECU_Address@KIPM_HVCHWorkModeDflt_enum@ */ Scalar_UBYTE 0 AppSwcIpm_CM_uint8_enum 0.0 255.0 /end CHARACTERISTIC
/begin CHARACTERISTIC KIPM_HVCHWorkMode_enum_ovrdval "" VALUE 0x0000 /* @ECU_Address@KIPM_HVCHWorkMode_enum_ovrdval@ */ Scalar_UBYTE 0 AppSwcIpm_CM_uint8_enum 0.0 255.0 /end CHARACTERISTIC
/begin CHARACTERISTIC KIPM_HVCHWorkStDflt_enum "" VALUE 0x0000 /* @ECU_Address@KIPM_HVCHWorkStDflt_enum@ */ Scalar_UBYTE 0 AppSwcIpm_CM_uint8_enum 0.0 255.0 /end CHARACTERISTIC
/begin CHARACTERISTIC KIPM_HVCHWorkSt_enum_ovrdval "" VALUE 0x0000 /* @ECU_Address@KIPM_HVCHWorkSt_enum_ovrdval@ */ Scalar_UBYTE 0 AppSwcIpm_CM_uint8_enum 0.0 255.0 /end CHARACTERISTIC
/begin CHARACTERISTIC KIPM_HwVerMaxDflt_enum "" VALUE 0x0000 /* @ECU_Address@KIPM_HwVerMaxDflt_enum@ */ Scalar_UBYTE 0 AppSwcIpm_CM_uint8_enum 0.0 255.0 /end CHARACTERISTIC
/begin CHARACTERISTIC KIPM_HwVerMax_enum_ovrdval "" VALUE 0x0000 /* @ECU_Address@KIPM_HwVerMax_enum_ovrdval@ */ Scalar_UBYTE 0 AppSwcIpm_CM_uint8_enum 0.0 255.0 /end CHARACTERISTIC
/begin CHARACTERISTIC KIPM_HwVerMinDflt_enum "" VALUE 0x0000 /* @ECU_Address@KIPM_HwVerMinDflt_enum@ */ Scalar_UBYTE 0 AppSwcIpm_CM_uint8_enum 0.0 255.0 /end CHARACTERISTIC
/begin CHARACTERISTIC KIPM_HwVerMin_enum_ovrdval "" VALUE 0x0000 /* @ECU_Address@KIPM_HwVerMin_enum_ovrdval@ */ Scalar_UBYTE 0 AppSwcIpm_CM_uint8_enum 0.0 255.0 /end CHARACTERISTIC
/begin CHARACTERISTIC KIPM_INVLrngData02Dflt_nu "" VALUE 0x0000 /* @ECU_Address@KIPM_INVLrngData02Dflt_nu@ */ Scalar_UBYTE 0 AppSwcIpm_CM_uint8_nu 0.0 255.0 /end CHARACTERISTIC
/begin CHARACTERISTIC KIPM_INVLrngData02_nu_ovrdval "" VALUE 0x0000 /* @ECU_Address@KIPM_INVLrngData02_nu_ovrdval@ */ Scalar_UBYTE 0 AppSwcIpm_CM_uint8_nu 0.0 255.0 /end CHARACTERISTIC
/begin CHARACTERISTIC KIPM_INVLrngData03Dflt_nu "" VALUE 0x0000 /* @ECU_Address@KIPM_INVLrngData03Dflt_nu@ */ Scalar_UBYTE 0 AppSwcIpm_CM_uint8_nu 0.0 255.0 /end CHARACTERISTIC
/begin CHARACTERISTIC KIPM_INVLrngData03_nu_ovrdval "" VALUE 0x0000 /* @ECU_Address@KIPM_INVLrngData03_nu_ovrdval@ */ Scalar_UBYTE 0 AppSwcIpm_CM_uint8_nu 0.0 255.0 /end CHARACTERISTIC
/begin CHARACTERISTIC KIPM_INVLrngData04Dflt_nu "" VALUE 0x0000 /* @ECU_Address@KIPM_INVLrngData04Dflt_nu@ */ Scalar_UBYTE 0 AppSwcIpm_CM_uint8_nu 0.0 255.0 /end CHARACTERISTIC
/begin CHARACTERISTIC KIPM_INVLrngData04_nu_ovrdval "" VALUE 0x0000 /* @ECU_Address@KIPM_INVLrngData04_nu_ovrdval@ */ Scalar_UBYTE 0 AppSwcIpm_CM_uint8_nu 0.0 255.0 /end CHARACTERISTIC
/begin CHARACTERISTIC KIPM_INVLrngData05Dflt_nu "" VALUE 0x0000 /* @ECU_Address@KIPM_INVLrngData05Dflt_nu@ */ Scalar_UBYTE 0 AppSwcIpm_CM_uint8_nu 0.0 255.0 /end CHARACTERISTIC
/begin CHARACTERISTIC KIPM_INVLrngData05_nu_ovrdval "" VALUE 0x0000 /* @ECU_Address@KIPM_INVLrngData05_nu_ovrdval@ */ Scalar_UBYTE 0 AppSwcIpm_CM_uint8_nu 0.0 255.0 /end CHARACTERISTIC
/begin CHARACTERISTIC KIPM_INVLrngData06Dflt_nu "" VALUE 0x0000 /* @ECU_Address@KIPM_INVLrngData06Dflt_nu@ */ Scalar_UBYTE 0 AppSwcIpm_CM_uint8_nu 0.0 255.0 /end CHARACTERISTIC
/begin CHARACTERISTIC KIPM_INVLrngData06_nu_ovrdval "" VALUE 0x0000 /* @ECU_Address@KIPM_INVLrngData06_nu_ovrdval@ */ Scalar_UBYTE 0 AppSwcIpm_CM_uint8_nu 0.0 255.0 /end CHARACTERISTIC
/begin CHARACTERISTIC KIPM_INVLrngData07Dflt_nu "" VALUE 0x0000 /* @ECU_Address@KIPM_INVLrngData07Dflt_nu@ */ Scalar_UBYTE 0 AppSwcIpm_CM_uint8_nu 0.0 255.0 /end CHARACTERISTIC
/begin CHARACTERISTIC KIPM_INVLrngData07_nu_ovrdval "" VALUE 0x0000 /* @ECU_Address@KIPM_INVLrngData07_nu_ovrdval@ */ Scalar_UBYTE 0 AppSwcIpm_CM_uint8_nu 0.0 255.0 /end CHARACTERISTIC
/begin CHARACTERISTIC KIPM_INVLrngStsDflt_enum "" VALUE 0x0000 /* @ECU_Address@KIPM_INVLrngStsDflt_enum@ */ Scalar_UBYTE 0 AppSwcIpm_CM_uint8_enum 0.0 255.0 /end CHARACTERISTIC
/begin CHARACTERISTIC KIPM_INVLrngSts_enum_ovrdval "" VALUE 0x0000 /* @ECU_Address@KIPM_INVLrngSts_enum_ovrdval@ */ Scalar_UBYTE 0 AppSwcIpm_CM_uint8_enum 0.0 255.0 /end CHARACTERISTIC
/begin CHARACTERISTIC KIPM_INVLrngSubIDDflt_cnt "" VALUE 0x0000 /* @ECU_Address@KIPM_INVLrngSubIDDflt_cnt@ */ Scalar_UBYTE 0 AppSwcIpm_CM_uint8_cnt 0.0 255.0 /end CHARACTERISTIC
/begin CHARACTERISTIC KIPM_INVLrngSubID_cnt_ovrdval "" VALUE 0x0000 /* @ECU_Address@KIPM_INVLrngSubID_cnt_ovrdval@ */ Scalar_UBYTE 0 AppSwcIpm_CM_uint8_cnt 0.0 255.0 /end CHARACTERISTIC
/begin CHARACTERISTIC KIPM_IPUDCCSysFailStaDflt_enum "" VALUE 0x0000 /* @ECU_Address@KIPM_IPUDCCSysFailStaDflt_enum@ */ Scalar_UBYTE 0 AppSwcIpm_CM_uint8_enum 0.0 255.0 /end CHARACTERISTIC
/begin CHARACTERISTIC KIPM_IPUDCCSysFailSta_enum_ovrdval "" VALUE 0x0000 /* @ECU_Address@KIPM_IPUDCCSysFailSta_enum_ovrdval@ */ Scalar_UBYTE 0 AppSwcIpm_CM_uint8_enum 0.0 255.0 /end CHARACTERISTIC
/begin CHARACTERISTIC KIPM_IPUOBCSysFailStaDflt_enum "" VALUE 0x0000 /* @ECU_Address@KIPM_IPUOBCSysFailStaDflt_enum@ */ Scalar_UBYTE 0 AppSwcIpm_CM_uint8_enum 0.0 255.0 /end CHARACTERISTIC
/begin CHARACTERISTIC KIPM_IPUOBCSysFailSta_enum_ovrdval "" VALUE 0x0000 /* @ECU_Address@KIPM_IPUOBCSysFailSta_enum_ovrdval@ */ Scalar_UBYTE 0 AppSwcIpm_CM_uint8_enum 0.0 255.0 /end CHARACTERISTIC
/begin CHARACTERISTIC KIPM_TBOXBJSTimeDayDflt_nu "" VALUE 0x0000 /* @ECU_Address@KIPM_TBOXBJSTimeDayDflt_nu@ */ Scalar_UBYTE 0 AppSwcIpm_CM_uint8_nu 0.0 255.0 /end CHARACTERISTIC
/begin CHARACTERISTIC KIPM_TBOXBJSTimeDay_nu_ovrdval "" VALUE 0x0000 /* @ECU_Address@KIPM_TBOXBJSTimeDay_nu_ovrdval@ */ Scalar_UBYTE 0 AppSwcIpm_CM_uint8_enum 0.0 255.0 /end CHARACTERISTIC
/begin CHARACTERISTIC KIPM_TBOXBJSTimeHourDflt_nu "" VALUE 0x0000 /* @ECU_Address@KIPM_TBOXBJSTimeHourDflt_nu@ */ Scalar_UBYTE 0 AppSwcIpm_CM_uint8_nu 0.0 255.0 /end CHARACTERISTIC
/begin CHARACTERISTIC KIPM_TBOXBJSTimeHour_nu_ovrdval "" VALUE 0x0000 /* @ECU_Address@KIPM_TBOXBJSTimeHour_nu_ovrdval@ */ Scalar_UBYTE 0 AppSwcIpm_CM_uint8_enum 0.0 255.0 /end CHARACTERISTIC
/begin CHARACTERISTIC KIPM_TBOXBJSTimeMinDflt_nu "" VALUE 0x0000 /* @ECU_Address@KIPM_TBOXBJSTimeMinDflt_nu@ */ Scalar_UBYTE 0 AppSwcIpm_CM_uint8_nu 0.0 255.0 /end CHARACTERISTIC
/begin CHARACTERISTIC KIPM_TBOXBJSTimeMin_nu_ovrdval "" VALUE 0x0000 /* @ECU_Address@KIPM_TBOXBJSTimeMin_nu_ovrdval@ */ Scalar_UBYTE 0 AppSwcIpm_CM_uint8_enum 0.0 255.0 /end CHARACTERISTIC
/begin CHARACTERISTIC KIPM_TBOXBJSTimeMonthDflt_nu "" VALUE 0x0000 /* @ECU_Address@KIPM_TBOXBJSTimeMonthDflt_nu@ */ Scalar_UBYTE 0 AppSwcIpm_CM_uint8_nu 0.0 255.0 /end CHARACTERISTIC
/begin CHARACTERISTIC KIPM_TBOXBJSTimeMonth_nu_ovrdval "" VALUE 0x0000 /* @ECU_Address@KIPM_TBOXBJSTimeMonth_nu_ovrdval@ */ Scalar_UBYTE 0 AppSwcIpm_CM_uint8_enum 0.0 255.0 /end CHARACTERISTIC
/begin CHARACTERISTIC KIPM_TBOXBJSTimeSecDflt_nu "" VALUE 0x0000 /* @ECU_Address@KIPM_TBOXBJSTimeSecDflt_nu@ */ Scalar_UBYTE 0 AppSwcIpm_CM_uint8_nu 0.0 255.0 /end CHARACTERISTIC
/begin CHARACTERISTIC KIPM_TBOXBJSTimeSec_nu_ovrdval "" VALUE 0x0000 /* @ECU_Address@KIPM_TBOXBJSTimeSec_nu_ovrdval@ */ Scalar_UBYTE 0 AppSwcIpm_CM_uint8_enum 0.0 255.0 /end CHARACTERISTIC
/begin MEASUREMENT VIPM_EPSRotSpd_degps "" FLOAT32_IEEE AppSwcIpm_CM_single_degps 0 0 -100000.0 100000.0 ECU_ADDRESS 0x0000 /* @ECU_Address@VIPM_EPSRotSpd_degps@ */ /end MEASUREMENT
/begin MEASUREMENT VIPM_EHBBrkPwrRecupTarWhlTq_Nm "" FLOAT32_IEEE AppSwcIpm_CM_single_Nm 0 0 -100000.0 100000.0 ECU_ADDRESS 0x0000 /* @ECU_Address@VIPM_EHBBrkPwrRecupTarWhlTq_Nm@ */ /end MEASUREMENT
/begin MEASUREMENT VIPM_EHBBrkPedlValPerc_pct "" FLOAT32_IEEE AppSwcIpm_CM_single_pct 0 0 -100000.0 100000.0 ECU_ADDRESS 0x0000 /* @ECU_Address@VIPM_EHBBrkPedlValPerc_pct@ */ /end MEASUREMENT
/begin MEASUREMENT VIPM_IPUOBCTempInt_C "" FLOAT32_IEEE AppSwcIpm_CM_single_C 0 0 -100000.0 100000.0 ECU_ADDRESS 0x0000 /* @ECU_Address@VIPM_IPUOBCTempInt_C@ */ /end MEASUREMENT
/begin MEASUREMENT VIPM_IPUOBCACMaxPwrAllow_kW "" FLOAT32_IEEE AppSwcIpm_CM_single_kW 0 0 -100000.0 100000.0 ECU_ADDRESS 0x0000 /* @ECU_Address@VIPM_IPUOBCACMaxPwrAllow_kW@ */ /end MEASUREMENT
/begin MEASUREMENT VIPM_IPUDeviceIntTemp_C "" FLOAT32_IEEE AppSwcIpm_CM_single_C 0 0 -100000.0 100000.0 ECU_ADDRESS 0x0000 /* @ECU_Address@VIPM_IPUDeviceIntTemp_C@ */ /end MEASUREMENT
/begin MEASUREMENT VIPM_IPUOBCInletActPwr_kW "" FLOAT32_IEEE AppSwcIpm_CM_single_kW 0 0 -100000.0 100000.0 ECU_ADDRESS 0x0000 /* @ECU_Address@VIPM_IPUOBCInletActPwr_kW@ */ /end MEASUREMENT
/begin MEASUREMENT VIPM_IPUOBCHVDCActVol_V "" FLOAT32_IEEE AppSwcIpm_CM_single_V 0 0 -100000.0 100000.0 ECU_ADDRESS 0x0000 /* @ECU_Address@VIPM_IPUOBCHVDCActVol_V@ */ /end MEASUREMENT
/begin MEASUREMENT VIPM_IPUOBCHVDCActCur_A "" FLOAT32_IEEE AppSwcIpm_CM_single_A 0 0 -100000.0 100000.0 ECU_ADDRESS 0x0000 /* @ECU_Address@VIPM_IPUOBCHVDCActCur_A@ */ /end MEASUREMENT
/begin MEASUREMENT VIPM_IPUDCCHiVoltActVolt_V "" FLOAT32_IEEE AppSwcIpm_CM_single_V 0 0 -100000.0 100000.0 ECU_ADDRESS 0x0000 /* @ECU_Address@VIPM_IPUDCCHiVoltActVolt_V@ */ /end MEASUREMENT
/begin MEASUREMENT VIPM_IPUDCCHiVoltActCurnt_A "" FLOAT32_IEEE AppSwcIpm_CM_single_A 0 0 -100000.0 100000.0 ECU_ADDRESS 0x0000 /* @ECU_Address@VIPM_IPUDCCHiVoltActCurnt_A@ */ /end MEASUREMENT
/begin MEASUREMENT VIPM_IPUDCCLoVoltActVolt_V "" FLOAT32_IEEE AppSwcIpm_CM_single_V 0 0 -100000.0 100000.0 ECU_ADDRESS 0x0000 /* @ECU_Address@VIPM_IPUDCCLoVoltActVolt_V@ */ /end MEASUREMENT
/begin MEASUREMENT VIPM_IPUDCCLoVoltActCurnt_A "" FLOAT32_IEEE AppSwcIpm_CM_single_A 0 0 -100000.0 100000.0 ECU_ADDRESS 0x0000 /* @ECU_Address@VIPM_IPUDCCLoVoltActCurnt_A@ */ /end MEASUREMENT
/begin MEASUREMENT VIPM_BMSHVBatCellTempMin_C "" FLOAT32_IEEE AppSwcIpm_CM_single_C 0 0 -100000.0 100000.0 ECU_ADDRESS 0x0000 /* @ECU_Address@VIPM_BMSHVBatCellTempMin_C@ */ /end MEASUREMENT
/begin MEASUREMENT VIPM_BMSHVBatCellTempMax_C "" FLOAT32_IEEE AppSwcIpm_CM_single_C 0 0 -100000.0 100000.0 ECU_ADDRESS 0x0000 /* @ECU_Address@VIPM_BMSHVBatCellTempMax_C@ */ /end MEASUREMENT
/begin MEASUREMENT VIPM_BMSHVBatCellTempAve_C "" FLOAT32_IEEE AppSwcIpm_CM_single_C 0 0 -100000.0 100000.0 ECU_ADDRESS 0x0000 /* @ECU_Address@VIPM_BMSHVBatCellTempAve_C@ */ /end MEASUREMENT
/begin MEASUREMENT VIPM_HVCHPwr_kW "" FLOAT32_IEEE AppSwcIpm_CM_single_kW 0 0 -100000.0 100000.0 ECU_ADDRESS 0x0000 /* @ECU_Address@VIPM_HVCHPwr_kW@ */ /end MEASUREMENT
/begin MEASUREMENT VIPM_HVCHHVVolts_V "" FLOAT32_IEEE AppSwcIpm_CM_single_V 0 0 -100000.0 100000.0 ECU_ADDRESS 0x0000 /* @ECU_Address@VIPM_HVCHHVVolts_V@ */ /end MEASUREMENT
/begin MEASUREMENT VIPM_HVCHCurr_A "" FLOAT32_IEEE AppSwcIpm_CM_single_A 0 0 -100000.0 100000.0 ECU_ADDRESS 0x0000 /* @ECU_Address@VIPM_HVCHCurr_A@ */ /end MEASUREMENT
/begin MEASUREMENT VIPM_HVCHPCBTemp_C "" FLOAT32_IEEE AppSwcIpm_CM_single_C 0 0 -100000.0 100000.0 ECU_ADDRESS 0x0000 /* @ECU_Address@VIPM_HVCHPCBTemp_C@ */ /end MEASUREMENT
/begin MEASUREMENT VIPM_HVCHOutlTemp_C "" FLOAT32_IEEE AppSwcIpm_CM_single_C 0 0 -100000.0 100000.0 ECU_ADDRESS 0x0000 /* @ECU_Address@VIPM_HVCHOutlTemp_C@ */ /end MEASUREMENT
/begin MEASUREMENT VIPM_HVCHInletTemp_C "" FLOAT32_IEEE AppSwcIpm_CM_single_C 0 0 -100000.0 100000.0 ECU_ADDRESS 0x0000 /* @ECU_Address@VIPM_HVCHInletTemp_C@ */ /end MEASUREMENT
/begin MEASUREMENT VIPM_COMPTemp_C "" FLOAT32_IEEE AppSwcIpm_CM_single_C 0 0 -100000.0 100000.0 ECU_ADDRESS 0x0000 /* @ECU_Address@VIPM_COMPTemp_C@ */ /end MEASUREMENT
/begin MEASUREMENT VIPM_COMPInCurr_A "" FLOAT32_IEEE AppSwcIpm_CM_single_A 0 0 -100000.0 100000.0 ECU_ADDRESS 0x0000 /* @ECU_Address@VIPM_COMPInCurr_A@ */ /end MEASUREMENT
/begin MEASUREMENT VIPM_COMPHiVolt_V "" FLOAT32_IEEE AppSwcIpm_CM_single_V 0 0 -100000.0 100000.0 ECU_ADDRESS 0x0000 /* @ECU_Address@VIPM_COMPHiVolt_V@ */ /end MEASUREMENT
/begin MEASUREMENT VIPM_COMPEcompActSpd_rpm "" FLOAT32_IEEE AppSwcIpm_CM_single_rpm 0 0 -100000.0 100000.0 ECU_ADDRESS 0x0000 /* @ECU_Address@VIPM_COMPEcompActSpd_rpm@ */ /end MEASUREMENT
/begin MEASUREMENT VIPM_TBOXBJSTimeYear_nu "" UWORD AppSwcIpm_CM_uint16_nu 0 0 0.0 65535.0 ECU_ADDRESS 0x0000 /* @ECU_Address@VIPM_TBOXBJSTimeYear_nu@ */ /end MEASUREMENT
/begin MEASUREMENT VIPM_HVCHFltCod_enum "" UWORD AppSwcIpm_CM_uint16_enum 0 0 0.0 65535.0 ECU_ADDRESS 0x0000 /* @ECU_Address@VIPM_HVCHFltCod_enum@ */ /end MEASUREMENT
/begin MEASUREMENT VIPM_EHBFltLvl_enum "" UBYTE AppSwcIpm_CM_uint8_enum 0 0 0.0 255.0 ECU_ADDRESS 0x0000 /* @ECU_Address@VIPM_EHBFltLvl_enum@ */ /end MEASUREMENT
/begin MEASUREMENT VIPM_BMSPackID_enum "" UBYTE AppSwcIpm_CM_uint8_enum 0 0 0.0 255.0 ECU_ADDRESS 0x0000 /* @ECU_Address@VIPM_BMSPackID_enum@ */ /end MEASUREMENT
/begin MEASUREMENT VIPM_BMSBatCapcty_Ah "" UBYTE AppSwcIpm_CM_uint8_Ah 0 0 0.0 255.0 ECU_ADDRESS 0x0000 /* @ECU_Address@VIPM_BMSBatCapcty_Ah@ */ /end MEASUREMENT
/begin MEASUREMENT VIPM_IPUOBCSysFailSta_enum "" UBYTE AppSwcIpm_CM_uint8_enum 0 0 0.0 255.0 ECU_ADDRESS 0x0000 /* @ECU_Address@VIPM_IPUOBCSysFailSta_enum@ */ /end MEASUREMENT
/begin MEASUREMENT VIPM_IPUDCCSysFailSta_enum "" UBYTE AppSwcIpm_CM_uint8_enum 0 0 0.0 255.0 ECU_ADDRESS 0x0000 /* @ECU_Address@VIPM_IPUDCCSysFailSta_enum@ */ /end MEASUREMENT
/begin MEASUREMENT VIPM_INVLrngSubID_cnt "" UBYTE AppSwcIpm_CM_uint8_cnt 0 0 0.0 255.0 ECU_ADDRESS 0x0000 /* @ECU_Address@VIPM_INVLrngSubID_cnt@ */ /end MEASUREMENT
/begin MEASUREMENT VIPM_INVLrngSts_enum "" UBYTE AppSwcIpm_CM_uint8_enum 0 0 0.0 255.0 ECU_ADDRESS 0x0000 /* @ECU_Address@VIPM_INVLrngSts_enum@ */ /end MEASUREMENT
/begin MEASUREMENT VIPM_INVLrngData07_nu "" UBYTE AppSwcIpm_CM_uint8_nu 0 0 0.0 255.0 ECU_ADDRESS 0x0000 /* @ECU_Address@VIPM_INVLrngData07_nu@ */ /end MEASUREMENT
/begin MEASUREMENT VIPM_INVLrngData06_nu "" UBYTE AppSwcIpm_CM_uint8_nu 0 0 0.0 255.0 ECU_ADDRESS 0x0000 /* @ECU_Address@VIPM_INVLrngData06_nu@ */ /end MEASUREMENT
/begin MEASUREMENT VIPM_INVLrngData05_nu "" UBYTE AppSwcIpm_CM_uint8_nu 0 0 0.0 255.0 ECU_ADDRESS 0x0000 /* @ECU_Address@VIPM_INVLrngData05_nu@ */ /end MEASUREMENT
/begin MEASUREMENT VIPM_INVLrngData04_nu "" UBYTE AppSwcIpm_CM_uint8_nu 0 0 0.0 255.0 ECU_ADDRESS 0x0000 /* @ECU_Address@VIPM_INVLrngData04_nu@ */ /end MEASUREMENT
/begin MEASUREMENT VIPM_INVLrngData03_nu "" UBYTE AppSwcIpm_CM_uint8_nu 0 0 0.0 255.0 ECU_ADDRESS 0x0000 /* @ECU_Address@VIPM_INVLrngData03_nu@ */ /end MEASUREMENT
/begin MEASUREMENT VIPM_INVLrngData02_nu "" UBYTE AppSwcIpm_CM_uint8_nu 0 0 0.0 255.0 ECU_ADDRESS 0x0000 /* @ECU_Address@VIPM_INVLrngData02_nu@ */ /end MEASUREMENT
/begin MEASUREMENT VIPM_HUWiprIntlTmSet_enum "" UBYTE AppSwcIpm_CM_uint8_enum 0 0 0.0 255.0 ECU_ADDRESS 0x0000 /* @ECU_Address@VIPM_HUWiprIntlTmSet_enum@ */ /end MEASUREMENT
/begin MEASUREMENT VIPM_HUTrnkLckSwCtrl_enum "" UBYTE AppSwcIpm_CM_uint8_enum 0 0 0.0 255.0 ECU_ADDRESS 0x0000 /* @ECU_Address@VIPM_HUTrnkLckSwCtrl_enum@ */ /end MEASUREMENT
/begin MEASUREMENT VIPM_HUSteerWhlHeat_enum "" UBYTE AppSwcIpm_CM_uint8_enum 0 0 0.0 255.0 ECU_ADDRESS 0x0000 /* @ECU_Address@VIPM_HUSteerWhlHeat_enum@ */ /end MEASUREMENT
/begin MEASUREMENT VIPM_HURrMirrHeat_enum "" UBYTE AppSwcIpm_CM_uint8_enum 0 0 0.0 255.0 ECU_ADDRESS 0x0000 /* @ECU_Address@VIPM_HURrMirrHeat_enum@ */ /end MEASUREMENT
/begin MEASUREMENT VIPM_HURecupPwrSet_pct "" UBYTE AppSwcIpm_CM_uint8_enum 0 0 0.0 255.0 ECU_ADDRESS 0x0000 /* @ECU_Address@VIPM_HURecupPwrSet_pct@ */ /end MEASUREMENT
/begin MEASUREMENT VIPM_HUParkAutoUnlckSet_enum "" UBYTE AppSwcIpm_CM_uint8_enum 0 0 0.0 255.0 ECU_ADDRESS 0x0000 /* @ECU_Address@VIPM_HUParkAutoUnlckSet_enum@ */ /end MEASUREMENT
/begin MEASUREMENT VIPM_HUOvrspdCntrlLckSet_enum "" UBYTE AppSwcIpm_CM_uint8_enum 0 0 0.0 255.0 ECU_ADDRESS 0x0000 /* @ECU_Address@VIPM_HUOvrspdCntrlLckSet_enum@ */ /end MEASUREMENT
/begin MEASUREMENT VIPM_HUManlDefrstCtl_enum "" UBYTE AppSwcIpm_CM_uint8_enum 0 0 0.0 255.0 ECU_ADDRESS 0x0000 /* @ECU_Address@VIPM_HUManlDefrstCtl_enum@ */ /end MEASUREMENT
/begin MEASUREMENT VIPM_HUMaiDrvrSeatHeat_enum "" UBYTE AppSwcIpm_CM_uint8_enum 0 0 0.0 255.0 ECU_ADDRESS 0x0000 /* @ECU_Address@VIPM_HUMaiDrvrSeatHeat_enum@ */ /end MEASUREMENT
/begin MEASUREMENT VIPM_HULeftTempSet_enum "" UBYTE AppSwcIpm_CM_uint8_enum 0 0 0.0 255.0 ECU_ADDRESS 0x0000 /* @ECU_Address@VIPM_HULeftTempSet_enum@ */ /end MEASUREMENT
/begin MEASUREMENT VIPM_HULckHornOnSt_enum "" UBYTE AppSwcIpm_CM_uint8_enum 0 0 0.0 255.0 ECU_ADDRESS 0x0000 /* @ECU_Address@VIPM_HULckHornOnSt_enum@ */ /end MEASUREMENT
/begin MEASUREMENT VIPM_HUIllmndUnlckSts_enum "" UBYTE AppSwcIpm_CM_uint8_enum 0 0 0.0 255.0 ECU_ADDRESS 0x0000 /* @ECU_Address@VIPM_HUIllmndUnlckSts_enum@ */ /end MEASUREMENT
/begin MEASUREMENT VIPM_HUIllmndLckSts_enum "" UBYTE AppSwcIpm_CM_uint8_enum 0 0 0.0 255.0 ECU_ADDRESS 0x0000 /* @ECU_Address@VIPM_HUIllmndLckSts_enum@ */ /end MEASUREMENT
/begin MEASUREMENT VIPM_HUIllmndEntrySts_enum "" UBYTE AppSwcIpm_CM_uint8_enum 0 0 0.0 255.0 ECU_ADDRESS 0x0000 /* @ECU_Address@VIPM_HUIllmndEntrySts_enum@ */ /end MEASUREMENT
/begin MEASUREMENT VIPM_HUHybEcoModeSet_enum "" UBYTE AppSwcIpm_CM_uint8_enum 0 0 0.0 255.0 ECU_ADDRESS 0x0000 /* @ECU_Address@VIPM_HUHybEcoModeSet_enum@ */ /end MEASUREMENT
/begin MEASUREMENT VIPM_HUFrntFanSpdSet_enum "" UBYTE AppSwcIpm_CM_uint8_enum 0 0 0.0 255.0 ECU_ADDRESS 0x0000 /* @ECU_Address@VIPM_HUFrntFanSpdSet_enum@ */ /end MEASUREMENT
/begin MEASUREMENT VIPM_HUFlwrMeHmCtrl_enum "" UBYTE AppSwcIpm_CM_uint8_enum 0 0 0.0 255.0 ECU_ADDRESS 0x0000 /* @ECU_Address@VIPM_HUFlwrMeHmCtrl_enum@ */ /end MEASUREMENT
/begin MEASUREMENT VIPM_HUDrvPwrSet_cnt "" UBYTE AppSwcIpm_CM_uint8_enum 0 0 0.0 255.0 ECU_ADDRESS 0x0000 /* @ECU_Address@VIPM_HUDrvPwrSet_cnt@ */ /end MEASUREMENT
/begin MEASUREMENT VIPM_HUChgWiprMtMdSwSet_enum "" UBYTE AppSwcIpm_CM_uint8_enum 0 0 0.0 255.0 ECU_ADDRESS 0x0000 /* @ECU_Address@VIPM_HUChgWiprMtMdSwSet_enum@ */ /end MEASUREMENT
/begin MEASUREMENT VIPM_HUBlwrModeSet_enum "" UBYTE AppSwcIpm_CM_uint8_enum 0 0 0.0 255.0 ECU_ADDRESS 0x0000 /* @ECU_Address@VIPM_HUBlwrModeSet_enum@ */ /end MEASUREMENT
/begin MEASUREMENT VIPM_HUAirInletModeSet_enum "" UBYTE AppSwcIpm_CM_uint8_enum 0 0 0.0 255.0 ECU_ADDRESS 0x0000 /* @ECU_Address@VIPM_HUAirInletModeSet_enum@ */ /end MEASUREMENT
/begin MEASUREMENT VIPM_HUACPwrCtl_enum "" UBYTE AppSwcIpm_CM_uint8_enum 0 0 0.0 255.0 ECU_ADDRESS 0x0000 /* @ECU_Address@VIPM_HUACPwrCtl_enum@ */ /end MEASUREMENT
/begin MEASUREMENT VIPM_HUACAutoCtl_enum "" UBYTE AppSwcIpm_CM_uint8_enum 0 0 0.0 255.0 ECU_ADDRESS 0x0000 /* @ECU_Address@VIPM_HUACAutoCtl_enum@ */ /end MEASUREMENT
/begin MEASUREMENT VIPM_CDCBackLadjval_enum "" UBYTE AppSwcIpm_CM_uint8_enum 0 0 0.0 255.0 ECU_ADDRESS 0x0000 /* @ECU_Address@VIPM_CDCBackLadjval_enum@ */ /end MEASUREMENT
/begin MEASUREMENT VIPM_TBOXBJSTimeSec_nu "" UBYTE AppSwcIpm_CM_uint8_nu 0 0 0.0 255.0 ECU_ADDRESS 0x0000 /* @ECU_Address@VIPM_TBOXBJSTimeSec_nu@ */ /end MEASUREMENT
/begin MEASUREMENT VIPM_TBOXBJSTimeMonth_nu "" UBYTE AppSwcIpm_CM_uint8_nu 0 0 0.0 255.0 ECU_ADDRESS 0x0000 /* @ECU_Address@VIPM_TBOXBJSTimeMonth_nu@ */ /end MEASUREMENT
/begin MEASUREMENT VIPM_TBOXBJSTimeMin_nu "" UBYTE AppSwcIpm_CM_uint8_nu 0 0 0.0 255.0 ECU_ADDRESS 0x0000 /* @ECU_Address@VIPM_TBOXBJSTimeMin_nu@ */ /end MEASUREMENT
/begin MEASUREMENT VIPM_TBOXBJSTimeHour_nu "" UBYTE AppSwcIpm_CM_uint8_nu 0 0 0.0 255.0 ECU_ADDRESS 0x0000 /* @ECU_Address@VIPM_TBOXBJSTimeHour_nu@ */ /end MEASUREMENT
/begin MEASUREMENT VIPM_TBOXBJSTimeDay_nu "" UBYTE AppSwcIpm_CM_uint8_nu 0 0 0.0 255.0 ECU_ADDRESS 0x0000 /* @ECU_Address@VIPM_TBOXBJSTimeDay_nu@ */ /end MEASUREMENT
/begin MEASUREMENT VIPM_HVCHWorkSt_enum "" UBYTE AppSwcIpm_CM_uint8_enum 0 0 0.0 255.0 ECU_ADDRESS 0x0000 /* @ECU_Address@VIPM_HVCHWorkSt_enum@ */ /end MEASUREMENT
/begin MEASUREMENT VIPM_HVCHWorkMode_enum "" UBYTE AppSwcIpm_CM_uint8_enum 0 0 0.0 255.0 ECU_ADDRESS 0x0000 /* @ECU_Address@VIPM_HVCHWorkMode_enum@ */ /end MEASUREMENT
/begin MEASUREMENT VIPM_HVCHSt_enum "" UBYTE AppSwcIpm_CM_uint8_enum 0 0 0.0 255.0 ECU_ADDRESS 0x0000 /* @ECU_Address@VIPM_HVCHSt_enum@ */ /end MEASUREMENT
/begin MEASUREMENT VIPM_COMPSelfChkErr_enum "" UBYTE AppSwcIpm_CM_uint8_enum 0 0 0.0 255.0 ECU_ADDRESS 0x0000 /* @ECU_Address@VIPM_COMPSelfChkErr_enum@ */ /end MEASUREMENT
/begin MEASUREMENT VIPM_COMPOvrCurr_enum "" UBYTE AppSwcIpm_CM_uint8_enum 0 0 0.0 255.0 ECU_ADDRESS 0x0000 /* @ECU_Address@VIPM_COMPOvrCurr_enum@ */ /end MEASUREMENT
/begin MEASUREMENT VIPM_COMPLvErr_enum "" UBYTE AppSwcIpm_CM_uint8_enum 0 0 0.0 255.0 ECU_ADDRESS 0x0000 /* @ECU_Address@VIPM_COMPLvErr_enum@ */ /end MEASUREMENT
/begin MEASUREMENT VIPM_COMPHvErr_enum "" UBYTE AppSwcIpm_CM_uint8_enum 0 0 0.0 255.0 ECU_ADDRESS 0x0000 /* @ECU_Address@VIPM_COMPHvErr_enum@ */ /end MEASUREMENT
/begin MEASUREMENT VIPM_COMPEcompST_enum "" UBYTE AppSwcIpm_CM_uint8_enum 0 0 0.0 255.0 ECU_ADDRESS 0x0000 /* @ECU_Address@VIPM_COMPEcompST_enum@ */ /end MEASUREMENT
/begin MEASUREMENT VIPM_HwVerMin_enum "" UBYTE AppSwcIpm_CM_uint8_enum 0 0 0.0 255.0 ECU_ADDRESS 0x0000 /* @ECU_Address@VIPM_HwVerMin_enum@ */ /end MEASUREMENT
/begin MEASUREMENT VIPM_HwVerMax_enum "" UBYTE AppSwcIpm_CM_uint8_enum 0 0 0.0 255.0 ECU_ADDRESS 0x0000 /* @ECU_Address@VIPM_HwVerMax_enum@ */ /end MEASUREMENT
/begin MEASUREMENT VIPM_ClientNum_enum "" UBYTE AppSwcIpm_CM_uint8_enum 0 0 0.0 255.0 ECU_ADDRESS 0x0000 /* @ECU_Address@VIPM_ClientNum_enum@ */ /end MEASUREMENT
/begin MEASUREMENT VIPM_BootVer_enum "" UBYTE AppSwcIpm_CM_uint8_enum 0 0 0.0 255.0 ECU_ADDRESS 0x0000 /* @ECU_Address@VIPM_BootVer_enum@ */ /end MEASUREMENT
/begin MEASUREMENT VIPM_APPVerMin_enum "" UBYTE AppSwcIpm_CM_uint8_enum 0 0 0.0 255.0 ECU_ADDRESS 0x0000 /* @ECU_Address@VIPM_APPVerMin_enum@ */ /end MEASUREMENT
/begin MEASUREMENT VIPM_APPVerMax_enum "" UBYTE AppSwcIpm_CM_uint8_enum 0 0 0.0 255.0 ECU_ADDRESS 0x0000 /* @ECU_Address@VIPM_APPVerMax_enum@ */ /end MEASUREMENT
/begin MEASUREMENT VIPM_EPTCANBusOff_flg "" UBYTE AppSwcIpm_CM_boolean_flg 0 0 0.0 1.0 ECU_ADDRESS 0x0000 /* @ECU_Address@VIPM_EPTCANBusOff_flg@ */ /end MEASUREMENT
/begin MEASUREMENT VIPM_BMSLostComm_flg "" UBYTE AppSwcIpm_CM_boolean_flg 0 0 0.0 1.0 ECU_ADDRESS 0x0000 /* @ECU_Address@VIPM_BMSLostComm_flg@ */ /end MEASUREMENT
/begin MEASUREMENT VIPM_MCULostComm_flg "" UBYTE AppSwcIpm_CM_boolean_flg 0 0 0.0 1.0 ECU_ADDRESS 0x0000 /* @ECU_Address@VIPM_MCULostComm_flg@ */ /end MEASUREMENT
/begin MEASUREMENT VIPM_IPULostComm_flg "" UBYTE AppSwcIpm_CM_boolean_flg 0 0 0.0 1.0 ECU_ADDRESS 0x0000 /* @ECU_Address@VIPM_IPULostComm_flg@ */ /end MEASUREMENT
/begin MEASUREMENT VIPM_CHACANBusOff_flg "" UBYTE AppSwcIpm_CM_boolean_flg 0 0 0.0 1.0 ECU_ADDRESS 0x0000 /* @ECU_Address@VIPM_CHACANBusOff_flg@ */ /end MEASUREMENT
/begin MEASUREMENT VIPM_EPSLostComm_flg "" UBYTE AppSwcIpm_CM_boolean_flg 0 0 0.0 1.0 ECU_ADDRESS 0x0000 /* @ECU_Address@VIPM_EPSLostComm_flg@ */ /end MEASUREMENT
/begin MEASUREMENT VIPM_SRSLostComm_flg "" UBYTE AppSwcIpm_CM_boolean_flg 0 0 0.0 1.0 ECU_ADDRESS 0x0000 /* @ECU_Address@VIPM_SRSLostComm_flg@ */ /end MEASUREMENT
/begin MEASUREMENT VIPM_ESCLostComm_flg "" UBYTE AppSwcIpm_CM_boolean_flg 0 0 0.0 1.0 ECU_ADDRESS 0x0000 /* @ECU_Address@VIPM_ESCLostComm_flg@ */ /end MEASUREMENT
/begin MEASUREMENT VIPM_FCMLostComm_flg "" UBYTE AppSwcIpm_CM_boolean_flg 0 0 0.0 1.0 ECU_ADDRESS 0x0000 /* @ECU_Address@VIPM_FCMLostComm_flg@ */ /end MEASUREMENT
/begin MEASUREMENT VIPM_BACCANBusOff_flg "" UBYTE AppSwcIpm_CM_boolean_flg 0 0 0.0 1.0 ECU_ADDRESS 0x0000 /* @ECU_Address@VIPM_BACCANBusOff_flg@ */ /end MEASUREMENT
/begin MEASUREMENT VIPM_ICULostComm_flg "" UBYTE AppSwcIpm_CM_boolean_flg 0 0 0.0 1.0 ECU_ADDRESS 0x0000 /* @ECU_Address@VIPM_ICULostComm_flg@ */ /end MEASUREMENT
/begin MEASUREMENT VIPM_TBOXLostComm_flg "" UBYTE AppSwcIpm_CM_boolean_flg 0 0 0.0 1.0 ECU_ADDRESS 0x0000 /* @ECU_Address@VIPM_TBOXLostComm_flg@ */ /end MEASUREMENT
/begin MEASUREMENT VIPM_BODCANBusOff_flg "" UBYTE AppSwcIpm_CM_boolean_flg 0 0 0.0 1.0 ECU_ADDRESS 0x0000 /* @ECU_Address@VIPM_BODCANBusOff_flg@ */ /end MEASUREMENT
/begin MEASUREMENT VIPM_ACCMLostComm_flg "" UBYTE AppSwcIpm_CM_boolean_flg 0 0 0.0 1.0 ECU_ADDRESS 0x0000 /* @ECU_Address@VIPM_ACCMLostComm_flg@ */ /end MEASUREMENT
/begin MEASUREMENT VIPM_CDCLostComm_flg "" UBYTE AppSwcIpm_CM_boolean_flg 0 0 0.0 1.0 ECU_ADDRESS 0x0000 /* @ECU_Address@VIPM_CDCLostComm_flg@ */ /end MEASUREMENT
/begin MEASUREMENT VIPM_PTCLostComm_flg "" UBYTE AppSwcIpm_CM_boolean_flg 0 0 0.0 1.0 ECU_ADDRESS 0x0000 /* @ECU_Address@VIPM_PTCLostComm_flg@ */ /end MEASUREMENT
/begin MEASUREMENT VIPM_CRRRLostComm_flg "" UBYTE AppSwcIpm_CM_boolean_flg 0 0 0.0 1.0 ECU_ADDRESS 0x0000 /* @ECU_Address@VIPM_CRRRLostComm_flg@ */ /end MEASUREMENT
/begin MEASUREMENT VIPM_PPLostComm_flg "" UBYTE AppSwcIpm_CM_boolean_flg 0 0 0.0 1.0 ECU_ADDRESS 0x0000 /* @ECU_Address@VIPM_PPLostComm_flg@ */ /end MEASUREMENT
/begin MEASUREMENT VIPM_EPSRotSpdVld_flg "" UBYTE AppSwcIpm_CM_boolean_flg 0 0 0.0 1.0 ECU_ADDRESS 0x0000 /* @ECU_Address@VIPM_EPSRotSpdVld_flg@ */ /end MEASUREMENT
/begin MEASUREMENT VIPM_EHBReqBrkLiOnVld_flg "" UBYTE AppSwcIpm_CM_boolean_flg 0 0 0.0 1.0 ECU_ADDRESS 0x0000 /* @ECU_Address@VIPM_EHBReqBrkLiOnVld_flg@ */ /end MEASUREMENT
/begin MEASUREMENT VIPM_EHBReqBrkLiOn_flg "" UBYTE AppSwcIpm_CM_boolean_flg 0 0 0.0 1.0 ECU_ADDRESS 0x0000 /* @ECU_Address@VIPM_EHBReqBrkLiOn_flg@ */ /end MEASUREMENT
/begin MEASUREMENT VIPM_EHBFltLvlVld_flg "" UBYTE AppSwcIpm_CM_boolean_flg 0 0 0.0 1.0 ECU_ADDRESS 0x0000 /* @ECU_Address@VIPM_EHBFltLvlVld_flg@ */ /end MEASUREMENT
/begin MEASUREMENT VIPM_EHBEPBActuatorStRVld_flg "" UBYTE AppSwcIpm_CM_boolean_flg 0 0 0.0 1.0 ECU_ADDRESS 0x0000 /* @ECU_Address@VIPM_EHBEPBActuatorStRVld_flg@ */ /end MEASUREMENT
/begin MEASUREMENT VIPM_EHBCDDActvVld_flg "" UBYTE AppSwcIpm_CM_boolean_flg 0 0 0.0 1.0 ECU_ADDRESS 0x0000 /* @ECU_Address@VIPM_EHBCDDActvVld_flg@ */ /end MEASUREMENT
/begin MEASUREMENT VIPM_EHBCDDActv_flg "" UBYTE AppSwcIpm_CM_boolean_flg 0 0 0.0 1.0 ECU_ADDRESS 0x0000 /* @ECU_Address@VIPM_EHBCDDActv_flg@ */ /end MEASUREMENT
/begin MEASUREMENT VIPM_EHBBrkPwrRecupTarWhlTqVld_flg "" UBYTE AppSwcIpm_CM_boolean_flg 0 0 0.0 1.0 ECU_ADDRESS 0x0000 /* @ECU_Address@VIPM_EHBBrkPwrRecupTarWhlTqVld_flg@ */ /end MEASUREMENT
/begin MEASUREMENT VIPM_EHBBrkPwrRecupTarWhlTqStsVld_flg "" UBYTE AppSwcIpm_CM_boolean_flg 0 0 0.0 1.0 ECU_ADDRESS 0x0000 /* @ECU_Address@VIPM_EHBBrkPwrRecupTarWhlTqStsVld_flg@ */ /end MEASUREMENT
/begin MEASUREMENT VIPM_EHBBrkPedlValPercVld_flg "" UBYTE AppSwcIpm_CM_boolean_flg 0 0 0.0 1.0 ECU_ADDRESS 0x0000 /* @ECU_Address@VIPM_EHBBrkPedlValPercVld_flg@ */ /end MEASUREMENT
/begin MEASUREMENT VIPM_BMSPackIDVld_flg "" UBYTE AppSwcIpm_CM_boolean_flg 0 0 0.0 1.0 ECU_ADDRESS 0x0000 /* @ECU_Address@VIPM_BMSPackIDVld_flg@ */ /end MEASUREMENT
/begin MEASUREMENT VIPM_BMSBatCapctyVld_flg "" UBYTE AppSwcIpm_CM_boolean_flg 0 0 0.0 1.0 ECU_ADDRESS 0x0000 /* @ECU_Address@VIPM_BMSBatCapctyVld_flg@ */ /end MEASUREMENT
/begin MEASUREMENT VIPM_IPUOBCWakeUpModeVld_flg "" UBYTE AppSwcIpm_CM_boolean_flg 0 0 0.0 1.0 ECU_ADDRESS 0x0000 /* @ECU_Address@VIPM_IPUOBCWakeUpModeVld_flg@ */ /end MEASUREMENT
/begin MEASUREMENT VIPM_IPUOBCTempIntVld_flg "" UBYTE AppSwcIpm_CM_boolean_flg 0 0 0.0 1.0 ECU_ADDRESS 0x0000 /* @ECU_Address@VIPM_IPUOBCTempIntVld_flg@ */ /end MEASUREMENT
/begin MEASUREMENT VIPM_IPUOBCS2StateVld_flg "" UBYTE AppSwcIpm_CM_boolean_flg 0 0 0.0 1.0 ECU_ADDRESS 0x0000 /* @ECU_Address@VIPM_IPUOBCS2StateVld_flg@ */ /end MEASUREMENT
/begin MEASUREMENT VIPM_IPUOBCS2State_flg "" UBYTE AppSwcIpm_CM_boolean_flg 0 0 0.0 1.0 ECU_ADDRESS 0x0000 /* @ECU_Address@VIPM_IPUOBCS2State_flg@ */ /end MEASUREMENT
/begin MEASUREMENT VIPM_IPUOBCACMaxPwrAllowVld_flg "" UBYTE AppSwcIpm_CM_boolean_flg 0 0 0.0 1.0 ECU_ADDRESS 0x0000 /* @ECU_Address@VIPM_IPUOBCACMaxPwrAllowVld_flg@ */ /end MEASUREMENT
/begin MEASUREMENT VIPM_IPUDeviceIntTempVld_flg "" UBYTE AppSwcIpm_CM_boolean_flg 0 0 0.0 1.0 ECU_ADDRESS 0x0000 /* @ECU_Address@VIPM_IPUDeviceIntTempVld_flg@ */ /end MEASUREMENT
/begin MEASUREMENT VIPM_IPUOBCSysFailStaVld_flg "" UBYTE AppSwcIpm_CM_boolean_flg 0 0 0.0 1.0 ECU_ADDRESS 0x0000 /* @ECU_Address@VIPM_IPUOBCSysFailStaVld_flg@ */ /end MEASUREMENT
/begin MEASUREMENT VIPM_IPUOBCReqVld_flg "" UBYTE AppSwcIpm_CM_boolean_flg 0 0 0.0 1.0 ECU_ADDRESS 0x0000 /* @ECU_Address@VIPM_IPUOBCReqVld_flg@ */ /end MEASUREMENT
/begin MEASUREMENT VIPM_IPUOBCInletConnectStaVld_flg "" UBYTE AppSwcIpm_CM_boolean_flg 0 0 0.0 1.0 ECU_ADDRESS 0x0000 /* @ECU_Address@VIPM_IPUOBCInletConnectStaVld_flg@ */ /end MEASUREMENT
/begin MEASUREMENT VIPM_IPUOBCInletActPwrVld_flg "" UBYTE AppSwcIpm_CM_boolean_flg 0 0 0.0 1.0 ECU_ADDRESS 0x0000 /* @ECU_Address@VIPM_IPUOBCInletActPwrVld_flg@ */ /end MEASUREMENT
/begin MEASUREMENT VIPM_IPUOBCHVDCActVolVld_flg "" UBYTE AppSwcIpm_CM_boolean_flg 0 0 0.0 1.0 ECU_ADDRESS 0x0000 /* @ECU_Address@VIPM_IPUOBCHVDCActVolVld_flg@ */ /end MEASUREMENT
/begin MEASUREMENT VIPM_IPUOBCHVDCActCurVld_flg "" UBYTE AppSwcIpm_CM_boolean_flg 0 0 0.0 1.0 ECU_ADDRESS 0x0000 /* @ECU_Address@VIPM_IPUOBCHVDCActCurVld_flg@ */ /end MEASUREMENT
/begin MEASUREMENT VIPM_IPUOBCConnectMainStaVld_flg "" UBYTE AppSwcIpm_CM_boolean_flg 0 0 0.0 1.0 ECU_ADDRESS 0x0000 /* @ECU_Address@VIPM_IPUOBCConnectMainStaVld_flg@ */ /end MEASUREMENT
/begin MEASUREMENT VIPM_IPUOBCConnectMainSta_flg "" UBYTE AppSwcIpm_CM_boolean_flg 0 0 0.0 1.0 ECU_ADDRESS 0x0000 /* @ECU_Address@VIPM_IPUOBCConnectMainSta_flg@ */ /end MEASUREMENT
/begin MEASUREMENT VIPM_IPUOBCActOprtModeVld_flg "" UBYTE AppSwcIpm_CM_boolean_flg 0 0 0.0 1.0 ECU_ADDRESS 0x0000 /* @ECU_Address@VIPM_IPUOBCActOprtModeVld_flg@ */ /end MEASUREMENT
/begin MEASUREMENT VIPM_IPUDCCHiVoltActVoltVld_flg "" UBYTE AppSwcIpm_CM_boolean_flg 0 0 0.0 1.0 ECU_ADDRESS 0x0000 /* @ECU_Address@VIPM_IPUDCCHiVoltActVoltVld_flg@ */ /end MEASUREMENT
/begin MEASUREMENT VIPM_IPUDCCHiVoltActCurntVld_flg "" UBYTE AppSwcIpm_CM_boolean_flg 0 0 0.0 1.0 ECU_ADDRESS 0x0000 /* @ECU_Address@VIPM_IPUDCCHiVoltActCurntVld_flg@ */ /end MEASUREMENT
/begin MEASUREMENT VIPM_IPUDCCSysFailStaVld_flg "" UBYTE AppSwcIpm_CM_boolean_flg 0 0 0.0 1.0 ECU_ADDRESS 0x0000 /* @ECU_Address@VIPM_IPUDCCSysFailStaVld_flg@ */ /end MEASUREMENT
/begin MEASUREMENT VIPM_IPUDCCLoVoltActVoltVld_flg "" UBYTE AppSwcIpm_CM_boolean_flg 0 0 0.0 1.0 ECU_ADDRESS 0x0000 /* @ECU_Address@VIPM_IPUDCCLoVoltActVoltVld_flg@ */ /end MEASUREMENT
/begin MEASUREMENT VIPM_IPUDCCLoVoltActCurntVld_flg "" UBYTE AppSwcIpm_CM_boolean_flg 0 0 0.0 1.0 ECU_ADDRESS 0x0000 /* @ECU_Address@VIPM_IPUDCCLoVoltActCurntVld_flg@ */ /end MEASUREMENT
/begin MEASUREMENT VIPM_IPUDCCActOprtModeVld_flg "" UBYTE AppSwcIpm_CM_boolean_flg 0 0 0.0 1.0 ECU_ADDRESS 0x0000 /* @ECU_Address@VIPM_IPUDCCActOprtModeVld_flg@ */ /end MEASUREMENT
/begin MEASUREMENT VIPM_INVLrngSubIDVld_flg "" UBYTE AppSwcIpm_CM_boolean_flg 0 0 0.0 1.0 ECU_ADDRESS 0x0000 /* @ECU_Address@VIPM_INVLrngSubIDVld_flg@ */ /end MEASUREMENT
/begin MEASUREMENT VIPM_INVLrngStsVld_flg "" UBYTE AppSwcIpm_CM_boolean_flg 0 0 0.0 1.0 ECU_ADDRESS 0x0000 /* @ECU_Address@VIPM_INVLrngStsVld_flg@ */ /end MEASUREMENT
/begin MEASUREMENT VIPM_INVLrngData07Vld_flg "" UBYTE AppSwcIpm_CM_boolean_flg 0 0 0.0 1.0 ECU_ADDRESS 0x0000 /* @ECU_Address@VIPM_INVLrngData07Vld_flg@ */ /end MEASUREMENT
/begin MEASUREMENT VIPM_INVLrngData06Vld_flg "" UBYTE AppSwcIpm_CM_boolean_flg 0 0 0.0 1.0 ECU_ADDRESS 0x0000 /* @ECU_Address@VIPM_INVLrngData06Vld_flg@ */ /end MEASUREMENT
/begin MEASUREMENT VIPM_INVLrngData05Vld_flg "" UBYTE AppSwcIpm_CM_boolean_flg 0 0 0.0 1.0 ECU_ADDRESS 0x0000 /* @ECU_Address@VIPM_INVLrngData05Vld_flg@ */ /end MEASUREMENT
/begin MEASUREMENT VIPM_INVLrngData04Vld_flg "" UBYTE AppSwcIpm_CM_boolean_flg 0 0 0.0 1.0 ECU_ADDRESS 0x0000 /* @ECU_Address@VIPM_INVLrngData04Vld_flg@ */ /end MEASUREMENT
/begin MEASUREMENT VIPM_INVLrngData03Vld_flg "" UBYTE AppSwcIpm_CM_boolean_flg 0 0 0.0 1.0 ECU_ADDRESS 0x0000 /* @ECU_Address@VIPM_INVLrngData03Vld_flg@ */ /end MEASUREMENT
/begin MEASUREMENT VIPM_INVLrngData02Vld_flg "" UBYTE AppSwcIpm_CM_boolean_flg 0 0 0.0 1.0 ECU_ADDRESS 0x0000 /* @ECU_Address@VIPM_INVLrngData02Vld_flg@ */ /end MEASUREMENT
/begin MEASUREMENT VIPM_BMSHVBatCellTempMinVld_flg "" UBYTE AppSwcIpm_CM_boolean_flg 0 0 0.0 1.0 ECU_ADDRESS 0x0000 /* @ECU_Address@VIPM_BMSHVBatCellTempMinVld_flg@ */ /end MEASUREMENT
/begin MEASUREMENT VIPM_BMSHVBatCellTempMaxVld_flg "" UBYTE AppSwcIpm_CM_boolean_flg 0 0 0.0 1.0 ECU_ADDRESS 0x0000 /* @ECU_Address@VIPM_BMSHVBatCellTempMaxVld_flg@ */ /end MEASUREMENT
/begin MEASUREMENT VIPM_BMSHVBatCellTempAveVld_flg "" UBYTE AppSwcIpm_CM_boolean_flg 0 0 0.0 1.0 ECU_ADDRESS 0x0000 /* @ECU_Address@VIPM_BMSHVBatCellTempAveVld_flg@ */ /end MEASUREMENT
/begin MEASUREMENT VIPM_HUWiprIntlTmSetVld_flg "" UBYTE AppSwcIpm_CM_boolean_flg 0 0 0.0 1.0 ECU_ADDRESS 0x0000 /* @ECU_Address@VIPM_HUWiprIntlTmSetVld_flg@ */ /end MEASUREMENT
/begin MEASUREMENT VIPM_HUTrnkLckSwCtrlVld_flg "" UBYTE AppSwcIpm_CM_boolean_flg 0 0 0.0 1.0 ECU_ADDRESS 0x0000 /* @ECU_Address@VIPM_HUTrnkLckSwCtrlVld_flg@ */ /end MEASUREMENT
/begin MEASUREMENT VIPM_HUTPMSRstReqVld_flg "" UBYTE AppSwcIpm_CM_boolean_flg 0 0 0.0 1.0 ECU_ADDRESS 0x0000 /* @ECU_Address@VIPM_HUTPMSRstReqVld_flg@ */ /end MEASUREMENT
/begin MEASUREMENT VIPM_HUTPMSRstReq_flg "" UBYTE AppSwcIpm_CM_boolean_flg 0 0 0.0 1.0 ECU_ADDRESS 0x0000 /* @ECU_Address@VIPM_HUTPMSRstReq_flg@ */ /end MEASUREMENT
/begin MEASUREMENT VIPM_HUSteerWhlHeatVld_flg "" UBYTE AppSwcIpm_CM_boolean_flg 0 0 0.0 1.0 ECU_ADDRESS 0x0000 /* @ECU_Address@VIPM_HUSteerWhlHeatVld_flg@ */ /end MEASUREMENT
/begin MEASUREMENT VIPM_HURrMirrHeatVld_flg "" UBYTE AppSwcIpm_CM_boolean_flg 0 0 0.0 1.0 ECU_ADDRESS 0x0000 /* @ECU_Address@VIPM_HURrMirrHeatVld_flg@ */ /end MEASUREMENT
/begin MEASUREMENT VIPM_HURecupPwrSetVld_flg "" UBYTE AppSwcIpm_CM_boolean_flg 0 0 0.0 1.0 ECU_ADDRESS 0x0000 /* @ECU_Address@VIPM_HURecupPwrSetVld_flg@ */ /end MEASUREMENT
/begin MEASUREMENT VIPM_HUPwrOffReqVld_flg "" UBYTE AppSwcIpm_CM_boolean_flg 0 0 0.0 1.0 ECU_ADDRESS 0x0000 /* @ECU_Address@VIPM_HUPwrOffReqVld_flg@ */ /end MEASUREMENT
/begin MEASUREMENT VIPM_HUPwrOffReq_flg "" UBYTE AppSwcIpm_CM_boolean_flg 0 0 0.0 1.0 ECU_ADDRESS 0x0000 /* @ECU_Address@VIPM_HUPwrOffReq_flg@ */ /end MEASUREMENT
/begin MEASUREMENT VIPM_HUPeristalsisModeEnblVld_flg "" UBYTE AppSwcIpm_CM_boolean_flg 0 0 0.0 1.0 ECU_ADDRESS 0x0000 /* @ECU_Address@VIPM_HUPeristalsisModeEnblVld_flg@ */ /end MEASUREMENT
/begin MEASUREMENT VIPM_HUParkAutoUnlckSetVld_flg "" UBYTE AppSwcIpm_CM_boolean_flg 0 0 0.0 1.0 ECU_ADDRESS 0x0000 /* @ECU_Address@VIPM_HUParkAutoUnlckSetVld_flg@ */ /end MEASUREMENT
/begin MEASUREMENT VIPM_HUOvrspdCntrlLckSetVld_flg "" UBYTE AppSwcIpm_CM_boolean_flg 0 0 0.0 1.0 ECU_ADDRESS 0x0000 /* @ECU_Address@VIPM_HUOvrspdCntrlLckSetVld_flg@ */ /end MEASUREMENT
/begin MEASUREMENT VIPM_HUManlDefrstCtlVld_flg "" UBYTE AppSwcIpm_CM_boolean_flg 0 0 0.0 1.0 ECU_ADDRESS 0x0000 /* @ECU_Address@VIPM_HUManlDefrstCtlVld_flg@ */ /end MEASUREMENT
/begin MEASUREMENT VIPM_HUMaiDrvrSeatHeatVld_flg "" UBYTE AppSwcIpm_CM_boolean_flg 0 0 0.0 1.0 ECU_ADDRESS 0x0000 /* @ECU_Address@VIPM_HUMaiDrvrSeatHeatVld_flg@ */ /end MEASUREMENT
/begin MEASUREMENT VIPM_HULeftTempSetVld_flg "" UBYTE AppSwcIpm_CM_boolean_flg 0 0 0.0 1.0 ECU_ADDRESS 0x0000 /* @ECU_Address@VIPM_HULeftTempSetVld_flg@ */ /end MEASUREMENT
/begin MEASUREMENT VIPM_HULckHornOnStVld_flg "" UBYTE AppSwcIpm_CM_boolean_flg 0 0 0.0 1.0 ECU_ADDRESS 0x0000 /* @ECU_Address@VIPM_HULckHornOnStVld_flg@ */ /end MEASUREMENT
/begin MEASUREMENT VIPM_HUIllmndUnlckStsVld_flg "" UBYTE AppSwcIpm_CM_boolean_flg 0 0 0.0 1.0 ECU_ADDRESS 0x0000 /* @ECU_Address@VIPM_HUIllmndUnlckStsVld_flg@ */ /end MEASUREMENT
/begin MEASUREMENT VIPM_HUIllmndLckStsVld_flg "" UBYTE AppSwcIpm_CM_boolean_flg 0 0 0.0 1.0 ECU_ADDRESS 0x0000 /* @ECU_Address@VIPM_HUIllmndLckStsVld_flg@ */ /end MEASUREMENT
/begin MEASUREMENT VIPM_HUIllmndEntryStsVld_flg "" UBYTE AppSwcIpm_CM_boolean_flg 0 0 0.0 1.0 ECU_ADDRESS 0x0000 /* @ECU_Address@VIPM_HUIllmndEntryStsVld_flg@ */ /end MEASUREMENT
/begin MEASUREMENT VIPM_HUHybEcoModeSetVld_flg "" UBYTE AppSwcIpm_CM_boolean_flg 0 0 0.0 1.0 ECU_ADDRESS 0x0000 /* @ECU_Address@VIPM_HUHybEcoModeSetVld_flg@ */ /end MEASUREMENT
/begin MEASUREMENT VIPM_HUFrntFanSpdSetVld_flg "" UBYTE AppSwcIpm_CM_boolean_flg 0 0 0.0 1.0 ECU_ADDRESS 0x0000 /* @ECU_Address@VIPM_HUFrntFanSpdSetVld_flg@ */ /end MEASUREMENT
/begin MEASUREMENT VIPM_HUFlwrMeHmCtrlVld_flg "" UBYTE AppSwcIpm_CM_boolean_flg 0 0 0.0 1.0 ECU_ADDRESS 0x0000 /* @ECU_Address@VIPM_HUFlwrMeHmCtrlVld_flg@ */ /end MEASUREMENT
/begin MEASUREMENT VIPM_HUDrvPwrSetVld_flg "" UBYTE AppSwcIpm_CM_boolean_flg 0 0 0.0 1.0 ECU_ADDRESS 0x0000 /* @ECU_Address@VIPM_HUDrvPwrSetVld_flg@ */ /end MEASUREMENT
/begin MEASUREMENT VIPM_HUDrvModeSelVld_flg "" UBYTE AppSwcIpm_CM_boolean_flg 0 0 0.0 1.0 ECU_ADDRESS 0x0000 /* @ECU_Address@VIPM_HUDrvModeSelVld_flg@ */ /end MEASUREMENT
/begin MEASUREMENT VIPM_HUCstRecupModeSelVld_flg "" UBYTE AppSwcIpm_CM_boolean_flg 0 0 0.0 1.0 ECU_ADDRESS 0x0000 /* @ECU_Address@VIPM_HUCstRecupModeSelVld_flg@ */ /end MEASUREMENT
/begin MEASUREMENT VIPM_HUChgWiprMtMdSwSetVld_flg "" UBYTE AppSwcIpm_CM_boolean_flg 0 0 0.0 1.0 ECU_ADDRESS 0x0000 /* @ECU_Address@VIPM_HUChgWiprMtMdSwSetVld_flg@ */ /end MEASUREMENT
/begin MEASUREMENT VIPM_HUBlwrModeSetVld_flg "" UBYTE AppSwcIpm_CM_boolean_flg 0 0 0.0 1.0 ECU_ADDRESS 0x0000 /* @ECU_Address@VIPM_HUBlwrModeSetVld_flg@ */ /end MEASUREMENT
/begin MEASUREMENT VIPM_HUAirInletModeSetVld_flg "" UBYTE AppSwcIpm_CM_boolean_flg 0 0 0.0 1.0 ECU_ADDRESS 0x0000 /* @ECU_Address@VIPM_HUAirInletModeSetVld_flg@ */ /end MEASUREMENT
/begin MEASUREMENT VIPM_HUACPwrCtlVld_flg "" UBYTE AppSwcIpm_CM_boolean_flg 0 0 0.0 1.0 ECU_ADDRESS 0x0000 /* @ECU_Address@VIPM_HUACPwrCtlVld_flg@ */ /end MEASUREMENT
/begin MEASUREMENT VIPM_HUACAutoCtlVld_flg "" UBYTE AppSwcIpm_CM_boolean_flg 0 0 0.0 1.0 ECU_ADDRESS 0x0000 /* @ECU_Address@VIPM_HUACAutoCtlVld_flg@ */ /end MEASUREMENT
/begin MEASUREMENT VIPM_CDCBackLadjvalVld_flg "" UBYTE AppSwcIpm_CM_boolean_flg 0 0 0.0 1.0 ECU_ADDRESS 0x0000 /* @ECU_Address@VIPM_CDCBackLadjvalVld_flg@ */ /end MEASUREMENT
/begin MEASUREMENT VIPM_TBOXBJSTimeYearVld_flg "" UBYTE AppSwcIpm_CM_boolean_flg 0 0 0.0 1.0 ECU_ADDRESS 0x0000 /* @ECU_Address@VIPM_TBOXBJSTimeYearVld_flg@ */ /end MEASUREMENT
/begin MEASUREMENT VIPM_TBOXBJSTimeSecVld_flg "" UBYTE AppSwcIpm_CM_boolean_flg 0 0 0.0 1.0 ECU_ADDRESS 0x0000 /* @ECU_Address@VIPM_TBOXBJSTimeSecVld_flg@ */ /end MEASUREMENT
/begin MEASUREMENT VIPM_TBOXBJSTimeMonthVld_flg "" UBYTE AppSwcIpm_CM_boolean_flg 0 0 0.0 1.0 ECU_ADDRESS 0x0000 /* @ECU_Address@VIPM_TBOXBJSTimeMonthVld_flg@ */ /end MEASUREMENT
/begin MEASUREMENT VIPM_TBOXBJSTimeMinVld_flg "" UBYTE AppSwcIpm_CM_boolean_flg 0 0 0.0 1.0 ECU_ADDRESS 0x0000 /* @ECU_Address@VIPM_TBOXBJSTimeMinVld_flg@ */ /end MEASUREMENT
/begin MEASUREMENT VIPM_TBOXBJSTimeHourVld_flg "" UBYTE AppSwcIpm_CM_boolean_flg 0 0 0.0 1.0 ECU_ADDRESS 0x0000 /* @ECU_Address@VIPM_TBOXBJSTimeHourVld_flg@ */ /end MEASUREMENT
/begin MEASUREMENT VIPM_TBOXBJSTimeDayVld_flg "" UBYTE AppSwcIpm_CM_boolean_flg 0 0 0.0 1.0 ECU_ADDRESS 0x0000 /* @ECU_Address@VIPM_TBOXBJSTimeDayVld_flg@ */ /end MEASUREMENT
/begin MEASUREMENT VIPM_HVCHWorkStVld_flg "" UBYTE AppSwcIpm_CM_boolean_flg 0 0 0.0 1.0 ECU_ADDRESS 0x0000 /* @ECU_Address@VIPM_HVCHWorkStVld_flg@ */ /end MEASUREMENT
/begin MEASUREMENT VIPM_HVCHPwrVld_flg "" UBYTE AppSwcIpm_CM_boolean_flg 0 0 0.0 1.0 ECU_ADDRESS 0x0000 /* @ECU_Address@VIPM_HVCHPwrVld_flg@ */ /end MEASUREMENT
/begin MEASUREMENT VIPM_HVCHHVVoltsVld_flg "" UBYTE AppSwcIpm_CM_boolean_flg 0 0 0.0 1.0 ECU_ADDRESS 0x0000 /* @ECU_Address@VIPM_HVCHHVVoltsVld_flg@ */ /end MEASUREMENT
/begin MEASUREMENT VIPM_HVCHFltCodVld_flg "" UBYTE AppSwcIpm_CM_boolean_flg 0 0 0.0 1.0 ECU_ADDRESS 0x0000 /* @ECU_Address@VIPM_HVCHFltCodVld_flg@ */ /end MEASUREMENT
/begin MEASUREMENT VIPM_HVCHCurrVld_flg "" UBYTE AppSwcIpm_CM_boolean_flg 0 0 0.0 1.0 ECU_ADDRESS 0x0000 /* @ECU_Address@VIPM_HVCHCurrVld_flg@ */ /end MEASUREMENT
/begin MEASUREMENT VIPM_HVCHWorkModeVld_flg "" UBYTE AppSwcIpm_CM_boolean_flg 0 0 0.0 1.0 ECU_ADDRESS 0x0000 /* @ECU_Address@VIPM_HVCHWorkModeVld_flg@ */ /end MEASUREMENT
/begin MEASUREMENT VIPM_HVCHStVld_flg "" UBYTE AppSwcIpm_CM_boolean_flg 0 0 0.0 1.0 ECU_ADDRESS 0x0000 /* @ECU_Address@VIPM_HVCHStVld_flg@ */ /end MEASUREMENT
/begin MEASUREMENT VIPM_HVCHPCBTempVld_flg "" UBYTE AppSwcIpm_CM_boolean_flg 0 0 0.0 1.0 ECU_ADDRESS 0x0000 /* @ECU_Address@VIPM_HVCHPCBTempVld_flg@ */ /end MEASUREMENT
/begin MEASUREMENT VIPM_HVCHOutlTempVld_flg "" UBYTE AppSwcIpm_CM_boolean_flg 0 0 0.0 1.0 ECU_ADDRESS 0x0000 /* @ECU_Address@VIPM_HVCHOutlTempVld_flg@ */ /end MEASUREMENT
/begin MEASUREMENT VIPM_HVCHInletTempVld_flg "" UBYTE AppSwcIpm_CM_boolean_flg 0 0 0.0 1.0 ECU_ADDRESS 0x0000 /* @ECU_Address@VIPM_HVCHInletTempVld_flg@ */ /end MEASUREMENT
/begin MEASUREMENT VIPM_HVCHHVStVld_flg "" UBYTE AppSwcIpm_CM_boolean_flg 0 0 0.0 1.0 ECU_ADDRESS 0x0000 /* @ECU_Address@VIPM_HVCHHVStVld_flg@ */ /end MEASUREMENT
/begin MEASUREMENT VIPM_HVCHHVSt_flg "" UBYTE AppSwcIpm_CM_boolean_flg 0 0 0.0 1.0 ECU_ADDRESS 0x0000 /* @ECU_Address@VIPM_HVCHHVSt_flg@ */ /end MEASUREMENT
/begin MEASUREMENT VIPM_ECUHiVoltInterlockSigVld_flg "" UBYTE AppSwcIpm_CM_boolean_flg 0 0 0.0 1.0 ECU_ADDRESS 0x0000 /* @ECU_Address@VIPM_ECUHiVoltInterlockSigVld_flg@ */ /end MEASUREMENT
/begin MEASUREMENT VIPM_ECUHiVoltInterlockSig_flg "" UBYTE AppSwcIpm_CM_boolean_flg 0 0 0.0 1.0 ECU_ADDRESS 0x0000 /* @ECU_Address@VIPM_ECUHiVoltInterlockSig_flg@ */ /end MEASUREMENT
/begin MEASUREMENT VIPM_COMPTempVld_flg "" UBYTE AppSwcIpm_CM_boolean_flg 0 0 0.0 1.0 ECU_ADDRESS 0x0000 /* @ECU_Address@VIPM_COMPTempVld_flg@ */ /end MEASUREMENT
/begin MEASUREMENT VIPM_COMPTempErrVld_flg "" UBYTE AppSwcIpm_CM_boolean_flg 0 0 0.0 1.0 ECU_ADDRESS 0x0000 /* @ECU_Address@VIPM_COMPTempErrVld_flg@ */ /end MEASUREMENT
/begin MEASUREMENT VIPM_COMPTempErr_flg "" UBYTE AppSwcIpm_CM_boolean_flg 0 0 0.0 1.0 ECU_ADDRESS 0x0000 /* @ECU_Address@VIPM_COMPTempErr_flg@ */ /end MEASUREMENT
/begin MEASUREMENT VIPM_COMPSelfChkErrVld_flg "" UBYTE AppSwcIpm_CM_boolean_flg 0 0 0.0 1.0 ECU_ADDRESS 0x0000 /* @ECU_Address@VIPM_COMPSelfChkErrVld_flg@ */ /end MEASUREMENT
/begin MEASUREMENT VIPM_COMPPISaturationVld_flg "" UBYTE AppSwcIpm_CM_boolean_flg 0 0 0.0 1.0 ECU_ADDRESS 0x0000 /* @ECU_Address@VIPM_COMPPISaturationVld_flg@ */ /end MEASUREMENT
/begin MEASUREMENT VIPM_COMPPISaturation_flg "" UBYTE AppSwcIpm_CM_boolean_flg 0 0 0.0 1.0 ECU_ADDRESS 0x0000 /* @ECU_Address@VIPM_COMPPISaturation_flg@ */ /end MEASUREMENT
/begin MEASUREMENT VIPM_COMPOvrCurrVld_flg "" UBYTE AppSwcIpm_CM_boolean_flg 0 0 0.0 1.0 ECU_ADDRESS 0x0000 /* @ECU_Address@VIPM_COMPOvrCurrVld_flg@ */ /end MEASUREMENT
/begin MEASUREMENT VIPM_COMPOverDutyVld_flg "" UBYTE AppSwcIpm_CM_boolean_flg 0 0 0.0 1.0 ECU_ADDRESS 0x0000 /* @ECU_Address@VIPM_COMPOverDutyVld_flg@ */ /end MEASUREMENT
/begin MEASUREMENT VIPM_COMPOverDuty_flg "" UBYTE AppSwcIpm_CM_boolean_flg 0 0 0.0 1.0 ECU_ADDRESS 0x0000 /* @ECU_Address@VIPM_COMPOverDuty_flg@ */ /end MEASUREMENT
/begin MEASUREMENT VIPM_COMPLvErrVld_flg "" UBYTE AppSwcIpm_CM_boolean_flg 0 0 0.0 1.0 ECU_ADDRESS 0x0000 /* @ECU_Address@VIPM_COMPLvErrVld_flg@ */ /end MEASUREMENT
/begin MEASUREMENT VIPM_COMPLoseStepVld_flg "" UBYTE AppSwcIpm_CM_boolean_flg 0 0 0.0 1.0 ECU_ADDRESS 0x0000 /* @ECU_Address@VIPM_COMPLoseStepVld_flg@ */ /end MEASUREMENT
/begin MEASUREMENT VIPM_COMPLoseStep_flg "" UBYTE AppSwcIpm_CM_boolean_flg 0 0 0.0 1.0 ECU_ADDRESS 0x0000 /* @ECU_Address@VIPM_COMPLoseStep_flg@ */ /end MEASUREMENT
/begin MEASUREMENT VIPM_COMPInCurrVld_flg "" UBYTE AppSwcIpm_CM_boolean_flg 0 0 0.0 1.0 ECU_ADDRESS 0x0000 /* @ECU_Address@VIPM_COMPInCurrVld_flg@ */ /end MEASUREMENT
/begin MEASUREMENT VIPM_COMPIPMErrVld_flg "" UBYTE AppSwcIpm_CM_boolean_flg 0 0 0.0 1.0 ECU_ADDRESS 0x0000 /* @ECU_Address@VIPM_COMPIPMErrVld_flg@ */ /end MEASUREMENT
/begin MEASUREMENT VIPM_COMPIPMErr_flg "" UBYTE AppSwcIpm_CM_boolean_flg 0 0 0.0 1.0 ECU_ADDRESS 0x0000 /* @ECU_Address@VIPM_COMPIPMErr_flg@ */ /end MEASUREMENT
/begin MEASUREMENT VIPM_COMPHvErrVld_flg "" UBYTE AppSwcIpm_CM_boolean_flg 0 0 0.0 1.0 ECU_ADDRESS 0x0000 /* @ECU_Address@VIPM_COMPHvErrVld_flg@ */ /end MEASUREMENT
/begin MEASUREMENT VIPM_COMPHiVoltVld_flg "" UBYTE AppSwcIpm_CM_boolean_flg 0 0 0.0 1.0 ECU_ADDRESS 0x0000 /* @ECU_Address@VIPM_COMPHiVoltVld_flg@ */ /end MEASUREMENT
/begin MEASUREMENT VIPM_COMPEcompSTVld_flg "" UBYTE AppSwcIpm_CM_boolean_flg 0 0 0.0 1.0 ECU_ADDRESS 0x0000 /* @ECU_Address@VIPM_COMPEcompSTVld_flg@ */ /end MEASUREMENT
/begin MEASUREMENT VIPM_COMPEcompActSpdVld_flg "" UBYTE AppSwcIpm_CM_boolean_flg 0 0 0.0 1.0 ECU_ADDRESS 0x0000 /* @ECU_Address@VIPM_COMPEcompActSpdVld_flg@ */ /end MEASUREMENT
/begin MEASUREMENT VIPM_COMPCurrOfstVld_flg "" UBYTE AppSwcIpm_CM_boolean_flg 0 0 0.0 1.0 ECU_ADDRESS 0x0000 /* @ECU_Address@VIPM_COMPCurrOfstVld_flg@ */ /end MEASUREMENT
/begin MEASUREMENT VIPM_COMPCurrOfst_flg "" UBYTE AppSwcIpm_CM_boolean_flg 0 0 0.0 1.0 ECU_ADDRESS 0x0000 /* @ECU_Address@VIPM_COMPCurrOfst_flg@ */ /end MEASUREMENT
/begin MEASUREMENT VIPM_COMPCommuErrorVld_flg "" UBYTE AppSwcIpm_CM_boolean_flg 0 0 0.0 1.0 ECU_ADDRESS 0x0000 /* @ECU_Address@VIPM_COMPCommuErrorVld_flg@ */ /end MEASUREMENT
/begin MEASUREMENT VIPM_COMPCommuError_flg "" UBYTE AppSwcIpm_CM_boolean_flg 0 0 0.0 1.0 ECU_ADDRESS 0x0000 /* @ECU_Address@VIPM_COMPCommuError_flg@ */ /end MEASUREMENT
/begin MEASUREMENT VIPM_COMPCANBusOffVld_flg "" UBYTE AppSwcIpm_CM_boolean_flg 0 0 0.0 1.0 ECU_ADDRESS 0x0000 /* @ECU_Address@VIPM_COMPCANBusOffVld_flg@ */ /end MEASUREMENT
/begin MEASUREMENT VIPM_COMPCANBusOff_flg "" UBYTE AppSwcIpm_CM_boolean_flg 0 0 0.0 1.0 ECU_ADDRESS 0x0000 /* @ECU_Address@VIPM_COMPCANBusOff_flg@ */ /end MEASUREMENT
/begin MEASUREMENT VIPM_HwVerMinVld_flg "" UBYTE AppSwcIpm_CM_boolean_flg 0 0 0.0 1.0 ECU_ADDRESS 0x0000 /* @ECU_Address@VIPM_HwVerMinVld_flg@ */ /end MEASUREMENT
/begin MEASUREMENT VIPM_HwVerMaxVld_flg "" UBYTE AppSwcIpm_CM_boolean_flg 0 0 0.0 1.0 ECU_ADDRESS 0x0000 /* @ECU_Address@VIPM_HwVerMaxVld_flg@ */ /end MEASUREMENT
/begin MEASUREMENT VIPM_ClientNumVld_flg "" UBYTE AppSwcIpm_CM_boolean_flg 0 0 0.0 1.0 ECU_ADDRESS 0x0000 /* @ECU_Address@VIPM_ClientNumVld_flg@ */ /end MEASUREMENT
/begin MEASUREMENT VIPM_BootVerVld_flg "" UBYTE AppSwcIpm_CM_boolean_flg 0 0 0.0 1.0 ECU_ADDRESS 0x0000 /* @ECU_Address@VIPM_BootVerVld_flg@ */ /end MEASUREMENT
/begin MEASUREMENT VIPM_APPVerMinVld_flg "" UBYTE AppSwcIpm_CM_boolean_flg 0 0 0.0 1.0 ECU_ADDRESS 0x0000 /* @ECU_Address@VIPM_APPVerMinVld_flg@ */ /end MEASUREMENT
/begin MEASUREMENT VIPM_APPVerMaxVld_flg "" UBYTE AppSwcIpm_CM_boolean_flg 0 0 0.0 1.0 ECU_ADDRESS 0x0000 /* @ECU_Address@VIPM_APPVerMaxVld_flg@ */ /end MEASUREMENT
/begin MEASUREMENT VIPM_EHBBrkPwrRecupTarWhlTqSts_enum "" UBYTE AppSwcIpm_CM_EnumRegenTgtTqStat 0 0 0 3 ECU_ADDRESS 0x0000 /* @ECU_Address@VIPM_EHBBrkPwrRecupTarWhlTqSts_enum@ */ /end MEASUREMENT
/begin MEASUREMENT VIPM_HUCstRecupModeSel_enum "" UBYTE AppSwcIpm_CM_EnumRegenModeSelct 0 0 0 3 ECU_ADDRESS 0x0000 /* @ECU_Address@VIPM_HUCstRecupModeSel_enum@ */ /end MEASUREMENT
/begin MEASUREMENT VIPM_IPUOBCWakeUpMode_enum "" UBYTE AppSwcIpm_CM_EnumOBCWakeUpMd 0 0 0 7 ECU_ADDRESS 0x0000 /* @ECU_Address@VIPM_IPUOBCWakeUpMode_enum@ */ /end MEASUREMENT
/begin MEASUREMENT VIPM_IPUOBCReq_enum "" UBYTE AppSwcIpm_CM_EnumOBCReq 0 0 0 3 ECU_ADDRESS 0x0000 /* @ECU_Address@VIPM_IPUOBCReq_enum@ */ /end MEASUREMENT
/begin MEASUREMENT VIPM_IPUOBCInletConnectSta_enum "" UBYTE AppSwcIpm_CM_EnumOBCPlugSt 0 0 0 3 ECU_ADDRESS 0x0000 /* @ECU_Address@VIPM_IPUOBCInletConnectSta_enum@ */ /end MEASUREMENT
/begin MEASUREMENT VIPM_IPUOBCActOprtMode_enum "" UBYTE AppSwcIpm_CM_EnumOBCActMd 0 0 0 15 ECU_ADDRESS 0x0000 /* @ECU_Address@VIPM_IPUOBCActOprtMode_enum@ */ /end MEASUREMENT
/begin MEASUREMENT VIPM_EHBEPBActuatorStR_enum "" UBYTE AppSwcIpm_CM_EnumEPBState 0 0 0 6 ECU_ADDRESS 0x0000 /* @ECU_Address@VIPM_EHBEPBActuatorStR_enum@ */ /end MEASUREMENT
/begin MEASUREMENT VIPM_HUDrvModeSel_enum "" UBYTE AppSwcIpm_CM_EnumDrvModeSelct 0 0 0 4 ECU_ADDRESS 0x0000 /* @ECU_Address@VIPM_HUDrvModeSel_enum@ */ /end MEASUREMENT
/begin MEASUREMENT VIPM_IPUDCCActOprtMode_enum "" UBYTE AppSwcIpm_CM_EnumDCCActMd 0 0 0 7 ECU_ADDRESS 0x0000 /* @ECU_Address@VIPM_IPUDCCActOprtMode_enum@ */ /end MEASUREMENT
/begin MEASUREMENT VIPM_HUPeristalsisModeEnbl_enum "" UBYTE AppSwcIpm_CM_EnumCrpModeEnbl 0 0 0 3 ECU_ADDRESS 0x0000 /* @ECU_Address@VIPM_HUPeristalsisModeEnbl_enum@ */ /end MEASUREMENT
/begin COMPU_METHOD AppSwcIpm_CM_single_A "Q = V" RAT_FUNC "%8.6" "A" COEFFS 0 1 0 0 0 1 /end COMPU_METHOD
/begin COMPU_METHOD AppSwcIpm_CM_single_pct "Q = V" RAT_FUNC "%8.6" "pct" COEFFS 0 1 0 0 0 1 /end COMPU_METHOD
/begin COMPU_METHOD AppSwcIpm_CM_single_V "Q = V" RAT_FUNC "%8.6" "V" COEFFS 0 1 0 0 0 1 /end COMPU_METHOD
/begin COMPU_METHOD AppSwcIpm_CM_single_C "Q = V" RAT_FUNC "%8.6" "C" COEFFS 0 1 0 0 0 1 /end COMPU_METHOD
/begin COMPU_METHOD AppSwcIpm_CM_single_rpm "Q = V" RAT_FUNC "%8.6" "rpm" COEFFS 0 1 0 0 0 1 /end COMPU_METHOD
/begin COMPU_METHOD AppSwcIpm_CM_single_Nm "Q = V" RAT_FUNC "%8.6" "Nm" COEFFS 0 1 0 0 0 1 /end COMPU_METHOD
/begin COMPU_METHOD AppSwcIpm_CM_single_degps "Q = V" RAT_FUNC "%8.6" "degps" COEFFS 0 1 0 0 0 1 /end COMPU_METHOD
/begin COMPU_METHOD AppSwcIpm_CM_single_kW "Q = V" RAT_FUNC "%8.6" "kW" COEFFS 0 1 0 0 0 1 /end COMPU_METHOD
/begin COMPU_METHOD AppSwcIpm_CM_uint16_enum "Q = V" RAT_FUNC "%5.0" "enum" COEFFS 0 1 0 0 0 1 /end COMPU_METHOD
/begin COMPU_METHOD AppSwcIpm_CM_uint16_nu "Q = V" RAT_FUNC "%5.0" "nu" COEFFS 0 1 0 0 0 1 /end COMPU_METHOD
/begin COMPU_METHOD AppSwcIpm_CM_EnumCrpModeEnbl "Enumerated data type: EnumCrpModeEnbl" TAB_VERB "%0.6" "" COMPU_TAB_REF VTAB_FOR_AppSwcIpm_CM_EnumCrpModeEnbl /end COMPU_METHOD
/begin COMPU_VTAB VTAB_FOR_AppSwcIpm_CM_EnumCrpModeEnbl "Enumerated data type: EnumCrpModeEnbl" TAB_VERB 4 0 "EnumCrpModeEnbl_NoCmd" 1 "EnumCrpModeEnbl_Enabled" 2 "EnumCrpModeEnbl_Disabled" 3 "EnumCrpModeEnbl_Reserved" /end COMPU_VTAB
/begin COMPU_METHOD AppSwcIpm_CM_EnumDCCActMd "Enumerated data type: EnumDCCActMd" TAB_VERB "%0.6" "" COMPU_TAB_REF VTAB_FOR_AppSwcIpm_CM_EnumDCCActMd /end COMPU_METHOD
/begin COMPU_VTAB VTAB_FOR_AppSwcIpm_CM_EnumDCCActMd "Enumerated data type: EnumDCCActMd" TAB_VERB 8 0 "EnumDCCActMd_Init" 1 "EnumDCCActMd_Standby" 2 "EnumDCCActMd_Prechrg" 3 "EnumDCCActMd_Buck" 4 "EnumDCCActMd_Boost" 5 "EnumDCCActMd_Fault" 6 "EnumDCCActMd_OFF" 7 "EnumDCCActMd_Rsrvd" /end COMPU_VTAB
/begin COMPU_METHOD AppSwcIpm_CM_EnumDrvModeSelct "Enumerated data type: EnumDrvModeSelct" TAB_VERB "%0.6" "" COMPU_TAB_REF VTAB_FOR_AppSwcIpm_CM_EnumDrvModeSelct /end COMPU_METHOD
/begin COMPU_VTAB VTAB_FOR_AppSwcIpm_CM_EnumDrvModeSelct "Enumerated data type: EnumDrvModeSelct" TAB_VERB 5 0 "EnumDrvModeSelct_NoCmd" 1 "EnumDrvModeSelct_Eco" 2 "EnumDrvModeSelct_Auto" 3 "EnumDrvModeSelct_Manual" 4 "EnumDrvModeSelct_Eped" /end COMPU_VTAB
/begin COMPU_METHOD AppSwcIpm_CM_EnumEPBState "Enumerated data type: EnumEPBState" TAB_VERB "%0.6" "" COMPU_TAB_REF VTAB_FOR_AppSwcIpm_CM_EnumEPBState /end COMPU_METHOD
/begin COMPU_VTAB VTAB_FOR_AppSwcIpm_CM_EnumEPBState "Enumerated data type: EnumEPBState" TAB_VERB 7 0 "EnumEPBState_Releasing" 1 "EnumEPBState_Applied" 2 "EnumEPBState_Released" 3 "EnumEPBState_Applying" 4 "EnumEPBState_CmpltReleased" 5 "EnumEPBState_Unknown" 6 "EnumEPBState_Hold" /end COMPU_VTAB
/begin COMPU_METHOD AppSwcIpm_CM_EnumOBCActMd "Enumerated data type: EnumOBCActMd" TAB_VERB "%0.6" "" COMPU_TAB_REF VTAB_FOR_AppSwcIpm_CM_EnumOBCActMd /end COMPU_METHOD
/begin COMPU_VTAB VTAB_FOR_AppSwcIpm_CM_EnumOBCActMd "Enumerated data type: EnumOBCActMd" TAB_VERB 16 0 "EnumOBCActMd_Init" 1 "EnumOBCActMd_ChrgStrt" 2 "EnumOBCActMd_Charging" 3 "EnumOBCActMd_ChrgStop" 4 "EnumOBCActMd_V2VDchaStrtg" 5 "EnumOBCActMd_V2LDchaStrtg" 6 "EnumOBCActMd_DchaStrt" 7 "EnumOBCActMd_V2VDischrging" 8 "EnumOBCActMd_V2LDischrging" 9 "EnumOBCActMd_Dischrging" 10 "EnumOBCActMd_DchaStop" 11 "EnumOBCActMd_PreSleep" 12 "EnumOBCActMd_Sleep" 13 "EnumOBCActMd_Rsrvd1" 14 "EnumOBCActMd_Rsrvd2" 15 "EnumOBCActMd_Rsrvd3" /end COMPU_VTAB
/begin COMPU_METHOD AppSwcIpm_CM_EnumOBCPlugSt "Enumerated data type: EnumOBCPlugSt" TAB_VERB "%0.6" "" COMPU_TAB_REF VTAB_FOR_AppSwcIpm_CM_EnumOBCPlugSt /end COMPU_METHOD
/begin COMPU_VTAB VTAB_FOR_AppSwcIpm_CM_EnumOBCPlugSt "Enumerated data type: EnumOBCPlugSt" TAB_VERB 4 0 "EnumOBCPlugSt_NoPlug" 1 "EnumOBCPlugSt_HalfPlug" 2 "EnumOBCPlugSt_Plug" 3 "EnumOBCPlugSt_Rsrvd" /end COMPU_VTAB
/begin COMPU_METHOD AppSwcIpm_CM_EnumOBCReq "Enumerated data type: EnumOBCReq" TAB_VERB "%0.6" "" COMPU_TAB_REF VTAB_FOR_AppSwcIpm_CM_EnumOBCReq /end COMPU_METHOD
/begin COMPU_VTAB VTAB_FOR_AppSwcIpm_CM_EnumOBCReq "Enumerated data type: EnumOBCReq" TAB_VERB 4 0 "EnumOBCReq_NoReq" 1 "EnumOBCReq_Charge" 2 "EnumOBCReq_DisChrg" 3 "EnumOBCReq_Rsrvd" /end COMPU_VTAB
/begin COMPU_METHOD AppSwcIpm_CM_EnumOBCWakeUpMd "Enumerated data type: EnumOBCWakeUpMd" TAB_VERB "%0.6" "" COMPU_TAB_REF VTAB_FOR_AppSwcIpm_CM_EnumOBCWakeUpMd /end COMPU_METHOD
/begin COMPU_VTAB VTAB_FOR_AppSwcIpm_CM_EnumOBCWakeUpMd "Enumerated data type: EnumOBCWakeUpMd" TAB_VERB 8 0 "EnumOBCWakeUpMd_Invld" 1 "EnumOBCWakeUpMd_ACChrg" 2 "EnumOBCWakeUpMd_V2VDcha" 3 "EnumOBCWakeUpMd_V2LDcha" 4 "EnumOBCWakeUpMd_InDcha" 5 "EnumOBCWakeUpMd_Rsrvd1" 6 "EnumOBCWakeUpMd_Rsrvd2" 7 "EnumOBCWakeUpMd_Rsrvd3" /end COMPU_VTAB
/begin COMPU_METHOD AppSwcIpm_CM_EnumRegenModeSelct "Enumerated data type: EnumRegenModeSelct" TAB_VERB "%0.6" "" COMPU_TAB_REF VTAB_FOR_AppSwcIpm_CM_EnumRegenModeSelct /end COMPU_METHOD
/begin COMPU_VTAB VTAB_FOR_AppSwcIpm_CM_EnumRegenModeSelct "Enumerated data type: EnumRegenModeSelct" TAB_VERB 4 0 "EnumRegenModeSelct_NoCmd" 1 "EnumRegenModeSelct_Weak" 2 "EnumRegenModeSelct_Strong" 3 "EnumRegenModeSelct_Off" /end COMPU_VTAB
/begin COMPU_METHOD AppSwcIpm_CM_EnumRegenTgtTqStat "Enumerated data type: EnumRegenTgtTqStat" TAB_VERB "%0.6" "" COMPU_TAB_REF VTAB_FOR_AppSwcIpm_CM_EnumRegenTgtTqStat /end COMPU_METHOD
/begin COMPU_VTAB VTAB_FOR_AppSwcIpm_CM_EnumRegenTgtTqStat "Enumerated data type: EnumRegenTgtTqStat" TAB_VERB 4 0 "EnumRegenTgtTqStat_NotInit" 1 "EnumRegenTgtTqStat_Inactive" 2 "EnumRegenTgtTqStat_Active" 3 "EnumRegenTgtTqStat_Fault" /end COMPU_VTAB
/begin COMPU_METHOD AppSwcIpm_CM_boolean_flg "Q = V" RAT_FUNC "%1.0" "flg" COEFFS 0 1 0 0 0 1 /end COMPU_METHOD
/begin COMPU_METHOD AppSwcIpm_CM_uint8_enum "Q = V" RAT_FUNC "%3.0" "enum" COEFFS 0 1 0 0 0 1 /end COMPU_METHOD
/begin COMPU_METHOD AppSwcIpm_CM_uint8_Ah "Q = V" RAT_FUNC "%3.0" "Ah" COEFFS 0 1 0 0 0 1 /end COMPU_METHOD
/begin COMPU_METHOD AppSwcIpm_CM_uint8_cnt "Q = V" RAT_FUNC "%3.0" "cnt" COEFFS 0 1 0 0 0 1 /end COMPU_METHOD
/begin COMPU_METHOD AppSwcIpm_CM_uint8_pct "Q = V" RAT_FUNC "%3.0" "pct" COEFFS 0 1 0 0 0 1 /end COMPU_METHOD
/begin COMPU_METHOD AppSwcIpm_CM_uint8_nu "Q = V" RAT_FUNC "%3.0" "nu" COEFFS 0 1 0 0 0 1 /end COMPU_METHOD
/begin GROUP AppSwcIpm "AppSwcIpm" /* Root */ ROOT
 /begin SUB_GROUP Root_Ipm100ms Root_Ipm10ms Root_Ipm20ms Root_Ipm50ms Root_IpmMsgActv /end SUB_GROUP
/end GROUP
/begin GROUP Root_Ipm100ms "AppSwcIpm/Ipm100ms"
 /begin SUB_GROUP S2_BODCAN_IN_1000ms S2_BODCAN_IN_100ms S2_BacCAN_IN_1000ms S2_BacCAN_IN_100ms S2_EptCAN_IN_100ms S2_EptCAN_IN_200ms S2_EptCAN_IN_500ms /end SUB_GROUP
/end GROUP
/begin GROUP Root_Ipm10ms "AppSwcIpm/Ipm10ms" /begin SUB_GROUP S3_CHACAN_IN_10ms S3_EPTCAN_IN_10ms /end SUB_GROUP /end GROUP
/begin GROUP Root_Ipm20ms "AppSwcIpm/Ipm20ms" /begin SUB_GROUP S4_BodCAN_IN_20ms S4_ChaCAN_IN_20ms S4_EptCAN_IN_20ms /end SUB_GROUP /end GROUP
/begin GROUP Root_Ipm50ms "AppSwcIpm/Ipm50ms" /begin SUB_GROUP S5_BodCAN_IN_50ms S5_CHACAN_IN_50ms /end SUB_GROUP /end GROUP
/begin GROUP Root_IpmMsgActv "AppSwcIpm/IpmMsgActv" /begin SUB_GROUP S6_CANCommError /end SUB_GROUP /end GROUP
/begin GROUP S2_BODCAN_IN_1000ms "AppSwcIpm/Ipm100ms/BODCAN_IN_1000ms" /begin SUB_GROUP S7_Msg_ACCM_Version_BOD /end SUB_GROUP /end GROUP
/begin GROUP S2_BODCAN_IN_100ms "AppSwcIpm/Ipm100ms/BODCAN_IN_100ms"
 /begin SUB_GROUP S8_Msg_COMP_AC_BOD S8_Msg_HVCH_Status1_BOD S8_Msg_HVCH_Status2_BOD /end SUB_GROUP
/end GROUP
/begin GROUP S2_BacCAN_IN_1000ms "AppSwcIpm/Ipm100ms/BacCAN_IN_1000ms" /begin SUB_GROUP S9_Msg_TBOX_BJS_Time_BAC /end SUB_GROUP /end GROUP
/begin GROUP S2_BacCAN_IN_100ms "AppSwcIpm/Ipm100ms/BacCAN_IN_100ms" /begin SUB_GROUP S10_Msg_HU_B_BAC /end SUB_GROUP /end GROUP
/begin GROUP S2_EptCAN_IN_100ms "AppSwcIpm/Ipm100ms/EptCAN_IN_100ms"
 /begin SUB_GROUP S11_Msg_BMS_5_BatTemp_EPT S11_Msg_INV_IMMO_Req_EPT S11_Msg_IPU_DCC_1_State_EPT S11_Msg_IPU_DCC_2_ChrgInValue_EPT S11_Msg_IPU_OBC_1_State_EPT /end SUB_GROUP
/end GROUP
/begin GROUP S2_EptCAN_IN_200ms "AppSwcIpm/Ipm100ms/EptCAN_IN_200ms" /begin SUB_GROUP S12_Msg_IPU_OBC_2_Inlet_EPT /end SUB_GROUP /end GROUP
/begin GROUP S2_EptCAN_IN_500ms "AppSwcIpm/Ipm100ms/EptCAN_IN_500ms" /begin SUB_GROUP S13_Msg_BMS_9_BattInfo_EPT /end SUB_GROUP /end GROUP
/begin GROUP S3_CHACAN_IN_10ms "AppSwcIpm/Ipm10ms/CHACAN_IN_10ms"
 /begin SUB_GROUP S152_Msg_EHB_B_CHA S152_Msg_EPS_2_StrWhlAng_CHA S152_Msg_ESC_7_FuncStatus_CHA S152_Msg_ESC_A_CHA /end SUB_GROUP
/end GROUP
/begin GROUP S3_EPTCAN_IN_10ms "AppSwcIpm/Ipm10ms/EPTCAN_IN_10ms"
 /begin SUB_GROUP S153_Msg_INV_1_Value_EPT S153_Msg_INV_2_Value_EPT S153_Msg_INV_3_Value_EPT S153_Msg_INV_4_Value_EPT /end SUB_GROUP
/end GROUP
/begin GROUP S4_BodCAN_IN_20ms "AppSwcIpm/Ipm20ms/BodCAN_IN_20ms" /begin SUB_GROUP S225_Msg_SCS_RiSwitchSts_BOD /end SUB_GROUP /end GROUP
/begin GROUP S4_ChaCAN_IN_20ms "AppSwcIpm/Ipm20ms/ChaCAN_IN_20ms" /begin SUB_GROUP S226_Msg_CRRR_A_CHA S226_Msg_EHB_A_CHA S226_Msg_FCM_B_CHA /end SUB_GROUP /end GROUP
/begin GROUP S4_EptCAN_IN_20ms "AppSwcIpm/Ipm20ms/EptCAN_IN_20ms"
 /begin SUB_GROUP S227_Msg_BMS_10_DC_ChargeStates_EPT S227_Msg_BMS_1_MainState_EPT S227_Msg_BMS_2_BatState_EPT S227_Msg_BMS_3_DC_ChargeState_EPT S227_Msg_BMS_4_AC_ChargeState_EPT S227_Msg_BMS_6_DischrgRecup_EPT S227_Msg_BMS_7_CellVolt_EPT /end SUB_GROUP
/end GROUP
/begin GROUP S5_BodCAN_IN_50ms "AppSwcIpm/Ipm50ms/BodCAN_IN_50ms"
 /begin SUB_GROUP S314_Msg_CCP_PanelStatus_BOD S314_Msg_ESCL_ESCLStatus_BOD S314_Msg_SCS_LeSwitchSts_BOD /end SUB_GROUP
/end GROUP
/begin GROUP S5_CHACAN_IN_50ms "AppSwcIpm/Ipm50ms/CHACAN_IN_50ms" /begin SUB_GROUP S315_Msg_SRS_1_Status_CHA /end SUB_GROUP /end GROUP
/begin GROUP S6_CANCommError "AppSwcIpm/IpmMsgActv/CANCommError"
 /begin REF_CHARACTERISTIC KIPM_ACCMLostCommOvrdSw_flg KIPM_ACCMLostCommOvrdVal_flg KIPM_BACCANBusOffOvrdSw_flg KIPM_BACCANBusOffOvrdVal_flg KIPM_BMSLostCommOvrdSw_flg KIPM_BMSLostCommOvrdVal_flg KIPM_BODCANBusOffOvrdSw_flg KIPM_BODCANBusOffOvrdVal_flg KIPM_CDCLostCommOvrdSw_flg KIPM_CDCLostCommOvrdVal_flg KIPM_CHACANBusOffOvrdSw_flg KIPM_CHACANBusOffOvrdVal_flg KIPM_CRRRLostCommOvrdSw_flg KIPM_CRRRLostCommOvrdVal_flg KIPM_EPSLostCommOvrdSw_flg KIPM_EPSLostCommOvrdVal_flg KIPM_EPTCANBusOffOvrdSw_flg KIPM_EPTCANBusOffOvrdVal_flg KIPM_ESCLostCommOvrdSw_flg KIPM_ESCLostCommOvrdVal_flg KIPM_FCMLostCommOvrdSw_flg KIPM_FCMLostCommOvrdVal_flg KIPM_ICULostCommOvrdSw_flg KIPM_ICULostCommOvrdVal_flg KIPM_IPULostCommOvrdSw_flg KIPM_IPULostCommOvrdVal_flg KIPM_MCULostCommOvrdSw_flg KIPM_MCULostCommOvrdVal_flg KIPM_PPLostCommOvrdSw_flg KIPM_PPLostCommOvrdVal_flg KIPM_PTCLostCommOvrdSw_flg KIPM_PTCLostCommOvrdVal_flg KIPM_SRSLostCommOvrdSw_flg KIPM_SRSLostCommOvrdVal_flg KIPM_TBOXLostCommOvrdSw_flg KIPM_TBOXLostCommOvrdVal_flg /end REF_CHARACTERISTIC
 /begin REF_MEASUREMENT VIPM_ACCMLostComm_flg VIPM_BACCANBusOff_flg VIPM_BMSLostComm_flg VIPM_BODCANBusOff_flg VIPM_CDCLostComm_flg VIPM_CHACANBusOff_flg VIPM_CRRRLostComm_flg VIPM_EPSLostComm_flg VIPM_EPTCANBusOff_flg VIPM_ESCLostComm_flg VIPM_FCMLostComm_flg VIPM_ICULostComm_flg VIPM_IPULostComm_flg VIPM_MCULostComm_flg VIPM_PPLostComm_flg VIPM_PTCLostComm_flg VIPM_SRSLostComm_flg VIPM_TBOXLostComm_flg /end REF_MEASUREMENT
/end GROUP
/begin GROUP S7_Msg_ACCM_Version_BOD "AppSwcIpm/Ipm100ms/BODCAN_IN_1000ms/Msg_ACCM_Version_BOD"
 /begin SUB_GROUP S14_Subsys_VIPM_APPVerMax_enum S14_Subsys_VIPM_APPVerMin_enum S14_Subsys_VIPM_BootVer_enum S14_Subsys_VIPM_ClientNum_enum S14_Subsys_VIPM_HwVerMax_enum S14_Subsys_VIPM_HwVerMin_enum /end SUB_GROUP
/end GROUP
/begin GROUP S8_Msg_COMP_AC_BOD "AppSwcIpm/Ipm100ms/BODCAN_IN_100ms/Msg_COMP_AC_BOD"
 /begin SUB_GROUP S21_Subsys_VIPM_COMPCANBusOff_flg S21_Subsys_VIPM_COMPCommuError_flg S21_Subsys_VIPM_COMPCurrOfst_flg S21_Subsys_VIPM_COMPEcompActSpd_rpm S21_Subsys_VIPM_COMPEcompST_enum S21_Subsys_VIPM_COMPHiVolt_V S21_Subsys_VIPM_COMPHvErr_enum S21_Subsys_VIPM_COMPIPMErr_flg S21_Subsys_VIPM_COMPInCurr_A S21_Subsys_VIPM_COMPLoseStep_flg S21_Subsys_VIPM_COMPLvErr_enum S21_Subsys_VIPM_COMPOverDuty_flg S21_Subsys_VIPM_COMPOvrCurr_enum S21_Subsys_VIPM_COMPPISaturation_flg S21_Subsys_VIPM_COMPSelfChkErr_enum S21_Subsys_VIPM_COMPTempErr_flg S21_Subsys_VIPM_COMPTemp_C S21_Subsys_VIPM_ECUHiVoltInterlockSig_flg /end SUB_GROUP
/end GROUP
/begin GROUP S8_Msg_HVCH_Status1_BOD "AppSwcIpm/Ipm100ms/BODCAN_IN_100ms/Msg_HVCH_Status1_BOD"
 /begin SUB_GROUP S22_Subsys_VIPM_HVCHHVSt_flg S22_Subsys_VIPM_HVCHInletTemp_C S22_Subsys_VIPM_HVCHOutlTemp_C S22_Subsys_VIPM_HVCHPCBTemp_C S22_Subsys_VIPM_HVCHSt_enum S22_Subsys_VIPM_HVCHWorkMode_enum /end SUB_GROUP
/end GROUP
/begin GROUP S8_Msg_HVCH_Status2_BOD "AppSwcIpm/Ipm100ms/BODCAN_IN_100ms/Msg_HVCH_Status2_BOD"
 /begin SUB_GROUP S23_Subsys_VIPM_HVCHCurr_A S23_Subsys_VIPM_HVCHFltCod_enum S23_Subsys_VIPM_HVCHHVVolts_V S23_Subsys_VIPM_HVCHPwr_kW S23_Subsys_VIPM_HVCHWorkSt_enum /end SUB_GROUP
/end GROUP
/begin GROUP S9_Msg_TBOX_BJS_Time_BAC "AppSwcIpm/Ipm100ms/BacCAN_IN_1000ms/Msg_TBOX_BJS_Time_BAC"
 /begin SUB_GROUP S63_Subsys_VIPM_TBOXBJSTimeDay_nu S63_Subsys_VIPM_TBOXBJSTimeHour_nu S63_Subsys_VIPM_TBOXBJSTimeMin_nu S63_Subsys_VIPM_TBOXBJSTimeMonth_nu S63_Subsys_VIPM_TBOXBJSTimeSec_nu S63_Subsys_VIPM_TBOXBJSTimeYear_nu /end SUB_GROUP
/end GROUP
/begin GROUP S10_Msg_HU_B_BAC "AppSwcIpm/Ipm100ms/BacCAN_IN_100ms/Msg_HU_B_BAC"
 /begin SUB_GROUP S71_Subsys_VIPM_CDCBackLadjval_enum S71_Subsys_VIPM_HUACAutoCtl_enum S71_Subsys_VIPM_HUACPwrCtl_enum S71_Subsys_VIPM_HUAirInletModeSet_enum S71_Subsys_VIPM_HUBlwrModeSet_enum S71_Subsys_VIPM_HUChgWiprMtMdSwSet_enum S71_Subsys_VIPM_HUCstRecupModeSel_enum S71_Subsys_VIPM_HUDrvModeSel_enum S71_Subsys_VIPM_HUDrvPwrSet_cnt S71_Subsys_VIPM_HUFlwrMeHmCtrl_enum S71_Subsys_VIPM_HUFrntFanSpdSet_enum S71_Subsys_VIPM_HUHybEcoModeSet_enum S71_Subsys_VIPM_HUIllmndEntrySts_enum S71_Subsys_VIPM_HUIllmndLckSts_enum S71_Subsys_VIPM_HUIllmndUnlckSts_enum S71_Subsys_VIPM_HULckHornOnSt_enum S71_Subsys_VIPM_HULeftTempSet_enum S71_Subsys_VIPM_HUMaiDrvrSeatHeat_enum S71_Subsys_VIPM_HUManlDefrstCtl_enum S71_Subsys_VIPM_HUOvrspdCntrlLckSet_enum S71_Subsys_VIPM_HUParkAutoUnlckSet_enum S71_Subsys_VIPM_HUPeristalsisModeEnbl_enum S71_Subsys_VIPM_HUPwrOffReq_flg S71_Subsys_VIPM_HURecupPwrSet_pct S71_Subsys_VIPM_HURrMirrHeat_enum S71_Subsys_VIPM_HUSteerWhlHeat_enum S71_Subsys_VIPM_HUTPMSRstReq_flg S71_Subsys_VIPM_HUTrnkLckSwCtrl_enum S71_Subsys_VIPM_HUWiprIntlTmSet_enum /end SUB_GROUP
/end GROUP
/begin GROUP S11_Msg_BMS_5_BatTemp_EPT "AppSwcIpm/Ipm100ms/EptCAN_IN_100ms/Msg_BMS_5_BatTemp_EPT"
 /begin SUB_GROUP S101_Subsys_VIPM_BMSHVBatCellTempAve_C S101_Subsys_VIPM_BMSHVBatCellTempMax_C S101_Subsys_VIPM_BMSHVBatCellTempMin_C /end SUB_GROUP
/end GROUP
/begin GROUP S11_Msg_INV_IMMO_Req_EPT "AppSwcIpm/Ipm100ms/EptCAN_IN_100ms/Msg_INV_IMMO_Req_EPT"
 /begin SUB_GROUP S102_Subsys_VIPM_INVLrngData02_nu S102_Subsys_VIPM_INVLrngData03_nu S102_Subsys_VIPM_INVLrngData04_nu S102_Subsys_VIPM_INVLrngData05_nu S102_Subsys_VIPM_INVLrngData06_nu S102_Subsys_VIPM_INVLrngData07_nu S102_Subsys_VIPM_INVLrngSts_enum S102_Subsys_VIPM_INVLrngSubID_cnt /end SUB_GROUP
/end GROUP
/begin GROUP S11_Msg_IPU_DCC_1_State_EPT "AppSwcIpm/Ipm100ms/EptCAN_IN_100ms/Msg_IPU_DCC_1_State_EPT"
 /begin SUB_GROUP S103_Subsys_VIPM_IPUDCCActOprtMode_enum S103_Subsys_VIPM_IPUDCCLoVoltActCurnt_A S103_Subsys_VIPM_IPUDCCLoVoltActVolt_V S103_Subsys_VIPM_IPUDCCSysFailSta_enum /end SUB_GROUP
/end GROUP
/begin GROUP S11_Msg_IPU_DCC_2_ChrgInValue_EPT "AppSwcIpm/Ipm100ms/EptCAN_IN_100ms/Msg_IPU_DCC_2_ChrgInValue_EPT"
 /begin SUB_GROUP S104_Subsys_VIPM_IPUDCCHiVoltActCurnt_A S104_Subsys_VIPM_IPUDCCHiVoltActVolt_V /end SUB_GROUP
/end GROUP
/begin GROUP S11_Msg_IPU_OBC_1_State_EPT "AppSwcIpm/Ipm100ms/EptCAN_IN_100ms/Msg_IPU_OBC_1_State_EPT"
 /begin SUB_GROUP S105_Subsys_VIPM_IPUOBCActOprtMode_enum S105_Subsys_VIPM_IPUOBCConnectMainSta_flg S105_Subsys_VIPM_IPUOBCHVDCActCur_A S105_Subsys_VIPM_IPUOBCHVDCActVol_V S105_Subsys_VIPM_IPUOBCInletActPwr_kW S105_Subsys_VIPM_IPUOBCInletConnectSta_enum S105_Subsys_VIPM_IPUOBCReq_enum S105_Subsys_VIPM_IPUOBCSysFailSta_enum /end SUB_GROUP
/end GROUP
/begin GROUP S12_Msg_IPU_OBC_2_Inlet_EPT "AppSwcIpm/Ipm100ms/EptCAN_IN_200ms/Msg_IPU_OBC_2_Inlet_EPT"
 /begin SUB_GROUP S140_Subsys_VIPM_IPUDeviceIntTemp_C S140_Subsys_VIPM_IPUOBCACMaxPwrAllow_kW S140_Subsys_VIPM_IPUOBCS2State_flg S140_Subsys_VIPM_IPUOBCTempInt_C S140_Subsys_VIPM_IPUOBCWakeUpMode_enum /end SUB_GROUP
/end GROUP
/begin GROUP S13_Msg_BMS_9_BattInfo_EPT "AppSwcIpm/Ipm100ms/EptCAN_IN_500ms/Msg_BMS_9_BattInfo_EPT"
 /begin SUB_GROUP S149_Subsys_VIPM_BMSBatCapcty_Ah S149_Subsys_VIPM_BMSPackID_enum /end SUB_GROUP
/end GROUP
/begin GROUP S152_Msg_EHB_B_CHA "AppSwcIpm/Ipm10ms/CHACAN_IN_10ms/Msg_EHB_B_CHA"
 /begin SUB_GROUP S154_Subsys_VIPM_EHBBrkPedlValPerc_pct S154_Subsys_VIPM_EHBBrkPwrRecupTarWhlTqSts_enum S154_Subsys_VIPM_EHBBrkPwrRecupTarWhlTq_Nm S154_Subsys_VIPM_EHBCDDActv_flg S154_Subsys_VIPM_EHBEPBActuatorStR_enum S154_Subsys_VIPM_EHBFltLvl_enum S154_Subsys_VIPM_EHBReqBrkLiOn_flg /end SUB_GROUP
/end GROUP
/begin GROUP S152_Msg_EPS_2_StrWhlAng_CHA "AppSwcIpm/Ipm10ms/CHACAN_IN_10ms/Msg_EPS_2_StrWhlAng_CHA"
 /begin SUB_GROUP S155_Subsys_VIPM_EPSRotSpd_degps S155_Subsys_VIPM_EPSSteerWhlAngCald_flg S155_Subsys_VIPM_EPSSteerWhlAngFailr_flg S155_Subsys_VIPM_EPSSteerWhlAng_deg /end SUB_GROUP
/end GROUP
/begin GROUP S152_Msg_ESC_7_FuncStatus_CHA "AppSwcIpm/Ipm10ms/CHACAN_IN_10ms/Msg_ESC_7_FuncStatus_CHA"
 /begin SUB_GROUP S156_Subsys_VIPM_ESCABSActvSta_flg S156_Subsys_VIPM_ESCESPActvSta_flg S156_Subsys_VIPM_ESCESSActv_flg S156_Subsys_VIPM_ESCFltLvl_enum S156_Subsys_VIPM_ESCReqBrkLghtOn_flg S156_Subsys_VIPM_ESCTCSActvSta_flg S156_Subsys_VIPM_ESCVehSpd_kph /end SUB_GROUP
/end GROUP
/begin GROUP S152_Msg_ESC_A_CHA "AppSwcIpm/Ipm10ms/CHACAN_IN_10ms/Msg_ESC_A_CHA"
 /begin SUB_GROUP S157_Subsys_VIPM_ESCMstrCylPresr_bar S157_Subsys_VIPM_ESCVehStandStillSta_enum S157_Subsys_VIPM_ESCWhlDirctnFL_enum S157_Subsys_VIPM_ESCWhlDirctnFR_enum S157_Subsys_VIPM_ESCWhlDirctnRL_enum S157_Subsys_VIPM_ESCWhlDirctnRR_enum S157_Subsys_VIPM_ESCWhlSpdKphFL_kph S157_Subsys_VIPM_ESCWhlSpdKphFR_kph S157_Subsys_VIPM_ESCWhlSpdKphRL_kph S157_Subsys_VIPM_ESCWhlSpdKphRR_kph S157_Subsys_VIPM_ESCWhlTqDecReqActv_flg S157_Subsys_VIPM_ESCWhlTqDecReqVal_Nm S157_Subsys_VIPM_ESCWhlTqIncReqActv_flg S157_Subsys_VIPM_ESCWhlTqIncReqVal_Nm /end SUB_GROUP
/end GROUP
/begin GROUP S153_Msg_INV_1_Value_EPT "AppSwcIpm/Ipm10ms/EPTCAN_IN_10ms/Msg_INV_1_Value_EPT"
 /begin SUB_GROUP S200_Subsys_VIPM_INV1ActMode_enum S200_Subsys_VIPM_INV1ActTorq_Nm S200_Subsys_VIPM_INV1AntithftAuthRslt_enum S200_Subsys_VIPM_INV1MotSpd_rpm S200_Subsys_VIPM_INV1PreChrgAllwd_enum S200_Subsys_VIPM_INV1PreprogmFlg_flg S200_Subsys_VIPM_INV1ShutdownAllwd_enum /end SUB_GROUP
/end GROUP
/begin GROUP S153_Msg_INV_2_Value_EPT "AppSwcIpm/Ipm10ms/EPTCAN_IN_10ms/Msg_INV_2_Value_EPT"
 /begin SUB_GROUP S201_Subsys_VIPM_INV2IgbtMaxTemp_C S201_Subsys_VIPM_INV2InpCurnt_A S201_Subsys_VIPM_INV2InpVolt_V S201_Subsys_VIPM_INV2MotorMaxTemp_C /end SUB_GROUP
/end GROUP
/begin GROUP S153_Msg_INV_3_Value_EPT "AppSwcIpm/Ipm10ms/EPTCAN_IN_10ms/Msg_INV_3_Value_EPT"
 /begin SUB_GROUP S202_Subsys_VIPM_INV3DrvTqAllwdMax_Nm S202_Subsys_VIPM_INV3RecupTqAllwdMax_Nm /end SUB_GROUP
/end GROUP
/begin GROUP S153_Msg_INV_4_Value_EPT "AppSwcIpm/Ipm10ms/EPTCAN_IN_10ms/Msg_INV_4_Value_EPT" /begin SUB_GROUP S203_Subsys_VIPM_INV4FltLvl_enum /end SUB_GROUP /end GROUP
/begin GROUP S225_Msg_SCS_RiSwitchSts_BOD "AppSwcIpm/Ipm20ms/BodCAN_IN_20ms/Msg_SCS_RiSwitchSts_BOD"
 /begin SUB_GROUP S228_Subsys_VIPM_SCSGrShftLvrPstnReq_enum S228_Subsys_VIPM_SCSRght11Sw_flg S228_Subsys_VIPM_SCSRght12Sw_flg S228_Subsys_VIPM_SCSRght13Sw_flg S228_Subsys_VIPM_SCSRghtSwVldty_flg /end SUB_GROUP
/end GROUP
/begin GROUP S226_Msg_CRRR_A_CHA "AppSwcIpm/Ipm20ms/ChaCAN_IN_20ms/Msg_CRRR_A_CHA"
 /begin SUB_GROUP S234_Subsys_VIPM_CRRRBSDWarnLt_enum S234_Subsys_VIPM_CRRRBSDWarnRt_enum S234_Subsys_VIPM_CRRRDOWWarnLt_enum S234_Subsys_VIPM_CRRRDOWWarnRt_enum S234_Subsys_VIPM_CRRRRCTAWarnLt_enum S234_Subsys_VIPM_CRRRRCTAWarnRt_enum /end SUB_GROUP
/end GROUP
/begin GROUP S226_Msg_EHB_A_CHA "AppSwcIpm/Ipm20ms/ChaCAN_IN_20ms/Msg_EHB_A_CHA"
 /begin SUB_GROUP S235_Subsys_VIPM_EHBAVHAppldSt_enum S235_Subsys_VIPM_EHBBLA_flg S235_Subsys_VIPM_EHBEPBActuatorStL_enum S235_Subsys_VIPM_EHBEPBSwitchSts_enum S235_Subsys_VIPM_EHBEPBSysSt_enum S235_Subsys_VIPM_EHBHDCFucFault_flg /end SUB_GROUP
/end GROUP
/begin GROUP S226_Msg_FCM_B_CHA "AppSwcIpm/Ipm20ms/ChaCAN_IN_20ms/Msg_FCM_B_CHA"
 /begin SUB_GROUP S236_Subsys_VIPM_FCMACCWhlDece_mps2 S236_Subsys_VIPM_FCMACCWhlTqReqActv_flg S236_Subsys_VIPM_FCMACCWhlTqReqVal_Nm S236_Subsys_VIPM_FCMAEBReq_flg S236_Subsys_VIPM_FCMAccMode_enum S236_Subsys_VIPM_FCMAccReqDriveOff_flg S236_Subsys_VIPM_FCMAccReqStandstill_flg S236_Subsys_VIPM_FCMAccTarAccrnReqActv_flg S236_Subsys_VIPM_FCMAccTarAccrn_mps2 S236_Subsys_VIPM_FCMAccTgtAxReq_flg S236_Subsys_VIPM_FCMAccTgtAx_mps2 S236_Subsys_VIPM_FCMEPBReq_enum S236_Subsys_VIPM_FCMTrnLampReq_enum /end SUB_GROUP
/end GROUP
/begin GROUP S227_Msg_BMS_10_DC_ChargeStates_EPT "AppSwcIpm/Ipm20ms/EptCAN_IN_20ms/Msg_BMS_10_DC_ChargeStates_EPT"
 /begin SUB_GROUP S266_Subsys_VIPM_BMSDCSActOprtMode_enum S266_Subsys_VIPM_BMSDCSInletConnectSta_flg /end SUB_GROUP
/end GROUP
/begin GROUP S227_Msg_BMS_1_MainState_EPT "AppSwcIpm/Ipm20ms/EptCAN_IN_20ms/Msg_BMS_1_MainState_EPT"
 /begin SUB_GROUP S267_Subsys_VIPM_BMSActExchgCurnt_A S267_Subsys_VIPM_BMSChrgInterlockSta_enum S267_Subsys_VIPM_BMSDchrgInterlockSta_enum S267_Subsys_VIPM_BMSEmgcySdnReq_flg S267_Subsys_VIPM_BMSPwrTrainConnectSta_enum S267_Subsys_VIPM_BMSRunSta_enum S267_Subsys_VIPM_BMSSysFailSta_enum S267_Subsys_VIPM_BMSThermrunawayWrn_enum /end SUB_GROUP
/end GROUP
/begin GROUP S227_Msg_BMS_2_BatState_EPT "AppSwcIpm/Ipm20ms/EptCAN_IN_20ms/Msg_BMS_2_BatState_EPT"
 /begin SUB_GROUP S268_Subsys_VIPM_BMSBatSOCAct_pct S268_Subsys_VIPM_BMSBatSOCRpt_pct S268_Subsys_VIPM_BMSBatSOH_pct S268_Subsys_VIPM_BMSHVBatActVolt_V /end SUB_GROUP
/end GROUP
/begin GROUP S227_Msg_BMS_3_DC_ChargeState_EPT "AppSwcIpm/Ipm20ms/EptCAN_IN_20ms/Msg_BMS_3_DC_ChargeState_EPT" /begin SUB_GROUP S269_Subsys_VIPM_BMSDCSChrgReq_flg /end SUB_GROUP /end GROUP
/begin GROUP S227_Msg_BMS_4_AC_ChargeState_EPT "AppSwcIpm/Ipm20ms/EptCAN_IN_20ms/Msg_BMS_4_AC_ChargeState_EPT"
 /begin SUB_GROUP S270_Subsys_VIPM_BMSACChrgAtclSta_enum S270_Subsys_VIPM_BMSInletCooltActlTemp_C S270_Subsys_VIPM_BMSIsoResist_MOhm S270_Subsys_VIPM_BMSMaxChrgCurntAC_A S270_Subsys_VIPM_BMSMaxChrgVoltAC_V S270_Subsys_VIPM_BMSOutlCooltActlTemp_C /end SUB_GROUP
/end GROUP
/begin GROUP S227_Msg_BMS_6_DischrgRecup_EPT "AppSwcIpm/Ipm20ms/EptCAN_IN_20ms/Msg_BMS_6_DischrgRecup_EPT"
 /begin SUB_GROUP S271_Subsys_VIPM_BMSMaxConChrgCurnt_A S271_Subsys_VIPM_BMSMaxConDisCurnt_A S271_Subsys_VIPM_BMSMaxInsChrgCurnt_A S271_Subsys_VIPM_BMSMaxInsDisCurnt_A /end SUB_GROUP
/end GROUP
/begin GROUP S227_Msg_BMS_7_CellVolt_EPT "AppSwcIpm/Ipm20ms/EptCAN_IN_20ms/Msg_BMS_7_CellVolt_EPT"
 /begin SUB_GROUP S272_Subsys_VIPM_BMSCellVoltMax_mV S272_Subsys_VIPM_BMSCellVoltMin_mV /end SUB_GROUP
/end GROUP
/begin GROUP S314_Msg_CCP_PanelStatus_BOD "AppSwcIpm/Ipm50ms/BodCAN_IN_50ms/Msg_CCP_PanelStatus_BOD"
 /begin SUB_GROUP S316_Subsys_VIPM_CCPACAutoKey_flg S316_Subsys_VIPM_CCPACSwKey_flg S316_Subsys_VIPM_CCPAVASOffKey_flg S316_Subsys_VIPM_CCPAVHKey_flg S316_Subsys_VIPM_CCPAirInletModeKey_flg S316_Subsys_VIPM_CCPBlwngModeNextKey_flg S316_Subsys_VIPM_CCPBlwngModePrevKey_flg S316_Subsys_VIPM_CCPBlwrLvlAddKey_flg S316_Subsys_VIPM_CCPBlwrLvlDecKey_flg S316_Subsys_VIPM_CCPCenLckKey_flg S316_Subsys_VIPM_CCPESCOffKey_flg S316_Subsys_VIPM_CCPFrntWindDefrstKey_flg S316_Subsys_VIPM_CCPHDCKey_flg S316_Subsys_VIPM_CCPHzrdKey_flg S316_Subsys_VIPM_CCPModeKey_flg S316_Subsys_VIPM_CCPPwrRecupLvlKey_flg S316_Subsys_VIPM_CCPRrViewMirrHeatgKey_flg S316_Subsys_VIPM_CCPTPMSKey_flg S316_Subsys_VIPM_CCPTempAddKey_flg S316_Subsys_VIPM_CCPTempDecKey_flg /end SUB_GROUP
/end GROUP
/begin GROUP S314_Msg_ESCL_ESCLStatus_BOD "AppSwcIpm/Ipm50ms/BodCAN_IN_50ms/Msg_ESCL_ESCLStatus_BOD" /begin SUB_GROUP S317_Subsys_VIPM_ESCLUnOrLockfeedback_nu /end SUB_GROUP /end GROUP
/begin GROUP S314_Msg_SCS_LeSwitchSts_BOD "AppSwcIpm/Ipm50ms/BodCAN_IN_50ms/Msg_SCS_LeSwitchSts_BOD"
 /begin SUB_GROUP S318_Subsys_VIPM_SCSFrntWiprSwtSt_enum S318_Subsys_VIPM_SCSFrntWshrSwtSt_flg S318_Subsys_VIPM_SCSHiBeamSwSt_flg S318_Subsys_VIPM_SCSLampAutoSt_flg S318_Subsys_VIPM_SCSLeTrnLmpSwSt_flg S318_Subsys_VIPM_SCSLoBeamSwSt_flg S318_Subsys_VIPM_SCSOvrVehBeamSwSt_flg S318_Subsys_VIPM_SCSPstnLghtSwSt_flg S318_Subsys_VIPM_SCSRiTrnLmpSwSt_flg /end SUB_GROUP
/end GROUP
/begin GROUP S315_Msg_SRS_1_Status_CHA "AppSwcIpm/Ipm50ms/CHACAN_IN_50ms/Msg_SRS_1_Status_CHA"
 /begin SUB_GROUP S349_Subsys_VIPM_SRSCrashOutputSts_enum S349_Subsys_VIPM_SRSDrvSeatbeltBkld_flg /end SUB_GROUP
/end GROUP
/begin GROUP S14_Subsys_VIPM_APPVerMax_enum "AppSwcIpm/Ipm100ms/BODCAN_IN_1000ms/Msg_ACCM_Version_BOD/Subsys_VIPM_APPVerMax_enum"
 /begin REF_CHARACTERISTIC KIPM_APPVerMaxDflt_enum KIPM_APPVerMax_enum_ovrdflg KIPM_APPVerMax_enum_ovrdval /end REF_CHARACTERISTIC
 /begin REF_MEASUREMENT VIPM_APPVerMaxVld_flg VIPM_APPVerMax_enum /end REF_MEASUREMENT
/end GROUP
/begin GROUP S14_Subsys_VIPM_APPVerMin_enum "AppSwcIpm/Ipm100ms/BODCAN_IN_1000ms/Msg_ACCM_Version_BOD/Subsys_VIPM_APPVerMin_enum"
 /begin REF_CHARACTERISTIC KIPM_APPVerMinDflt_enum KIPM_APPVerMin_enum_ovrdflg KIPM_APPVerMin_enum_ovrdval /end REF_CHARACTERISTIC
 /begin REF_MEASUREMENT VIPM_APPVerMinVld_flg VIPM_APPVerMin_enum /end REF_MEASUREMENT
/end GROUP
/begin GROUP S14_Subsys_VIPM_BootVer_enum "AppSwcIpm/Ipm100ms/BODCAN_IN_1000ms/Msg_ACCM_Version_BOD/Subsys_VIPM_BootVer_enum"
 /begin REF_CHARACTERISTIC KIPM_BootVerDflt_enum KIPM_BootVer_enum_ovrdflg KIPM_BootVer_enum_ovrdval /end REF_CHARACTERISTIC
 /begin REF_MEASUREMENT VIPM_BootVerVld_flg VIPM_BootVer_enum /end REF_MEASUREMENT
/end GROUP
/begin GROUP S14_Subsys_VIPM_ClientNum_enum "AppSwcIpm/Ipm100ms/BODCAN_IN_1000ms/Msg_ACCM_Version_BOD/Subsys_VIPM_ClientNum_enum"
 /begin REF_CHARACTERISTIC KIPM_ClientNumDflt_enum KIPM_ClientNum_enum_ovrdflg KIPM_ClientNum_enum_ovrdval /end REF_CHARACTERISTIC
 /begin REF_MEASUREMENT VIPM_ClientNumVld_flg VIPM_ClientNum_enum /end REF_MEASUREMENT
/end GROUP
/begin GROUP S14_Subsys_VIPM_HwVerMax_enum "AppSwcIpm/Ipm100ms/BODCAN_IN_1000ms/Msg_ACCM_Version_BOD/Subsys_VIPM_HwVerMax_enum"
 /begin REF_CHARACTERISTIC KIPM_HwVerMaxDflt_enum KIPM_HwVerMax_enum_ovrdflg KIPM_HwVerMax_enum_ovrdval /end REF_CHARACTERISTIC
 /begin REF_MEASUREMENT VIPM_HwVerMaxVld_flg VIPM_HwVerMax_enum /end REF_MEASUREMENT
/end GROUP
/begin GROUP S14_Subsys_VIPM_HwVerMin_enum "AppSwcIpm/Ipm100ms/BODCAN_IN_1000ms/Msg_ACCM_Version_BOD/Subsys_VIPM_HwVerMin_enum"
 /begin REF_CHARACTERISTIC KIPM_HwVerMinDflt_enum KIPM_HwVerMin_enum_ovrdflg KIPM_HwVerMin_enum_ovrdval /end REF_CHARACTERISTIC
 /begin REF_MEASUREMENT VIPM_HwVerMinVld_flg VIPM_HwVerMin_enum /end REF_MEASUREMENT
/end GROUP
/begin GROUP S21_Subsys_VIPM_COMPCANBusOff_flg "AppSwcIpm/Ipm100ms/BODCAN_IN_100ms/Msg_COMP_AC_BOD/Subsys_VIPM_COMPCANBusOff_flg"
 /begin REF_CHARACTERISTIC KIPM_COMPCANBusOffDflt_flg KIPM_COMPCANBusOff_flg_ovrdflg KIPM_COMPCANBusOff_flg_ovrdval /end REF_CHARACTERISTIC
 /begin REF_MEASUREMENT VIPM_COMPCANBusOffVld_flg VIPM_COMPCANBusOff_flg /end REF_MEASUREMENT
/end GROUP
/begin GROUP S21_Subsys_VIPM_COMPCommuError_flg "AppSwcIpm/Ipm100ms/BODCAN_IN_100ms/Msg_COMP_AC_BOD/Subsys_VIPM_COMPCommuError_flg"
 /begin REF_CHARACTERISTIC KIPM_COMPCommuErrorDflt_flg KIPM_COMPCommuError_flg_ovrdflg KIPM_COMPCommuError_flg_ovrdval /end REF_CHARACTERISTIC
 /begin REF_MEASUREMENT VIPM_COMPCommuErrorVld_flg VIPM_COMPCommuError_flg /end REF_MEASUREMENT
/end GROUP
/begin GROUP S21_Subsys_VIPM_COMPCurrOfst_flg "AppSwcIpm/Ipm100ms/BODCAN_IN_100ms/Msg_COMP_AC_BOD/Subsys_VIPM_COMPCurrOfst_flg"
 /begin REF_CHARACTERISTIC KIPM_COMPCurrOfstDflt_flg KIPM_COMPCurrOfst_flg_ovrdflg KIPM_COMPCurrOfst_flg_ovrdval /end REF_CHARACTERISTIC
 /begin REF_MEASUREMENT VIPM_COMPCurrOfstVld_flg VIPM_COMPCurrOfst_flg /end REF_MEASUREMENT
/end GROUP
/begin GROUP S21_Subsys_VIPM_COMPEcompActSpd_rpm "AppSwcIpm/Ipm100ms/BODCAN_IN_100ms/Msg_COMP_AC_BOD/Subsys_VIPM_COMPEcompActSpd_rpm"
 /begin REF_CHARACTERISTIC KIPM_COMPEcompActSpdDflt_rpm KIPM_COMPEcompActSpdHi_rpm KIPM_COMPEcompActSpdLo_rpm KIPM_COMPEcompActSpd_rpm_ovrdflg KIPM_COMPEcompActSpd_rpm_ovrdval /end REF_CHARACTERISTIC
 /begin REF_MEASUREMENT VIPM_COMPEcompActSpdVld_flg VIPM_COMPEcompActSpd_rpm /end REF_MEASUREMENT
/end GROUP
/begin GROUP S21_Subsys_VIPM_COMPEcompST_enum "AppSwcIpm/Ipm100ms/BODCAN_IN_100ms/Msg_COMP_AC_BOD/Subsys_VIPM_COMPEcompST_enum"
 /begin REF_CHARACTERISTIC KIPM_COMPEcompSTDflt_enum KIPM_COMPEcompST_enum_ovrdflg KIPM_COMPEcompST_enum_ovrdval /end REF_CHARACTERISTIC
 /begin REF_MEASUREMENT VIPM_COMPEcompSTVld_flg VIPM_COMPEcompST_enum /end REF_MEASUREMENT
/end GROUP
/begin GROUP S21_Subsys_VIPM_COMPHiVolt_V "AppSwcIpm/Ipm100ms/BODCAN_IN_100ms/Msg_COMP_AC_BOD/Subsys_VIPM_COMPHiVolt_V"
 /begin REF_CHARACTERISTIC KIPM_COMPHiVoltDflt_V KIPM_COMPHiVoltHi_V KIPM_COMPHiVoltLo_V KIPM_COMPHiVolt_V_ovrdflg KIPM_COMPHiVolt_V_ovrdval /end REF_CHARACTERISTIC
 /begin REF_MEASUREMENT VIPM_COMPHiVoltVld_flg VIPM_COMPHiVolt_V /end REF_MEASUREMENT
/end GROUP
/begin GROUP S21_Subsys_VIPM_COMPHvErr_enum "AppSwcIpm/Ipm100ms/BODCAN_IN_100ms/Msg_COMP_AC_BOD/Subsys_VIPM_COMPHvErr_enum"
 /begin REF_CHARACTERISTIC KIPM_COMPHvErrDflt_enum KIPM_COMPHvErr_enum_ovrdflg KIPM_COMPHvErr_enum_ovrdval /end REF_CHARACTERISTIC
 /begin REF_MEASUREMENT VIPM_COMPHvErrVld_flg VIPM_COMPHvErr_enum /end REF_MEASUREMENT
/end GROUP
/begin GROUP S21_Subsys_VIPM_COMPIPMErr_flg "AppSwcIpm/Ipm100ms/BODCAN_IN_100ms/Msg_COMP_AC_BOD/Subsys_VIPM_COMPIPMErr_flg"
 /begin REF_CHARACTERISTIC KIPM_COMPIPMErrDflt_flg KIPM_COMPIPMErr_flg_ovrdflg KIPM_COMPIPMErr_flg_ovrdval /end REF_CHARACTERISTIC
 /begin REF_MEASUREMENT VIPM_COMPIPMErrVld_flg VIPM_COMPIPMErr_flg /end REF_MEASUREMENT
/end GROUP
/begin GROUP S21_Subsys_VIPM_COMPInCurr_A "AppSwcIpm/Ipm100ms/BODCAN_IN_100ms/Msg_COMP_AC_BOD/Subsys_VIPM_COMPInCurr_A"
 /begin REF_CHARACTERISTIC KIPM_COMPInCurrDflt_A KIPM_COMPInCurrHi_A KIPM_COMPInCurrLo_A KIPM_COMPInCurr_A_ovrdflg KIPM_COMPInCurr_A_ovrdval /end REF_CHARACTERISTIC
 /begin REF_MEASUREMENT VIPM_COMPInCurrVld_flg VIPM_COMPInCurr_A /end REF_MEASUREMENT
/end GROUP
/begin GROUP S21_Subsys_VIPM_COMPLoseStep_flg "AppSwcIpm/Ipm100ms/BODCAN_IN_100ms/Msg_COMP_AC_BOD/Subsys_VIPM_COMPLoseStep_flg"
 /begin REF_CHARACTERISTIC KIPM_COMPLoseStepDflt_flg KIPM_COMPLoseStep_flg_ovrdflg KIPM_COMPLoseStep_flg_ovrdval /end REF_CHARACTERISTIC
 /begin REF_MEASUREMENT VIPM_COMPLoseStepVld_flg VIPM_COMPLoseStep_flg /end REF_MEASUREMENT
/end GROUP
/begin GROUP S21_Subsys_VIPM_COMPLvErr_enum "AppSwcIpm/Ipm100ms/BODCAN_IN_100ms/Msg_COMP_AC_BOD/Subsys_VIPM_COMPLvErr_enum"
 /begin REF_CHARACTERISTIC KIPM_COMPLvErrDflt_enum KIPM_COMPLvErr_enum_ovrdflg KIPM_COMPLvErr_enum_ovrdval /end REF_CHARACTERISTIC
 /begin REF_MEASUREMENT VIPM_COMPLvErrVld_flg VIPM_COMPLvErr_enum /end REF_MEASUREMENT
/end GROUP
/begin GROUP S21_Subsys_VIPM_COMPOverDuty_flg "AppSwcIpm/Ipm100ms/BODCAN_IN_100ms/Msg_COMP_AC_BOD/Subsys_VIPM_COMPOverDuty_flg"
 /begin REF_CHARACTERISTIC KIPM_COMPOverDutyDflt_flg KIPM_COMPOverDuty_flg_ovrdflg KIPM_COMPOverDuty_flg_ovrdval /end REF_CHARACTERISTIC
 /begin REF_MEASUREMENT VIPM_COMPOverDutyVld_flg VIPM_COMPOverDuty_flg /end REF_MEASUREMENT
/end GROUP
/begin GROUP S21_Subsys_VIPM_COMPOvrCurr_enum "AppSwcIpm/Ipm100ms/BODCAN_IN_100ms/Msg_COMP_AC_BOD/Subsys_VIPM_COMPOvrCurr_enum"
 /begin REF_CHARACTERISTIC KIPM_COMPOvrCurrDflt_enum KIPM_COMPOvrCurr_enum_ovrdflg KIPM_COMPOvrCurr_enum_ovrdval /end REF_CHARACTERISTIC
 /begin REF_MEASUREMENT VIPM_COMPOvrCurrVld_flg VIPM_COMPOvrCurr_enum /end REF_MEASUREMENT
/end GROUP
/begin GROUP S21_Subsys_VIPM_COMPPISaturation_flg "AppSwcIpm/Ipm100ms/BODCAN_IN_100ms/Msg_COMP_AC_BOD/Subsys_VIPM_COMPPISaturation_flg"
 /begin REF_CHARACTERISTIC KIPM_COMPPISaturationDflt_flg KIPM_COMPPISaturation_flg_ovrdflg KIPM_COMPPISaturation_flg_ovrdval /end REF_CHARACTERISTIC
 /begin REF_MEASUREMENT VIPM_COMPPISaturationVld_flg VIPM_COMPPISaturation_flg /end REF_MEASUREMENT
/end GROUP
/begin GROUP S21_Subsys_VIPM_COMPSelfChkErr_enum "AppSwcIpm/Ipm100ms/BODCAN_IN_100ms/Msg_COMP_AC_BOD/Subsys_VIPM_COMPSelfChkErr_enum"
 /begin REF_CHARACTERISTIC KIPM_COMPSelfChkErrDflt_enum KIPM_COMPSelfChkErr_enum_ovrdflg KIPM_COMPSelfChkErr_enum_ovrdval /end REF_CHARACTERISTIC
 /begin REF_MEASUREMENT VIPM_COMPSelfChkErrVld_flg VIPM_COMPSelfChkErr_enum /end REF_MEASUREMENT
/end GROUP
/begin GROUP S21_Subsys_VIPM_COMPTempErr_flg "AppSwcIpm/Ipm100ms/BODCAN_IN_100ms/Msg_COMP_AC_BOD/Subsys_VIPM_COMPTempErr_flg"
 /begin REF_CHARACTERISTIC KIPM_COMPTempErrDflt_flg KIPM_COMPTempErr_flg_ovrdflg KIPM_COMPTempErr_flg_ovrdval /end REF_CHARACTERISTIC
 /begin REF_MEASUREMENT VIPM_COMPTempErrVld_flg VIPM_COMPTempErr_flg /end REF_MEASUREMENT
/end GROUP
/begin GROUP S21_Subsys_VIPM_COMPTemp_C "AppSwcIpm/Ipm100ms/BODCAN_IN_100ms/Msg_COMP_AC_BOD/Subsys_VIPM_COMPTemp_C"
 /begin REF_CHARACTERISTIC KIPM_COMPTempDflt_C KIPM_COMPTempHi_C KIPM_COMPTempLo_C KIPM_COMPTemp_C_ovrdflg KIPM_COMPTemp_C_ovrdval /end REF_CHARACTERISTIC
 /begin REF_MEASUREMENT VIPM_COMPTempVld_flg VIPM_COMPTemp_C /end REF_MEASUREMENT
/end GROUP
/begin GROUP S21_Subsys_VIPM_ECUHiVoltInterlockSig_flg "AppSwcIpm/Ipm100ms/BODCAN_IN_100ms/Msg_COMP_AC_BOD/Subsys_VIPM_ECUHiVoltInterlockSig_flg"
 /begin REF_CHARACTERISTIC KIPM_ECUHiVoltInterlockSigDflt_flg KIPM_ECUHiVoltInterlockSig_flg_ovrdflg KIPM_ECUHiVoltInterlockSig_flg_ovrdval /end REF_CHARACTERISTIC
 /begin REF_MEASUREMENT VIPM_ECUHiVoltInterlockSigVld_flg VIPM_ECUHiVoltInterlockSig_flg /end REF_MEASUREMENT
/end GROUP
/begin GROUP S22_Subsys_VIPM_HVCHHVSt_flg "AppSwcIpm/Ipm100ms/BODCAN_IN_100ms/Msg_HVCH_Status1_BOD/Subsys_VIPM_HVCHHVSt_flg"
 /begin REF_CHARACTERISTIC KIPM_HVCHHVStDflt_flg KIPM_HVCHHVSt_flg_ovrdflg KIPM_HVCHHVSt_flg_ovrdval /end REF_CHARACTERISTIC
 /begin REF_MEASUREMENT VIPM_HVCHHVStVld_flg VIPM_HVCHHVSt_flg /end REF_MEASUREMENT
/end GROUP
/begin GROUP S22_Subsys_VIPM_HVCHInletTemp_C "AppSwcIpm/Ipm100ms/BODCAN_IN_100ms/Msg_HVCH_Status1_BOD/Subsys_VIPM_HVCHInletTemp_C"
 /begin REF_CHARACTERISTIC KIPM_HVCHInletTempDflt_C KIPM_HVCHInletTempHi_C KIPM_HVCHInletTempLo_C KIPM_HVCHInletTemp_C_ovrdflg KIPM_HVCHInletTemp_C_ovrdval /end REF_CHARACTERISTIC
 /begin REF_MEASUREMENT VIPM_HVCHInletTempVld_flg VIPM_HVCHInletTemp_C /end REF_MEASUREMENT
/end GROUP
/begin GROUP S22_Subsys_VIPM_HVCHOutlTemp_C "AppSwcIpm/Ipm100ms/BODCAN_IN_100ms/Msg_HVCH_Status1_BOD/Subsys_VIPM_HVCHOutlTemp_C"
 /begin REF_CHARACTERISTIC KIPM_HVCHOutlTempDflt_C KIPM_HVCHOutlTempHi_C KIPM_HVCHOutlTempLo_C KIPM_HVCHOutlTemp_C_ovrdflg KIPM_HVCHOutlTemp_C_ovrdval /end REF_CHARACTERISTIC
 /begin REF_MEASUREMENT VIPM_HVCHOutlTempVld_flg VIPM_HVCHOutlTemp_C /end REF_MEASUREMENT
/end GROUP
/begin GROUP S22_Subsys_VIPM_HVCHPCBTemp_C "AppSwcIpm/Ipm100ms/BODCAN_IN_100ms/Msg_HVCH_Status1_BOD/Subsys_VIPM_HVCHPCBTemp_C"
 /begin REF_CHARACTERISTIC KIPM_HVCHPCBTempDflt_C KIPM_HVCHPCBTempHi_C KIPM_HVCHPCBTempLo_C KIPM_HVCHPCBTemp_C_ovrdflg KIPM_HVCHPCBTemp_C_ovrdval /end REF_CHARACTERISTIC
 /begin REF_MEASUREMENT VIPM_HVCHPCBTempVld_flg VIPM_HVCHPCBTemp_C /end REF_MEASUREMENT
/end GROUP
/begin GROUP S22_Subsys_VIPM_HVCHSt_enum "AppSwcIpm/Ipm100ms/BODCAN_IN_100ms/Msg_HVCH_Status1_BOD/Subsys_VIPM_HVCHSt_enum"
 /begin REF_CHARACTERISTIC KIPM_HVCHStDflt_enum KIPM_HVCHSt_enum_ovrdflg KIPM_HVCHSt_enum_ovrdval /end REF_CHARACTERISTIC
 /begin REF_MEASUREMENT VIPM_HVCHStVld_flg VIPM_HVCHSt_enum /end REF_MEASUREMENT
/end GROUP
/begin GROUP S22_Subsys_VIPM_HVCHWorkMode_enum "AppSwcIpm/Ipm100ms/BODCAN_IN_100ms/Msg_HVCH_Status1_BOD/Subsys_VIPM_HVCHWorkMode_enum"
 /begin REF_CHARACTERISTIC KIPM_HVCHWorkModeDflt_enum KIPM_HVCHWorkMode_enum_ovrdflg KIPM_HVCHWorkMode_enum_ovrdval /end REF_CHARACTERISTIC
 /begin REF_MEASUREMENT VIPM_HVCHWorkModeVld_flg VIPM_HVCHWorkMode_enum /end REF_MEASUREMENT
/end GROUP
/begin GROUP S23_Subsys_VIPM_HVCHCurr_A "AppSwcIpm/Ipm100ms/BODCAN_IN_100ms/Msg_HVCH_Status2_BOD/Subsys_VIPM_HVCHCurr_A"
 /begin REF_CHARACTERISTIC KIPM_HVCHCurrDflt_A KIPM_HVCHCurrHi_A KIPM_HVCHCurrLo_A KIPM_HVCHCurr_A_ovrdflg KIPM_HVCHCurr_A_ovrdval /end REF_CHARACTERISTIC
 /begin REF_MEASUREMENT VIPM_HVCHCurrVld_flg VIPM_HVCHCurr_A /end REF_MEASUREMENT
/end GROUP
/begin GROUP S23_Subsys_VIPM_HVCHFltCod_enum "AppSwcIpm/Ipm100ms/BODCAN_IN_100ms/Msg_HVCH_Status2_BOD/Subsys_VIPM_HVCHFltCod_enum"
 /begin REF_CHARACTERISTIC KIPM_HVCHFltCodDflt_enum KIPM_HVCHFltCod_enum_ovrdflg KIPM_HVCHFltCod_enum_ovrdval /end REF_CHARACTERISTIC
 /begin REF_MEASUREMENT VIPM_HVCHFltCodVld_flg VIPM_HVCHFltCod_enum /end REF_MEASUREMENT
/end GROUP
/begin GROUP S23_Subsys_VIPM_HVCHHVVolts_V "AppSwcIpm/Ipm100ms/BODCAN_IN_100ms/Msg_HVCH_Status2_BOD/Subsys_VIPM_HVCHHVVolts_V"
 /begin REF_CHARACTERISTIC KIPM_HVCHHVVoltsDflt_V KIPM_HVCHHVVoltsHi_V KIPM_HVCHHVVoltsLo_V KIPM_HVCHHVVolts_V_ovrdflg KIPM_HVCHHVVolts_V_ovrdval /end REF_CHARACTERISTIC
 /begin REF_MEASUREMENT VIPM_HVCHHVVoltsVld_flg VIPM_HVCHHVVolts_V /end REF_MEASUREMENT
/end GROUP
/begin GROUP S23_Subsys_VIPM_HVCHPwr_kW "AppSwcIpm/Ipm100ms/BODCAN_IN_100ms/Msg_HVCH_Status2_BOD/Subsys_VIPM_HVCHPwr_kW"
 /begin REF_CHARACTERISTIC KIPM_HVCHPwrDflt_kW KIPM_HVCHPwrHi_kW KIPM_HVCHPwrLo_kW KIPM_HVCHPwr_kW_ovrdflg KIPM_HVCHPwr_kW_ovrdval /end REF_CHARACTERISTIC
 /begin REF_MEASUREMENT VIPM_HVCHPwrVld_flg VIPM_HVCHPwr_kW /end REF_MEASUREMENT
/end GROUP
/begin GROUP S23_Subsys_VIPM_HVCHWorkSt_enum "AppSwcIpm/Ipm100ms/BODCAN_IN_100ms/Msg_HVCH_Status2_BOD/Subsys_VIPM_HVCHWorkSt_enum"
 /begin REF_CHARACTERISTIC KIPM_HVCHWorkStDflt_enum KIPM_HVCHWorkSt_enum_ovrdflg KIPM_HVCHWorkSt_enum_ovrdval /end REF_CHARACTERISTIC
 /begin REF_MEASUREMENT VIPM_HVCHWorkStVld_flg VIPM_HVCHWorkSt_enum /end REF_MEASUREMENT
/end GROUP
/begin GROUP S63_Subsys_VIPM_TBOXBJSTimeDay_nu "AppSwcIpm/Ipm100ms/BacCAN_IN_1000ms/Msg_TBOX_BJS_Time_BAC/Subsys_VIPM_TBOXBJSTimeDay_nu"
 /begin REF_CHARACTERISTIC KIPM_TBOXBJSTimeDayDflt_nu KIPM_TBOXBJSTimeDay_nu_ovrdflg KIPM_TBOXBJSTimeDay_nu_ovrdval /end REF_CHARACTERISTIC
 /begin REF_MEASUREMENT VIPM_TBOXBJSTimeDayVld_flg VIPM_TBOXBJSTimeDay_nu /end REF_MEASUREMENT
/end GROUP
/begin GROUP S63_Subsys_VIPM_TBOXBJSTimeHour_nu "AppSwcIpm/Ipm100ms/BacCAN_IN_1000ms/Msg_TBOX_BJS_Time_BAC/Subsys_VIPM_TBOXBJSTimeHour_nu"
 /begin REF_CHARACTERISTIC KIPM_TBOXBJSTimeHourDflt_nu KIPM_TBOXBJSTimeHour_nu_ovrdflg KIPM_TBOXBJSTimeHour_nu_ovrdval /end REF_CHARACTERISTIC
 /begin REF_MEASUREMENT VIPM_TBOXBJSTimeHourVld_flg VIPM_TBOXBJSTimeHour_nu /end REF_MEASUREMENT
/end GROUP
/begin GROUP S63_Subsys_VIPM_TBOXBJSTimeMin_nu "AppSwcIpm/Ipm100ms/BacCAN_IN_1000ms/Msg_TBOX_BJS_Time_BAC/Subsys_VIPM_TBOXBJSTimeMin_nu"
 /begin REF_CHARACTERISTIC KIPM_TBOXBJSTimeMinDflt_nu KIPM_TBOXBJSTimeMin_nu_ovrdflg KIPM_TBOXBJSTimeMin_nu_ovrdval /end REF_CHARACTERISTIC
 /begin REF_MEASUREMENT VIPM_TBOXBJSTimeMinVld_flg VIPM_TBOXBJSTimeMin_nu /end REF_MEASUREMENT
/end GROUP
/begin GROUP S63_Subsys_VIPM_TBOXBJSTimeMonth_nu "AppSwcIpm/Ipm100ms/BacCAN_IN_1000ms/Msg_TBOX_BJS_Time_BAC/Subsys_VIPM_TBOXBJSTimeMonth_nu"
 /begin REF_CHARACTERISTIC KIPM_TBOXBJSTimeMonthDflt_nu KIPM_TBOXBJSTimeMonth_nu_ovrdflg KIPM_TBOXBJSTimeMonth_nu_ovrdval /end REF_CHARACTERISTIC
 /begin REF_MEASUREMENT VIPM_TBOXBJSTimeMonthVld_flg VIPM_TBOXBJSTimeMonth_nu /end REF_MEASUREMENT
/end GROUP
/begin GROUP S63_Subsys_VIPM_TBOXBJSTimeSec_nu "AppSwcIpm/Ipm100ms/BacCAN_IN_1000ms/Msg_TBOX_BJS_Time_BAC/Subsys_VIPM_TBOXBJSTimeSec_nu"
 /begin REF_CHARACTERISTIC KIPM_TBOXBJSTimeSecDflt_nu KIPM_TBOXBJSTimeSec_nu_ovrdflg KIPM_TBOXBJSTimeSec_nu_ovrdval /end REF_CHARACTERISTIC
 /begin REF_MEASUREMENT VIPM_TBOXBJSTimeSecVld_flg VIPM_TBOXBJSTimeSec_nu /end REF_MEASUREMENT
/end GROUP
/begin GROUP S63_Subsys_VIPM_TBOXBJSTimeYear_nu "AppSwcIpm/Ipm100ms/BacCAN_IN_1000ms/Msg_TBOX_BJS_Time_BAC/Subsys_VIPM_TBOXBJSTimeYear_nu"
 /begin REF_CHARACTERISTIC KIPM_TBOXBJSTimeYearDflt_nu KIPM_TBOXBJSTimeYear_nu_ovrdflg KIPM_TBOXBJSTimeYear_nu_ovrdval /end REF_CHARACTERISTIC
 /begin REF_MEASUREMENT VIPM_TBOXBJSTimeYearVld_flg VIPM_TBOXBJSTimeYear_nu /end REF_MEASUREMENT
/end GROUP
/begin GROUP S71_Subsys_VIPM_CDCBackLadjval_enum "AppSwcIpm/Ipm100ms/BacCAN_IN_100ms/Msg_HU_B_BAC/Subsys_VIPM_CDCBackLadjval_enum"
 /begin REF_CHARACTERISTIC KIPM_CDCBackLadjvalDflt_enum KIPM_CDCBackLadjval_enum_ovrdflg KIPM_CDCBackLadjval_enum_ovrdval /end REF_CHARACTERISTIC
 /begin REF_MEASUREMENT VIPM_CDCBackLadjvalVld_flg VIPM_CDCBackLadjval_enum /end REF_MEASUREMENT
/end GROUP
/begin GROUP S71_Subsys_VIPM_HUACAutoCtl_enum "AppSwcIpm/Ipm100ms/BacCAN_IN_100ms/Msg_HU_B_BAC/Subsys_VIPM_HUACAutoCtl_enum"
 /begin REF_CHARACTERISTIC KIPM_HUACAutoCtlDflt_enum KIPM_HUACAutoCtl_enum_ovrdflg KIPM_HUACAutoCtl_enum_ovrdval /end REF_CHARACTERISTIC
 /begin REF_MEASUREMENT VIPM_HUACAutoCtlVld_flg VIPM_HUACAutoCtl_enum /end REF_MEASUREMENT
/end GROUP
/begin GROUP S71_Subsys_VIPM_HUACPwrCtl_enum "AppSwcIpm/Ipm100ms/BacCAN_IN_100ms/Msg_HU_B_BAC/Subsys_VIPM_HUACPwrCtl_enum"
 /begin REF_CHARACTERISTIC KIPM_HUACPwrCtlDflt_enum KIPM_HUACPwrCtl_enum_ovrdflg KIPM_HUACPwrCtl_enum_ovrdval /end REF_CHARACTERISTIC
 /begin REF_MEASUREMENT VIPM_HUACPwrCtlVld_flg VIPM_HUACPwrCtl_enum /end REF_MEASUREMENT
/end GROUP
/begin GROUP S71_Subsys_VIPM_HUAirInletModeSet_enum "AppSwcIpm/Ipm100ms/BacCAN_IN_100ms/Msg_HU_B_BAC/Subsys_VIPM_HUAirInletModeSet_enum"
 /begin REF_CHARACTERISTIC KIPM_HUAirInletModeSetDflt_enum KIPM_HUAirInletModeSet_enum_ovrdflg KIPM_HUAirInletModeSet_enum_ovrdval /end REF_CHARACTERISTIC
 /begin REF_MEASUREMENT VIPM_HUAirInletModeSetVld_flg VIPM_HUAirInletModeSet_enum /end REF_MEASUREMENT
/end GROUP
/begin GROUP S71_Subsys_VIPM_HUBlwrModeSet_enum "AppSwcIpm/Ipm100ms/BacCAN_IN_100ms/Msg_HU_B_BAC/Subsys_VIPM_HUBlwrModeSet_enum"
 /begin REF_CHARACTERISTIC KIPM_HUBlwrModeSetDflt_enum KIPM_HUBlwrModeSet_enum_ovrdflg KIPM_HUBlwrModeSet_enum_ovrdval /end REF_CHARACTERISTIC
 /begin REF_MEASUREMENT VIPM_HUBlwrModeSetVld_flg VIPM_HUBlwrModeSet_enum /end REF_MEASUREMENT
/end GROUP
/begin GROUP S71_Subsys_VIPM_HUChgWiprMtMdSwSet_enum "AppSwcIpm/Ipm100ms/BacCAN_IN_100ms/Msg_HU_B_BAC/Subsys_VIPM_HUChgWiprMtMdSwSet_enum"
 /begin REF_CHARACTERISTIC KIPM_HUChgWiprMtMdSwSetDflt_enum KIPM_HUChgWiprMtMdSwSet_enum_ovrdflg KIPM_HUChgWiprMtMdSwSet_enum_ovrdval /end REF_CHARACTERISTIC
 /begin REF_MEASUREMENT VIPM_HUChgWiprMtMdSwSetVld_flg VIPM_HUChgWiprMtMdSwSet_enum /end REF_MEASUREMENT
/end GROUP
/begin GROUP S71_Subsys_VIPM_HUCstRecupModeSel_enum "AppSwcIpm/Ipm100ms/BacCAN_IN_100ms/Msg_HU_B_BAC/Subsys_VIPM_HUCstRecupModeSel_enum"
 /begin REF_CHARACTERISTIC KIPM_HUCstRecupModeSelDflt_enum KIPM_HUCstRecupModeSel_enum_ovrdflg KIPM_HUCstRecupModeSel_enum_ovrdval /end REF_CHARACTERISTIC
 /begin REF_MEASUREMENT VIPM_HUCstRecupModeSelVld_flg VIPM_HUCstRecupModeSel_enum /end REF_MEASUREMENT
/end GROUP
/begin GROUP S71_Subsys_VIPM_HUDrvModeSel_enum "AppSwcIpm/Ipm100ms/BacCAN_IN_100ms/Msg_HU_B_BAC/Subsys_VIPM_HUDrvModeSel_enum"
 /begin REF_CHARACTERISTIC KIPM_HUDrvModeSelDflt_enum KIPM_HUDrvModeSel_enum_ovrdflg KIPM_HUDrvModeSel_enum_ovrdval /end REF_CHARACTERISTIC
 /begin REF_MEASUREMENT VIPM_HUDrvModeSelVld_flg VIPM_HUDrvModeSel_enum /end REF_MEASUREMENT
/end GROUP
/begin GROUP S71_Subsys_VIPM_HUDrvPwrSet_cnt "AppSwcIpm/Ipm100ms/BacCAN_IN_100ms/Msg_HU_B_BAC/Subsys_VIPM_HUDrvPwrSet_cnt"
 /begin REF_CHARACTERISTIC KIPM_HUDrvPwrSetDflt_cnt KIPM_HUDrvPwrSet_cnt_ovrdflg KIPM_HUDrvPwrSet_cnt_ovrdval /end REF_CHARACTERISTIC
 /begin REF_MEASUREMENT VIPM_HUDrvPwrSetVld_flg VIPM_HUDrvPwrSet_cnt /end REF_MEASUREMENT
/end GROUP
/begin GROUP S71_Subsys_VIPM_HUFlwrMeHmCtrl_enum "AppSwcIpm/Ipm100ms/BacCAN_IN_100ms/Msg_HU_B_BAC/Subsys_VIPM_HUFlwrMeHmCtrl_enum"
 /begin REF_CHARACTERISTIC KIPM_HUFlwrMeHmCtrlDflt_enum KIPM_HUFlwrMeHmCtrl_enum_ovrdflg KIPM_HUFlwrMeHmCtrl_enum_ovrdval /end REF_CHARACTERISTIC
 /begin REF_MEASUREMENT VIPM_HUFlwrMeHmCtrlVld_flg VIPM_HUFlwrMeHmCtrl_enum /end REF_MEASUREMENT
/end GROUP
/begin GROUP S71_Subsys_VIPM_HUFrntFanSpdSet_enum "AppSwcIpm/Ipm100ms/BacCAN_IN_100ms/Msg_HU_B_BAC/Subsys_VIPM_HUFrntFanSpdSet_enum"
 /begin REF_CHARACTERISTIC KIPM_HUFrntFanSpdSetDflt_enum KIPM_HUFrntFanSpdSet_enum_ovrdflg KIPM_HUFrntFanSpdSet_enum_ovrdval /end REF_CHARACTERISTIC
 /begin REF_MEASUREMENT VIPM_HUFrntFanSpdSetVld_flg VIPM_HUFrntFanSpdSet_enum /end REF_MEASUREMENT
/end GROUP
/begin GROUP S71_Subsys_VIPM_HUHybEcoModeSet_enum "AppSwcIpm/Ipm100ms/BacCAN_IN_100ms/Msg_HU_B_BAC/Subsys_VIPM_HUHybEcoModeSet_enum"
 /begin REF_CHARACTERISTIC KIPM_HUHybEcoModeSetDflt_enum KIPM_HUHybEcoModeSet_enum_ovrdflg KIPM_HUHybEcoModeSet_enum_ovrdval /end REF_CHARACTERISTIC
 /begin REF_MEASUREMENT VIPM_HUHybEcoModeSetVld_flg VIPM_HUHybEcoModeSet_enum /end REF_MEASUREMENT
/end GROUP
/begin GROUP S71_Subsys_VIPM_HUIllmndEntrySts_enum "AppSwcIpm/Ipm100ms/BacCAN_IN_100ms/Msg_HU_B_BAC/Subsys_VIPM_HUIllmndEntrySts_enum"
 /begin REF_CHARACTERISTIC KIPM_HUIllmndEntryStsDflt_enum KIPM_HUIllmndEntrySts_enum_ovrdflg KIPM_HUIllmndEntrySts_enum_ovrdval /end REF_CHARACTERISTIC
 /begin REF_MEASUREMENT VIPM_HUIllmndEntryStsVld_flg VIPM_HUIllmndEntrySts_enum /end REF_MEASUREMENT
/end GROUP
/begin GROUP S71_Subsys_VIPM_HUIllmndLckSts_enum "AppSwcIpm/Ipm100ms/BacCAN_IN_100ms/Msg_HU_B_BAC/Subsys_VIPM_HUIllmndLckSts_enum"
 /begin REF_CHARACTERISTIC KIPM_HUIllmndLckStsDflt_enum KIPM_HUIllmndLckSts_enum_ovrdflg KIPM_HUIllmndLckSts_enum_ovrdval /end REF_CHARACTERISTIC
 /begin REF_MEASUREMENT VIPM_HUIllmndLckStsVld_flg VIPM_HUIllmndLckSts_enum /end REF_MEASUREMENT
/end GROUP
/begin GROUP S71_Subsys_VIPM_HUIllmndUnlckSts_enum "AppSwcIpm/Ipm100ms/BacCAN_IN_100ms/Msg_HU_B_BAC/Subsys_VIPM_HUIllmndUnlckSts_enum"
 /begin REF_CHARACTERISTIC KIPM_HUIllmndUnlckStsDflt_enum KIPM_HUIllmndUnlckSts_enum_ovrdflg KIPM_HUIllmndUnlckSts_enum_ovrdval /end REF_CHARACTERISTIC
 /begin REF_MEASUREMENT VIPM_HUIllmndUnlckStsVld_flg VIPM_HUIllmndUnlckSts_enum /end REF_MEASUREMENT
/end GROUP
/begin GROUP S71_Subsys_VIPM_HULckHornOnSt_enum "AppSwcIpm/Ipm100ms/BacCAN_IN_100ms/Msg_HU_B_BAC/Subsys_VIPM_HULckHornOnSt_enum"
 /begin REF_CHARACTERISTIC KIPM_HULckHornOnStDflt_enum KIPM_HULckHornOnSt_enum_ovrdflg KIPM_HULckHornOnSt_enum_ovrdval /end REF_CHARACTERISTIC
 /begin REF_MEASUREMENT VIPM_HULckHornOnStVld_flg VIPM_HULckHornOnSt_enum /end REF_MEASUREMENT
/end GROUP
/begin GROUP S71_Subsys_VIPM_HULeftTempSet_enum "AppSwcIpm/Ipm100ms/BacCAN_IN_100ms/Msg_HU_B_BAC/Subsys_VIPM_HULeftTempSet_enum"
 /begin REF_CHARACTERISTIC KIPM_HULeftTempSetDflt_enum KIPM_HULeftTempSet_enum_ovrdflg KIPM_HULeftTempSet_enum_ovrdval /end REF_CHARACTERISTIC
 /begin REF_MEASUREMENT VIPM_HULeftTempSetVld_flg VIPM_HULeftTempSet_enum /end REF_MEASUREMENT
/end GROUP
/begin GROUP S71_Subsys_VIPM_HUMaiDrvrSeatHeat_enum "AppSwcIpm/Ipm100ms/BacCAN_IN_100ms/Msg_HU_B_BAC/Subsys_VIPM_HUMaiDrvrSeatHeat_enum"
 /begin REF_CHARACTERISTIC KIPM_HUMaiDrvrSeatHeatDflt_enum KIPM_HUMaiDrvrSeatHeat_enum_ovrdflg KIPM_HUMaiDrvrSeatHeat_enum_ovrdval /end REF_CHARACTERISTIC
 /begin REF_MEASUREMENT VIPM_HUMaiDrvrSeatHeatVld_flg VIPM_HUMaiDrvrSeatHeat_enum /end REF_MEASUREMENT
/end GROUP
/begin GROUP S71_Subsys_VIPM_HUManlDefrstCtl_enum "AppSwcIpm/Ipm100ms/BacCAN_IN_100ms/Msg_HU_B_BAC/Subsys_VIPM_HUManlDefrstCtl_enum"
 /begin REF_CHARACTERISTIC KIPM_HUManlDefrstCtlDflt_enum KIPM_HUManlDefrstCtl_enum_ovrdflg KIPM_HUManlDefrstCtl_enum_ovrdval /end REF_CHARACTERISTIC
 /begin REF_MEASUREMENT VIPM_HUManlDefrstCtlVld_flg VIPM_HUManlDefrstCtl_enum /end REF_MEASUREMENT
/end GROUP
/begin GROUP S71_Subsys_VIPM_HUOvrspdCntrlLckSet_enum "AppSwcIpm/Ipm100ms/BacCAN_IN_100ms/Msg_HU_B_BAC/Subsys_VIPM_HUOvrspdCntrlLckSet_enum"
 /begin REF_CHARACTERISTIC KIPM_HUOvrspdCntrlLckSetDflt_enum KIPM_HUOvrspdCntrlLckSet_enum_ovrdflg KIPM_HUOvrspdCntrlLckSet_enum_ovrdval /end REF_CHARACTERISTIC
 /begin REF_MEASUREMENT VIPM_HUOvrspdCntrlLckSetVld_flg VIPM_HUOvrspdCntrlLckSet_enum /end REF_MEASUREMENT
/end GROUP
/begin GROUP S71_Subsys_VIPM_HUParkAutoUnlckSet_enum "AppSwcIpm/Ipm100ms/BacCAN_IN_100ms/Msg_HU_B_BAC/Subsys_VIPM_HUParkAutoUnlckSet_enum"
 /begin REF_CHARACTERISTIC KIPM_HUParkAutoUnlckSetDflt_enum KIPM_HUParkAutoUnlckSet_enum_ovrdflg KIPM_HUParkAutoUnlckSet_enum_ovrdval /end REF_CHARACTERISTIC
 /begin REF_MEASUREMENT VIPM_HUParkAutoUnlckSetVld_flg VIPM_HUParkAutoUnlckSet_enum /end REF_MEASUREMENT
/end GROUP
/begin GROUP S71_Subsys_VIPM_HUPeristalsisModeEnbl_enum "AppSwcIpm/Ipm100ms/BacCAN_IN_100ms/Msg_HU_B_BAC/Subsys_VIPM_HUPeristalsisModeEnbl_enum"
 /begin REF_CHARACTERISTIC KIPM_HUPeristalsisModeEnblDflt_enum KIPM_HUPeristalsisModeEnbl_enum_ovrdflg KIPM_HUPeristalsisModeEnbl_enum_ovrdval /end REF_CHARACTERISTIC
 /begin REF_MEASUREMENT VIPM_HUPeristalsisModeEnblVld_flg VIPM_HUPeristalsisModeEnbl_enum /end REF_MEASUREMENT
/end GROUP
/begin GROUP S71_Subsys_VIPM_HUPwrOffReq_flg "AppSwcIpm/Ipm100ms/BacCAN_IN_100ms/Msg_HU_B_BAC/Subsys_VIPM_HUPwrOffReq_flg"
 /begin REF_CHARACTERISTIC KIPM_HUPwrOffReqDflt_flg KIPM_HUPwrOffReq_flg_ovrdflg KIPM_HUPwrOffReq_flg_ovrdval /end REF_CHARACTERISTIC
 /begin REF_MEASUREMENT VIPM_HUPwrOffReqVld_flg VIPM_HUPwrOffReq_flg /end REF_MEASUREMENT
/end GROUP
/begin GROUP S71_Subsys_VIPM_HURecupPwrSet_pct "AppSwcIpm/Ipm100ms/BacCAN_IN_100ms/Msg_HU_B_BAC/Subsys_VIPM_HURecupPwrSet_pct"
 /begin REF_CHARACTERISTIC KIPM_HURecupPwrSetDflt_pct KIPM_HURecupPwrSet_pct_ovrdflg KIPM_HURecupPwrSet_pct_ovrdval /end REF_CHARACTERISTIC
 /begin REF_MEASUREMENT VIPM_HURecupPwrSetVld_flg VIPM_HURecupPwrSet_pct /end REF_MEASUREMENT
/end GROUP
/begin GROUP S71_Subsys_VIPM_HURrMirrHeat_enum "AppSwcIpm/Ipm100ms/BacCAN_IN_100ms/Msg_HU_B_BAC/Subsys_VIPM_HURrMirrHeat_enum"
 /begin REF_CHARACTERISTIC KIPM_HURrMirrHeatDflt_enum KIPM_HURrMirrHeat_enum_ovrdflg KIPM_HURrMirrHeat_enum_ovrdval /end REF_CHARACTERISTIC
 /begin REF_MEASUREMENT VIPM_HURrMirrHeatVld_flg VIPM_HURrMirrHeat_enum /end REF_MEASUREMENT
/end GROUP
/begin GROUP S71_Subsys_VIPM_HUSteerWhlHeat_enum "AppSwcIpm/Ipm100ms/BacCAN_IN_100ms/Msg_HU_B_BAC/Subsys_VIPM_HUSteerWhlHeat_enum"
 /begin REF_CHARACTERISTIC KIPM_HUSteerWhlHeatDflt_enum KIPM_HUSteerWhlHeat_enum_ovrdflg KIPM_HUSteerWhlHeat_enum_ovrdval /end REF_CHARACTERISTIC
 /begin REF_MEASUREMENT VIPM_HUSteerWhlHeatVld_flg VIPM_HUSteerWhlHeat_enum /end REF_MEASUREMENT
/end GROUP
/begin GROUP S71_Subsys_VIPM_HUTPMSRstReq_flg "AppSwcIpm/Ipm100ms/BacCAN_IN_100ms/Msg_HU_B_BAC/Subsys_VIPM_HUTPMSRstReq_flg"
 /begin REF_CHARACTERISTIC KIPM_HUTPMSRstReqDflt_flg KIPM_HUTPMSRstReq_flg_ovrdflg KIPM_HUTPMSRstReq_flg_ovrdval /end REF_CHARACTERISTIC
 /begin REF_MEASUREMENT VIPM_HUTPMSRstReqVld_flg VIPM_HUTPMSRstReq_flg /end REF_MEASUREMENT
/end GROUP
/begin GROUP S71_Subsys_VIPM_HUTrnkLckSwCtrl_enum "AppSwcIpm/Ipm100ms/BacCAN_IN_100ms/Msg_HU_B_BAC/Subsys_VIPM_HUTrnkLckSwCtrl_enum"
 /begin REF_CHARACTERISTIC KIPM_HUTrnkLckSwCtrlDflt_enum KIPM_HUTrnkLckSwCtrl_enum_ovrdflg KIPM_HUTrnkLckSwCtrl_enum_ovrdval /end REF_CHARACTERISTIC
 /begin REF_MEASUREMENT VIPM_HUTrnkLckSwCtrlVld_flg VIPM_HUTrnkLckSwCtrl_enum /end REF_MEASUREMENT
/end GROUP
/begin GROUP S71_Subsys_VIPM_HUWiprIntlTmSet_enum "AppSwcIpm/Ipm100ms/BacCAN_IN_100ms/Msg_HU_B_BAC/Subsys_VIPM_HUWiprIntlTmSet_enum"
 /begin REF_CHARACTERISTIC KIPM_HUWiprIntlTmSetDflt_enum KIPM_HUWiprIntlTmSet_enum_ovrdflg KIPM_HUWiprIntlTmSet_enum_ovrdval /end REF_CHARACTERISTIC
 /begin REF_MEASUREMENT VIPM_HUWiprIntlTmSetVld_flg VIPM_HUWiprIntlTmSet_enum /end REF_MEASUREMENT
/end GROUP
/begin GROUP S101_Subsys_VIPM_BMSHVBatCellTempAve_C "AppSwcIpm/Ipm100ms/EptCAN_IN_100ms/Msg_BMS_5_BatTemp_EPT/Subsys_VIPM_BMSHVBatCellTempAve_C"
 /begin REF_CHARACTERISTIC KIPM_BMSHVBatCellTempAveDflt_C KIPM_BMSHVBatCellTempAveHi_C KIPM_BMSHVBatCellTempAveLo_C KIPM_BMSHVBatCellTempAve_C_ovrdflg KIPM_BMSHVBatCellTempAve_C_ovrdval /end REF_CHARACTERISTIC
 /begin REF_MEASUREMENT VIPM_BMSHVBatCellTempAveVld_flg VIPM_BMSHVBatCellTempAve_C /end REF_MEASUREMENT
/end GROUP
/begin GROUP S101_Subsys_VIPM_BMSHVBatCellTempMax_C "AppSwcIpm/Ipm100ms/EptCAN_IN_100ms/Msg_BMS_5_BatTemp_EPT/Subsys_VIPM_BMSHVBatCellTempMax_C"
 /begin REF_CHARACTERISTIC KIPM_BMSHVBatCellTempMaxDflt_C KIPM_BMSHVBatCellTempMaxHi_C KIPM_BMSHVBatCellTempMaxLo_C KIPM_BMSHVBatCellTempMax_C_ovrdflg KIPM_BMSHVBatCellTempMax_C_ovrdval /end REF_CHARACTERISTIC
 /begin REF_MEASUREMENT VIPM_BMSHVBatCellTempMaxVld_flg VIPM_BMSHVBatCellTempMax_C /end REF_MEASUREMENT
/end GROUP
/begin GROUP S101_Subsys_VIPM_BMSHVBatCellTempMin_C "AppSwcIpm/Ipm100ms/EptCAN_IN_100ms/Msg_BMS_5_BatTemp_EPT/Subsys_VIPM_BMSHVBatCellTempMin_C"
 /begin REF_CHARACTERISTIC KIPM_BMSHVBatCellTempMinDflt_C KIPM_BMSHVBatCellTempMinHi_C KIPM_BMSHVBatCellTempMinLo_C KIPM_BMSHVBatCellTempMin_C_ovrdflg KIPM_BMSHVBatCellTempMin_C_ovrdval /end REF_CHARACTERISTIC
 /begin REF_MEASUREMENT VIPM_BMSHVBatCellTempMinVld_flg VIPM_BMSHVBatCellTempMin_C /end REF_MEASUREMENT
/end GROUP
/begin GROUP S102_Subsys_VIPM_INVLrngData02_nu "AppSwcIpm/Ipm100ms/EptCAN_IN_100ms/Msg_INV_IMMO_Req_EPT/Subsys_VIPM_INVLrngData02_nu"
 /begin REF_CHARACTERISTIC KIPM_INVLrngData02Dflt_nu KIPM_INVLrngData02_nu_ovrdflg KIPM_INVLrngData02_nu_ovrdval /end REF_CHARACTERISTIC
 /begin REF_MEASUREMENT VIPM_INVLrngData02Vld_flg VIPM_INVLrngData02_nu /end REF_MEASUREMENT
/end GROUP
/begin GROUP S102_Subsys_VIPM_INVLrngData03_nu "AppSwcIpm/Ipm100ms/EptCAN_IN_100ms/Msg_INV_IMMO_Req_EPT/Subsys_VIPM_INVLrngData03_nu"
 /begin REF_CHARACTERISTIC KIPM_INVLrngData03Dflt_nu KIPM_INVLrngData03_nu_ovrdflg KIPM_INVLrngData03_nu_ovrdval /end REF_CHARACTERISTIC
 /begin REF_MEASUREMENT VIPM_INVLrngData03Vld_flg VIPM_INVLrngData03_nu /end REF_MEASUREMENT
/end GROUP
/begin GROUP S102_Subsys_VIPM_INVLrngData04_nu "AppSwcIpm/Ipm100ms/EptCAN_IN_100ms/Msg_INV_IMMO_Req_EPT/Subsys_VIPM_INVLrngData04_nu"
 /begin REF_CHARACTERISTIC KIPM_INVLrngData04Dflt_nu KIPM_INVLrngData04_nu_ovrdflg KIPM_INVLrngData04_nu_ovrdval /end REF_CHARACTERISTIC
 /begin REF_MEASUREMENT VIPM_INVLrngData04Vld_flg VIPM_INVLrngData04_nu /end REF_MEASUREMENT
/end GROUP
/begin GROUP S102_Subsys_VIPM_INVLrngData05_nu "AppSwcIpm/Ipm100ms/EptCAN_IN_100ms/Msg_INV_IMMO_Req_EPT/Subsys_VIPM_INVLrngData05_nu"
 /begin REF_CHARACTERISTIC KIPM_INVLrngData05Dflt_nu KIPM_INVLrngData05_nu_ovrdflg KIPM_INVLrngData05_nu_ovrdval /end REF_CHARACTERISTIC
 /begin REF_MEASUREMENT VIPM_INVLrngData05Vld_flg VIPM_INVLrngData05_nu /end REF_MEASUREMENT
/end GROUP
/begin GROUP S102_Subsys_VIPM_INVLrngData06_nu "AppSwcIpm/Ipm100ms/EptCAN_IN_100ms/Msg_INV_IMMO_Req_EPT/Subsys_VIPM_INVLrngData06_nu"
 /begin REF_CHARACTERISTIC KIPM_INVLrngData06Dflt_nu KIPM_INVLrngData06_nu_ovrdflg KIPM_INVLrngData06_nu_ovrdval /end REF_CHARACTERISTIC
 /begin REF_MEASUREMENT VIPM_INVLrngData06Vld_flg VIPM_INVLrngData06_nu /end REF_MEASUREMENT
/end GROUP
/begin GROUP S102_Subsys_VIPM_INVLrngData07_nu "AppSwcIpm/Ipm100ms/EptCAN_IN_100ms/Msg_INV_IMMO_Req_EPT/Subsys_VIPM_INVLrngData07_nu"
 /begin REF_CHARACTERISTIC KIPM_INVLrngData07Dflt_nu KIPM_INVLrngData07_nu_ovrdflg KIPM_INVLrngData07_nu_ovrdval /end REF_CHARACTERISTIC
 /begin REF_MEASUREMENT VIPM_INVLrngData07Vld_flg VIPM_INVLrngData07_nu /end REF_MEASUREMENT
/end GROUP
/begin GROUP S102_Subsys_VIPM_INVLrngSts_enum "AppSwcIpm/Ipm100ms/EptCAN_IN_100ms/Msg_INV_IMMO_Req_EPT/Subsys_VIPM_INVLrngSts_enum"
 /begin REF_CHARACTERISTIC KIPM_INVLrngStsDflt_enum KIPM_INVLrngSts_enum_ovrdflg KIPM_INVLrngSts_enum_ovrdval /end REF_CHARACTERISTIC
 /begin REF_MEASUREMENT VIPM_INVLrngStsVld_flg VIPM_INVLrngSts_enum /end REF_MEASUREMENT
/end GROUP
/begin GROUP S102_Subsys_VIPM_INVLrngSubID_cnt "AppSwcIpm/Ipm100ms/EptCAN_IN_100ms/Msg_INV_IMMO_Req_EPT/Subsys_VIPM_INVLrngSubID_cnt"
 /begin REF_CHARACTERISTIC KIPM_INVLrngSubIDDflt_cnt KIPM_INVLrngSubID_cnt_ovrdflg KIPM_INVLrngSubID_cnt_ovrdval /end REF_CHARACTERISTIC
 /begin REF_MEASUREMENT VIPM_INVLrngSubIDVld_flg VIPM_INVLrngSubID_cnt /end REF_MEASUREMENT
/end GROUP
/begin GROUP S103_Subsys_VIPM_IPUDCCActOprtMode_enum "AppSwcIpm/Ipm100ms/EptCAN_IN_100ms/Msg_IPU_DCC_1_State_EPT/Subsys_VIPM_IPUDCCActOprtMode_enum"
 /begin REF_CHARACTERISTIC KIPM_IPUDCCActOprtModeDflt_enum KIPM_IPUDCCActOprtMode_enum_ovrdflg KIPM_IPUDCCActOprtMode_enum_ovrdval /end REF_CHARACTERISTIC
 /begin REF_MEASUREMENT VIPM_IPUDCCActOprtModeVld_flg VIPM_IPUDCCActOprtMode_enum /end REF_MEASUREMENT
/end GROUP
/begin GROUP S103_Subsys_VIPM_IPUDCCLoVoltActCurnt_A "AppSwcIpm/Ipm100ms/EptCAN_IN_100ms/Msg_IPU_DCC_1_State_EPT/Subsys_VIPM_IPUDCCLoVoltActCurnt_A"
 /begin REF_CHARACTERISTIC KIPM_IPUDCCLoVoltActCurntDflt_A KIPM_IPUDCCLoVoltActCurntHi_A KIPM_IPUDCCLoVoltActCurntLo_A KIPM_IPUDCCLoVoltActCurnt_A_ovrdflg KIPM_IPUDCCLoVoltActCurnt_A_ovrdval /end REF_CHARACTERISTIC
 /begin REF_MEASUREMENT VIPM_IPUDCCLoVoltActCurntVld_flg VIPM_IPUDCCLoVoltActCurnt_A /end REF_MEASUREMENT
/end GROUP
/begin GROUP S103_Subsys_VIPM_IPUDCCLoVoltActVolt_V "AppSwcIpm/Ipm100ms/EptCAN_IN_100ms/Msg_IPU_DCC_1_State_EPT/Subsys_VIPM_IPUDCCLoVoltActVolt_V"
 /begin REF_CHARACTERISTIC KIPM_IPUDCCLoVoltActVoltDflt_V KIPM_IPUDCCLoVoltActVoltHi_V KIPM_IPUDCCLoVoltActVoltLo_V KIPM_IPUDCCLoVoltActVolt_V_ovrdflg KIPM_IPUDCCLoVoltActVolt_V_ovrdval /end REF_CHARACTERISTIC
 /begin REF_MEASUREMENT VIPM_IPUDCCLoVoltActVoltVld_flg VIPM_IPUDCCLoVoltActVolt_V /end REF_MEASUREMENT
/end GROUP
/begin GROUP S103_Subsys_VIPM_IPUDCCSysFailSta_enum "AppSwcIpm/Ipm100ms/EptCAN_IN_100ms/Msg_IPU_DCC_1_State_EPT/Subsys_VIPM_IPUDCCSysFailSta_enum"
 /begin REF_CHARACTERISTIC KIPM_IPUDCCSysFailStaDflt_enum KIPM_IPUDCCSysFailSta_enum_ovrdflg KIPM_IPUDCCSysFailSta_enum_ovrdval /end REF_CHARACTERISTIC
 /begin REF_MEASUREMENT VIPM_IPUDCCSysFailStaVld_flg VIPM_IPUDCCSysFailSta_enum /end REF_MEASUREMENT
/end GROUP
/begin GROUP S104_Subsys_VIPM_IPUDCCHiVoltActCurnt_A "AppSwcIpm/Ipm100ms/EptCAN_IN_100ms/Msg_IPU_DCC_2_ChrgInValue_EPT/Subsys_VIPM_IPUDCCHiVoltActCurnt_A"
 /begin REF_CHARACTERISTIC KIPM_IPUDCCHiVoltActCurntDflt_A KIPM_IPUDCCHiVoltActCurntHi_A KIPM_IPUDCCHiVoltActCurntLo_A KIPM_IPUDCCHiVoltActCurnt_A_ovrdflg KIPM_IPUDCCHiVoltActCurnt_A_ovrdval /end REF_CHARACTERISTIC
 /begin REF_MEASUREMENT VIPM_IPUDCCHiVoltActCurntVld_flg VIPM_IPUDCCHiVoltActCurnt_A /end REF_MEASUREMENT
/end GROUP
/begin GROUP S104_Subsys_VIPM_IPUDCCHiVoltActVolt_V "AppSwcIpm/Ipm100ms/EptCAN_IN_100ms/Msg_IPU_DCC_2_ChrgInValue_EPT/Subsys_VIPM_IPUDCCHiVoltActVolt_V"
 /begin REF_CHARACTERISTIC KIPM_IPUDCCHiVoltActVoltDflt_V KIPM_IPUDCCHiVoltActVoltHi_V KIPM_IPUDCCHiVoltActVoltLo_V KIPM_IPUDCCHiVoltActVolt_V_ovrdflg KIPM_IPUDCCHiVoltActVolt_V_ovrdval /end REF_CHARACTERISTIC
 /begin REF_MEASUREMENT VIPM_IPUDCCHiVoltActVoltVld_flg VIPM_IPUDCCHiVoltActVolt_V /end REF_MEASUREMENT
/end GROUP
/begin GROUP S105_Subsys_VIPM_IPUOBCActOprtMode_enum "AppSwcIpm/Ipm100ms/EptCAN_IN_100ms/Msg_IPU_OBC_1_State_EPT/Subsys_VIPM_IPUOBCActOprtMode_enum"
 /begin REF_CHARACTERISTIC KIPM_IPUOBCActOprtModeDflt_enum KIPM_IPUOBCActOprtMode_enum_ovrdflg KIPM_IPUOBCActOprtMode_enum_ovrdval /end REF_CHARACTERISTIC
 /begin REF_MEASUREMENT VIPM_IPUOBCActOprtModeVld_flg VIPM_IPUOBCActOprtMode_enum /end REF_MEASUREMENT
/end GROUP
/begin GROUP S105_Subsys_VIPM_IPUOBCConnectMainSta_flg "AppSwcIpm/Ipm100ms/EptCAN_IN_100ms/Msg_IPU_OBC_1_State_EPT/Subsys_VIPM_IPUOBCConnectMainSta_flg"
 /begin REF_CHARACTERISTIC KIPM_IPUOBCConnectMainStaDflt_flg KIPM_IPUOBCConnectMainSta_flg_ovrdflg KIPM_IPUOBCConnectMainSta_flg_ovrdval /end REF_CHARACTERISTIC
 /begin REF_MEASUREMENT VIPM_IPUOBCConnectMainStaVld_flg VIPM_IPUOBCConnectMainSta_flg /end REF_MEASUREMENT
/end GROUP
/begin GROUP S105_Subsys_VIPM_IPUOBCHVDCActCur_A "AppSwcIpm/Ipm100ms/EptCAN_IN_100ms/Msg_IPU_OBC_1_State_EPT/Subsys_VIPM_IPUOBCHVDCActCur_A"
 /begin REF_CHARACTERISTIC KIPM_IPUOBCHVDCActCurDflt_A KIPM_IPUOBCHVDCActCurHi_A KIPM_IPUOBCHVDCActCurLo_A KIPM_IPUOBCHVDCActCur_A_ovrdflg KIPM_IPUOBCHVDCActCur_A_ovrdval /end REF_CHARACTERISTIC
 /begin REF_MEASUREMENT VIPM_IPUOBCHVDCActCurVld_flg VIPM_IPUOBCHVDCActCur_A /end REF_MEASUREMENT
/end GROUP
/begin GROUP S105_Subsys_VIPM_IPUOBCHVDCActVol_V "AppSwcIpm/Ipm100ms/EptCAN_IN_100ms/Msg_IPU_OBC_1_State_EPT/Subsys_VIPM_IPUOBCHVDCActVol_V"
 /begin REF_CHARACTERISTIC KIPM_IPUOBCHVDCActVolDflt_V KIPM_IPUOBCHVDCActVolHi_V KIPM_IPUOBCHVDCActVolLo_V KIPM_IPUOBCHVDCActVol_V_ovrdflg KIPM_IPUOBCHVDCActVol_V_ovrdval /end REF_CHARACTERISTIC
 /begin REF_MEASUREMENT VIPM_IPUOBCHVDCActVolVld_flg VIPM_IPUOBCHVDCActVol_V /end REF_MEASUREMENT
/end GROUP
/begin GROUP S105_Subsys_VIPM_IPUOBCInletActPwr_kW "AppSwcIpm/Ipm100ms/EptCAN_IN_100ms/Msg_IPU_OBC_1_State_EPT/Subsys_VIPM_IPUOBCInletActPwr_kW"
 /begin REF_CHARACTERISTIC KIPM_IPUOBCInletActPwrDflt_kW KIPM_IPUOBCInletActPwrHi_kW KIPM_IPUOBCInletActPwrLo_kW KIPM_IPUOBCInletActPwr_kW_ovrdflg KIPM_IPUOBCInletActPwr_kW_ovrdval /end REF_CHARACTERISTIC
 /begin REF_MEASUREMENT VIPM_IPUOBCInletActPwrVld_flg VIPM_IPUOBCInletActPwr_kW /end REF_MEASUREMENT
/end GROUP
/begin GROUP S105_Subsys_VIPM_IPUOBCInletConnectSta_enum "AppSwcIpm/Ipm100ms/EptCAN_IN_100ms/Msg_IPU_OBC_1_State_EPT/Subsys_VIPM_IPUOBCInletConnectSta_enum"
 /begin REF_CHARACTERISTIC KIPM_IPUOBCInletConnectStaDflt_enum KIPM_IPUOBCInletConnectSta_enum_ovrdflg KIPM_IPUOBCInletConnectSta_enum_ovrdval /end REF_CHARACTERISTIC
 /begin REF_MEASUREMENT VIPM_IPUOBCInletConnectStaVld_flg VIPM_IPUOBCInletConnectSta_enum /end REF_MEASUREMENT
/end GROUP
/begin GROUP S105_Subsys_VIPM_IPUOBCReq_enum "AppSwcIpm/Ipm100ms/EptCAN_IN_100ms/Msg_IPU_OBC_1_State_EPT/Subsys_VIPM_IPUOBCReq_enum"
 /begin REF_CHARACTERISTIC KIPM_IPUOBCReqDflt_enum KIPM_IPUOBCReq_enum_ovrdflg KIPM_IPUOBCReq_enum_ovrdval /end REF_CHARACTERISTIC
 /begin REF_MEASUREMENT VIPM_IPUOBCReqVld_flg VIPM_IPUOBCReq_enum /end REF_MEASUREMENT
/end GROUP
/begin GROUP S105_Subsys_VIPM_IPUOBCSysFailSta_enum "AppSwcIpm/Ipm100ms/EptCAN_IN_100ms/Msg_IPU_OBC_1_State_EPT/Subsys_VIPM_IPUOBCSysFailSta_enum"
 /begin REF_CHARACTERISTIC KIPM_IPUOBCSysFailStaDflt_enum KIPM_IPUOBCSysFailSta_enum_ovrdflg KIPM_IPUOBCSysFailSta_enum_ovrdval /end REF_CHARACTERISTIC
 /begin REF_MEASUREMENT VIPM_IPUOBCSysFailStaVld_flg VIPM_IPUOBCSysFailSta_enum /end REF_MEASUREMENT
/end GROUP
/begin GROUP S140_Subsys_VIPM_IPUDeviceIntTemp_C "AppSwcIpm/Ipm100ms/EptCAN_IN_200ms/Msg_IPU_OBC_2_Inlet_EPT/Subsys_VIPM_IPUDeviceIntTemp_C"
 /begin REF_CHARACTERISTIC KIPM_IPUDeviceIntTempDflt_C KIPM_IPUDeviceIntTempHi_C KIPM_IPUDeviceIntTempLo_C KIPM_IPUDeviceIntTemp_C_ovrdflg KIPM_IPUDeviceIntTemp_C_ovrdval /end REF_CHARACTERISTIC
 /begin REF_MEASUREMENT VIPM_IPUDeviceIntTempVld_flg VIPM_IPUDeviceIntTemp_C /end REF_MEASUREMENT
/end GROUP
/begin GROUP S140_Subsys_VIPM_IPUOBCACMaxPwrAllow_kW "AppSwcIpm/Ipm100ms/EptCAN_IN_200ms/Msg_IPU_OBC_2_Inlet_EPT/Subsys_VIPM_IPUOBCACMaxPwrAllow_kW"
 /begin REF_CHARACTERISTIC KIPM_IPUOBCACMaxPwrAllowDflt_kW KIPM_IPUOBCACMaxPwrAllowHi_kW KIPM_IPUOBCACMaxPwrAllowLo_kW KIPM_IPUOBCACMaxPwrAllow_kW_ovrdflg KIPM_IPUOBCACMaxPwrAllow_kW_ovrdval /end REF_CHARACTERISTIC
 /begin REF_MEASUREMENT VIPM_IPUOBCACMaxPwrAllowVld_flg VIPM_IPUOBCACMaxPwrAllow_kW /end REF_MEASUREMENT
/end GROUP
/begin GROUP S140_Subsys_VIPM_IPUOBCS2State_flg "AppSwcIpm/Ipm100ms/EptCAN_IN_200ms/Msg_IPU_OBC_2_Inlet_EPT/Subsys_VIPM_IPUOBCS2State_flg"
 /begin REF_CHARACTERISTIC KIPM_IPUOBCS2StateDflt_flg KIPM_IPUOBCS2State_flg_ovrdflg KIPM_IPUOBCS2State_flg_ovrdval /end REF_CHARACTERISTIC
 /begin REF_MEASUREMENT VIPM_IPUOBCS2StateVld_flg VIPM_IPUOBCS2State_flg /end REF_MEASUREMENT
/end GROUP
/begin GROUP S140_Subsys_VIPM_IPUOBCTempInt_C "AppSwcIpm/Ipm100ms/EptCAN_IN_200ms/Msg_IPU_OBC_2_Inlet_EPT/Subsys_VIPM_IPUOBCTempInt_C"
 /begin REF_CHARACTERISTIC KIPM_IPUOBCTempIntDflt_C KIPM_IPUOBCTempIntHi_C KIPM_IPUOBCTempIntLo_C KIPM_IPUOBCTempInt_C_ovrdflg KIPM_IPUOBCTempInt_C_ovrdval /end REF_CHARACTERISTIC
 /begin REF_MEASUREMENT VIPM_IPUOBCTempIntVld_flg VIPM_IPUOBCTempInt_C /end REF_MEASUREMENT
/end GROUP
/begin GROUP S140_Subsys_VIPM_IPUOBCWakeUpMode_enum "AppSwcIpm/Ipm100ms/EptCAN_IN_200ms/Msg_IPU_OBC_2_Inlet_EPT/Subsys_VIPM_IPUOBCWakeUpMode_enum"
 /begin REF_CHARACTERISTIC KIPM_IPUOBCWakeUpModeDflt_enum KIPM_IPUOBCWakeUpMode_enum_ovrdflg KIPM_IPUOBCWakeUpMode_enum_ovrdval /end REF_CHARACTERISTIC
 /begin REF_MEASUREMENT VIPM_IPUOBCWakeUpModeVld_flg VIPM_IPUOBCWakeUpMode_enum /end REF_MEASUREMENT
/end GROUP
/begin GROUP S149_Subsys_VIPM_BMSBatCapcty_Ah "AppSwcIpm/Ipm100ms/EptCAN_IN_500ms/Msg_BMS_9_BattInfo_EPT/Subsys_VIPM_BMSBatCapcty_Ah"
 /begin REF_CHARACTERISTIC KIPM_BMSBatCapctyDflt_Ah KIPM_BMSBatCapcty_Ah_ovrdflg KIPM_BMSBatCapcty_Ah_ovrdval /end REF_CHARACTERISTIC
 /begin REF_MEASUREMENT VIPM_BMSBatCapctyVld_flg VIPM_BMSBatCapcty_Ah /end REF_MEASUREMENT
/end GROUP
/begin GROUP S149_Subsys_VIPM_BMSPackID_enum "AppSwcIpm/Ipm100ms/EptCAN_IN_500ms/Msg_BMS_9_BattInfo_EPT/Subsys_VIPM_BMSPackID_enum"
 /begin REF_CHARACTERISTIC KIPM_BMSPackIDDflt_enum KIPM_BMSPackID_enum_ovrdflg KIPM_BMSPackID_enum_ovrdval /end REF_CHARACTERISTIC
 /begin REF_MEASUREMENT VIPM_BMSPackIDVld_flg VIPM_BMSPackID_enum /end REF_MEASUREMENT
/end GROUP
/begin GROUP S154_Subsys_VIPM_EHBBrkPedlValPerc_pct "AppSwcIpm/Ipm10ms/CHACAN_IN_10ms/Msg_EHB_B_CHA/Subsys_VIPM_EHBBrkPedlValPerc_pct"
 /begin REF_CHARACTERISTIC KIPM_EHBBrkPedlValPercDflt_pct KIPM_EHBBrkPedlValPercHi_pct KIPM_EHBBrkPedlValPercLo_pct KIPM_EHBBrkPedlValPerc_pct_ovrdflg KIPM_EHBBrkPedlValPerc_pct_ovrdval /end REF_CHARACTERISTIC
 /begin REF_MEASUREMENT VIPM_EHBBrkPedlValPercVld_flg VIPM_EHBBrkPedlValPerc_pct /end REF_MEASUREMENT
/end GROUP
/begin GROUP S154_Subsys_VIPM_EHBBrkPwrRecupTarWhlTqSts_enum "AppSwcIpm/Ipm10ms/CHACAN_IN_10ms/Msg_EHB_B_CHA/Subsys_VIPM_EHBBrkPwrRecupTarWhlTqSts_enum"
 /begin REF_CHARACTERISTIC KIPM_EHBBrkPwrRecupTarWhlTqStsDflt_enum KIPM_EHBBrkPwrRecupTarWhlTqSts_enum_ovrdflg KIPM_EHBBrkPwrRecupTarWhlTqSts_enum_ovrdval /end REF_CHARACTERISTIC
 /begin REF_MEASUREMENT VIPM_EHBBrkPwrRecupTarWhlTqStsVld_flg VIPM_EHBBrkPwrRecupTarWhlTqSts_enum /end REF_MEASUREMENT
/end GROUP
/begin GROUP S154_Subsys_VIPM_EHBBrkPwrRecupTarWhlTq_Nm "AppSwcIpm/Ipm10ms/CHACAN_IN_10ms/Msg_EHB_B_CHA/Subsys_VIPM_EHBBrkPwrRecupTarWhlTq_Nm"
 /begin REF_CHARACTERISTIC KIPM_EHBBrkPwrRecupTarWhlTqDflt_Nm KIPM_EHBBrkPwrRecupTarWhlTqHi_Nm KIPM_EHBBrkPwrRecupTarWhlTqLo_Nm KIPM_EHBBrkPwrRecupTarWhlTq_Nm_ovrdflg KIPM_EHBBrkPwrRecupTarWhlTq_Nm_ovrdval /end REF_CHARACTERISTIC
 /begin REF_MEASUREMENT VIPM_EHBBrkPwrRecupTarWhlTqVld_flg VIPM_EHBBrkPwrRecupTarWhlTq_Nm /end REF_MEASUREMENT
/end GROUP
/begin GROUP S154_Subsys_VIPM_EHBCDDActv_flg "AppSwcIpm/Ipm10ms/CHACAN_IN_10ms/Msg_EHB_B_CHA/Subsys_VIPM_EHBCDDActv_flg"
 /begin REF_CHARACTERISTIC KIPM_EHBCDDActvDflt_flg KIPM_EHBCDDActv_flg_ovrdflg KIPM_EHBCDDActv_flg_ovrdval /end REF_CHARACTERISTIC
 /begin REF_MEASUREMENT VIPM_EHBCDDActvVld_flg VIPM_EHBCDDActv_flg /end REF_MEASUREMENT
/end GROUP
/begin GROUP S154_Subsys_VIPM_EHBEPBActuatorStR_enum "AppSwcIpm/Ipm10ms/CHACAN_IN_10ms/Msg_EHB_B_CHA/Subsys_VIPM_EHBEPBActuatorStR_enum"
 /begin REF_CHARACTERISTIC KIPM_EHBEPBActuatorStRDflt_enum KIPM_EHBEPBActuatorStR_enum_ovrdflg KIPM_EHBEPBActuatorStR_enum_ovrdval /end REF_CHARACTERISTIC
 /begin REF_MEASUREMENT VIPM_EHBEPBActuatorStRVld_flg VIPM_EHBEPBActuatorStR_enum /end REF_MEASUREMENT
/end GROUP
/begin GROUP S154_Subsys_VIPM_EHBFltLvl_enum "AppSwcIpm/Ipm10ms/CHACAN_IN_10ms/Msg_EHB_B_CHA/Subsys_VIPM_EHBFltLvl_enum"
 /begin REF_CHARACTERISTIC KIPM_EHBFltLvlDflt_enum KIPM_EHBFltLvl_enum_ovrdflg KIPM_EHBFltLvl_enum_ovrdval /end REF_CHARACTERISTIC
 /begin REF_MEASUREMENT VIPM_EHBFltLvlVld_flg VIPM_EHBFltLvl_enum /end REF_MEASUREMENT
/end GROUP
/begin GROUP S154_Subsys_VIPM_EHBReqBrkLiOn_flg "AppSwcIpm/Ipm10ms/CHACAN_IN_10ms/Msg_EHB_B_CHA/Subsys_VIPM_EHBReqBrkLiOn_flg"
 /begin REF_CHARACTERISTIC KIPM_EHBReqBrkLiOnDflt_flg KIPM_EHBReqBrkLiOn_flg_ovrdflg KIPM_EHBReqBrkLiOn_flg_ovrdval /end REF_CHARACTERISTIC
 /begin REF_MEASUREMENT VIPM_EHBReqBrkLiOnVld_flg VIPM_EHBReqBrkLiOn_flg /end REF_MEASUREMENT
/end GROUP
/begin GROUP S155_Subsys_VIPM_EPSRotSpd_degps "AppSwcIpm/Ipm10ms/CHACAN_IN_10ms/Msg_EPS_2_StrWhlAng_CHA/Subsys_VIPM_EPSRotSpd_degps"
 /begin REF_CHARACTERISTIC KIPM_EPSRotSpdDflt_degps KIPM_EPSRotSpdHi_degps KIPM_EPSRotSpdLo_degps KIPM_EPSRotSpd_degps_ovrdflg KIPM_EPSRotSpd_degps_ovrdval /end REF_CHARACTERISTIC
 /begin REF_MEASUREMENT VIPM_EPSRotSpdVld_flg VIPM_EPSRotSpd_degps /end REF_MEASUREMENT
/end GROUP
/end MODULE
/end PROJECT
/* (add any file trailer comments here) */ /* EOF AppSwcIpm.a2l */
